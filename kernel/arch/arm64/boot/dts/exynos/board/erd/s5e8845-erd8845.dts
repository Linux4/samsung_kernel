/*
 * SAMSUNG S5E8845 board device tree source
 *
 * Copyright (c) 2023 Samsung Electronics Co., Ltd.
 *		http://www.samsung.com
 *
 * This program is free software; you can redistribute it and/or modify
 * it under the terms of the GNU General Public License version 2 as
 * published by the Free Software Foundation.
 */

/dts-v1/;
/plugin/;

#include "s5e8845-erd8845_common.dtsi"
//#include "panel/samsung-emulation-video-panel.dtsi"
#include "panel/samsung-s6e3had-1080-2400-command-panel.dtsi"

#define BOARD_ID	0x0
#define BOARD_REV	0x0

/ {
	compatible = "samsung,s5e8845", "samsung,ERD8845";
	board_id = <BOARD_ID>;
	board_rev = <BOARD_REV>;

	fragment@model {
		target-path = "/";
		__overlay__ {
			#address-cells = <2>;
			#size-cells = <1>;

			model = "Samsung ERD8845 board based on S5E8845";
		}; /* end of __overlay__ */
	}; /* end of fragment */
}; /* end of root */

&serial_0 {
	status = "okay";
};

&drmdsim_0 {
        drmpanel {
                default-panel = "s6e3had_1080_2400_cmd";
        };
};
