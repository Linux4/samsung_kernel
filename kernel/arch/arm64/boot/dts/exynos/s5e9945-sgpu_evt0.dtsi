/*
 * SAMSUNG SGPU device tree sourceA
 *
 * Copyright (c) 2022 Samsung Electronics Co., Ltd.
 *		http://www.samsung.com
 *
 * This program is free software; you can redistribute it and/or modify
 * it under the terms of the GNU General Public License version 2 as
 * published by the Free Software Foundation.
 */

#include "s5e9945-sgpu_common.dtsi"

/{
	/* sgpu */
	sgpu: sgpu@22200000 {
		chip_revision = <0x02600100>;

		/* GPU DVFS */
		freq_table = <252000 300000 350000 400000 456000 500000
			      600000 710000 806000 900000 999000 1095000>;
		min_freq = <252000>;
		max_freq = <900000>;
		min_threshold = "0 300000:60 400000:65 600000:78";
		max_threshold = "75 300000:80 400000:85 500000:90 600000:95";
		downstay_time = "32 456000:64 500000:96 806000:160";
		mif_min_lock = "421000 456000:1352000 500000:1539000 600000:2028000 710000:3738000 806000:4206000";
		mif_cl_boost_min_lock = "421000 456000:1014000 500000:1352000 710000:1539000 806000:1716000 900000:2028000";
		cl_boost_freq = <900000>;
		mo_scenario = "default 456000:g3d_performance";
		llc_ways = "0 500000:16";
		highspeed_freq = <456000>;
		highspeed_load = <99>;
		highspeed_delay = <0>;
		ifpo_disable_freq = <800000>;

		/* IFPO */
		ifpo_type = <IFPO_ABORT>;
		ifpo_cal_id = <0x23>;
	};
};
