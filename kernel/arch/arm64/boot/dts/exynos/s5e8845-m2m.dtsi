/* SPDX-License-Identifier: GPL-2.0-only */
/*
 * EXYNOS M2M device tree source for M2M IP(MSCL, SMFC)
 *
 * Copyright (c) 2012 Samsung Electronics Co., Ltd.
 *		http://www.samsung.com
 */
#include <dt-bindings/clock/s5e8845.h>
#include <dt-bindings/interrupt-controller/s5e8845.h>
#include <dt-bindings/soc/samsung/exynos_pm_qos.h>

/ {
	aliases {
		smfc0 = &smfc_0;
                scaler0 = &scaler_0;
	};

	smfc_0: smfc@12C90000 {
		compatible = "samsung,exynos8890-jpeg";
	/*	dma-coherent;*/
		reg = <0x0 0x12C90000 0x1000>;
		interrupts = <0 INTREQ__JPEG IRQ_TYPE_LEVEL_HIGH>;
	        iommus = <&sysmmu_m2m_s0>;
		samsung,iommu-group=<&iommu_group_mscl_smfc>;
                core_dvfs_class = <PM_QOS_INTCAM_THROUGHPUT>;
                smfc,core_qos_minlock = <800000>;
                smfc,mif_qos_minlock = <1352000>;
                smfc_bpc = <16>;
                smfc_core_clk = <800000>;
	};

	scaler_0: scaler@12C60000 {
		compatible = "samsung,exynos5-scaler";
		reg = <0x0 0x12C60000 0x3000>;
		interrupts = <0 INTREQ__M2M IRQ_TYPE_LEVEL_HIGH>;
		itmon,master = "MSCL";
		itmon,dest = "M2M";
        /*	dma-coherent;*/
		iommus = <&sysmmu_m2m_s0>;
		samsung,iommu-group=<&iommu_group_mscl_smfc>;
		samsung,tzmp;

		#dma-address-cells = <1>;
		#dma-size-cells = <1>;
		dma-window = <0x0 0xE0000000>;

		/* MIF (not used) | INT | MSCL_clock */
                mscl_qos_table = < 0 800000 800000
                                   0 533000 533000
                                   0 444000 444000
                                   0 333000 333000
                                   0 266000 266000
                                   0 200000 200000
                                   0 133000 133000
                                   0 80000 80000 >;
		/* bpp means, YUV420(12), YUV422(16), P010(24), RGB(32), SBWC(100) */
		/* bpp | ppc * 100 | ppc * 100 with rotation */
		mscl_ppc_table = <  12  499 516
				    16  379 357
				    24  400 397
                                    32  193 194
				   100  484 445 >;
		mscl_mif_ref = < 676000 >;
		mscl_bw_ref = < 3037500 >;
                mscl_dvfs_class = <PM_QOS_INTCAM_THROUGHPUT>;

                /* bpp means, YUV420(12), YUV422(16), P010(24), RGB(32), SBWC(100) */
                /* bpp | min_bus_int */
                mscl_min_bus_int_table = < 12 133000
                                           16 133000
                                           24 133000
                                           32 133000
                                          100 133000 >;
		#mscl-votf-address-cells = <1>;
		#mscl-votf-size-cells = <1>;
		mscl_votf_reg = < 0x12C70000 0x10000 >;
		/* <phandle to the vOTF target> <SFR_BASE_ADDR> <SFR_RANGE> <vOTF_SFR_BASE_ADDR> <vOTF_SFR_RANGE> */
		samsung,mscl-votf_targets = < &drmdecon0 0x14890000 0x10000 0x14880000 0x10000 >;
	};

};
