
&smd {
	sec-direct-charger {
		status = "okay";
		compatible = "samsung,sec-direct-charger";

		charger,battery_name = "battery";
		charger,main_charger = "max77775-charger";
		charger,direct_charger = "nu2111a-charger";

	#if 0
		charger,direct_chargers =
				"nu2111a-charger",
				"${direct_charger_name2}";
	#endif

		charger,dchg_min_current = <2000>;

		charger,ta_alert_wa;
	};
};


/* /home/dpi/qb5_8814/workspace/P4_1716/android/kernel/kmodule/battery/suwon/common/sec_direct_charger/dts/r12s/sec_direct_charger.dtsi */
&smd {
	sec-direct-charger {
		charger,end_soc = <100>;
		charger,fpdo_dc_max_vbat = <4050>;
	};

	pass-through {
		start_delay = <5000>; /* msec */
		init_delay = <5000>; /* msec */
		min_cap = <200>; /* 0.1 % */
		fixed_sc_cap = <900>; /* 0.1 % */
		max_icl = <3000>; /* mA */
	};
};
