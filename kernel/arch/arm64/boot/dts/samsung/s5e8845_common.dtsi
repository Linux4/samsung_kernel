/*
 * SAMSUNG S5E8845 SoC device tree source
 *
 * Copyright (c) 2023 Samsung Electronics Co., Ltd.
 *             http://www.samsung.com
 *
 * SAMSUNG S5E8845 SoC device nodes are listed in this file.
 * EXYNOS based board files can include this file and provide
 * values for board specfic bindings.
 *
 * This program is free software; you can redistribute it and/or modify
 * it under the terms of the GNU General Public License version 2 as
 * published by the Free Software Foundation.
 */

/ {
	fragment@model {
		target-path = "/";
		__overlay__ {
			#address-cells = <2>;
			#size-cells = <1>;

			model = "S5E8845";

			sec_reloc_gpio: samsung,reloc_gpio {
				compatible = "samsung,reloc_gpio";
				status = "okay";
				/* see, '/sys/kernel/debug/pinctrl' */
				sec,gpio-label = "reloc_gpio";
				sec,reloc-base = <0>;
			};

		}; /* end of __overlay__ */
	}; /* end of fragment */
}; /* end of root */

