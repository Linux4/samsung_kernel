/* Copyright (c) 2020, Samsung Electronics Corporation. All rights reserved.
 *
 * This program is free software; you can redistribute it and/or modify
 * it under the terms of the GNU General Public License version 2 and
 * only version 2 as published by the Free Software Foundation.
 *
 * This program is distributed in the hope that it will be useful,
 * but WITHOUT ANY WARRANTY; without even the implied warranty of
 * MERCHANTABILITY or FITNESS FOR A PARTICULAR PURPOSE.  See the
 * GNU General Public License for more details.
 */

#if !(0)
&s2mps28_2_gpio {
	mst_pwr_en: sec-mst,mst-pwr-gpio {
		GPIO_CONFIG_PUD(PM,s2mps28_2_gpio,gpio_s,2, FUNC_OUTPUT_LOW, PULL_DOWN);
#if defined(CONFIG_ARCH_EXYNOS) || defined(CONFIG_ARCH_EXYNOS9)
		samsung,pin-con-pdn = <0>;
		samsung,pin-pud-pdn = <1>;
#endif
	};
};
#endif

#if 0
&pinctrl_1 {
	mst_en: sec-mst,mst-en-gpio {
		GPIO_CONFIG_PUD(AP,gpm9,gpm9,0, FUNC_OUTPUT_LOW, PULL_DOWN);
#if defined(CONFIG_ARCH_EXYNOS) || defined(CONFIG_ARCH_EXYNOS9)
		samsung,pin-con-pdn = <0>;
		samsung,pin-pud-pdn = <1>;
#endif
	};
};

&pinctrl_1 {
	mst_data: sec-mst,mst-data-gpio {
		GPIO_CONFIG_PUD(AP,gpm9,gpm9,1, FUNC_OUTPUT_LOW, PULL_DOWN);
#if defined(CONFIG_ARCH_EXYNOS) || defined(CONFIG_ARCH_EXYNOS9)
		samsung,pin-con-pdn = <0>;
		samsung,pin-pud-pdn = <1>;
#endif
	};
};
#endif

#if 0
&${mst_support_parent} {
	mst_support_gpio: sec-mst,mst-support-gpio {
		GPIO_CONFIG_PUD(${mst_support}, FUNC_INPUT, PULL_NONE);
#if defined(CONFIG_ARCH_EXYNOS) || defined(CONFIG_ARCH_EXYNOS9)
		samsung,pin-con-pdn = <2>;
		samsung,pin-pud-pdn = <0>;
#endif
	};
};
#endif

&smd {
	sec_mst: sec-mst{
		compatible = "sec-mst";
#if !(0)
		sec-mst,mst-pwr-gpio = <SEC_GPIO_REF(PM,s2mps28_2_gpio,gpio_s,2) 0>;
#endif
#if 0
		sec-mst,mst-en-gpio = <SEC_GPIO_REF(AP,gpm9,gpm9,0) 0>;
		sec-mst,mst-data-gpio = <SEC_GPIO_REF(AP,gpm9,gpm9,1) 0>;
#endif
#if 0
		sec-mst,mst-support-gpio = <SEC_GPIO_REF(${mst_support}) 0>;
#endif

		pinctrl-names = "default";
#if !(0) || 0 || 0
		pinctrl-0 = <
#if !(0)
				&mst_pwr_en 
#endif
#if 0
				&mst_en &mst_data
#endif
#if 0
				&mst_support_gpio
#endif
				>;
#endif
	};
};

/* /home/dpi/qb5_8814/workspace/P4_1716/android/kernel/kmodule/mst/mst.e[123][sq].dtsi */
&sec_mst {
	sec-mst,mst-use-uno-power;
};
