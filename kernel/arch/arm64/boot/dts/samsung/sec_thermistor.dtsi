&smd{
	sec_ap_thermistor: sec_thermistor@0 {
		compatible = "samsung,sec-thermistor";
		status = "okay";
		thermistor_name = "sec-ap-thermistor";
		id = <0>;

		io-channels = SEC_ADC(s2mpu15_gpadc,1);
		io-channel-names = "adc-ap-temp";
		io-channel-ranges;
	};
};
