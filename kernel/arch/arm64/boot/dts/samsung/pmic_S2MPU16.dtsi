#if 0 && 0
&s_l1_reg {
	regulator-name = "vdd_ldo1";
	regulator-min-microvolt = <0>;
	regulator-max-microvolt = <0>;
	 
	
};
#endif

#if 0 && 0
&s_l2_reg {
	regulator-name = "vdd_ldo2";
	regulator-min-microvolt = <0>;
	regulator-max-microvolt = <0>;
	 
	
};
#endif

#if 0 && 0
&s_l3_reg {
	regulator-name = "vdd_ldo3";
	regulator-min-microvolt = <0>;
	regulator-max-microvolt = <0>;
	 
	
};
#endif

#if 0 && 0
&s_l4_reg {
	regulator-name = "vdd_ldo4";
	regulator-min-microvolt = <0>;
	regulator-max-microvolt = <0>;
	 
	
};
#endif

#if 0 && 0
&s_l5_reg {
	regulator-name = "vdd_ldo5";
	regulator-min-microvolt = <0>;
	regulator-max-microvolt = <0>;
	 
	
};
#endif

#if 0 && 0
&s_l6_reg {
	regulator-name = "vdd_ldo6";
	regulator-min-microvolt = <0>;
	regulator-max-microvolt = <0>;
	 
	
};
#endif

#if 0 && 0
&s_l7_reg {
	regulator-name = "vdd_ldo7";
	regulator-min-microvolt = <0>;
	regulator-max-microvolt = <0>;
	 
	
};
#endif

#if 0 && 0
&s_l8_reg {
	regulator-name = "vdd_ldo8";
	regulator-min-microvolt = <0>;
	regulator-max-microvolt = <0>;
	 
	
};
#endif

#if 0 && 0
&s_l9_reg {
	regulator-name = "vdd_ldo9";
	regulator-min-microvolt = <0>;
	regulator-max-microvolt = <0>;
	 
	
};
#endif

#if 0 && 0
&s_l10_reg {
	regulator-name = "vdd_ldo10";
	regulator-min-microvolt = <0>;
	regulator-max-microvolt = <0>;
	 
	
};
#endif

#if 0 && 0
&s_l11_reg {
	regulator-name = "vdd_ldo11";
	regulator-min-microvolt = <0>;
	regulator-max-microvolt = <0>;
	 
	
};
#endif

#if 0 && 0
&s_l12_reg {
	regulator-name = "vdd_ldo12";
	regulator-min-microvolt = <0>;
	regulator-max-microvolt = <0>;
	 
	
};
#endif

#if 1800000 && 3000000
&s_l13_reg {
	regulator-name = "vmmc";
	regulator-min-microvolt = <1800000>;
	regulator-max-microvolt = <3000000>;
	 regulator-ramp-delay = <12000>;regulator-initial-mode = <3>;
	/delete-property/ regulator-always-on;
};
#endif

#if 0 && 0
&s_l14_reg {
	regulator-name = "vdd_ldo14";
	regulator-min-microvolt = <0>;
	regulator-max-microvolt = <0>;
	 
	
};
#endif

#if 0 && 0
&s_l15_reg {
	regulator-name = "vdd_ldo15";
	regulator-min-microvolt = <0>;
	regulator-max-microvolt = <0>;
	 
	
};
#endif
