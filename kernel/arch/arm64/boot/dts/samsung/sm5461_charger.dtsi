&hsi2c_19 {
	status = "okay";

	sm5461_charger: sm5461@63 {
		compatible = "siliconmitus,sm5461";
		reg = <0x63>;

		sm5461,freq = <2>; /* 500kHz */
		sm5461,r_ttl = <520000>;
		sm5461,topoff = <380>;
		sm5461,en_vbatreg = <1>;
		sm5461,single_mode = <1>;
	};
};

/* /home/dpi/qb5_8815/workspace/P4_1716/android/kernel/kmodule/battery/suwon/charger/sm5461/sm5461_charger.a55x.dtsi */
&sm5461_charger {
	sm5461,topoff = <450>;
};
