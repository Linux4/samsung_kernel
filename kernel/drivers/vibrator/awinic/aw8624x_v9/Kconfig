## kernel/drivers/vibrator/awinic/aw8624x_v9/Kconfig
```kconfig
#
# AW8624X Driver
#

config INPUT_AW8624X_HAPTIC
	tristate "Awinic AW8624X Input Haptic Driver"
	depends on I2C
	help
		Say Y here if you have Awinic AW8624X controller
		chip in your system.
		If unsure, say N.
		To compile this driver as a module, choose M here: the
		module will be called AW8624X driver.

config AW8624X_SAMSUNG_FEATURE
	bool "AWINIC AW8624X Haptic Driver for Samsung feature"
	depends on INPUT_AW8624X_HAPTIC
	default n
	help
		Say Y to enable AW8624X_SAMSUNG_FEATURE
		codes featured with this comment
		aren't the original code from AWINIC.
		To use samsung concept, please enable this.
```

## kernel/drivers/vibrator/zinitix/zm918/Kconfig
```kconfig
config INPUT_ZM918_HAPTIC
	tristate "Zinitix ZM918 Input Haptic Driver"
	depends on I2C
	help
	  Say Y here if you have Zinitix ZM918 chip in your system.
	  If unsure, say N.
	  To compile this driver as a module, choose M here: the
	  module will be called zm918 input haptic driver.
```

## kernel/drivers/vision/npu/interface/Kconfig
```kconfig
config NPU_INTERFACE
	bool "Select Interface"
	help
	  This is NPU interface

config NPU_HARDWARE
	bool "Use Hardware"
	depends on NPU_INTERFACE
	help
 	  This is hardware device

config NPU_MAILBOX_VERSION
	int "NPU Mailbox Version"
	range 9 10
	default 10
	help
	  NPU Mailbox Version

config NPU_COMMAND_VERSION
	int "NPU Command Version"
	range 10 12
	default 12
	help
	  NPU Command Version
```

## kernel/ftt/Kconfig
```kconfig
config FAST_TRACK
    bool "ftt feature"
    default y
    depends on RWSEM_SPIN_ON_OWNER
    help
      if set, ftt feature is enable
```

## kernel/kernel_device_modules-6.1/Documentation/devicetree/bindings/soc/mediatek/gpio_sap_ctrl.yaml
```yaml
# SPDX-License-Identifier: (GPL-2.0 OR BSD-2-Clause)
# # Copyright 2023 MediaTek Inc.
%YAML 1.2
---
$id: "http://devicetree.org/schemas/soc/mediatek/gpio_sap_ctrl.yaml#"
$schema: "http://devicetree.org/meta-schemas/core.yaml#"

title: MediaTek GPIO Controller For Aligning State Of sAP

maintainers:
  - Pei-Huai Ciou <pei-huai.ciou@mediatek.com>

description: |
  The GPIO Controller For Aligning State Of sAP (gpio_sap_ctrl) is used to
  control our gpio state in response for algining the state on sAP. In the case
  of host controlling slave power, there might be a path from some host pin with
  non-zero voltage to unpower slave and finally to another host pin. In this
  case, the pins might be in something like 50% high voltage, which is invalid
  in such digital pins.

properties:
  compatible:
    enum:
      - mediatek,gpio_sap_ctrl

required:
  - compatible

additionalProperties: false

examples:
  - |
  gpio_sap_ctrl: gpio-sap-ctrl {
    compatible = "mediatek,gpio_sap_ctrl";
  };
```

## kernel/kernel_device_modules-6.1/Kconfig.ext
```kconfig
# SPDX-License-Identifier: GPL-2.0

config DEVICE_MODULES_ALLOW_BUILTIN
	bool "allow builtin drivers into kernel image"
	help
	  All modules are default built as kernel modules.
	  Set DEVICE_MODULES_ALLOW_BUILTIN=y to build modules
	  into the kernel image.
	  If unsure, say N.

source "$(KCONFIG_EXT_PREFIX)drivers/memory/Kconfig"

source "$(KCONFIG_EXT_PREFIX)drivers/iio/adc/Kconfig"

source "$(KCONFIG_EXT_PREFIX)drivers/mfd/Kconfig"

source "$(KCONFIG_EXT_PREFIX)drivers/nvmem/Kconfig"

source "$(KCONFIG_EXT_PREFIX)drivers/dma/mediatek/Kconfig"

source "$(KCONFIG_EXT_PREFIX)drivers/ufs/Kconfig"

source "$(KCONFIG_EXT_PREFIX)drivers/char/Kconfig"

source "$(KCONFIG_EXT_PREFIX)drivers/clk/mediatek/Kconfig"

source "$(KCONFIG_EXT_PREFIX)drivers/clocksource/Kconfig"

source "$(KCONFIG_EXT_PREFIX)drivers/cpufreq/Kconfig"

source "$(KCONFIG_EXT_PREFIX)drivers/soc/mediatek/Kconfig"

source "$(KCONFIG_EXT_PREFIX)drivers/watchdog/Kconfig"

source "$(KCONFIG_EXT_PREFIX)drivers/dma-buf/heaps/Kconfig"

source "$(KCONFIG_EXT_PREFIX)drivers/regulator/Kconfig"

source "$(KCONFIG_EXT_PREFIX)drivers/leds/Kconfig"

source "$(KCONFIG_EXT_PREFIX)drivers/pinctrl/mediatek/Kconfig"

source "$(KCONFIG_EXT_PREFIX)drivers/power/supply/Kconfig"

source "$(KCONFIG_EXT_PREFIX)drivers/rtc/Kconfig"

source "$(KCONFIG_EXT_PREFIX)drivers/remoteproc/Kconfig"

source "$(KCONFIG_EXT_PREFIX)drivers/rpmsg/Kconfig"

source "$(KCONFIG_EXT_PREFIX)drivers/input/keyboard/Kconfig"

source "$(KCONFIG_EXT_PREFIX)drivers/phy/mediatek/Kconfig"

source "$(KCONFIG_EXT_PREFIX)drivers/thermal/mediatek/Kconfig"

source "$(KCONFIG_EXT_PREFIX)drivers/spmi/Kconfig"

source "$(KCONFIG_EXT_PREFIX)drivers/tty/serial/8250/Kconfig"

source "$(KCONFIG_EXT_PREFIX)drivers/reset/Kconfig"

source "$(KCONFIG_EXT_PREFIX)drivers/mailbox/Kconfig"

source "$(KCONFIG_EXT_PREFIX)drivers/interconnect/Kconfig"

source "$(KCONFIG_EXT_PREFIX)drivers/i2c/busses/Kconfig"

source "$(KCONFIG_EXT_PREFIX)drivers/pwm/Kconfig"

source "$(KCONFIG_EXT_PREFIX)drivers/spi/Kconfig"

source "$(KCONFIG_EXT_PREFIX)drivers/iommu/Kconfig"

source "$(KCONFIG_EXT_PREFIX)drivers/tee/Kconfig"

source "$(KCONFIG_EXT_PREFIX)drivers/mmc/host/Kconfig"

source "$(KCONFIG_EXT_PREFIX)drivers/gpu/drm/mediatek/Kconfig"

source "$(KCONFIG_EXT_PREFIX)drivers/input/touchscreen/Kconfig"

source "$(KCONFIG_EXT_PREFIX)drivers/gpu/drm/panel/Kconfig"

source "$(KCONFIG_EXT_PREFIX)drivers/gpu/mediatek/Kconfig"

source "$(KCONFIG_EXT_PREFIX)drivers/media/platform/Kconfig"

source "$(KCONFIG_EXT_PREFIX)drivers/usb/Kconfig"

source "$(KCONFIG_EXT_PREFIX)drivers/devfreq/Kconfig"

source "$(KCONFIG_EXT_PREFIX)drivers/misc/mediatek/Kconfig"

source "$(KCONFIG_EXT_PREFIX)drivers/firmware/cirrus/Kconfig"

source "$(KCONFIG_EXT_PREFIX)sound/soc/codecs/Kconfig"

source "$(KCONFIG_EXT_PREFIX)sound/soc/mediatek/Kconfig"

source "$(KCONFIG_EXT_PREFIX)sound/soc/samsung/Kconfig"

source "$(KCONFIG_EXT_PREFIX)drivers/pci/controller/Kconfig"

source "$(KCONFIG_EXT_PREFIX)drivers/pinctrl/Kconfig"

source "$(KCONFIG_EXT_PREFIX)drivers/media/platform/mtk-isp/Kconfig"

source "$(KCONFIG_EXT_PREFIX)fs/f2fs/Kconfig"

source "$(KCONFIG_EXT_PREFIX)drivers/samsung/Kconfig"

source "$(KCONFIG_EXT_PREFIX)block/Kconfig"
source "$(KCONFIG_EXT_PREFIX)drivers/sec_panel_notifier_v2/Kconfig" # ADDED BY LEGO AUTOMATICALLY: DO NOT SUBMIT
source "$(KCONFIG_EXT_PREFIX)drivers/usb/typec/manager/Kconfig" # ADDED BY LEGO AUTOMATICALLY: DO NOT SUBMIT
source "$(KCONFIG_EXT_PREFIX)security/samsung/proca/Kconfig" # ADDED BY LEGO AUTOMATICALLY: DO NOT SUBMIT
source "$(KCONFIG_EXT_PREFIX)security/samsung/proca/gaf/Kconfig" # ADDED BY LEGO AUTOMATICALLY: DO NOT SUBMIT
source "$(KCONFIG_EXT_PREFIX)drivers/input/sec_input/Kconfig" # ADDED BY LEGO AUTOMATICALLY: DO NOT SUBMIT
source "$(KCONFIG_EXT_PREFIX)drivers/muic/common/Kconfig" # ADDED BY LEGO AUTOMATICALLY: DO NOT SUBMIT
source "$(KCONFIG_EXT_PREFIX)drivers/staging/android/switch/Kconfig" # ADDED BY LEGO AUTOMATICALLY: DO NOT SUBMIT
source "$(KCONFIG_EXT_PREFIX)drivers/gpu/drm/panel/mcd_panel/Kconfig" # ADDED BY LEGO AUTOMATICALLY: DO NOT SUBMIT
source "$(KCONFIG_EXT_PREFIX)drivers/vibrator/common/Kconfig" # ADDED BY LEGO AUTOMATICALLY: DO NOT SUBMIT
source "$(KCONFIG_EXT_PREFIX)drivers/sdp/Kconfig" # ADDED BY LEGO AUTOMATICALLY: DO NOT SUBMIT
source "$(KCONFIG_EXT_PREFIX)drivers/usb/common/vbus_notifier/Kconfig" # ADDED BY LEGO AUTOMATICALLY: DO NOT SUBMIT
source "$(KCONFIG_EXT_PREFIX)drivers/misc/drb/Kconfig" # ADDED BY LEGO AUTOMATICALLY: DO NOT SUBMIT
source "$(KCONFIG_EXT_PREFIX)drivers/gpu/drm/samsung/panel/ana38407/Kconfig" # ADDED BY LEGO AUTOMATICALLY: DO NOT SUBMIT
source "$(KCONFIG_EXT_PREFIX)drivers/gpu/drm/samsung/panel/ana38407/kunit_test/Kconfig" # ADDED BY LEGO AUTOMATICALLY: DO NOT SUBMIT
source "$(KCONFIG_EXT_PREFIX)drivers/gpu/drm/samsung/panel/oled_common/Kconfig" # ADDED BY LEGO AUTOMATICALLY: DO NOT SUBMIT
source "$(KCONFIG_EXT_PREFIX)drivers/vibrator/common/vib_info/Kconfig" # ADDED BY LEGO AUTOMATICALLY: DO NOT SUBMIT
source "$(KCONFIG_EXT_PREFIX)drivers/sti/common/Kconfig" # ADDED BY LEGO AUTOMATICALLY: DO NOT SUBMIT
source "$(KCONFIG_EXT_PREFIX)drivers/input/input_boost/Kconfig" # ADDED BY LEGO AUTOMATICALLY: DO NOT SUBMIT
source "$(KCONFIG_EXT_PREFIX)drivers/input/touchscreen/goodix/berlin/Kconfig" # ADDED BY LEGO AUTOMATICALLY: DO NOT SUBMIT
source "$(KCONFIG_EXT_PREFIX)drivers/sensorhub/vendor/Kconfig" # ADDED BY LEGO AUTOMATICALLY: DO NOT SUBMIT
source "$(KCONFIG_EXT_PREFIX)drivers/battery/core/Kconfig" # ADDED BY LEGO AUTOMATICALLY: DO NOT SUBMIT
source "$(KCONFIG_EXT_PREFIX)drivers/kperfmon/Kconfig" # ADDED BY LEGO AUTOMATICALLY: DO NOT SUBMIT
source "$(KCONFIG_EXT_PREFIX)drivers/usb/notify/Kconfig" # ADDED BY LEGO AUTOMATICALLY: DO NOT SUBMIT
source "$(KCONFIG_EXT_PREFIX)security/samsung/five/Kconfig" # ADDED BY LEGO AUTOMATICALLY: DO NOT SUBMIT
source "$(KCONFIG_EXT_PREFIX)drivers/knox/hdm/Kconfig" # ADDED BY LEGO AUTOMATICALLY: DO NOT SUBMIT
source "$(KCONFIG_EXT_PREFIX)drivers/fingerprint/Kconfig" # ADDED BY LEGO AUTOMATICALLY: DO NOT SUBMIT
source "$(KCONFIG_EXT_PREFIX)drivers/battery/charger/sm5714_charger/Kconfig" # ADDED BY LEGO AUTOMATICALLY: DO NOT SUBMIT
source "$(KCONFIG_EXT_PREFIX)drivers/usb/typec/common/Kconfig" # ADDED BY LEGO AUTOMATICALLY: DO NOT SUBMIT
source "$(KCONFIG_EXT_PREFIX)drivers/gpu/drm/Kconfig" # ADDED BY LEGO AUTOMATICALLY: DO NOT SUBMIT
source "$(KCONFIG_EXT_PREFIX)drivers/gpu/drm/samsung/panel/Kconfig" # ADDED BY LEGO AUTOMATICALLY: DO NOT SUBMIT
source "$(KCONFIG_EXT_PREFIX)drivers/sti/abc/Kconfig" # ADDED BY LEGO AUTOMATICALLY: DO NOT SUBMIT
source "$(KCONFIG_EXT_PREFIX)drivers/vibrator/dc/Kconfig" # ADDED BY LEGO AUTOMATICALLY: DO NOT SUBMIT
source "$(KCONFIG_EXT_PREFIX)drivers/mfd/sm/sm5714/Kconfig" # ADDED BY LEGO AUTOMATICALLY: DO NOT SUBMIT
source "$(KCONFIG_EXT_PREFIX)drivers/gpu/drm/mediatek/sec_dp/Kconfig" # ADDED BY LEGO AUTOMATICALLY: DO NOT SUBMIT
source "$(KCONFIG_EXT_PREFIX)drivers/input/misc/hall/Kconfig" # ADDED BY LEGO AUTOMATICALLY: DO NOT SUBMIT
source "$(KCONFIG_EXT_PREFIX)drivers/battery/fuelgauge/sm5714_fuelgauge/Kconfig" # ADDED BY LEGO AUTOMATICALLY: DO NOT SUBMIT
source "$(KCONFIG_EXT_PREFIX)drivers/muic/sm/sm5714/Kconfig" # ADDED BY LEGO AUTOMATICALLY: DO NOT SUBMIT
source "$(KCONFIG_EXT_PREFIX)drivers/samsung/pm/sec_thermistor/Kconfig" # ADDED BY LEGO AUTOMATICALLY: DO NOT SUBMIT
source "$(KCONFIG_EXT_PREFIX)drivers/battery/battery_auth/ds28e30/Kconfig" # ADDED BY LEGO AUTOMATICALLY: DO NOT SUBMIT
source "$(KCONFIG_EXT_PREFIX)drivers/sensorhub/Kconfig" # ADDED BY LEGO AUTOMATICALLY: DO NOT SUBMIT
source "$(KCONFIG_EXT_PREFIX)drivers/sensorhub/debug/Kconfig" # ADDED BY LEGO AUTOMATICALLY: DO NOT SUBMIT
source "$(KCONFIG_EXT_PREFIX)drivers/sensorhub/sensor/Kconfig" # ADDED BY LEGO AUTOMATICALLY: DO NOT SUBMIT
source "$(KCONFIG_EXT_PREFIX)drivers/sensorhub/sensorhub/Kconfig" # ADDED BY LEGO AUTOMATICALLY: DO NOT SUBMIT
source "$(KCONFIG_EXT_PREFIX)drivers/nfc/snvm/Kconfig" # ADDED BY LEGO AUTOMATICALLY: DO NOT SUBMIT
source "$(KCONFIG_EXT_PREFIX)drivers/battery/battery_auth/sle956681/Kconfig" # ADDED BY LEGO AUTOMATICALLY: DO NOT SUBMIT
source "$(KCONFIG_EXT_PREFIX)drivers/redriver/ps5169/Kconfig" # ADDED BY LEGO AUTOMATICALLY: DO NOT SUBMIT
source "$(KCONFIG_EXT_PREFIX)drivers/input/wacom/Kconfig" # ADDED BY LEGO AUTOMATICALLY: DO NOT SUBMIT
source "$(KCONFIG_EXT_PREFIX)drivers/input/sec_input/stm_fst1ba90a_i2c/Kconfig" # ADDED BY LEGO AUTOMATICALLY: DO NOT SUBMIT
source "$(KCONFIG_EXT_PREFIX)drivers/usb/typec/sm/sm5714/Kconfig" # ADDED BY LEGO AUTOMATICALLY: DO NOT SUBMIT
source "$(KCONFIG_EXT_PREFIX)drivers/battery/charger/sm5440_charger/Kconfig" # ADDED BY LEGO AUTOMATICALLY: DO NOT SUBMIT
source "$(KCONFIG_EXT_PREFIX)drivers/sensors_lego/Kconfig" # ADDED BY LEGO AUTOMATICALLY: DO NOT SUBMIT
source "$(KCONFIG_EXT_PREFIX)drivers/input/sec_input/stm32/Kconfig" # ADDED BY LEGO AUTOMATICALLY: DO NOT SUBMIT
source "$(KCONFIG_EXT_PREFIX)drivers/battery/common/Kconfig" # ADDED BY LEGO AUTOMATICALLY: DO NOT SUBMIT
```

## kernel/kernel_device_modules-6.1/arch/arm64/Kconfig
```kconfig
# SPDX-License-Identifier: GPL-2.0-only

config MTK_DCACHE_INVAL
	tristate "export DCACHE_INVAL API"
	help
	  MTK_DCACHE_INVAL is the kernel config of export API.
	  Fix dma cache issue.
```

## kernel/kernel_device_modules-6.1/arch/arm64/configs/gts10uwifi_00_defconfig
```kconfig
# CONFIG_SND_SOC_RT5512 is not set
# CONFIG_SND_SOC_TFA9874 is not set
CONFIG_DEVICE_MODULES_SND_SOC_CS35L45_I2C=m
CONFIG_DEVICE_MODULES_SND_SOC_CIRRUS_AMP=m
CONFIG_SND_SOC_SAMSUNG_AUDIO=m
CONFIG_MTK_AUDIODSP_DEBUG_SUPPORT=y
CONFIG_IMGSENSOR_CUSTOM_CAMERA=y
CONFIG_CAMERA_STX_V10U=y
CONFIG_CAMERA_SAMSUNG_MODEL_NAME="stx_v10u"
CONFIG_CUSTOM_KERNEL_IMGSENSOR="hi1337_mipi_raw hi1337f_mipi_raw hi847_mipi_raw hi1337fu_mipi_raw"
CONFIG_IMGSENSOR_SYSFS=y
CONFIG_LEDS_SM5714=m
CONFIG_MTK_SM5714_FLASHLIGHT=m
# CONFIG_CAMERA_ADAPTIVE_MIPI is not set
CONFIG_DRM_PANEL_MCD_COMMON=m
CONFIG_USDM_PANEL=m
CONFIG_USDM_PANEL_DISPLAY_MODE=y
CONFIG_USDM_PANEL_DPUI=y
CONFIG_USDM_MDNIE=y
CONFIG_USDM_SDP_ADAPTIVE_MIPI=y
CONFIG_USDM_PANEL_SELF_DISPLAY=y
CONFIG_USDM_PANEL_DIMMING=y
CONFIG_USDM_PANEL_BIG_LOCK=y
CONFIG_USDM_PANEL_TESTMODE=y
CONFIG_USDM_BLIC_I2C=y
CONFIG_USDM_PANEL_BLIC=y
CONFIG_USDM_PANEL_MASK_LAYER=y
CONFIG_USDM_TCON_PRE_EMPHASIS_TEST=y
CONFIG_USDM_FACTORY_GCT_TEST=y
CONFIG_USDM_PANEL_BACKLIGHT_PAC_3_0=y
CONFIG_UH=y
CONFIG_RKP=y
CONFIG_KDP=y
CONFIG_KDP_CRED=y
&{NGK_COMMON_FEATURES}
CONFIG_SEC_DEBUG_DUMP_SINK=y
CONFIG_USDM_PANEL_FIRMWARE_UPDATE=y
```
