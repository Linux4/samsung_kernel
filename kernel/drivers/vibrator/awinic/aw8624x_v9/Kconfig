## kernel/kernel_device_modules-6.1/drivers/clocksource/Kconfig
```kconfig
# SPDX-License-Identifier: GPL-2.0-only
menu "Clock Source drivers"
	depends on GENERIC_CLOCKEVENTS

config DEVICE_MODULES_MTK_TIMER
	tristate "Mediatek timer driver"
	depends on HAS_IOMEM
	select TIMER_OF
	select CLKSRC_MMIO
	help
	  Support for Mediatek timer driver.

endmenu
```

## kernel/kernel_device_modules-6.1/drivers/cpufreq/Kconfig
```kconfig
# SPDX-License-Identifier: GPL-2.0-only
menu "CPU Frequency scaling"

if ARM || ARM64
source "$(KCONFIG_EXT_PREFIX)drivers/cpufreq/Kconfig.arm"
endif

endmenu
```

## kernel/kernel_device_modules-6.1/drivers/cpufreq/Kconfig.arm
```kconfig
# SPDX-License-Identifier: GPL-2.0-only
#
# ARM CPU Frequency scaling drivers
#

config DEVICE_MODULES_ARM_MEDIATEK_CPUFREQ_HW
	tristate "MediaTek CPUFreq HW driver"
	depends on ARCH_MEDIATEK || COMPILE_TEST
	default m
	help
	  Support for the CPUFreq HW driver.
	  Some MediaTek chipsets have a HW engine to offload the steps
	  necessary for changing the frequency of the CPUs. Firmware loaded
	  in this engine exposes a programming interface to the OS.
	  The driver implements the cpufreq interface for this HW engine.
	  Say Y if you want to support CPUFreq HW.

config CPU_FREQ_LIMIT
	tristate "CPU frequency limit API"
	help
	  This driver supports API to limit CPU frequency.
```

## kernel/kernel_device_modules-6.1/drivers/devfreq/Kconfig
```kconfig
# SPDX-License-Identifier: GPL-2.0-only

if PM_DEVFREQ

config MTK_DVFSRC_DEVFREQ
	tristate "MediaTek DVFSRC DEVFREQ Driver"
	depends on (MTK_DVFSRC && HAVE_ARM_SMCCC) || \
		(COMPILE_TEST && MTK_DVFSRC && HAVE_ARM_SMCCC)
	select DEVFREQ_GOV_USERSPACE
	help
	  This adds the DEVFREQ driver for the MediaTek DVFSRC
	  (dynamic voltage and frequency scaling resource collector).
	  The driver support to request dram frequency by DVFSRC and
	  user can adjust dram frequency on userspace.

endif # PM_DEVFREQ
```

## kernel/kernel_device_modules-6.1/drivers/dma-buf/heaps/Kconfig
```kconfig
config DEVICE_MODULES_DMABUF_HEAPS_SYSTEM
	tristate "DMA-BUF System Heap"
	depends on DMABUF_HEAPS
	help
	  Choose this option to enable the system dmabuf heap. The system heap
	  is backed by pages from the buddy allocator. If in doubt, say Y.

config DEVICE_MODULES_DMABUF_HEAPS_REFILL
	tristate "DMA-BUF heap refill"
	depends on DEVICE_MODULES_DMABUF_HEAPS_SYSTEM
	help
	  Choose this option to enable heap refill. Pool has high water and low
	  water. After executing dmabuf alloc and detecting that the current pool
	  size is lower than the low water, the refill thread is started. The
	  refill worker thread allocates pages to fill in the pool, and stops
	  filling when the pool size is higher than the high water mark.

config DMABUF_HEAPS_DEBUG
	tristate "DMA-BUF debug Heap"
	depends on DEVICE_MODULES_DMABUF_HEAPS_SYSTEM
	help
	  Choose this option to enable the mtk debug heap.
	  This debug tool can be use to dump dmabuf usage for users
	  If you want use it, say Y if you are not using GKI
	  say m and add ko into your system for GKI.

config RBIN
	bool "DMA-BUF RBIN Samsung Heap"
	depends on DMABUF_HEAPS && CLEANCACHE
	default y
	help
	  Choose this option to enable dma-buf rbin heap for samsung.
```

## kernel/kernel_device_modules-6.1/drivers/dma/mediatek/Kconfig
```kconfig
# SPDX-License-Identifier: GPL-2.0-only

config DEVICE_MODULES_MTK_CQDMA
	tristate "MediaTek Command-Queue DMA controller support"
	depends on ARCH_MEDIATEK || COMPILE_TEST
	select DMA_ENGINE
	select DMA_VIRTUAL_CHANNELS
	select ASYNC_TX_ENABLE_CHANNEL_SWITCH
	help
	  Enable support for Command-Queue DMA controller on MediaTek
	  SoCs.

	  This controller provides the channels which is dedicated to
	  memory-to-memory transfer to offload from CPU.

config DEVICE_MODULES_MTK_UART_APDMA
	tristate "MediaTek SoCs APDMA support for UART"
	depends on OF && DEVICE_MODULES_SERIAL_8250_MT6577
	select DMA_ENGINE
	select DMA_VIRTUAL_CHANNELS
	help
	  Support for the UART DMA engine found on MediaTek MTK SoCs.
	  When DEVICE_MODULES_SERIAL_8250_MT6577 is enabled, and if you want to use DMA,
	  you can enable the config. The DMA engine can only be used
	  with MediaTek SoCs.
```

## kernel/kernel_device_modules-6.1/drivers/firmware/cirrus/Kconfig
```kconfig
# SPDX-License-Identifier: GPL-2.0-only

config DEVICE_MODULES_CS_DSP
	tristate
	default n
```

## kernel/kernel_device_modules-6.1/drivers/gpu/drm/Kconfig
```kconfig
########## FOR KUNIT ##########

config DRM_PANEL_MCD_COMMON_TEST
    bool "KUnit test for exynos mcd-common-panel test"
    depends on SEC_KUNIT
    help
      TODO: Describe config fully.
```

## kernel/kernel_device_modules-6.1/drivers/gpu/drm/mediatek/dpc/Kconfig
```kconfig
config MTK_DPC
	tristate "MTK Display Power Controller"
	help
	  Choose this option if you have a Mediatek SoCs.
	  This driver is used to optimize the power control
	  of display vidle, it has low latency MTCMOS ctrl
	  and flexible display triggers.
```

## kernel/kernel_device_modules-6.1/drivers/gpu/drm/mediatek/dummy_drm/Kconfig
```kconfig
config DRM_MEDIATEK_DUMMY
	tristate "MTK Virtual KMS"
	depends on DRM
	select DRM_KMS_HELPER
	select CRC32
	help
	  MTK Virtual Kernel Mode-Setting (VKMS) is used for FPGA early porting without
          display HW stage. Choose this option to get
	  a MTK VKMS.
	  If M is selected the module will be called vkms.
```
