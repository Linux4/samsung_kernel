## kernel/kernel_device_modules-6.1/block/Kconfig
```kconfig
# SPDX-License-Identifier: GPL-2.0
#
# Block layer core configuration
#

if BLOCK

config BLK_SEC_COMMON
	tristate "Samsung specific module in block layer"
	default n
	help
	  Say Y here if you want to be enable samsung specific module
	  in block layer.

config BLK_SEC_STATS
	tristate "Samsung statistics module in block layer"
	default n
	select BLK_SEC_COMMON
	help
	  Say Y here if you want to be enable samsung statistics module
	  in block layer.

config BLK_SEC_WB
	tristate "Samsung Write Booster module in block layer"
	default n
	select BLK_SEC_COMMON
	help
	  Say Y here if you want to be enable samsung write booster module
	  in block layer.

config MQ_IOSCHED_SSG
	tristate "SamSung Generic I/O scheduler"
	default n
	help
	  SamSung Generic IO scheduler.

config MQ_IOSCHED_SSG_CGROUP
	tristate "Control Group for SamSung Generic I/O scheduler"
	default n
	depends on BLK_CGROUP
	depends on MQ_IOSCHED_SSG
	help
	  Control Group for SamSung Generic IO scheduler.

config MQ_IOSCHED_SSG_WB
	tristate "Write Booster for SamSung Generic I/O scheduler"
	default n
	depends on MQ_IOSCHED_SSG
	help
	  Write Booster for SamSung Generic IO scheduler.

endif # BLOCK
```

## kernel/kernel_device_modules-6.1/drivers/battery/battery_auth/ds28e30/Kconfig
```kconfig
#
# ADI Authenticate IC
#

config BATTERY_AUTH_DS28E30
	tristate "ADI Authenticate IC"
	default n
	help
	  Say Y to ADI Authenticate IC.
```

## kernel/kernel_device_modules-6.1/drivers/char/Kconfig
```kconfig
# SPDX-License-Identifier: GPL-2.0
#
# Character device configuration
#

source "$(KCONFIG_EXT_PREFIX)drivers/char/hw_random/Kconfig"
source "$(KCONFIG_EXT_PREFIX)drivers/char/rpmb/Kconfig"
```

## kernel/kernel_device_modules-6.1/drivers/char/hw_random/Kconfig
```kconfig
# SPDX-License-Identifier: GPL-2.0-only
#
# Hardware Random Number Generator (RNG) configuration
#

config HW_RANDOM_SECURE
	tristate "Arm Security Random Number Generator support"
	depends on HW_RANDOM
	depends on HAVE_ARM_SMCCC || COMPILE_TEST
	default HW_RANDOM
	help
	  This driver provides kernel-side support for the Arm Security
	  Random Number Generator.

	  To compile this driver as a module, choose M here. the
	  module will be called sec-rng.

	  If unsure, say Y.
```
