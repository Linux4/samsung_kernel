## kernel/kernel_device_modules-6.1/arch/arm64/configs/lego_defconfig
```kconfig
CONFIG_SEC_PANEL_NOTIFIER_V2=m
CONFIG_USB_TYPEC_MANAGER_NOTIFIER=m
CONFIG_IF_CB_MANAGER=m
CONFIG_INPUT_SEC_INPUT=m
CONFIG_INPUT_SEC_NOTIFIER=m
CONFIG_SEC_DEBUG_TSP_LOG=m
CONFIG_TOUCHSCREEN_DUMP_MODE=m
CONFIG_SEC_INPUT_HEADER=y
# CONFIG_INPUT_SEC_SECURE_TOUCH is not set
# CONFIG_INPUT_SEC_TRUSTED_TOUCH is not set
CONFIG_INPUT_TOUCHSCREEN_TCLMV2=m
# CONFIG_SEC_INPUT_MULTI_DEVICE is not set
# CONFIG_SEC_INPUT_RAWDATA is not set
CONFIG_MUIC_NOTIFIER=m
CONFIG_HICCUP_CHARGER=y
CONFIG_MUIC_AFC_RETRY=y
CONFIG_MUIC_SUPPORT_PDIC=y
CONFIG_MUIC_USE_MODULE_PARAM=y
CONFIG_USE_MUIC=y
CONFIG_ANDROID_SWITCH=m
# CONFIG_ANDROID_SWITCH_GPIO is not set
CONFIG_SEC_VIBRATOR=m
CONFIG_SEC_VIB_NOTIFIER=y
CONFIG_SDP=m
CONFIG_VBUS_NOTIFIER=m
CONFIG_DEV_RIL_BRIDGE=m
CONFIG_USDM_PANEL_OLED_COMMON=m
CONFIG_USDM_PANEL_ANA38407=m
CONFIG_SEC_DISPLAYPORT_REDRIVER=y
CONFIG_VIBRATOR_VIB_INFO=m
CONFIG_SEC_STI=y
CONFIG_SEC_INPUT_BOOSTER=m
CONFIG_SEC_INPUT_BOOSTER_MODE=y
CONFIG_SEC_INPUT_BOOSTER_MTK=y
CONFIG_SEC_INPUT_BOOSTER_HANDLER=y
CONFIG_TOUCHSCREEN_GOODIX_BRL=m
CONFIG_SHUB_MODULE=y
CONFIG_SHUB_MTK=y
CONFIG_SHUB_AP_STATUS_CMD=y
CONFIG_SHUB_MTK_SCP_INCLUDE=y
CONFIG_SB_CORE=m
CONFIG_SB_PQUEUE=y
CONFIG_SB_NOTIFY=y
CONFIG_SB_SYSFS=y
CONFIG_SB_VOTE=y
CONFIG_KPERFMON=y
CONFIG_KPERFMON_BUILD=m
CONFIG_USB_NOTIFY_LAYER=m
CONFIG_USB_DEBUG_DETAILED_LOG=y
CONFIG_USB_EXTERNAL_NOTIFY=y
CONFIG_USB_HMT_SAMSUNG_INPUT=y
CONFIG_USB_HOST_NOTIFY=y
CONFIG_USB_HOST_SAMSUNG_FEATURE=y
CONFIG_USB_HW_PARAM=y
CONFIG_USB_INTERFACE_LPM_LIST=y
CONFIG_USB_NOTIFY_PROC_LOG=y
CONFIG_USB_USING_ADVANCED_USBLOG=y
CONFIG_HDM=m
CONFIG_HDM_MTK=y
CONFIG_SENSORS_FINGERPRINT=m
CONFIG_CHARGER_SM5714=m
CONFIG_SHIPMODE_BY_VBAT=y
CONFIG_SEC_ABC_SPEC_TYPE1=m
CONFIG_PDIC_NOTIFIER=m
CONFIG_PDIC_USE_MODULE_PARAM=y
CONFIG_DRM_PANEL_MCD_COMMON=m
# CONFIG_DRM_PANEL_SAMSUNG_COMMON is not set
CONFIG_USDM_PANEL_JSON=y
CONFIG_USB_NOTIFIER=m
CONFIG_SEC_ABC=m
CONFIG_SEC_ABC_HUB=m
CONFIG_SEC_ABC_COMMON=m
CONFIG_SEC_ABC_HUB_CORE=m
CONFIG_SEC_ABC_HUB_BOOTC=m
CONFIG_SEC_ABC_MOTTO=m
CONFIG_I2C_GPIO=y
CONFIG_I2C_GPIO=m
CONFIG_DC_VIBRATOR=m
# CONFIG_MTK_VIBRATOR is not set
CONFIG_MFD_SM5714=m
CONFIG_SEC_DISPLAYPORT=m
CONFIG_SEC_DISPLAYPORT_LOGGER=y
CONFIG_SEC_DISPLAYPORT_BIGDATA=y
CONFIG_INPUT_HALL_IC=m
CONFIG_HALL_NOTIFIER=m
CONFIG_HALL_LOGICAL=m
# CONFIG_HALL_DUMP_KEY_MODE is not set
CONFIG_REGULATOR_FIXED_VOLTAGE=y
CONFIG_FUELGAUGE_SM5714=m
CONFIG_UI_SOC_PROLONGING=y
CONFIG_MUIC_SM5714=m
CONFIG_MUIC_BCD_RESCAN=y
CONFIG_SEC_PM_THERMISTOR=y
CONFIG_SEC_PM_THERMISTOR=m
CONFIG_BATTERY_AUTH_DS28E30=m
CONFIG_IIO=y
CONFIG_IIO_BUFFER=y
CONFIG_SHUB=m
CONFIG_STAR_K250A_LEGO=m
CONFIG_SEC_SNVM_PLATFORM_DRV=y
CONFIG_SEC_SNVM_I2C_CLOCK_CONTROL=y
CONFIG_SEC_SNVM_WAKELOCK_METHOD=2
# CONFIG_STAR_MEMORY_LEAK is not set
CONFIG_SENSORS_EL7XX=m
CONFIG_SENSORS_FINGERPRINT_MODULE=y
CONFIG_FINGERPRINT_SECURE=y
CONFIG_SENSORS_FINGERPRINT_MTK=y
CONFIG_BATTERY_AUTH_SLE956681=m
CONFIG_COMBO_REDRIVER_PS5169=m
CONFIG_EPEN_WACOM_WEZ01=m
CONFIG_TOUCHSCREEN_STM_FST1BA90A_I2C=m
CONFIG_PDIC_SM5714=m
CONFIG_SM5714_FACTORY_MODE=y
CONFIG_SM5714_WATER_DETECTION_ENABLE=y
CONFIG_SM5714_SUPPORT_SBU=y
CONFIG_PDIC_PD30=y
CONFIG_SUPPORT_USB_TYPEC_OPS=y
CONFIG_SM5714_NORMAL_DRP=y
CONFIG_CHARGER_SM5440=m
CONFIG_SENSORS_A96T396_A13X=y
CONFIG_SENSORS_A96T396=m
CONFIG_SENSORS_A96T396_SUB=m
CONFIG_SENSORS_A96T396_SUB2=m
CONFIG_SENSORS_A96T396_WIFI=m
CONFIG_SENSORS_A96T396_2CH=y
# CONFIG_SENSORS_A96T396_CRC_CHECK is not set
CONFIG_SENSORS_A96T396_LDO_SHARE=y
# CONFIG_SENSORS_CORE_AP is not set
CONFIG_SENSORS_FW_VENDOR=y
# CONFIG_SENSORS_GRIP_FAILURE_DEBUG is not set
# CONFIG_SENSORS_LOW_TEMP_COMP is not set
CONFIG_SENSORS_SUPPORT_LOGIC_PARAMETER=y
CONFIG_KEYBOARD_STM32_POGO_V3=m
CONFIG_DIRECT_CHARGING=m
CONFIG_BATTERY_SAMSUNG=m
CONFIG_SEC_PD=m
CONFIG_BATTERY_GKI=y
CONFIG_BATTERY_AGE_FORECAST=y
CONFIG_BATTERY_CISD=y
CONFIG_AFC_CHARGER_MODE=y
CONFIG_BATTERY_LOGGING=y
CONFIG_ENABLE_FULL_BY_SOC=y
CONFIG_STEP_CHARGING=y
CONFIG_SUPPORT_HV_CTRL=y
CONFIG_TABLET_MODEL_CONCEPT=y
```
