## kernel/drivers/gpu/drm/samsung/dpu/tests/Kconfig
```kconfig
config DRM_SAMSUNG_KUNIT_TEST
	tristate "Support DPU Kunit Test"
	depends on DRM_SAMSUNG_DPU
	select KUNIT
	select KUNIT_DEFAULT_ENABLED
	default n
	help
	  If this menu is enabled, you can test DPU kunit.

config DRM_SAMSUNG_KUNIT_TEST_DSIM_BIST
	tristate "Support DSIM bist Test"
	select DRM_SAMSUNG_KUNIT_TEST
	default n
	help
	  If this menu is enabled, you can test dsim bist at booting time.

config DRM_SAMSUNG_KUNIT_TEST_DECON_COLORMAP
	tristate "Support DECON colormap Test"
	select DRM_SAMSUNG_KUNIT_TEST
	default n
	help
	  If this menu is enabled, you can test decon colormap at booting time.

config DRM_SAMSUNG_KUNIT_TEST_DPU_DMA
	tristate "Support DPU_DMA with dma buf Test"
	select DRM_SAMSUNG_KUNIT_TEST
	default n
	help
	  If this menu is enabled, you can test DPU_DMA with dma buf at booting time.
```

## kernel/drivers/gpu/drm/samsung/gpu/sgpu/Kconfig
```kconfig
# SPDX-License-Identifier: MIT
config DRM_SGPU
	tristate "Samsung GPU"
	depends on DRM && MMU
	select FW_LOADER
	select DRM_DISPLAY_DP_HELPER
	select DRM_DISPLAY_HELPER
	select DRM_KMS_HELPER
	select DRM_SCHED
	select DRM_TTM
	select DRM_TTM_HELPER
	select POWER_SUPPLY
	select HWMON
	select BACKLIGHT_CLASS_DEVICE
	select INTERVAL_TREE
	select CHASH
	select TRACE_GPU_MEM
	help
	  Choose this option if you have a recent SGPU.

	  If M is selected, the module will be called sgpu.

config DRM_SGPU_BUILTIN_FIRMWARE
	bool "Enable use of built-in firmware"
	depends on DRM_SGPU
	default n
	help
	  Selecting this option enables linking firmware binaries into the driver.

config DRM_SGPU_EMU_MODE
	bool "Enable emulation mode"
	depends on DRM_SGPU
	default n
	help
	  Selecting this option enables emulation mode by default. Emulation
	  mode is required for running on QEMU or hardware emulator.

config DRM_SGPU_EMULATOR_WORKAROUND
	bool "Enable emulation mode"
	depends on DRM_SGPU
	default n
	help
	  Selecting this option enables workaround for SoC emulators like
	  Palladium and ZeBu. They emulate a lot of components of SoC but
	  are missing some components that causes serious performance impact.
	  The time in the emulators is also very different from the time in
	  silicon. Select this option if you are compiling for ZeBu or
	  Palladium.

config DRM_SGPU_EXYNOS
	bool "Enable Exynos related code"
	depends on DRM_SGPU
	default n
	help
	  This option is for SGPU in Exynos.

config DRM_SGPU_DVFS
	bool "Enable DVFS related code"
	depends on DRM_SGPU
	depends on PM_DEVFREQ
	default n
	help
	  This option is for DVFS framework in SGPU

config DRM_SGPU_AFM
	bool "Enable GPU AFM feature"
	depends on DRM_SGPU_DVFS
	default n
	help
	  AFM is Adaptive Frequency Manager. PMIC assert AFM_WARN signal when
	  over-current situation is detected. HTU_G3D receives this signal
	  and makes interrupt notifying over-currency to KMD. GPU DVFS need to
	  down the GPU frequency for ensuring GPU stability.
	  GPU AFM driver lock the gpu's max frequency when PMIC AFM_WARN
	  interrupt is occurred.

config DRM_SGPU_WORKTIME
	bool "Enable gpu_work_period"
	depends on DRM_SGPU && FTRACE
	default n
	help
	 From Android 14, GPU driver should provide the command
	 "dumpsys gpu --gpuwork" to display the aggregated GPU work data
	 returned by the power/gpu_work_period kernel tracepoint.

config DRM_SGPU_VENDOR_HOOKS
	bool "Enable VENDOR HOOKS function"
	depends on DRM_SGPU
	depends on ANDROID_VENDOR_HOOKS
	default y
	help
	 At Android, GPU driver need to hook function that provides
	 memory information using GPU. This option is enabled when
	 "android_vh_show_mem" are incldued.

config DRM_SGPU_FORCE_WRITECOMBINE
	bool "Force all GPU buffers write-combining for non-coherenty GPU"
	depends on DRM_SGPU_EXYNOS
	default y
	help
	  If GPU does have memory coherent with the host CPUs, GPU drivers
	  should make sure the GPU bufffers shared with CPU are coherent.
	  The cost of extra SW overhead for memory coherency can be significant
	  while the latency of an access to write-combining memory is dramatically
	  slow. Set n if PAL is able to handle all memory coherency for cacheable
	  buffer objects and performance impact of SW overhead for memory coherency
	  is neglectable.

config DRM_SGPU_GRAPHIC_MEMORY_RECLAIM
	bool "Graphics Memory Reclamation"
	depends on DRM_SGPU_EXYNOS
	default y
	help
	  Choose this option to create sysfs files for reclaiming GEM buffers.

config DRM_AMDGPU_GART_DEBUGFS
	bool "Allow GART access through debugfs"
	depends on DRM_SGPU
	depends on DEBUG_FS
	default n
	help
	  Selecting this option creates a debugfs file to inspect the mapped
	  pages. Uses more memory for housekeeping, enable only for debugging.

config DRM_AMDGPU_DUMP
	bool "Enable AMDGPU GPU dump upon GPU hang"
	depends on DRM_SGPU
	default y
	help
	  Selecting this option enables support for persisting AMDGPU's
	  different blocks register status upon GPU hang.

config DRM_AMDGPU_GMC_DUMP
	bool "Persist GMC block's status"
	depends on DRM_AMDGPU_DUMP
	default y
	help
	  Selecting this option enables support for persisting
	  AMDGPU's GMC block register status upon GPU hang.

config DRM_AMDGPU_GFX_DUMP
	bool "Persist GFX block's status"
	depends on DRM_AMDGPU_DUMP
	default y
	help
	  Selecting this option enables support for persisting
	  AMDGPU's GFX block register status upon GPU hang.

config DRM_AMDGPU_COMPUTE_DUMP
	bool "Persist COMPUTE block's status"
	depends on DRM_AMDGPU_DUMP
	default y
	help
	  Selecting this option enables support for persisting
	  AMDGPU's COMPUTE block register status upon GPU hang.

config DRM_AMDGPU_SDMA_DUMP
	bool "Persist SDMA block's status"
	depends on DRM_AMDGPU_DUMP
	default y
	help
	  Selecting this option enables support for persisting
	  AMDGPU's SDMA block register status upon GPU hang.

choice
	prompt "SGPU DRM dump's sink"
	depends on DRM_AMDGPU_DUMP
	default DRM_SGPU_DUMP_LOG
	help
	  Choose where to write the dump

config DRM_SGPU_DUMP_LOG
	bool "Dump to log"

config DRM_SGPU_DUMP_PSTORE
	bool "Dump to pstore"
	depends on PSTORE
	depends on DRM_DUMP

endchoice

config DRM_SGPU_BPMD
	bool "Enable BPMD (Binary PostMortem Dump)"
	depends on DRM_SGPU
	default n
	help
	  This option is for SGPU BPMD.

config DRM_SGPU_BPMD_FILE_DUMP
	bool "Enable dumping BPMD data into a file"
	depends on DRM_SGPU_BPMD
	default n
	help
	  This option is for dumping SGPU BPMD data into a file in kernel.

config DRM_SGPU_BPMD_OUTPUT_DEFAULT
	string "Default path to BMPD's output"
	depends on DRM_SGPU_BPMD
	default "/tmp"
	help
	  Serves as a default value for the `bmpdpath` module parameter

config DRM_SGPU_BPMD_MEMLOGGER_TEXT
	bool "Enable dumping textual dump to memloger"
	depends on EXYNOS_MEMORY_LOGGER
	select DRM_SGPU_BPMD
	default n

config SEC_GPUINFO
	bool "Enable gpuinfo sysfs nodes for hqm"
	default y
	help
	  Enable the additional sysfs node for hqm big data collection
```

## kernel/drivers/gpu/drm/samsung/panel/ana6710/Kconfig
```kconfig
menuconfig USDM_PANEL_ANA6710
	tristate "ANA6710 DDI Panel Driver"
	depends on USDM_PANEL
	depends on USDM_PANEL_OLED_COMMON
	default n
	help
		This enables ANA6710 DDI dependent panel drivers of
		common panel driver. say Y, if you have a panel based on
		the ANA6710 DDI.


########## FOR KUNIT ##########

config ANA6710_TEST
	bool "KUnit test for ana6710 ddi driver"
	depends on SEC_KUNIT
	help
	  TODO: Describe config fully.



########## FOR KUNIT ##########

config ANA6710_A55X_TEST
	bool "KUnit test for tft_common ddi driver"
	depends on SEC_KUNIT
	help
	  TODO: Describe config fully.
```

## kernel/drivers/input/sec_input/synaptics_s3908t/Kconfig
```kconfig
# SPDX-License-Identifier: GPL-2.0-only
#
# SYNAPTICS TOUCH driver configuration
#

config TOUCHSCREEN_SYNAPTICS_S3908T_SPI
    tristate "SYNAPTICS S3908T SPI Touchscreen"
    depends on SPI
    help
      Say Y here if you want support for SYNAPTICS SPI touchscreen controllers.
      If unsure, say N.

config TOUCHSCREEN_SYNAPTICS_S3908T_I2C
    tristate "SYNAPTICS S3908T I2C Touchscreen"
    depends on I2C
    help
      Say Y here if you want support for SYNAPTICS I2C touchscreen controllers.
      If unsure, say N.
```

## kernel/drivers/iommu/samsung/Kconfig
```kconfig
# SPDX-License-Identifier: GPL-2.0-only
config SAMSUNG_IOMMU
	tristate "Samsung IOMMU Support"
	select ARM_DMA_USE_IOMMU
	select IOMMU_DMA
	select SAMSUNG_IOMMU_GROUP
	help
	  Support for IOMMU on Samsung Exynos SoCs.

config SAMSUNG_IOMMU_GROUP
	tristate "Samsung IOMMU Group Support"
	help
	  Support for IOMMU group on Samsung Exynos SoCs.

config SAMSUNG_SECURE_IOVA
	tristate "Samsung Secure IOVA Support"
	help
	  Support secure device virtual address management for Samsung Exynos SoCs.

config SAMSUNG_IOMMU_V9
	tristate "Samsung IOMMU V9 Support"
	select ARM_DMA_USE_IOMMU
	select IOMMU_DMA
	select SAMSUNG_IOMMU_GROUP_V9
	help
	  Support for IOMMU V9 on Samsung Exynos SoCs.

config SAMSUNG_IOMMU_GROUP_V9
	tristate "Samsung IOMMU Group V9 Support"
	help
	  Support for IOMMU group on Samsung Exynos SoCs.
```

## kernel/drivers/media/platform/exynos/camera/ischain/Kconfig
```kconfig
config PABLO_V10_1_0
	bool "Use PABLO v10.1.0"
	depends on SOC_S5E9925
	depends on !SOC_S5E9925_EVT0
	default y
	select EXYNOS_DEVICE_MIPI_CSIS_VER4
	select CSIS_V8_0
	select PABLO_CAMIF_BNS
	select CAMERA_CIS_SELECT
	select CAMERA_ACT_SELECT
	select CAMERA_FLASH_SELECT
	select CAMERA_PDP
	select CAMERA_DVFS_V2
	select CAMERA_MEM_V2
	select PDP_V4_1
	select CSTAT_V1_1
	select BYRP_V1_1
	select RGBP_V1_1
	select MCFP_V10_1
	select YUVP_V1_1
	select LME_V2_1
	select COMMON_DMA_V1_0
	select PABLO_HW_HELPER_V1
	select PABLO_SENSOR_VC_VIDEO_NODE
	help
	  PABLO ISP version 10.1.0

config PABLO_V10_20_0
	bool "Use PABLO v10.20.0"
	depends on SOC_S5E8825
	default y
	select EXYNOS_DEVICE_MIPI_CSIS_VER4
	select CSIS_V5_4
	select CAMERA_CIS_SELECT
	select CAMERA_ACT_SELECT
	select CAMERA_FLASH_SELECT
	select CAMERA_PDP
	select CAMERA_DVFS_V2
	select CAMERA_MEM_V2
	select PDP_V3_1
	select TAA_V9_20
	select ORBMCH_V2_1
	select MCFP_V10_20
	select DNS_V1_20
	select ITP_V1_20
	select COMMON_DMA_V1_0
	select PABLO_HW_HELPER_V1
	select PABLO_SENSOR_VC_VIDEO_NODE
	help
	  PABLO ISP version 10.20.0

config PABLO_V11_0_0
	bool "Use PABLO v11.0.0"
	depends on SOC_S5E9935
	default y
	select PABLO_ICPU_HW_V1_0
	select EXYNOS_DEVICE_MIPI_CSIS_VER4
	select CSIS_V8_1
	select CSIS_PDP_TOP_API
	select CSIS_PDP_TOP_V5_0
	select PABLO_CAMIF_BNS
	select CAMERA_CIS_SELECT
	select CAMERA_ACT_SELECT
	select CAMERA_FLASH_SELECT
	select CAMERA_PDP
	select CAMERA_DVFS_V2
	select CAMERA_MEM_V2
	select PDP_V5_0
	select CSTAT_V2_0
	select COMMON_DMA_V2_0
	select PABLO_HW_HELPER_V2
	select PABLO_ICPU_ADT_V2
	select PABLO_SENSOR_ADT
	select PABLO_CRTA_BUFMGR
	help
	  PABLO ISP version 11.0.0

config PABLO_V11_20_0
	bool "Use PABLO v11.20.0"
	depends on SOC_S5E8835
	default y
	select PABLO_ICPU_HW_V1_0
	select EXYNOS_DEVICE_MIPI_CSIS_VER4
	select CSIS_V5_4_8
	select PABLO_CAMIF_BNS
	select CAMERA_CIS_SELECT
	select CAMERA_ACT_SELECT
	select CAMERA_FLASH_SELECT
	select CAMERA_PDP
	select CAMERA_DVFS_V2
	select CAMERA_MEM_V2
	select PDP_V4_4
	select CSTAT_V1_20
	select COMMON_DMA_V1_0
	select PABLO_HW_HELPER_V2
	select PABLO_ICPU_ADT_V2
	select PABLO_SENSOR_ADT
	select PABLO_CRTA_BUFMGR
	help
	  PABLO ISP version 11.20.0

config PABLO_V11_30_0
	bool "Use PABLO v11.30.0"
	depends on SOC_S5E8535
	default y
	select PABLO_ICPU_HW_V1_0
	select EXYNOS_DEVICE_MIPI_CSIS_VER4
	select CSIS_V5_4_8
	select PABLO_CAMIF_BNS
	select CAMERA_CIS_SELECT
	select CAMERA_ACT_SELECT
	select CAMERA_FLASH_SELECT
	select CAMERA_PDP
	select CAMERA_DVFS_V2
	select CAMERA_MEM_V2
	select PDP_V4_4
	select CSTAT_V1_40
	select COMMON_DMA_V1_0
	select PABLO_HW_HELPER_V2
	select PABLO_ICPU_ADT_V2
	select PABLO_SENSOR_ADT
	select PABLO_CRTA_BUFMGR
	select PABLO_SENSOR_VC_VIDEO_NODE
	help
	  PABLO ISP version 11.30.0


config PABLO_V12_0_0
	bool "Use PABLO v12.0.0"
	depends on SOC_S5E9945_EVT0
	default y
	select PABLO_ICPU_HW_V2_0
	select EXYNOS_DEVICE_MIPI_CSIS_VER4
	select CSIS_V6_0
	select CSIS_PDP_TOP_API
	select CSIS_PDP_TOP_V6_0
	select PABLO_CAMIF_BNS
	select CAMERA_CIS_SELECT
	select CAMERA_ACT_SELECT
	select CAMERA_FLASH_SELECT
	select CAMERA_PDP
	select CAMERA_DVFS_V2
	select CAMERA_MEM_V2
	select PDP_V6_0
	select CSTAT_V3_0
	select COMMON_DMA_V2_0
	select PABLO_HW_HELPER_V2
	select PABLO_ICPU_ADT_V2
	select PABLO_SENSOR_ADT
	select PABLO_CRTA_BUFMGR
	select PABLO_DLFE
	select DLFE_API_V1_0
	help
	  PABLO ISP version 12.0.0

config PABLO_V12_1_0
	bool "Use PABLO v12.1.0"
	depends on SOC_S5E9945 && !SOC_S5E9945_EVT0
	default y
	select PABLO_ICPU_HW_V2_0
	select EXYNOS_DEVICE_MIPI_CSIS_VER4
	select CSIS_V6_0
	select CSIS_PDP_TOP_API
	select CSIS_PDP_TOP_V6_1
	select PABLO_CAMIF_BNS
	select CAMERA_CIS_SELECT
	select CAMERA_ACT_SELECT
	select CAMERA_FLASH_SELECT
	select CAMERA_PDP
	select CAMERA_DVFS_V2
	select CAMERA_MEM_V2
	select PDP_V6_0
	select CSTAT_V3_0
	select COMMON_DMA_V2_0
	select PABLO_HW_HELPER_V2
	select PABLO_ICPU_ADT_V2
	select PABLO_SENSOR_ADT
	select PABLO_CRTA_BUFMGR
	select PABLO_DLFE
	select DLFE_API_V1_0
	select PABLO_CMN_CTRL_API
	help
	  PABLO ISP version 12.1.0

config PABLO_V12_20_0
	bool "Use PABLO v12.20.0"
	depends on SOC_S5E8845
	default y
	select PABLO_ICPU_HW_V2_0
	select EXYNOS_DEVICE_MIPI_CSIS_VER4
	select CSIS_V5_20
	select CSIS_PDP_TOP_API
	select CSIS_PDP_TOP_V5_20
	select PABLO_CAMIF_BNS
	select CAMERA_CIS_SELECT
	select CAMERA_ACT_SELECT
	select CAMERA_FLASH_SELECT
	select CAMERA_PDP
	select CAMERA_DVFS_V2
	select CAMERA_MEM_V2
	select PDP_V5_0
	select CSTAT_V2_20
	select COMMON_DMA_V2_0
	select PABLO_HW_HELPER_V2
	select PABLO_ICPU_ADT_V2
	select PABLO_SENSOR_ADT
	select PABLO_CRTA_BUFMGR
	help
	  PABLO ISP version 12.20.0

config PABLO_V13_0_0
	bool "Use PABLO v13.0.0"
	depends on SOC_S5E9955
	default y
	select PABLO_ICPU_HW_V2_0
	select EXYNOS_DEVICE_MIPI_CSIS_VER4
	select CSIS_V6_0
	select CSIS_PDP_TOP_API
	select CSIS_PDP_TOP_V13_0
	select PABLO_CAMIF_BNS
	select CAMERA_CIS_SELECT
	select CAMERA_ACT_SELECT
	select CAMERA_FLASH_SELECT
	select CAMERA_PDP
	select CAMERA_DVFS_V2
	select CAMERA_MEM_V2
	select PDP_V13_0
	select CSTAT_V3_0
	select COMMON_DMA_V2_0
	select PABLO_HW_HELPER_V2
	select PABLO_ICPU_ADT_V2
	select PABLO_SENSOR_ADT
	select PABLO_CRTA_BUFMGR
	select PABLO_CMN_CTRL_API
	select PABLO_YUVSC
	select YUVSC_API_V13_0
	help
	  PABLO ISP version 13.0.0
```

## kernel/drivers/media/platform/exynos/camera/sensor/Kconfig
```kconfig
config EXYNOS_DEVICE_CAMERA_MODULE
	bool "Use Camera modules"
	depends on VIDEO_EXYNOS_PABLO_ISP
	default y
	help
	  Select camera module.

config PABLO_SENSOR_VC_VIDEO_NODE
	bool "Use Pablo Sensor VC subdev video nodes"
	depends on VIDEO_EXYNOS_PABLO_ISP
	default n
	help
	  Select whether this SOC should give
	  the interface to get the video buffer from user
	  through physical V4L2 video node or not.
	  When it set into 'false', the buffer should be delivered
	  through LVN node interface.

source "drivers/media/platform/exynos/camera/sensor/module_framework/Kconfig"
```

## kernel/drivers/media/platform/exynos/camera/vendor/Kconfig
```kconfig
#menu depth2
menu "Vendor Feature Setting"
	depends on VIDEO_EXYNOS_PABLO_ISP

choice VENDOR_FEATURES
	prompt "Use vendor features"
	depends on VIDEO_EXYNOS_PABLO_ISP
	default CAMERA_VENDOR_DEFAULT
	help
	  Use the vendor specific features.

config CAMERA_VENDOR_DEFAULT
        bool "Default"
config CAMERA_VENDOR_MCD
        bool "MCD"
config CAMERA_VENDOR_MCD_V2
        bool "MCD_V2"
endchoice

source "drivers/media/platform/exynos/camera/vendor/default/Kconfig"
source "drivers/media/platform/exynos/camera/vendor/mcd/Kconfig"
endmenu
```
