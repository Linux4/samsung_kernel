## kernel/drivers/media/platform/exynos/camera/vendor/default/Kconfig
```kconfig
#
# Generic vendor feature config states
#

# Enable the vendor features
config SECURE_CAMERA_USE
	tristate "Use secure camera"
	depends on CAMERA_VENDOR_DEFAULT
	default n
	help
	  Use secure camera.
```

## kernel/drivers/media/platform/exynos/camera/vendor/mcd/Kconfig
```kconfig
config CAMERA_HW_BIG_DATA
        tristate "Enable hw big data"
        depends on CAMERA_VENDOR_MCD
        default n
        help
          Enable hw big data.
config COMPANION_DCDC_USE
        bool "Use companion DCDC regulator"
        depends on CAMERA_VENDOR_MCD
        default n
        help
          Use companion DCDC regulator.
config SENSOR_RETENTION_USE
        bool "Use sensor retention"
        depends on CAMERA_VENDOR_MCD
        default n
        help
          Use sensor retention.
config OIS_USE
        bool "Use ois"
        depends on CAMERA_VENDOR_MCD
        default n
        help
          Use ois.
config OIS_FW_UPDATE_THREAD_USE
        bool "Enable ois fw update thread"
        depends on OIS_USE
        default n
        help
          Enable ois fw update thread.
config AF_HOST_CONTROL
        bool "Enable host af control"
        depends on CAMERA_VENDOR_MCD
        default n
        help
          Enable host af control.
config TORCH_CURRENT_CHANGE_SUPPORT
        bool "Change torch current in recording mode"
        depends on CAMERA_VENDOR_MCD
        default n
        help
          Change torch current in recording mode.
config FLASH_CURRENT_CHANGE_SUPPORT
        bool "Change flash current in capturing image"
        depends on CAMERA_VENDOR_MCD
        default n
        help
           Change torch current in capturing image.
config USE_SIGNED_BINARY
        bool "Enable signed binary processing."
        depends on CAMERA_VENDOR_MCD
        default n
        help
          Enable signed binary processing.
config USE_CAMERA_LDU
        bool "Use Camera LDU"
        depends on CAMERA_VENDOR_MCD
        default n
        help
          Use Camera LDU.
config CAMERA_CIS_TOF_BUCK_USE
        bool "Use isl91128 for tof"
        depends on CAMERA_VENDOR_MCD
        default n
        help
          Use isl91128.
config CAMERA_USE_MCU
        bool "Use Camera mcu"
        depends on CAMERA_VENDOR_MCD
        default n
        help
          Use Camera MCU.
config SENSORCORE_MCU_CONTROL
        bool "Use sensor core mcu control"
        depends on CAMERA_VENDOR_MCD
        default n
        help
          Use sensor control mcu.
config CAMERA_USE_INTERNAL_MCU
        bool "Use internal MCU for OIS"
        depends on OIS_USE
        default n
        help
          Use internal MCU for OIS.
config CAMERA_USE_EXTERNAL_MCU
        bool "Use external MCU for OIS"
        depends on OIS_USE
        default n
        help
          Use external MCU for OIS.
config CAMERA_USE_AOIS
        bool "Use AOIS"
        depends on OIS_USE
        default n
        help
          Use Advanced OIS.
config CAMERA_ESX_V01
        bool "This camera is esx_v01"
        depends on CAMERA_VENDOR_MCD
        default n
        help
          This camera is esx_v01.
config CAMERA_ESX_V02
        bool "This camera is esx_v02"
        depends on CAMERA_VENDOR_MCD
        default n
        help
          This camera is esx_v02.
config CAMERA_ESX_V03
        bool "This camera is esx_v03"
        depends on CAMERA_VENDOR_MCD
        default n
        help
          This camera is esx_v03.
config CAMERA_AAX_V55X
        bool "This camera is aax_v55x"
        depends on CAMERA_VENDOR_MCD
        default n
        help
         This camera is aax_v55x.
config USE_OIS_TAMODE_CONTROL
	bool "Use ois TAMODE control"
        depends on CAMERA_VENDOR_MCD
        default n
        help
          Use ois TAMODE control.
config MCU_S5E9925_EVT0
	bool "Mcu s5e9925 evt0"
        depends on CAMERA_VENDOR_MCD
        default n
        help
          Mcu s5e9925 evt0.
```

## kernel/drivers/media/platform/exynos/mcfrc/Kconfig
```kconfig
#
# Exynos multimedia device drivers
#
config VIDEO_EXYNOS_MC_FRC
        tristate "Exynos MC FRC driver"
        depends on VIDEO_EXYNOS
        default n
        help
          This is a representative exynos MC FRC device
```

## kernel/drivers/media/radio/exynos/s610/Kconfig
```kconfig
#
# SAMSUNG's S6x0 FM driver based on SPEEDY driver.
#
menu "Samsung S6x0 FM driver (SPEEDY based)"
config RADIO_S6X0
	tristate "Samsung S6x0 FM Radio"
	depends on VIDEO_DEV
	help
	Choose Y here if you have this FM radio chip.

endmenu
```

## kernel/drivers/media/radio/exynos/s621/Kconfig
```kconfig
#
# SAMSUNG's S621 FM driver based on SPEEDY driver.
#
menu "Samsung S621 FM driver (SPEEDY based)"
config RADIO_S621
	tristate "Samsung S621 FM Radio"
	depends on VIDEO_DEV
	help
	Choose Y here if you have this FM radio chip.

endmenu
```

## kernel/drivers/mfd/maxim/Kconfig
```kconfig
config MFD_MAX77775
	tristate "Maxim Semiconductor MAX77775 PMIC Support"
	depends on I2C=y
	select MFD_CORE
	help
	  Say yes here to support for Maxim Semiconductor MAX77775.
	  This is a Power Management IC with Charger, safe LDOs,
	  and Haptic controls on chip.
	  This driver provides common support for accessing the device;
	  additional drivers

config MAX77775_ABC_IFPMIC_EVENT
	bool "Using EVENT SENDING TO ABC MODULE"
	depends on I2C=y
	default n
	help
	  If you say yes here you will not get support for the sending event to abc module.

config MAX77775_SKIP_FWUPDATE_IS_UID
	bool "FW update skip when UID recognizes"
	depends on I2C=y
	default n
	help
	  If uid is recognized during booting,
	  fw update skip and then fw update to ATcmd(AT+FIRMVERS=3,0,2).
```

## kernel/drivers/misc/samsung/hardening/Kconfig
```kconfig
config HARDENING_TEST
	tristate "Exynos Kernel Hardening feature test"
	default n

config KCFI_PANIC_TEST
	tristate "kCFI functional test in driver module"
	depends on HARDENING_TEST
	help
		Select if intentional kernel panic test in CFI enalbed kernel
		Only expert use this test modue with very careful examination
```
