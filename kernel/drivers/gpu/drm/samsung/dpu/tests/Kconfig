## kernel/drivers/misc/samsung/scsc/Kconfig
```kconfig
config SCSC_CORE
	tristate "Samsung SCSC Maxwell driver"
	default n

if SCSC_CORE != n
config SCSC_CORE_CM
	tristate "Samsung SCSC Maxwell driver Core Module"
	depends on SCSC_CORE

config SCSC_INDEPENDENT_SUBSYSTEM
	tristate "Samsung SCSC independent subsystems arch"
	depends on SCSC_CORE
	depends on (SOC_S5E5515 || SOC_S5E8825 || SOC_S5E9925 || SOC_S5E9935 || SOC_S5E9945 || SCSC_PCIE || SOC_S5E8535 || SOC_S5E8835 || SOC_S5E8845 || SOC_S5E5535)
	default y

config SCSC_WLBT_CONFIG_GENERIC
	bool "WLBT CONFIG GENERIC"
	default y
	help
	  Select if using generic path for hcf.

config SCSC_WLBT_CONFIG_PLATFORM
	string "SCSC WLBT PLATFORM"
	default ""
	help
	  Select the platform, e.g. lassen_smdk

config SCSC_CORE_FW_LOCATION
	string "SCSC FW location"
	default "/vendor/etc/wifi"
	help
	  Select the FW location, when CONFIG_SCSC_CORE_FW_LOCATION_AUTO=n

config SCSC_CORE_TOOL_LOCATION
	string "SCSC tool location"
	default "/vendor/bin"
	help
	  Select the moredump tool location, when CONFIG_SCSC_CORE_FW_LOCATION_AUTO=n

config SCSC_PCIE
	tristate "Samsung SCSC MIF PCIE implementation"
	default n
	depends on SCSC_CORE
	depends on PCI

config SCSC_PCIE_PAEAN_X86
	tristate "Samsung SCSC MIF PCIE for M.2"
	default n
	depends on SCSC_CORE
	depends on PCI

config SCSC_MXLOGGER
	tristate "Samsung SCSC MXLOGGER"
	depends on SCSC_CORE
	default y
	help
	   MXLOGGER provides FW level logging in DRAM

config SCSC_SMAPPER
	bool "Samsung SCSC WLAN Smapper support"
	default y
	depends on SCSC_CORE
	help
	   SMAPPER provides direct access to Linux SKBs

config SCSC_WLBTD
	bool "Samsung SCSC Daemon support for Android O"
	depends on SCSC_CORE
	default n
	help
	   Uses generic netlink messages to communicate events to userspace daemon which takes necessary actions e.g. taking moredump

config SCSC_WRITE_INFO_FILE_WLBTD
	bool "SCSC flag to decide whether to write file via wlbtd or not"
	depends on SCSC_WLBTD
	default n

config SCSC_QOS
	bool "Samsung SCSC kernel PM QoS support"
	default y
	depends on SCSC_CORE
	help
	   SCSC_QOS provides support to configure kernel PM QoS to register configuration as per performance expectations

config SCSC_PLATFORM
	tristate "Samsung SCSC MIF Platform driver implementation"
	depends on SCSC_CORE

config SCSC_CM_MX_CLIENT_TEST
	tristate "Samsung SCSC Test Client"
	depends on SCSC_CORE

config SCSC_MX_ALWAYS_ON
	tristate "Samsung SCSC MX140 always booted"
	depends on SCSC_CM_MX_CLIENT_TEST

config SCSC_CLK20MHZ
	tristate "Samsung SCSC USB 20MHz Clock"
	depends on SCSC_CORE

config SCSC_CLK20MHZ_TEST
	tristate "Samsung SCSC USB 20MHz Clock Test"
	depends on SCSC_CLK20MHZ

config SCSC_FM
	tristate "Samsung SCSC MX250 enables LDOs used for FM"
	depends on SCSC_CORE

config SCSC_MMAP
	tristate "Samsung SCSC MMAP/GDB User space interface"
	depends on SCSC_CORE

config SCSC_DBG_SAMPLER
	tristate "Samsung SCSC Debug Sampler Service"
	depends on SCSC_CORE

config SCSC_DEBUG
	tristate "Samsung SCSC Logging"
	depends on SCSC_CORE && DEBUG_FS
	default n

config SCSC_DEBUG_COMPATIBILITY
	bool "Samsung SCSC Logging mode"
	default y

config SCSC_LOGRING
	tristate "Samsung SCSC Kernel Logging"
	default y
       help
         SCSC Drivers logging mechanism

config SCSC_STATIC_RING
	tristate "Samsung SCSC Logging use static ring"
	depends on SCSC_LOGRING
	default y

config SCSC_STATIC_RING_SIZE
	int "Size of the static ring"
	depends on SCSC_STATIC_RING
	default "1048576"
	range 1024 16777216

config SCSC_CHV_SUPPORT
	bool "Samsung CHV f/w support"
	depends on SCSC_CORE
	default n

config SCSC_GPR4_CON_DEBUG
	bool "GPR4 PIO muxes switching to the Maxwell Subsystem"
	depends on SCSC_PLATFORM
	default n

config SCSC_BUILD_TYPE
       string "Type of Kernel Build"
       help
         Type of Kernel Build: User, User Debug, Engineering

config SCSC_LOGRING_DEBUGFS
        bool "Samsung SCSC Logring DebugFS"
        depends on SCSC_LOGRING && DEBUG_FS
        default y

config SCSC_LOG_COLLECTION
	tristate "Samsung SCSC Log Collection"
	depends on SCSC_CORE
	default y
	help
	  Enable LOG collection to collect Chunks (host and FW) and generate a SBL file

config SCSC_COMMON_HCF
	bool "Enable Common HCF loader"
	depends on SCSC_CORE
	default y
	help
	  Enable Common HCF loader

config SCSC_WLBT_AUTORECOVERY_PERMANENT_DISABLE
	bool "Permanently disable WLBT autorecovery, ignroring module parameter"
	depends on SCSC_CORE
	default n
	help
	  Override module parameter, and disable recovery

config SCSC_MX450_GDB_SUPPORT
	bool "Enable GDB Channels for MX450"
	depends on SCSC_CORE
	default n
	help
	  Enable GDB Channels for MX450

config SCSC_LAST_PANIC_IN_DRAM
        bool "Enable last panic in DRAM"
        default n
        help
        This option tells if WLBTd will copy the last Sable/panic
	in DRAM

config SCSC_WLBT_CFG_REQ_WQ
	bool "Enable processing CFG REQ by Workqueue"
	depends on SCSC_CORE
	default n
	help
	Enable processing CFG REQ by Workqueue

config SCSC_MEMLOG
	tristate "Enable WLBT logging with memlog API"
	depends on EXYNOS_MEMORY_LOGGER
	depends on SCSC_CORE
	depends on (SOC_S5E9815 || SOC_S5E5515 || SOC_S5E8825 || SOC_S5E8535 || SOC_S5E8835 || SOC_S5E8845 || SOC_S5E5535)
	default y
	help
	  Enable memlog feature. So mxlogger doesn't allocated in reserved memory, dynamically by memlog API.

config WLBT_AUTOGEN_PMUCAL
	bool "Enable to use auto gen pmu cal"
	depends on SCSC_CORE
	depends on (SOC_S5E5515 || SOC_S5E8825 || SOC_S5E8535 || SOC_S5E8835 || SOC_S5E8845 || SOC_S5E5535)
	default y
	help
	  Enable auto gen pmu cal

config SCSC_MX152_EXT_DUAL_FEM
	bool "Enable dual fem for MX152"
	default n
	help
		Enable dual fem for MX152

config SCSC_FLASH_SERVICE
	tristate "Samsung SCSC Flash service"
	default y
	depends on SCSC_CORE
	depends on (SOC_S5E9945 || SOC_S5E9935 || SOC_S5E9925 || SCSC_PCIE_PAEAN_X86)
	help
	   SCSC_FLASH_SERVICE provides support to Flash external
	   programming.

config SCSC_FLASH_SERVICE_ON_BOOT
	tristate "Samsung SCSC Flash service on boot"
	default y
	depends on SCSC_FLASH_SERVICE
	depends on SCSC_CORE
	depends on (SOC_S5E9945 || SOC_S5E9935 || SOC_S5E9925 || SCSC_PCIE_PAEAN_X86)
	help
	   Enables SCSC_FLASH_SERVICE when kernel
	   is booting

config WLBT_WARN_ON
	bool "Enable wlbt warn on"
	default n
	help
		Enable wlbt warn on

config DUAL_FIRMWARE
	bool "Enable wlbt dual firmware"
	default y
	depends on SCSC_CORE
        depends on (SOC_S5E9925 || SOC_S5E9935)
	help
		Enable dual firmware. Mostly depends on chip revision.

config SCSC_I3C
        bool "Check whether wlbt use I3C"
	default y
        depends on SCSC_CORE
        depends on (SOC_S5E3830 || SOC_S5E5515 || SOC_S5E8825 || SOC_S5E8535 || SOC_S5E9630 || SOC_S5E9815)
	help
		Check whether wlbt use I3C"

config WLBT_PROPERTY_READ
	bool "Check whether wlbt use of_property_read api"
	default y
	depends on SCSC_CORE
	depends on (SOC_S5E8535 || SOC_S5E8835 || SOC_S5E9925 || SOC_S5E9935 || SOC_S5E8845)
	help
		Check whether wlbt use of_property_read api

config WLBT_PMU2AP_MBOX
	bool "Enable PMU2AP Mailbox"
	default y
	depends on SCSC_CORE
	depends on (SOC_S5E8835 || SOC_S5E8845 || SOC_S5E5535)
	help
		Enable PMU2AP Mailbox

config SCSC_PCIE_CHIP
	bool "Samsung Connectivity chips using PCIe"
	default y
	depends on (SOC_S5E9925 || SOC_S5E9935 || SOC_S5E9945)
	help
		Use PCIe

config WLBT_DCXO_TUNE
	bool "Enable to Control DCXO Calibration Tune value"
	default n
	depends on SCSC_CORE
	depends on SOC_S5E8835
	help
		Enable to Control DCXO Calibration Tune value

config WLBT_ITMON_NOTIFIER
	bool "check whether wlbt set itmon notifier"
	default y
	depends on SCSC_CORE
	depends on (EXYNOS_ITMON || EXYNOS_ITMON_V2)
	depends on (SOC_S5E5515 || SOC_S5E8535 || SOC_S5E8835 || SOC_S5E8845 || SOC_S5E5535)
	help
		check whether wlbt set itmon notifier

config WLBT_EXYNOS_HVC
	bool "check whther wlbt use exynos-hvc interface"
	default y
	depends on SCSC_CORE
	depends on EXYNOS_EL2
	depends on (SOC_S5E8535 || SOC_S5E8835)
	help
		bool check whther wlbt use exynos-hvc interface

config WLBT_REFACTORY
	bool "config of mif refactoring"
	default n
	help
		config of mif refactoring

config WLBT_QOS_CPUFREQ_POLICY
	bool "check whether qos use cpufreq_policy struct"
	default y
	depends on SCSC_CORE
	depends on (SOC_S5E8535 || SOC_S5E8835 || SOC_S5E8845 || SOC_S5E5535)
	help
		check whether qos use cpufreq_policy struct

config WLBT_KUNIT
	tristate "Kunit test for Samsung WLBT"
	depends on KUNIT
	default n
	help
		Kunit test for Samsung WLBT.

config SCSC_64KB_ALLIGNED_MEMLOG
	bool "Enable this if memlog need to be 64KB address alligned."
	default n
	depends on SCSC_CORE
	depends on (SOC_S5E5535 || SOC_S5E8845)
	help
		Enable this if memlog need to be 64KB address alligned

config SCSC_SEP_VERSION
	int "SEP version value"
	default 0
	help
		this option tells SEP Version value

config CHIPLOGGER_V_2_0
	bool "Enabling this will add the support for chipset logging V2"
	default y
	depends on SCSC_CORE
	depends on (SOC_S5E8845)
	help
		Enabling this will add the support for chipset logging V2

config SCSC_BB_REDWOOD
	bool "Platform has REDWOOD Slim Modem WLBT solution"
	default n
	depends on SCSC_PCIE_CHIP
	help
	This option suggests the platform has REDWOOD Slim Modem WLBT solution

config SCSC_BB_PAEAN
	bool "Platform has PAEAN Slim Modem WLBT solution"
	default y
	depends on SCSC_PCIE_CHIP
	depends on !SCSC_BB_REDWOOD
	help
	This option suggests the platform has PAEAN Slim Modem WLBT solution

config WLBT_SPLIT_RECOVERY
	bool "Enable Split recovery based on warm reset"
	default n
	depends on SCSC_INDEPENDENT_SUBSYSTEM
	help
		This option supports to enable the operation of split recovery based on warm reset for WLBT solution.

config SCSC_XO_CDAC_CON
	bool "Driver have to send to fw RFIC's DCXO"
	default n
	depends on SCSC_CORE
	depends on SCSC_BB_REDWOOD
	help
	This option checks fw will use RFIC's DCXO

config BT_FWSNOOP_LOGGING
	bool "Enable fwsnoop logging for Bluetooth"
	default y
	depends on SCSC_MXLOGGER
	depends on !SCSC_PCIE_CHIP
	help
		This option supports to enable fwsnoop logging for Bluetooth.

config HDM_WLBT_SUPPORT
	bool "Enable HDM block/unblock wlbt"
	default n
	depends on SCSC_CORE
	depends on SCSC_BB_REDWOOD
	help
		This option supports to enable hdm blocks wlan/bt.

config WLBT_EXYNOS_S2MPU
	bool "check whther wlbt use exynos-s2pmu interface"
	default y
	depends on SCSC_CORE
	depends on EXYNOS_S2MPU
	depends on (SOC_S5E8845 || SOC_S5E5535)
	help
		bool check whther wlbt use exynos-s2pmu interface.

config SCSC_COMMON_ANDROID
	bool "Android specific support"
	default y
	help
		Enable support for Android specific aspects of the common driver.
endif
```

## kernel/drivers/phy/nxp/ptn3222/Kconfig
```kconfig
config USB_REPEATER_PTN3222
	tristate "NXP PTN3222 Support"
	depends on I2C && USB_REPEATER
	help
	  Say yes here to support for NXP PTN3222.
```

## kernel/drivers/regulator/dio8018/Kconfig
```kconfig
if REGULATOR

config REGULATOR_DIO8018
	tristate "DIOO DIO8018 PMIC"
	depends on I2C
	help
	  This driver controls a DIOO DIO8018 PMIC
	  via I2C bus.

endif
```

## kernel/drivers/samsung/Kconfig
```kconfig
menuconfig SEC_DEBUG
	tristate "Enable Samsung Debugging features"
	default n

config SEC_BOOTSTAT
	tristate "Enable TN Bootstat logging"
	default n
	help
	  This adds support for Samsung boot-stat
	  To compile this driver as a module, choose M here.
    
config SEC_KEY_NOTIFIER
	tristate "Enable Samsung key event notifier"
	default n
	help
	  Samsung Key input event notifier

config SEC_PMIC_PWRKEY
	bool "Enable PMIC power key for key crash"
	help
	  SEC key crash for PMIC power key.

config SEC_PMIC_PWRKEY_DTNAME
	string "PMIC power key dt node name"
	depends on SEC_PMIC_PWRKEY
	default ""
	help
	  Select PMIC power key dt node with key code.

config DRV_SAMSUNG
	tristate "Samsung sec class/sysfs Feature"
	default n
	help
	  Samsung sysfs name 'sec' directory create.

config SEC_RELOC_GPIO
	tristate "Samsung Legacy-Style Relocated GPIO Interface for Factory Mode"
	default m
	depends on SEC_FACTORY
	help
	  TODO: help is not ready.	  

config SEC_FACTORY
	bool "SAMSUNG Factory build option"
	default n
	select CNSS2_DEBUG	
	help
	  Include some codes for Factory binary.
	  This option is enabled by Factory build option.
	  In samsung build script, '-F' enables this option.

config SEC_FACTORY_INTERPOSER
	bool "Samsung Factory interposer binary"
	default n
	help
	  Samsung Factory interposer binary.

config SAMSUNG_PRODUCT_SHIP
	bool "set up for product shipping"
	default n
	help
	  This option is enabled by SHIP build option.
	  In samsung build script, '-s' enables this option.

source "drivers/samsung/pm/Kconfig"

# drivers/samsung/Kconfig
#
# Copyright (c) 2010-2020 Samsung Electronics Co., Ltd.
#               http://www.samsung.com/
#
# Licensed under GPLv2
config SEC_REBOOT
	tristate "Enable Samsung reboot features"
	default n
	help
	  Samsung TN reboot extension Feature. Do additional work when reboot.
```

## kernel/drivers/samsung/pm/Kconfig
```kconfig
# drivers/samsung/pm/Kconfig
#
# Copyright (c) 2010-2021 Samsung Electronics Co., Ltd.
#		http://www.samsung.com/
#
# Licensed under GPLv2
#
comment "Samsung Mobile Power Management Options"
menuconfig SEC_PM
	bool "Samsung Mobile Power Management"
	default n
	help
	  This option enables support for various drivers and features for
	  Samsung Mobile Power Management.

config SEC_PM_DEBUG
	tristate "Enable Samsung Mobile Power management debug support"
	default n
	depends on SEC_PM
	help
	  This option enables Samsung Mobile Power management debug support.
	  Intended for test and debug only.
	  
config RTC_AUTO_PWRON
	tristate "RTC Auto Power on PMICs"
	default n
	depends on SEC_PM
	help
	  Support for the auto power on alarm on the PMIC.

config SEC_PM_REGULATOR
	tristate "Enable Samsung Mobile Power management regulator support"
	default n
	depends on SEC_PM
	help
	  This option enables Samsung Mobile Power management regulator support.

config SEC_WAKEUP_CPU_ALLOCATOR
	tristate "SEC Wakeup cpu support"
	depends on SEC_PM
	default n
	help
	  This driver supports SEC Wakeup cpu support
```

## kernel/drivers/sensorhub/vendor/Kconfig
```kconfig
config SHUB_LSI
	tristate "lsi sensorhub"
	default y
config SHUB_MTK
	tristate "Mediatek project"
	default n
```
