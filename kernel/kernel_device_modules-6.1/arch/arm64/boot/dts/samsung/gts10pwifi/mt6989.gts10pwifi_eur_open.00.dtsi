/* 
 * Generated by Samsung 
 * If these files should be changed, then please make a sync with MTK
*/

#include "mt6989-gts10pwifi_common.dtsi"
#include "mt6989-gts10pwifi_camera.dtsi"

/*End of this file, DO NOT ADD ANYTHING HERE*/
