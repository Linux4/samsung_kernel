/* 
 * Generated by Samsung 
 * If these files should be changed, then please make a sync with MTK
*/

#include "mt6989-gts10u_common.dtsi"
#include "mt6989-gts10u_camera.dtsi"

/*End of this file, DO NOT ADD ANYTHING HERE*/
