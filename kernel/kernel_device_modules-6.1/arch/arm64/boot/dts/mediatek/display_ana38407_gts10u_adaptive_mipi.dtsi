/*
 * SAMSUNG Panel Device Tree Source
 *
 * Copyright (c) Samsung Electronics Co., Ltd.
 *		http://www.samsung.com
 *
 * This program is free software; you can redistribute it and/or modify
 * it under the terms of the GNU General Public License version 2 as
 * published by the Free Software Foundation.
 */

#include <dt-bindings/display/rf-band-id.h>

/ {
	fragment@freq_hop {
		target-path = "/";
		__overlay__ {
			ana38407_gts10u_sdp_adaptive_mipi_info:
			ana38407_gts10u_sdp_adaptive_mipi_info {
				/* TABLE: ADAPTIVE MIPI V2: MIPI CLOCKS [kbps] */
				ADAPTIVE_MIPI_CLOCKS = <
					  1524000
					  1536000
					  1587000
				>;

				/* TABLE: ADAPTIVE MIPI V2: OSC CLOCKS [khz] */
				ADAPTIVE_OSC_CLOCKS = <
					  181300
				>;

				/* TABLE: ADAPTIVE MIPI V2: TABLE_10M */
				/* RAT BAND FROM END RATING_A RATING_B RATING_C */
				ADAPTIVE_MIPI_V2_CLK_SEL_TABLE_10M = <
					1	1	0	0	0	0	0
					1	2	0	0	0	147	0
					1	3	0	0	0	0	0
					1	4	0	0	0	0	63
					2	11	10562	10594	0	60	0
					2	11	10595	10838	0	0	0
					2	12	9662	9883	0	0	0
					2	12	9884	9938	0	0	60
					2	13	1162	1513	0	0	0
					2	14	1537	1569	0	60	0
					2	14	1570	1738	0	0	0
					2	15	4357	4458	0	0	0
					2	16	4387	4413	0	0	0
					2	17	2237	2424	0	0	0
					2	17	2425	2494	40	0	0
					2	17	2495	2529	0	0	0
					2	17	2530	2563	0	40	0
					2	18	2937	3027	0	0	0
					2	18	3028	3064	140	0	0
					2	18	3065	3088	140	140	0
					2	29	712	763	0	0	0
					3	91	0	89	0	60	0
					3	91	90	599	0	0	0
					3	92	600	1067	0	0	0
					3	92	1068	1199	0	0	60
					3	93	1200	1949	0	0	0
					3	94	1950	2039	0	60	0
					3	94	2040	2399	0	0	0
					3	95	2400	2649	0	0	0
					3	97	2750	3149	0	0	0
					3	97	3150	3289	40	0	0
					3	97	3290	3359	0	0	0
					3	97	3360	3449	0	40	0
					3	98	3450	3654	0	0	0
					3	98	3655	3729	140	0	0
					3	98	3730	3794	140	140	0
					3	98	3795	3799	0	140	0
					3	102	5010	5179	0	0	0
					3	103	5180	5269	0	0	0
					3	103	5270	5279	140	0	0
					3	104	5280	5309	140	0	0
					3	104	5310	5379	140	140	0
					3	107	5730	5849	0	0	0
					3	108	5850	5999	0	0	0
					3	109	6000	6149	0	0	0
					3	110	6150	6244	0	0	140
					3	110	6245	6449	0	0	0
					3	111	6450	6599	0	0	0
					3	115	8040	8507	0	0	0
					3	115	8508	8647	0	0	60
					3	115	8648	8689	0	0	0
					3	116	8690	9039	0	0	0
					3	118	9210	9239	140	0	0
					3	118	9240	9319	140	140	0
					3	118	9320	9379	0	140	0
					3	118	9380	9494	0	0	0
					3	118	9495	9634	0	0	140
					3	118	9635	9659	0	0	0
					3	119	9660	9769	0	0	0
					3	120	9770	9869	0	0	0
					3	122	9920	10359	0	0	0
					3	124	36200	36349	0	0	0
					3	128	37750	37768	0	0	0
					3	128	37769	37908	0	0	40
					3	128	37909	38249	0	0	0
					3	129	38250	38429	0	0	0
					3	129	38430	38569	60	0	0
					3	129	38570	38579	0	0	0
					3	129	38580	38649	0	60	0
					3	130	38650	38759	0	40	0
					3	130	38760	39384	0	0	0
					3	130	39385	39524	0	0	40
					3	130	39525	39649	0	0	0
					3	131	39650	39719	0	40	0
					3	131	39720	40408	0	0	0
					3	131	40409	40548	0	0	40
					3	131	40549	41289	0	0	0
					3	131	41290	41429	40	0	0
					3	131	41430	41499	0	0	0
					3	131	41500	41589	0	40	0
					3	132	41590	41810	0	0	0
					3	132	41811	41950	40	0	0
					3	132	41951	42080	0	0	0
					3	132	42081	42220	0	40	0
					3	132	42221	43227	0	0	0
					3	132	43228	43367	0	0	40
					3	132	43368	43589	0	0	0
					3	138	55240	55377	0	0	0
					3	138	55378	55517	0	0	40
					3	138	55518	55865	0	0	0
					3	138	55866	56005	40	0	0
					3	138	56006	56150	0	0	0
					3	138	56151	56290	0	40	0
					3	138	56291	56739	0	0	0
					3	156	66436	66525	0	60	0
					3	156	66526	67087	0	0	0
					3	156	67088	67227	0	0	60
					3	156	67228	67335	0	0	0
					3	161	68586	68935	0	0	0
					4	51	0	0	126	63	0
					4	52	0	0	63	0	0
					4	53	0	0	63	63	0
					4	54	0	0	0	0	9
					4	55	0	0	0	46	0
					4	56	0	0	63	63	0
					5	61	0	0	0	0	0
					5	62	0	0	0	0	63
					5	71	0	0	0	0	0
					7	256	422000	423780	0	60	0
					7	256	423781	433980	0	0	0
					7	257	386000	395340	0	0	0
					7	257	395341	397980	0	0	60
					7	258	361000	375980	0	0	0
					7	260	173800	178780	0	0	0
					7	262	524000	531980	0	0	0
					7	262	531981	534780	40	0	0
					7	262	534781	536180	0	0	0
					7	262	536181	538000	0	40	0
					7	263	185000	189080	0	0	0
					7	263	189081	190580	140	0	0
					7	263	190581	191880	140	140	0
					7	263	191881	191980	0	140	0
					7	267	145800	149200	0	0	0
					7	268	149200	150980	0	0	0
					7	268	150981	151200	140	0	0
					7	269	151600	152180	140	0	0
					7	269	152181	153580	140	140	0
					7	273	172000	175000	0	0	0
					7	275	158200	160080	0	0	140
					7	275	160081	164180	0	0	0
					7	280	386000	395340	0	0	0
					7	280	395341	398140	0	0	60
					7	280	398141	398980	0	0	0
					7	281	171800	178800	0	0	0
					7	283	151600	152180	140	0	0
					7	283	152181	153780	140	140	0
					7	283	153781	154980	0	140	0
					7	283	154981	157280	0	0	0
					7	283	157281	160080	0	0	140
					7	283	160081	160580	0	0	0
					7	284	143400	145580	0	0	0
					7	285	470000	471980	0	0	0
					7	293	514000	514360	0	0	0
					7	293	514361	517160	0	0	40
					7	293	517161	523980	0	0	0
					7	294	376000	379580	0	0	0
					7	294	379581	382380	60	0	0
					7	294	382381	382580	0	0	0
					7	294	382581	384000	0	60	0
					7	295	460000	462180	0	40	0
					7	295	462181	474680	0	0	0
					7	295	474681	477480	0	0	40
					7	295	477481	480000	0	0	0
					7	296	499200	500580	0	40	0
					7	296	500581	514360	0	0	0
					7	296	514361	517160	0	0	40
					7	296	517161	531980	0	0	0
					7	296	531981	534780	40	0	0
					7	296	534781	536180	0	0	0
					7	296	536181	537980	0	40	0
					7	303	636667	637567	0	0	0
					7	303	637568	638507	0	0	20
					7	303	638508	640827	0	0	0
					7	303	640828	641747	20	0	0
					7	303	641748	642727	0	0	0
					7	303	642728	643647	0	20	0
					7	303	643648	646666	0	0	0
					7	321	422000	423780	0	60	0
					7	321	423781	435020	0	0	0
					7	321	435021	437820	0	0	60
					7	321	437821	439980	0	0	0
					7	326	123400	130380	0	0	0
					7	332	620000	624340	0	0	0
					7	332	624341	625280	0	0	20
					7	332	625281	628120	0	0	0
					7	332	628121	629060	20	0	0
					7	332	629061	629920	0	0	0
					7	332	629921	630860	0	20	0
					7	332	630861	637580	0	0	0
					7	332	637581	638500	0	0	20
					7	332	638501	640820	0	0	0
					7	332	640821	641760	20	0	0
					7	332	641761	642720	0	0	0
					7	332	642721	643660	0	20	0
					7	332	643661	650800	0	0	0
					7	332	650801	651740	0	0	20
					7	332	651741	653520	0	0	0
					7	332	653521	654460	20	0	0
					7	332	654461	655520	0	0	0
					7	332	655521	656460	0	20	0
					7	332	656461	664020	0	0	0
					7	332	664021	664960	0	0	20
					7	332	664961	666220	0	0	0
					7	332	666221	667160	20	0	0
					7	332	667161	668320	0	0	0
					7	332	668321	669260	0	20	0
					7	332	669261	677240	0	0	0
					7	332	677241	678180	0	0	20
					7	332	678181	678920	0	0	0
					7	332	678921	679860	20	0	0
					7	332	679861	680000	0	0	0
					7	333	620000	624340	0	0	0
					7	333	624341	625280	0	0	20
					7	333	625281	628120	0	0	0
					7	333	628121	629060	20	0	0
					7	333	629061	629920	0	0	0
					7	333	629921	630860	0	20	0
					7	333	630861	637580	0	0	0
					7	333	637581	638500	0	0	20
					7	333	638501	640820	0	0	0
					7	333	640821	641760	20	0	0
					7	333	641761	642720	0	0	0
					7	333	642721	643660	0	20	0
					7	333	643661	650800	0	0	0
					7	333	650801	651740	0	0	20
					7	333	651741	653333	0	0	0
					7	334	693334	693934	0	0	0
					7	334	693935	694854	0	20	0
					7	334	694855	703694	0	0	0
					7	334	703695	704334	0	0	20
					7	334	704335	704634	20	0	20
					7	334	704635	705254	20	0	0
					7	334	705255	706734	0	0	0
					7	334	706735	707654	0	20	0
					7	334	707655	716934	0	0	0
					7	334	716935	717034	0	0	20
					7	334	717035	717854	20	0	20
					7	334	717855	717954	20	0	0
					7	334	717955	719534	0	0	0
					7	334	719535	720454	0	20	0
					7	334	720455	729734	0	0	0
					7	334	729735	730154	20	0	0
					7	334	730155	730654	20	0	20
					7	334	730655	731074	0	0	20
					7	334	731075	732334	0	0	0
					7	334	732335	733254	0	20	0
					7	334	733255	733333	0	0	0
				>;

				/* TABLE: ADAPTIVE MIPI V2: TABLE_20M */
				/* RAT BAND FROM END RATING_A RATING_B RATING_C */
				ADAPTIVE_MIPI_V2_CLK_SEL_TABLE_20M = <
					1	1	0	0	0	0	0
					1	2	0	0	0	147	0
					1	3	0	0	0	0	0
					1	4	0	0	0	0	63
					2	11	10562	10594	0	60	0
					2	11	10595	10838	0	0	0
					2	12	9662	9883	0	0	0
					2	12	9884	9938	0	0	60
					2	13	1162	1513	0	0	0
					2	14	1537	1569	0	60	0
					2	14	1570	1738	0	0	0
					2	15	4357	4458	0	0	0
					2	16	4387	4413	0	0	0
					2	17	2237	2424	0	0	0
					2	17	2425	2494	40	0	0
					2	17	2495	2529	0	0	0
					2	17	2530	2563	0	40	0
					2	18	2937	3027	0	0	0
					2	18	3028	3064	140	0	0
					2	18	3065	3088	140	140	0
					2	29	712	763	0	0	0
					3	91	0	139	0	60	0
					3	91	140	599	0	0	0
					3	92	600	619	0	60	0
					3	92	620	1017	0	0	0
					3	92	1018	1199	0	0	60
					3	93	1200	1949	0	0	0
					3	94	1950	2089	0	60	0
					3	94	2090	2399	0	0	0
					3	95	2400	2649	0	0	0
					3	97	2750	3099	0	0	0
					3	97	3100	3309	40	0	0
					3	97	3310	3339	40	40	0
					3	97	3340	3449	0	40	0
					3	98	3450	3604	0	0	0
					3	98	3605	3679	140	0	0
					3	98	3680	3799	140	140	0
					3	102	5010	5179	0	0	0
					3	103	5180	5219	0	0	0
					3	103	5220	5279	140	0	0
					3	104	5280	5379	140	140	0
					3	107	5730	5849	0	0	0
					3	108	5850	5999	0	0	0
					3	109	6000	6149	0	0	0
					3	110	6150	6294	0	0	140
					3	110	6295	6449	0	0	0
					3	111	6450	6599	0	0	0
					3	115	8040	8059	0	60	0
					3	115	8060	8457	0	0	0
					3	115	8458	8689	0	0	60
					3	116	8690	9039	0	0	0
					3	118	9210	9369	140	140	0
					3	118	9370	9429	0	140	0
					3	118	9430	9444	0	0	0
					3	118	9445	9659	0	0	140
					3	119	9660	9769	0	0	0
					3	120	9770	9869	0	0	0
					3	122	9920	10359	0	0	0
					3	124	36200	36349	0	0	0
					3	128	37750	37958	0	0	40
					3	128	37959	38249	0	0	0
					3	129	38250	38379	0	0	0
					3	129	38380	38529	60	0	0
					3	129	38530	38619	60	60	0
					3	129	38620	38649	0	60	0
					3	130	38650	38809	0	40	0
					3	130	38810	39334	0	0	0
					3	130	39335	39574	0	0	40
					3	130	39575	39649	0	0	0
					3	131	39650	39769	0	40	0
					3	131	39770	40358	0	0	0
					3	131	40359	40598	0	0	40
					3	131	40599	41239	0	0	0
					3	131	41240	41449	40	0	0
					3	131	41450	41479	40	40	0
					3	131	41480	41589	0	40	0
					3	132	41590	41760	0	0	0
					3	132	41761	42000	40	0	0
					3	132	42001	42030	0	0	0
					3	132	42031	42270	0	40	0
					3	132	42271	43177	0	0	0
					3	132	43178	43417	0	0	40
					3	132	43418	43589	0	0	0
					3	138	55240	55327	0	0	0
					3	138	55328	55567	0	0	40
					3	138	55568	55815	0	0	0
					3	138	55816	56055	40	0	0
					3	138	56056	56100	0	0	0
					3	138	56101	56340	0	40	0
					3	138	56341	56739	0	0	0
					3	156	66436	66575	0	60	0
					3	156	66576	67037	0	0	0
					3	156	67038	67277	0	0	60
					3	156	67278	67335	0	0	0
					3	161	68586	68935	0	0	0
					4	51	0	0	126	63	0
					4	52	0	0	63	0	0
					4	53	0	0	63	63	0
					4	54	0	0	0	0	63
					4	55	0	0	0	46	0
					4	56	0	0	63	63	0
					5	61	0	0	0	0	0
					5	62	0	0	0	0	63
					5	71	0	0	0	0	0
					7	256	422000	424780	0	60	0
					7	256	424781	433980	0	0	0
					7	257	386000	386380	0	60	0
					7	257	386381	394340	0	0	0
					7	257	394341	397980	0	0	60
					7	258	361000	375980	0	0	0
					7	260	173800	178780	0	0	0
					7	262	524000	530980	0	0	0
					7	262	530981	535180	40	0	0
					7	262	535181	535780	40	40	0
					7	262	535781	538000	0	40	0
					7	263	185000	188080	0	0	0
					7	263	188081	189580	140	0	0
					7	263	189581	191980	140	140	0
					7	267	145800	149200	0	0	0
					7	268	149200	149980	0	0	0
					7	268	149981	151200	140	0	0
					7	269	151600	153580	140	140	0
					7	273	172000	175000	0	0	0
					7	275	158200	161080	0	0	140
					7	275	161081	164180	0	0	0
					7	280	386000	386380	0	60	0
					7	280	386381	394340	0	0	0
					7	280	394341	398980	0	0	60
					7	281	171800	178800	0	0	0
					7	283	151600	154780	140	140	0
					7	283	154781	155980	0	140	0
					7	283	155981	156280	0	0	0
					7	283	156281	160580	0	0	140
					7	284	143400	145580	0	0	0
					7	285	470000	471980	0	0	0
					7	293	514000	518160	0	0	40
					7	293	518161	523980	0	0	0
					7	294	376000	378580	0	0	0
					7	294	378581	381580	60	0	0
					7	294	381581	383380	60	60	0
					7	294	383381	384000	0	60	0
					7	295	460000	463180	0	40	0
					7	295	463181	473680	0	0	0
					7	295	473681	478480	0	0	40
					7	295	478481	480000	0	0	0
					7	296	499200	501580	0	40	0
					7	296	501581	513360	0	0	0
					7	296	513361	518160	0	0	40
					7	296	518161	530980	0	0	0
					7	296	530981	535180	40	0	0
					7	296	535181	535780	40	40	0
					7	296	535781	537980	0	40	0
					7	303	636667	637247	0	0	0
					7	303	637248	638847	0	0	20
					7	303	638848	640487	0	0	0
					7	303	640488	642087	20	0	0
					7	303	642088	642387	0	0	0
					7	303	642388	643987	0	20	0
					7	303	643988	646666	0	0	0
					7	321	422000	424780	0	60	0
					7	321	424781	434020	0	0	0
					7	321	434021	438820	0	0	60
					7	321	438821	439980	0	0	0
					7	326	123400	130380	0	0	0
					7	332	620000	624020	0	0	0
					7	332	624021	625620	0	0	20
					7	332	625621	627800	0	0	0
					7	332	627801	629380	20	0	0
					7	332	629381	629600	0	0	0
					7	332	629601	631180	0	20	0
					7	332	631181	637240	0	0	0
					7	332	637241	638840	0	0	20
					7	332	638841	640500	0	0	0
					7	332	640501	642080	20	0	0
					7	332	642081	642400	0	0	0
					7	332	642401	643980	0	20	0
					7	332	643981	650460	0	0	0
					7	332	650461	652060	0	0	20
					7	332	652061	653200	0	0	0
					7	332	653201	654780	20	0	0
					7	332	654781	655200	0	0	0
					7	332	655201	656780	0	20	0
					7	332	656781	663700	0	0	0
					7	332	663701	665280	0	0	20
					7	332	665281	665900	0	0	0
					7	332	665901	667480	20	0	0
					7	332	667481	668000	0	0	0
					7	332	668001	669580	0	20	0
					7	332	669581	676920	0	0	0
					7	332	676921	678520	0	0	20
					7	332	678521	678600	0	0	0
					7	332	678601	680000	20	0	0
					7	333	620000	624020	0	0	0
					7	333	624021	625620	0	0	20
					7	333	625621	627800	0	0	0
					7	333	627801	629380	20	0	0
					7	333	629381	629600	0	0	0
					7	333	629601	631180	0	20	0
					7	333	631181	637240	0	0	0
					7	333	637241	638840	0	0	20
					7	333	638841	640500	0	0	0
					7	333	640501	642080	20	0	0
					7	333	642081	642400	0	0	0
					7	333	642401	643980	0	20	0
					7	333	643981	650460	0	0	0
					7	333	650461	652060	0	0	20
					7	333	652061	653200	0	0	0
					7	333	653201	653333	20	0	0
					7	334	693334	693594	0	0	0
					7	334	693595	695194	0	20	0
					7	334	695195	703374	0	0	0
					7	334	703375	703994	0	0	20
					7	334	703995	704974	20	0	20
					7	334	704975	705594	20	0	0
					7	334	705595	706394	0	0	0
					7	334	706395	707994	0	20	0
					7	334	707995	716594	0	0	0
					7	334	716595	716694	0	0	20
					7	334	716695	718194	20	0	20
					7	334	718195	718294	20	0	0
					7	334	718295	719194	0	0	0
					7	334	719195	720794	0	20	0
					7	334	720795	729394	0	0	0
					7	334	729395	729814	20	0	0
					7	334	729815	730994	20	0	20
					7	334	730995	731414	0	0	20
					7	334	731415	731994	0	0	0
					7	334	731995	733333	0	20	0
				>;
			};
		};
	};
};
