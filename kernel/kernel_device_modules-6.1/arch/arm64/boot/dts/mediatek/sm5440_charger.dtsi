&sw_i2c1 {
	status = "okay";

	sm5440_charger: sm5440@63 {
		compatible = "siliconmitus,sm5440";
		reg = <0x63>;
	};
};

/* /home/dpi/qb5_8814/workspace/P4_1716/android/kernel/kmodule/battery/suwon/charger/sm5440/sm5440_charger.gts10u(wifi).dtsi */
&sm5440_charger {
	sm5440,freq = <450>;
	sm5440,r_ttl = <500000>;
	sm5440,freq_siop = <250 250>;
	sm5440,en_vbatreg = <0>;
};
