## kernel/kernel_device_modules-6.1/drivers/spmi/Kconfig
```kconfig
# SPDX-License-Identifier: GPL-2.0-only
#
# SPMI driver configuration
#
if SPMI

config DEVICE_MODULES_SPMI_MTK_PMIF
	tristate "Mediatek SPMI Controller (PMIC Arbiter)"
	help
	  If you say yes to this option, support will be included for the
	  built-in SPMI PMIC Arbiter interface on Mediatek family
	  processors.

	  This is required for communicating with Mediatek PMICs and
	  other devices that have the SPMI interface.
endif
```

## kernel/kernel_device_modules-6.1/drivers/tee/Kconfig
```kconfig
# SPDX-License-Identifier: GPL-2.0-only
# Generic Trusted Execution Environment Configuration
if TEE

menu "TEE drivers"

config MTK_TEE_GP_SUPPORT
	bool "Enable MTK GlobalPlatform support in TEE related modules"
	default n
	depends on (TRUSTONIC_TEE_SUPPORT) || (MICROTRUST_TEE_SUPPORT)
	help
	  GlobalPlatform defines common/consistent APIs and this option
	  enables TEE related modules to use GPAPIs. (depending on
	  Trustonic TEE Support or Microtrust TEE Support or Google Trusty
	  TEE or other 3rd-party TEE)

config TEEGRIS_TEE_SUPPORT
	tristate "TEEGRIS_TEE_SUPPORT"
	default n
	depends on TZDEV
	help
	  TEEGRIS_TEE_SUPPORT

source "$(KCONFIG_EXT_PREFIX)drivers/tee/teeperf/Kconfig"
source "$(KCONFIG_EXT_PREFIX)drivers/tee/gud/Kconfig"
source "$(KCONFIG_EXT_PREFIX)drivers/tee/tzdev/Kconfig"
source "$(KCONFIG_EXT_PREFIX)drivers/tee/teei/Kconfig"
endmenu

endif
```

## kernel/kernel_device_modules-6.1/drivers/tee/tzdev/tests/Kconfig
```kconfig
if TZDEV_DEBUG

config TZ_PRINTK_TEST
	bool "TZ printk test helper module"
	default n
	help
	  Provide the way to minimally mimic iwlog in NWd and
	  spam messages into linux kmsg.

config TZASC_TEST
	bool "TZASC test helper module"
	default n
	help
	  Provide the way to allocate a region of DRAM suitable for protection by
	  a TZASC, get its physical address, and mmap it into userspace.

config TZASC_TEST_PAGE_ORDER
	int "TZASC test page allocation order"
	depends on TZASC_TEST
	help
	  Select TZASC test buffer page allocation order.

config TZPC_TEST
	bool "TZPC test helper module"
	default n
	help
	  Provide the way to try access to SSS device.

config TZ_MEMDUMP_TEST
	bool "TZ memdump test helper module"
	default n
	help
	  Provide the way to try to memdump from physical location.

config TZ_MMAP_TEST
	bool "TZ mmap test helper module"
	default n
	help
	  Provide the way to get physical address of a location with known
	  contents.

config EFUSE_TEST
	bool "efuse test Kernel Module"
	default n
	help
	  Say Y to enable efuse test kernel modules.

config TZ_CHTEST
	bool "Custom handler test Kernel Module"
	default n
	help
	  Provide ioctl to test custom handler functionality from NWd.

config TZ_CLK_TEST_HELPER
	bool "clk enable/disable helper module"
	default n
	help
	  Provide the way to enable and disable clocks for peripheral devices
	  from NWd.

config TZ_TEE_KERNEL_API_TEST
	bool "Kernel TEE client API test Kernel Module"
	default n
	help
	  Provide the way to test kernel-space implementation of TEE API.

config TZ_SCMA_TEST
	bool "SCMA test Kernel Module"
	default n
	help
	  Provide the way to map physical memory into userspace.

endif #TZDEV_DEBUG
```

## kernel/kernel_device_modules-6.1/drivers/thermal/Kconfig
```kconfig
# SPDX-License-Identifier: GPL-2.0-only
#
# Generic thermal drivers configuration
#

if THERMAL

menu "Mediatek thermal drivers"
depends on ARCH_MEDIATEK || COMPILE_TEST
source "$(KCONFIG_EXT_PREFIX)drivers/thermal/mediatek/Kconfig"
endmenu
```

## kernel/kernel_device_modules-6.1/drivers/tty/serial/8250/Kconfig
```kconfig
# SPDX-License-Identifier: GPL-2.0
#
# The 8250/16550 serial drivers.  You shouldn't be in this list unless
# you somehow have an implicit or explicit dependency on SERIAL_8250.
#

config DEVICE_MODULES_SERIAL_8250_MT6577
	tristate "Mediatek serial port support"
	depends on SERIAL_8250
	depends on ARCH_MEDIATEK || COMPILE_TEST
	help
	  If you have a Mediatek based board and want to use the
	  serial port, say Y to this option. If unsure, say N.
```

## kernel/kernel_device_modules-6.1/drivers/ufs/Kconfig
```kconfig
#
# Kernel configuration file for the UFS Host Controller
#
# This code is based on drivers/ufs/Kconfig
# Copyright (C) 2011-2013 Samsung India Software Operations
#
# Authors:
#	Santosh Yaraganavi <santosh.sy@samsung.com>
#	Vinayak Holikatti <h.vinayak@samsung.com>
#
# This program is free software; you can redistribute it and/or
# modify it under the terms of the GNU General Public License
# as published by the Free Software Foundation; either version 2
# of the License, or (at your option) any later version.
# See the COPYING file in the top-level directory or visit
# <http://www.gnu.org/licenses/gpl-2.0.html>
#
# This program is distributed in the hope that it will be useful,
# but WITHOUT ANY WARRANTY; without even the implied warranty of
# MERCHANTABILITY or FITNESS FOR A PARTICULAR PURPOSE.  See the
# GNU General Public License for more details.
#
# This program is provided "AS IS" and "WITH ALL FAULTS" and
# without warranty of any kind. You are solely responsible for
# determining the appropriateness of using and distributing
# the program and assume all risks associated with your exercise
# of rights with respect to the program, including but not limited
# to infringement of third party rights, the risks and costs of
# program errors, damage to or loss of data, programs or equipment,
# and unavailability or interruption of operations. Under no
# circumstances will the contributor of this Program be liable for
# any damages of any kind arising from your use or distribution of
# this program.

config DEVICE_MODULES_SCSI_UFS_MEDIATEK
	tristate "Mediatek specific hooks to UFS controller platform driver"
	depends on SCSI_UFSHCD_PLATFORM && ARCH_MEDIATEK
	select DEVICE_MODULES_PHY_MTK_UFS
	select DEVICE_MODULES_RESET_TI_SYSCON
	help
	  This selects the Mediatek specific additions to UFSHCD platform driver.
	  UFS host on Mediatek needs some vendor specific configuration before
	  accessing the hardware which includes PHY configuration and vendor
	  specific registers.

	  Select this if you have UFS controller on Mediatek chipset.

	  If unsure, say N.

config SCSI_UFS_MEDIATEK_DBG
	tristate "Debugging facility for MediaTek UFS platforms"
	depends on DEVICE_MODULES_SCSI_UFS_MEDIATEK
	help
	  This selects the debugging facility for Mediatek UFS platforms.
	  Provide UFS command history and connection to MediaTek Block IO
	  Tracer.

	  Select this if you want to enable above facilities.

	  If unsure, say N.

source "$(KCONFIG_EXT_PREFIX)drivers/ufs/vendor/Kconfig"

config MTK_UFS_DEBUG
	bool "Support Mediatek UFS upstreaming features"
	depends on SCSI_UFSHCD
	help
	  If it is enabled, all code sections that is under
	  upstream process or not pulled from the mainstream
	  are enabled.

	  If unsure, say N.

config MTK_UFS_DEBUG_BUILD
	bool "Support Mediatek UFS facilities in debug build only"
	depends on SCSI_UFSHCD
	help
	  This selects the debugging facility for Mediatek UFS platforms
	  existed in debug build only.

	  Select this if you want to enable above facilities.

	  If unsure, say N.
```

## kernel/kernel_device_modules-6.1/drivers/usb/Kconfig
```kconfig
# SPDX-License-Identifier: GPL-2.0

source "$(KCONFIG_EXT_PREFIX)drivers/usb/mtu3/Kconfig"

source "$(KCONFIG_EXT_PREFIX)drivers/usb/ss_function/Kconfig"
```

## kernel/kernel_device_modules-6.1/drivers/usb/ss_function/Kconfig
```kconfig
# SPDX-License-Identifier: GPL-2.0
#
# USB Gadget support on a system involves
#    (a) a peripheral controller, and
#    (b) the gadget driver using it.
#
# NOTE:  Gadget support ** DOES NOT ** depend on host-side CONFIG_USB !!
#
#  - Host systems (like PCs) need CONFIG_USB (with "A" jacks).
#  - Peripherals (like PDAs) need CONFIG_USB_GADGET (with "B" jacks).
#  - Some systems have both kinds of controllers.
#
# With help from a special transceiver and a "Mini-AB" jack, systems with
# both kinds of controller can also support "USB On-the-Go" (CONFIG_USB_OTG).
#

config DEVICE_MODULES_USB_SS_FUNCTIONS
	tristate "USB Gadget module Support"
	depends on USB_GADGET
	help
	  Say Y here if you want to use the Samsung USB Functios

if DEVICE_MODULES_USB_SS_FUNCTIONS

#
# SS USB Gadget Functios
#

# composite based drivers
config USB_F_DM
	tristate

config USB_F_CONN_GADGET
	tristate

config USB_F_SS_MON_GADGET
	tristate

# this first set of drivers all depend on bulk-capable hardware.

config USB_CONFIGFS_F_DM
        tristate "DM gadget"
        depends on USB_CONFIGFS
        select USB_F_DM
        help
          USB gadget DM(Diagnosis Monitor) support

config USB_CONFIGFS_F_CONN_GADGET
	tristate "Conn gadget function"
	depends on USB_CONFIGFS
	select USB_F_CONN_GADGET
	help
	  USB Sidesync function support

config USB_CONFIGFS_F_SS_MON_GADGET
	tristate "F_SAMSUNG gadget"
	depends on USB_CONFIGFS
	select USB_F_SS_MON_GADGET
	help
	 Driver for control to Samsung Usb device layer
	 For Samung working scenario and saving debug log, etc

endif # DEVICE_SS_USB_GADGET
```

## kernel/kernel_device_modules-6.1/drivers/watchdog/Kconfig
```kconfig
# SPDX-License-Identifier: GPL-2.0-only

#
# Watchdog device configuration
#

menuconfig WATCHDOG
	bool "Watchdog Timer Support"
	help
	  If you say Y here (and to one of the following options) and create a
	  character special file /dev/watchdog with major number 10 and minor
	  number 130 using mknod ("man mknod"), you will get a watchdog, i.e.:
	  subsequently opening the file and then failing to write to it for
	  longer than 1 minute will result in rebooting the machine. This
	  could be useful for a networked machine that needs to come back
	  on-line as fast as possible after a lock-up. There's both a watchdog
	  implementation entirely in software (which can sometimes fail to
	  reboot the machine) and a driver for hardware watchdog boards, which
	  are more robust and can also keep track of the temperature inside
	  your computer. For details, read
	  <file:Documentation/watchdog/watchdog-api.rst> in the kernel source.

	  The watchdog is usually used together with the watchdog daemon
	  which is available from
	  <https://ibiblio.org/pub/Linux/system/daemons/watchdog/>. This daemon
	  can also monitor NFS connections and can reboot the machine when the
	  process table is full.

	  If unsure, say N.

if WATCHDOG

config DEVICE_MODULES_MEDIATEK_WATCHDOG
	tristate "Mediatek SoCs watchdog support"
	depends on ARCH_MEDIATEK || COMPILE_TEST
	select WATCHDOG_CORE
	select RESET_CONTROLLER
	help
	  Say Y here to include support for the watchdog timer
	  in Mediatek SoCs.
	  To compile this driver as a module, choose M here: the
	  module will be called mtk_wdt.

endif # WATCHDOG
```

## kernel/kernel_device_modules-6.1/fs/f2fs/Kconfig
```kconfig
# SPDX-License-Identifier: GPL-2.0-only

config MTK_F2FS_DEBUG
	bool "mtk F2FS debug patch for userdebug and eng load"
	help
	  mtk F2FS debug patch for userdebug and eng load
```

## kernel/kernel_device_modules-6.1/kernel/time/Kconfig
```kconfig
# SPDX-License-Identifier: GPL-2.0-only
#
# Timer subsystem related configuration options
#

config ALARMTIMER_DEBUG
	bool "Alarmtimer Debug"
	help
	  This kernel config can be used to debug RTC (Real-time Clock)
          alarm not fire. When enable this option, we can get rtc alarm
          time and currnet time.
          If unsure, say N.
```
