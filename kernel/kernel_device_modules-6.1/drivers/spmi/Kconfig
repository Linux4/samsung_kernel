## kernel/kernel_device_modules-6.1/sound/soc/codecs/Kconfig
```kconfig
# SPDX-License-Identifier: GPL-2.0-only

menu "CODEC drivers"

config DEVICE_MODULES_SND_SOC_ALL_CODECS
	tristate "Build all ASoC CODEC drivers"
	depends on COMPILE_TEST
	imply DEVICE_MODULES_SND_SOC_MT6351
	imply DEVICE_MODULES_SND_SOC_MT6358
	imply DEVICE_MODULES_SND_SOC_MT6359
	imply SND_SOC_MT6359P
	imply SND_SOC_MT6368
	imply DEVICE_MODULES_SND_SOC_MT6369
	imply DEVICE_MODULES_SND_SOC_HDMI_CODEC
	imply DEVICE_MODULES_SND_SOC_CS35L45_SPI
	imply DEVICE_MODULES_SND_SOC_CS35L45_I2C
	imply SND_SOC_RT5512
	imply SND_SOC_TFA9874
	help
	  Normally ASoC codec drivers are only built if a machine driver which
	  uses them is also built since they are only usable with a machine
	  driver.  Selecting this option will allow these drivers to be built
	  without an explicit machine driver for test and development purposes.

	  Support for the bus types used to access the codecs to be built must
	  be selected separately.

	  If unsure select "N".

config DEVICE_MODULES_SND_SOC_WM_ADSP
	tristate
	select DEVICE_MODULES_CS_DSP
	select SND_SOC_COMPRESS
	default y if SND_SOC_MADERA=y
	default y if SND_SOC_CS47L24=y
	default y if SND_SOC_WM5102=y
	default y if SND_SOC_WM5110=y
	default y if SND_SOC_WM2200=y
	default y if SND_SOC_CS35L41_SPI=y
	default y if SND_SOC_CS35L41_I2C=y
	default y if SND_SOC_CS35L45_SPI=y
	default y if SND_SOC_CS35L45_I2C=y
	default m if SND_SOC_MADERA=m
	default m if SND_SOC_CS47L24=m
	default m if SND_SOC_WM5102=m
	default m if SND_SOC_WM5110=m
	default m if SND_SOC_WM2200=m
	default m if SND_SOC_CS35L41_SPI=m
	default m if SND_SOC_CS35L41_I2C=m
	default m if DEVICE_MODULES_SND_SOC_CS35L45_SPI=m
	default m if DEVICE_MODULES_SND_SOC_CS35L45_I2C=m

config DEVICE_MODULES_SND_SOC_CIRRUS_AMP
	tristate "Cirrus Logic Amp Feature drivers"
	help
	  Enable support for Cirrus Logic smart speaker amplifier factory
	  driver. Supports various smart amp functions, such as firmware
	  calibration, data logging, etc. Compatible with CS35L40 and CS35L46
	  amplifiers.

config DEVICE_MODULES_SND_SOC_CS35L45
	tristate "Cirrus Logic CS35L45 CODEC"
	depends on DEVICE_MODULES_SND_SOC_CS35L45_SPI || DEVICE_MODULES_SND_SOC_CS35L45_I2C
	select DEVICE_MODULES_SND_SOC_WM_ADSP
	select REGMAP_IRQ
	help
	  Enable support for Cirrus Logic CS35L45 smart speaker amplifier.
	  This amplifier supports control over I2C, SPI, and SoundWire.
	  PCM audio streaming supported over I2S/TDM and SoundWire.
	  Intended for use with Cirrus Logic WM ADSP framework.

config DEVICE_MODULES_SND_SOC_CS35L45_SPI
	tristate "Cirrus Logic CS35L45 CODEC (SPI)"
	depends on SPI_MASTER
	select DEVICE_MODULES_SND_SOC_CS35L45
	select REGMAP_SPI

config DEVICE_MODULES_SND_SOC_CS35L45_I2C
	tristate "Cirrus Logic CS35L45 CODEC (I2C)"
	depends on I2C
	select DEVICE_MODULES_SND_SOC_CS35L45
	select REGMAP_I2C

config DEVICE_MODULES_SND_SOC_HDMI_CODEC
	tristate
	select SND_PCM_ELD
	select SND_PCM_IEC958
	select HDMI

config SND_SOC_RT5512
	tristate "Mediatek RT5512 speaker amplifier"
	depends on I2C
	help
	  Config of RT5512. It is a Smart power
	  amplifier which contain speaker protection,
	  multi-band DRC, equalizer function. It would
	  be set to yes if device with RT5512 on it.

config SND_SOC_TFA9874
	tristate "NXP TFA9874 speaker amplifier"
	depends on I2C
	help
	  Config of TFA9874. It is a Smart power
	  amplifier which contain speaker protection,
	  multi-band DRC, equalizer function. It would
	  be set to yes if device with TFA9874 on it.

config SND_SOC_MT6338
	tristate "MediaTek MT6338 Codec driver"
	depends on MFD_MT6338
	help
	  MediaTek MT6338 is a audio codec which contain
	  three ADC for uplink path(MICs), and
	  three DAC for downlink path(handset,
	  headset, lineout).

config SND_SOC_MT6338_ACCDET
	tristate "MediaTek MT6338 ACCDET driver"
	depends on MFD_MT6338
	help
	  ACCDET means Accessory Detection technology,
	  MediaTek develop it for ASoC codec soc-jack
	  detection mechanism. Select N if you don't
	  have jack on board.

config DEVICE_MODULES_SND_SOC_MT6351
	tristate "MediaTek MT6351 Codec"

config DEVICE_MODULES_SND_SOC_MT6358
	tristate "MediaTek MT6358 Codec"
	help
	  Enable support for the platform which uses MT6358 as
	  external codec device.

config DEVICE_MODULES_SND_SOC_MT6359
	tristate "MediaTek MT6359 Codec"
	depends on DEVICE_MODULES_MTK_PMIC_WRAP
	help
	  Enable support for the platform which uses MT6359 as
	  external codec device.

config DEVICE_MODULES_SND_SOC_MT6359_ACCDET
	tristate "MediaTek MT6359 ACCDET driver"
	depends on DEVICE_MODULES_MTK_PMIC_WRAP
	help
	  ACCDET means Accessory Detection technology, MediaTek develop it
	  for ASoC codec soc-jack detection mechanism.
	  Select N if you don't have jack on board.

config SND_SOC_MT6359P
	tristate "MediaTek MT6359P Codec driver"
	help
	  MediaTek MT6359P is a codec which contain
	  three ADC for uplink path(MICs), and
	  three DAC for downlink path(handset,
	  headset, lineout).

config SND_SOC_MT6359P_ACCDET
	tristate "MediaTek MT6359 ACCDET driver"
	default m
	help
	  ACCDET means Accessory Detection technology, MediaTek develop it
	  for ASoC codec soc-jack detection mechanism.
	  Select N if you don't have jack on board.

config SND_SOC_MT6368
	tristate "MediaTek MT6368 Codec driver"
	help
	  MediaTek MT6368 is a audio codec which contain
	  three ADC for uplink path(MICs), and
	  three DAC for downlink path(handset,
	  headset, lineout).

config SND_SOC_MT6368_ACCDET
	tristate "MediaTek MT6368 ACCDET driver"
	depends on MFD_MTK_SPMI_PMIC
	help
	  ACCDET means Accessory Detection technology,
	  MediaTek develop it for ASoC codec soc-jack
	  detection mechanism. Select N if you don't
	  have jack on board.

config SND_SOC_MT6369_ACCDET
	tristate "MediaTek MT6369 ACCDET driver"
	depends on MFD_MTK_SPMI_PMIC
	help
	  ACCDET means Accessory Detection technology,
	  MediaTek develop it for ASoC codec soc-jack
	  detection mechanism. Select N if you don't
	  have jack on board.

config DEVICE_MODULES_SND_SOC_MT6369
	tristate "MediaTek MT6369 Codec driver"
	help
	  MediaTek MT6369 is a audio codec which contain
	  three ADC for uplink path(MICs), and
	  three DAC for downlink path(handset,
	  headset, lineout).

config SND_SOC_MT6681
	tristate "MediaTek MT6681 Codec driver"
	depends on MFD_MT6681
	help
	  MediaTek MT6681 is a audio codec which contain
	  three ADC for uplink path(MICs), and
	  three DAC for downlink path(handset,
	  headset, lineout).

config SND_SOC_MT6681_ACCDET
	tristate "MediaTek MT6681 ACCDET driver"
	depends on MFD_MT6681
	help
	  ACCDET means Accessory Detection technology,
	  MediaTek develop it for ASoC codec soc-jack
	  detection mechanism. Select N if you don't
	  have jack on board.

endmenu
```

## kernel/kernel_device_modules-6.1/sound/soc/mediatek/Kconfig
```kconfig
# SPDX-License-Identifier: GPL-2.0-only
config DEVICE_MODULES_SND_SOC_MEDIATEK
	tristate

config SND_SOC_MTK_SMART_PHONE
	tristate "Mediatek Smart Phone PCM Operation"
	help
	  Mediatek PCM operation which is specific for
	  smart phone product.
	  Select Y if product is smart phone.
	  If unsure select "N".

config SND_SOC_MTK_SRAM
	tristate "Mediatek Audio SRAM Management"
	help
	  Mediatek Audio SRAM management for
	  normal mode and compact mode.
	  Select Y if you use this SRAM management.
	  If unsure select "N".

config SND_SOC_MT6853
	tristate "ASoC support for Mediatek MT6853 chip"
	depends on ARCH_MEDIATEK
	select DEVICE_MODULES_SND_SOC_MEDIATEK
	select SND_SOC_MTK_SRAM
	select SND_SOC_MTK_SMART_PHONE
	help
	  This adds ASoC driver for Mediatek MT6853 boards
	  that can be used with other codecs.
	  Select Y if you have such device.
	  If unsure select "N".

config SND_SOC_MT6853_MT6359P
	tristate "ASoc Audio driver for MT6853 with MT6359P codec"
	depends on SND_SOC_MT6853
	select SND_SOC_MT6359P
	help
	  This adds ASoC driver for Mediatek MT6853 boards
	  with the MT6359P codecs.
	  Select Y if you have such device.
	  If unsure select "N".

config SND_SOC_MT6873
	tristate "ASoC support for Mediatek MT6873 chip"
	depends on ARCH_MEDIATEK
	select DEVICE_MODULES_SND_SOC_MEDIATEK
	select SND_SOC_MTK_SRAM
	select SND_SOC_MTK_SMART_PHONE
	help
	  This adds ASoC driver for Mediatek MT6873 boards
	  that can be used with other codecs.
	  Select Y if you have such device.
	  If unsure select "N".

config SND_SOC_MT6873_MT6359P
	tristate "ASoc Audio driver for MT6873 with MT6359P codec"
	depends on SND_SOC_MT6873
	select SND_SOC_MT6359P
	help
	  This adds ASoC driver for Mediatek MT6873 boards
	  with the MT6359P codecs.
	  Select Y if you have such device.
	  If unsure select "N".

config DEVICE_MODULES_SND_SOC_MT6878
	tristate "ASoC support for Mediatek MT6878 chip"
	depends on ARCH_MEDIATEK
	select DEVICE_MODULES_SND_SOC_MEDIATEK
	select SND_SOC_MTK_SRAM
	select SND_SOC_MTK_SMART_PHONE
	help
	  This adds ASoC driver for Mediatek MT6878 boards
	  that can be used with other codecs.
	  Select Y if you have such device.
	  If unsure select "N".

config DEVICE_MODULES_SND_SOC_MT6878_MT6369
	tristate "ASoc Audio driver for MT6878 with MT6369 codec"
	depends on DEVICE_MODULES_SND_SOC_MT6878
	select DEVICE_MODULES_SND_SOC_MT6369
	help
	  This adds ASoC driver for Mediatek MT6878 boards
	  with the MT6369 codecs.
	  Select Y if you have such device.
	  If unsure select "N".

config SND_SOC_MT6886
	tristate "ASoC support for Mediatek MT6886 chip"
	depends on ARCH_MEDIATEK
	select DEVICE_MODULES_SND_SOC_MEDIATEK
	select SND_SOC_MTK_SRAM
	select SND_SOC_MTK_SMART_PHONE
	help
	  This adds ASoC driver for Mediatek MT6886 boards
	  that can be used with other codecs.
	  Select Y if you have such device.
	  If unsure select "N".

config SND_SOC_MT6886_MT6368
	tristate "ASoc Audio driver for MT6886 with MT6368 codec"
	depends on SND_SOC_MT6886
	select SND_SOC_MT6368
	help
	  This adds ASoC driver for Mediatek MT6886 boards
	  with the MT6368 codecs.
	  Select Y if you have such device.
	  If unsure select "N".

config SND_SOC_MT6897
	tristate "ASoC support for Mediatek MT6897 chip"
	depends on ARCH_MEDIATEK
	select DEVICE_MODULES_SND_SOC_MEDIATEK
	select SND_SOC_MTK_SRAM
	select SND_SOC_MTK_SMART_PHONE
	help
	  This adds ASoC driver for Mediatek MT6897 boards
	  that can be used with other codecs.
	  Select Y if you have such device.
	  If unsure select "N".

config SND_SOC_MT6897_MT6368
	tristate "ASoc Audio driver for MT6897 with MT6368 codec"
	depends on SND_SOC_MT6897
	select SND_SOC_MT6368
	help
	  This adds ASoC driver for Mediatek MT6897 boards
	  with the MT6368 codecs.
	  Select Y if you have such device.
	  If unsure select "N".

config SND_SOC_MT6983
	tristate "ASoC support for Mediatek MT6983 chip"
	depends on ARCH_MEDIATEK
	select DEVICE_MODULES_SND_SOC_MEDIATEK
	select SND_SOC_MTK_SRAM
	select SND_SOC_MTK_SMART_PHONE
	help
	  This adds ASoC driver for Mediatek MT6983 boards
	  that can be used with other codecs.
	  Select Y if you have such device.
	  If unsure select "N".

config SND_SOC_MT6983_MT6338
	tristate "ASoc Audio driver for MT6983 with MT6338 codec"
	depends on SND_SOC_MT6983
	select SND_SOC_MT6338
	help
	  This adds ASoC driver for Mediatek MT6983 boards
	  with the MT6338 codecs.
	  Select Y if you have such device.
	  If unsure select "N".

config SND_SOC_MT6985
	tristate "ASoC support for Mediatek MT6985 chip"
	depends on ARCH_MEDIATEK
	select DEVICE_MODULES_SND_SOC_MEDIATEK
	select SND_SOC_MTK_SRAM
	select SND_SOC_MTK_SMART_PHONE
	help
	  This adds ASoC driver for Mediatek MT6985 boards
	  that can be used with other codecs.
	  Select Y if you have such device.
	  If unsure select "N".

config SND_SOC_MT6985_MT6338
	tristate "ASoc Audio driver for MT6985 with MT6338 codec"
	depends on SND_SOC_MT6985
	select SND_SOC_MT6338
	help
	  This adds ASoC driver for Mediatek MT6985 boards
	  with the MT6338 codecs.
	  Select Y if you have such device.
	  If unsure select "N".

config SND_SOC_MT6989
	tristate "ASoC support for Mediatek MT6989 chip"
	depends on ARCH_MEDIATEK
	select DEVICE_MODULES_SND_SOC_MEDIATEK
	select SND_SOC_MTK_SRAM
	select SND_SOC_MTK_SMART_PHONE
	help
	  This adds ASoC driver for Mediatek MT6989 boards
	  that can be used with other codecs.
	  Select Y if you have such device.
	  If unsure select "N".

config SND_SOC_MT6989_MT6681
	tristate "ASoc Audio driver for MT6989 with MT6681 codec"
	depends on SND_SOC_MT6989
	select SND_SOC_MT6681
	help
	  This adds ASoC driver for Mediatek MT6989 boards
	  with the MT6681 codecs.
	  Select Y if you have such device.
	  If unsure select "N".

config DEVICE_MODULES_SND_SOC_MTK_BTCVSD
	tristate "ALSA BT SCO CVSD/MSBC Driver"
	help
	  This is for software BTCVSD. This enable
	  the function for transferring/receiving
	  BT encoded data to/from BT firmware.
	  Select Y if you have such device.
	  If unsure select "N".

config SND_SOC_MTK_OFFLOAD
	tristate "Audio DSP MP3/AAC offload support"
	help
	  This add compress offload driver. This enable
	  the function for offloading MP3/AAC playback
	  to audiodsp.
	  Select Y if you have such device.
	  If unsure select "N".

config SND_SOC_MTK_AUDIO_DSP
	tristate "ASoC support for Mediatek audiodsp chip"
	depends on MTK_AUDIODSP_SUPPORT
	select SND_SOC_COMPRESS
	help
	  This adds dsp driver for Mediatek boards
	  that can be used with other platforms

config MTK_ULTRASND_PROXIMITY
	tristate "MTK ultra sound proximity support"
	help
	  For ultra sound proximity kernel driver config.
	  This ultra sound proximity kernel driver
	  cooperate with SCP ultra sound driver to
	  emulate physical proximity sensor. Using
	  IPI interface to communicate with SCP side and
	  be controlled by sensor hal.


config SND_SOC_MT8188
	tristate "ASoC support for Mediatek MT8188 chip"
	select DEVICE_MODULES_SND_SOC_MEDIATEK
	help
	  This adds ASoC platform driver support for Mediatek MT8188 chip
	  that can be used with other codecs.
	  Select Y if you have such device.
	  If unsure select "N".

config SND_SOC_MT8188_ADSP
	tristate "ADSP support for Mediatek MT8188 chip"
	depends on SND_SOC_MT8188 && MTK_HIFIXDSP_SUPPORT
	help
	  This adds ADSP platform driver support for Mediatek MT8188 chip
	  that can be used with other codecs.
	  Select Y if you have such device.
	  If unsure select "N".

config SND_SOC_MT8188_EVB
	tristate "ASoC Audio driver for MT8188 EVB"
	depends on SND_SOC_MT8188
	select DEVICE_MODULES_SND_SOC_HDMI_CODEC
	help
	  This adds ASoC driver for Mediatek MT8188 boards
	  with the PMIC Audio.
	  Select Y if you have such device.
	  If unsure select "N".

config MTK_SCP_AUDIO
	tristate "ASoC support for Mediatek scp audio chip"
	help
	  This adds scp audio driver for Mediatek boards
	  that can be used with other platforms
	  Select Y if you have such device.
	  If unsure select "N".
```

## kernel/kernel_device_modules-6.1/sound/soc/samsung/Kconfig
```kconfig
# SPDX-License-Identifier: GPL-2.0-only

#
config SND_SOC_SAMSUNG_AUDIO
	tristate "Audio support for Samsung Projects"
	help
	  Say Y here to enable audio support for the Samsung Audio.
```

## kernel_platform/common/drivers/misc/huaqin/Kconfig
```kconfig
config RECORD_CRASH_INFO
    tristate "record crash info"
    help
      record crash info for display
```
