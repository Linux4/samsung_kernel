## kernel_platform/msm-kernel/arch/arm64/configs/oem/pineapple_sec_defconfig
```kconfig
# SEC_BSP / SEC_DEBUG
CONFIG_SOFT_WATCHDOG=m
CONFIG_SEC_CLASS=m
CONFIG_SEC_PARAM=m
CONFIG_SEC_KEY_NOTIFIER=m
CONFIG_SEC_RELOC_GPIO=m
CONFIG_SEC_QC_PARAM=m
CONFIG_SEC_DEBUG=m
CONFIG_SEC_BOOT_STAT=m
CONFIG_SEC_LOG_BUF=m
CONFIG_SEC_LOG_BUF_USING_TP_CONSOLE=y
CONFIG_SEC_PMSG=m
CONFIG_SEC_REBOOT_CMD=m
CONFIG_SEC_UPLOAD_CAUSE=m
CONFIG_SEC_CRASHKEY=m
CONFIG_SEC_CRASHKEY_LONG=m
CONFIG_SEC_DEBUG_REGION=m
CONFIG_SEC_RDX_BOOTDEV=m
CONFIG_SEC_ARM64_AP_CONTEXT=m
CONFIG_SEC_ARM64_FSIMD_DEBUG=m
CONFIG_SEC_ARM64_DEBUG=m
CONFIG_SEC_QC_DEBUG=m
CONFIG_SEC_QC_RBCMD=m
CONFIG_SEC_QC_DEBUG_PARTITION=m
CONFIG_SEC_QC_QCOM_REBOOT_REASON=m
CONFIG_SEC_QC_UPLOAD_CAUSE=m
CONFIG_SEC_QC_LOGGER=m
CONFIG_SEC_QC_SOC_ID=m
CONFIG_SEC_QC_SUMMARY=m
CONFIG_SEC_QC_USER_RESET=m
CONFIG_SEC_QC_HW_PARAM=m
CONFIG_SEC_QC_RST_EXINFO=m
CONFIG_SEC_QC_QCOM_WDT_CORE=m
CONFIG_SEC_QC_SMEM=m
CONFIG_I2C_GPIO=m

#Audio
CONFIG_SND_SOC_CIRRUS_AMP=m
CONFIG_SND_SOC_CS35L43=m
CONFIG_SND_SOC_CS35L43_I2C=m
CONFIG_SND_SOC_SAMSUNG_AUDIO=m

# Display
CONFIG_LCD_CLASS_DEVICE=m

#POWER
CONFIG_SEC_PM=y
CONFIG_SEC_AP_PMIC=m
CONFIG_SEC_GPIO_DUMP=y
CONFIG_CPU_FREQ_LIMIT=m
CONFIG_RTC_AUTO_PWRON=m

#USB
CONFIG_I2C_EUSB2_REPEATER=m
CONFIG_USB_PHY_SETTING_QCOM=y
CONFIG_USB_ANNOUNCE_NEW_DEVICES=y
# CONFIG_SND_QC_USB_AUDIO_MODULE=m
# CONFIG_SUPPORT_USB_TYPEC_OPS=y
CONFIG_USB_CONFIGFS_F_CONN_GADGET=m
CONFIG_USB_CONFIGFS_F_SS_MON_GADGET=m
CONFIG_USB_CONFIGFS_F_SS_ACM=m
CONFIG_USB_LINK_LAYER_TEST=m
CONFIG_USB_NET_SMSC75XX=m
CONFIG_USB_NET_SMSC95XX=m
CONFIG_USB_EHSET_TEST_FIXTURE=m
CONFIG_USB_HOST_SAMSUNG_FEATURE=y

# Sensors
CONFIG_ADSP_FACTORY=m
CONFIG_SENSORS=m
CONFIG_LSM6DSO_FACTORY=y
CONFIG_AK09918_FACTORY=y
CONFIG_SUPPORT_LIGHT_SEAMLESS=y
CONFIG_SEC_SENSORS_SSC=y

# block layer
CONFIG_BLK_SEC_COMMON=m
CONFIG_BLK_SEC_STATS=m
CONFIG_BLK_SEC_WB=m
CONFIG_MQ_IOSCHED_SSG=m
CONFIG_MQ_IOSCHED_SSG_CGROUP=m
CONFIG_MQ_IOSCHED_SSG_WB=m

# UFS
CONFIG_SEC_UFS_FEATURE=y

# PCIE
CONFIG_SEC_PCIE=y
CONFIG_SEC_PCIE_AER=y
CONFIG_SEC_PCIE_L1SS=y

# Network
CONFIG_INET6_AH=y
CONFIG_IP_NF_MATCH_AH=y
CONFIG_IP_NF_MATCH_RPFILTER=y
CONFIG_TCP_CONG_ADVANCED=y
CONFIG_TCP_CONG_BIC=y
# CONFIG_TCP_CONG_WESTWOOD is not set
# CONFIG_TCP_CONG_HTCP is not set
CONFIG_DEFAULT_BIC=y
CONFIG_DEFAULT_TCP_CONG="bic"
CONFIG_IPC_LOGGING_CDEV=m

# Performance
CONFIG_RQ_STAT_SHOW=y


CONFIG_SAMSUNG_PRODUCT_SHIP=y


# CONFIG_SEC_FACTORY is not set


# CONFIG_SEC_FACTORY_INTERPOSER is not set
```

## kernel_platform/msm-kernel/arch/arm64/configs/vendor/kalama_sec_defconfig
```kconfig
#SEC_DEBUG
CONFIG_SOFT_WATCHDOG=m
CONFIG_SEC_KEY_NOTIFIER=m
CONFIG_SEC_CLASS=m
CONFIG_SEC_PARAM=m
CONFIG_SEC_DEBUG=m
CONFIG_SEC_LOG_BUF=m
CONFIG_SEC_REBOOT_CMD=m
CONFIG_SEC_UPLOAD_CAUSE=m
CONFIG_SEC_CRASHKEY=m
CONFIG_SEC_CRASHKEY_LONG=m
CONFIG_SEC_DEBUG_REGION=m
CONFIG_SEC_PMSG=m
CONFIG_SEC_BOOT_STAT=m
CONFIG_SEC_ARM64_AP_CONTEXT=m
CONFIG_SEC_ARM64_FSIMD_DEBUG=m
CONFIG_SEC_ARM64_DEBUG=m
CONFIG_SEC_QC_DEBUG=m
CONFIG_SEC_QC_PARAM=m
CONFIG_SEC_QC_LOGGER=m
CONFIG_SEC_QC_QCOM_WDT_CORE=m
CONFIG_SEC_QC_RBCMD=m
CONFIG_SEC_QC_QCOM_REBOOT_REASON=m
CONFIG_SEC_QC_UPLOAD_CAUSE=m
CONFIG_SEC_QC_DEBUG_PARTITION=m
CONFIG_SEC_QC_SUMMARY=m
CONFIG_SEC_QC_USER_RESET=m
CONFIG_SEC_QC_SMEM=m
CONFIG_SEC_QC_HW_PARAM=m
CONFIG_SEC_QC_RST_EXINFO=m
CONFIG_SEC_QC_RDX_BOOTDEV=m
CONFIG_SEC_QC_SOC_ID=m

# Sensors
CONFIG_ADSP_FACTORY=m
CONFIG_SENSORS=m
CONFIG_LSM6DSO_FACTORY=y
CONFIG_AK09918_FACTORY=y
CONFIG_SUPPORT_LIGHT_SEAMLESS=y
CONFIG_SEC_SENSORS_SSC=y
CONFIG_RPMSG_QCOM_GLINK_DEBUG=y

# Display
CONFIG_LCD_CLASS_DEVICE=m
# CONFIG_SEC_FACTORY is not set

#POWER
CONFIG_SEC_PM=y
CONFIG_SEC_AP_PMIC=m
CONFIG_SEC_GPIO_DUMP=m
CONFIG_CPU_FREQ_LIMIT=m
CONFIG_SEC_PM_LOG=m
CONFIG_RTC_AUTO_PWRON=m
# CONFIG_SEC_EXT_THERMAL_MONITOR is not set

#Audio
CONFIG_SND_SOC_SAMSUNG_AUDIO=m
CONFIG_SND_SOC_CIRRUS_AMP=m
CONFIG_SND_SOC_CS35L43=m
CONFIG_SND_SOC_CS35L43_I2C=m
CONFIG_SND_SOC_CS35L45=m
CONFIG_SND_SOC_CS35L45_I2C=m
CONFIG_SND_SOC_CIRRUS_REINIT_SYSFS=y

#USB
CONFIG_USB_NOTIFY_LAYER=m
CONFIG_USB_NOTIFY_PROC_LOG=y
CONFIG_USB_HOST_NOTIFY=y
CONFIG_USB_EXTERNAL_NOTIFY=y
CONFIG_USB_NOTIFIER=m
CONFIG_USB_HW_PARAM=y
CONFIG_USB_USBNET=y
CONFIG_USB_RTL8152=y
CONFIG_USB_RTL8150=y
CONFIG_USB_NET_SMSC75XX=m
CONFIG_USB_NET_SMSC95XX=m
CONFIG_USB_HOST_SAMSUNG_FEATURE=y
CONFIG_USB_ANNOUNCE_NEW_DEVICES=y
CONFIG_USB_DEBUG_DETAILED_LOG=y
CONFIG_USB_INTERFACE_LPM_LIST=y
# CONFIG_SND_QC_USB_AUDIO_MODULE=m
# CONFIG_SUPPORT_USB_TYPEC_OPS=y
CONFIG_USB_CONFIGFS_F_CONN_GADGET=m
CONFIG_USB_CONFIGFS_F_SS_MON_GADGET=m
CONFIG_USB_CONFIGFS_F_SS_ACM=m
CONFIG_I2C_EUSB2_REPEATER=m
CONFIG_USB_AUDIO_POWER_SAVING=y

# Switch
CONFIG_SWITCH=m
CONFIG_SWITCH_GPIO=m

# UFS
CONFIG_SEC_UFS_FEATURE=y
CONFIG_SEC_UFS_CMD_LOGGING=y

# SD
CONFIG_SEC_MMC_FEATURE=y

# PCIE
CONFIG_SEC_PCIE=y
CONFIG_SEC_PCIE_AER=y
CONFIG_SEC_PCIE_L1SS=y

# Wi-Fi
# CONFIG_CNSS2_DEBUG is not set

# AIR
CONFIG_SEC_AUTO_INPUT=m

# I/O
CONFIG_MQ_IOSCHED_SSG=m
CONFIG_MQ_IOSCHED_SSG_CGROUP=m
CONFIG_MQ_IOSCHED_SSG_WB=m
CONFIG_BLK_SEC_STATS=m
CONFIG_BLK_SEC_COMMON=m
CONFIG_BLK_SEC_WB=m



CONFIG_SAMSUNG_PRODUCT_SHIP=y


# Network
CONFIG_INET6_AH=y
CONFIG_IP_NF_MATCH_AH=y
CONFIG_IP_NF_MATCH_RPFILTER=y
CONFIG_TCP_CONG_ADVANCED=y
CONFIG_TCP_CONG_BIC=y
# CONFIG_TCP_CONG_WESTWOOD is not set
# CONFIG_TCP_CONG_HTCP is not set
CONFIG_DEFAULT_BIC=y
CONFIG_DEFAULT_TCP_CONG="bic"

CONFIG_QRTR_WS_DEBUG=m

# Performance
CONFIG_RQ_STAT_SHOW=y
CONFIG_SCHED_POWER_OPTIMIZE=y

#VOLD ASEC
CONFIG_CRYPTO_TWOFISH=m






# CONFIG_SEC_FACTORY_INTERPOSER is not set
```

## kernel_platform/msm-kernel/arch/arm64/configs/vendor/kalama_sec_eng_defconfig
```kconfig
# kalama_sec_eng_defconfig
CONFIG_SEC_FORCE_ERR=y

CONFIG_SEC_GPIO_DVS=m

CONFIG_USB_PHY_TUNING_QCOM=y
CONFIG_SEC_PCIE_DEV=y

# Battery driver
CONFIG_ENG_BATTERY_CONCEPT=y

# ABC driver bootc eng option
CONFIG_SEC_ABC_HUB_BOOTC_ENG=m

# UFS
CONFIG_UFS_DBG=y

CONFIG_SEC_CDSP_NO_CRASH_FOR_ENG=y
```

## kernel_platform/msm-kernel/arch/arm64/configs/vendor/kalama_sec_userdebug_defconfig
```kconfig
# kalama_sec_userdebug_defconfig
CONFIG_SEC_FORCE_ERR=y

CONFIG_SEC_GPIO_DVS=m

CONFIG_USB_PHY_TUNING_QCOM=y
```

## kernel_platform/msm-kernel/arch/arm64/configs/vendor/m269_sec_defconfig
```kconfig
#SEC_DEBUG
CONFIG_SOFT_WATCHDOG=m
CONFIG_SEC_KEY_NOTIFIER=m
CONFIG_SEC_CLASS=m
CONFIG_SEC_PARAM=m
CONFIG_SEC_DEBUG=m
CONFIG_SEC_LOG_BUF=m
CONFIG_SEC_REBOOT_CMD=m
CONFIG_SEC_UPLOAD_CAUSE=m
CONFIG_SEC_CRASHKEY=m
CONFIG_SEC_CRASHKEY_LONG=m
CONFIG_SEC_DEBUG_REGION=m
CONFIG_SEC_PMSG=m
CONFIG_SEC_BOOT_STAT=m
CONFIG_SEC_ARM64_AP_CONTEXT=m
CONFIG_SEC_ARM64_FSIMD_DEBUG=m
CONFIG_SEC_ARM64_DEBUG=m
CONFIG_SEC_QC_DEBUG=m
CONFIG_SEC_QC_PARAM=m
CONFIG_SEC_QC_LOGGER=m
CONFIG_SEC_QC_QCOM_WDT_CORE=m
CONFIG_SEC_QC_RBCMD=m
CONFIG_SEC_QC_UPLOAD_CAUSE=m
CONFIG_SEC_QC_DEBUG_PARTITION=m
CONFIG_SEC_QC_SUMMARY=m
CONFIG_SEC_QC_USER_RESET=m
CONFIG_SEC_QC_SMEM=m
CONFIG_SEC_QC_HW_PARAM=m
CONFIG_SEC_QC_RST_EXINFO=m
CONFIG_SEC_QC_RDX_BOOTDEV=m
CONFIG_SEC_QC_SOC_ID=m
CONFIG_SEC_QC_MSM_POWEROFF=m

# UFS
CONFIG_SEC_UFS_FEATURE=y

# SD
CONFIG_SEC_MMC_FEATURE=y

# CP Dynamic reserved memmory
CONFIG_CP_DYNAMIC_MEM_RESERVE=y

# drb, dropdump
CONFIG_SUPPORT_DROPDUMP=m
CONFIG_DEV_RIL_BRIDGE=m

# Network
CONFIG_INET6_AH=y
CONFIG_IP_NF_MATCH_AH=y
CONFIG_IP_NF_MATCH_RPFILTER=y
CONFIG_TCP_CONG_ADVANCED=y
CONFIG_TCP_CONG_BIC=y
CONFIG_DEFAULT_BIC=y
CONFIG_DEFAULT_TCP_CONG="bic"
# CONFIG_TCP_CONG_WESTWOOD is not set
# CONFIG_TCP_CONG_HTCP is not set

# USB
CONFIG_USB_CONFIGFS_F_SS_MON_GADGET=m
CONFIG_USB_CONFIGFS_F_CONN_GADGET=m
CONFIG_USB_NOTIFY_LAYER=m
CONFIG_USB_NOTIFY_PROC_LOG=y
CONFIG_USB_HOST_NOTIFY=y
CONFIG_USB_EXTERNAL_NOTIFY=y
CONFIG_USB_NOTIFIER=m
CONFIG_USB_NOTIFY_EXTCON=y

# I/O
CONFIG_MQ_IOSCHED_SSG=m
CONFIG_MQ_IOSCHED_SSG_CGROUP=m
CONFIG_BLK_SEC_STATS=m

#VOLD ASEC
CONFIG_CRYPTO_TWOFISH=m
```
