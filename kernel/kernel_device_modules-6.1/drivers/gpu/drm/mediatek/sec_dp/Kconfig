## kernel/kernel_device_modules-6.1/drivers/mailbox/Kconfig
```kconfig
# SPDX-License-Identifier: GPL-2.0-only

if MAILBOX

config DEVICE_MODULES_MTK_CMDQ_MBOX
	tristate "MediaTek CMDQ Mailbox Support"
	depends on ARCH_MEDIATEK || COMPILE_TEST
	select MTK_INFRACFG
	help
	  Say yes here to add support for the MediaTek Command Queue (CMDQ)
	  mailbox driver. The CMDQ is used to help read/write registers with
	  critical time limitation, such as updating display configuration
	  during the vblank.

config MTK_TINYSYS_MBOX
	tristate "MediaTek TINYSYS MBOX Mailbox Support"
	help
	  Say yes here to add support for the MediaTek TINYSYS mailbox driver.
	  This uses MTK MBOX driver to communicate with remote processors
	  base on ipic framework. It provide channels, controller creation
	  and send operations.

config MTK_ISE_MBOX
	tristate "MediaTek ISE Mailbox Support"
	help
	  Say yes here to add support for the MediaTek ISE mailbox driver.
	  The driver is the transport to communicate with remote secure
	  processor. It provides init and request operations for local user
	  to communicate with remote user.

config MTK_SCMI_TIMEOUT_HOOK
	bool "MediaTek SCMI Timeout Hook Support"
	help
	  Say yes here to add support for the MediaTek SCMI Timeout Hook.
	  SCMI protocol is a set of operating system-independent software
	  interfaces that are used in system management.

	  This uses to revise MediaTek SCMI Timeout settings. Driver can
	  revise timeout paremeter for debug and development.

endif
```

## kernel/kernel_device_modules-6.1/drivers/media/platform/Kconfig
```kconfig
# SPDX-License-Identifier: GPL-2.0-only
#
# Platform drivers
#	Most drivers here are currently for webcam support

if V4L_PLATFORM_DRIVERS

config DEVICE_MODULES_VIDEO_MEDIATEK_JPEG
	tristate "Mediatek JPEG Codec driver"
	depends on MTK_IOMMU_V1 || DEVICE_MODULES_MTK_IOMMU || COMPILE_TEST
	depends on VIDEO_DEV
	depends on ARCH_MEDIATEK || COMPILE_TEST
	depends on DEVICE_MODULES_MTK_SMI || (COMPILE_TEST && DEVICE_MODULES_MTK_SMI=n)
	select VIDEOBUF2_DMA_CONTIG
	select V4L2_MEM2MEM_DEV
	help
	  Mediatek jpeg codec driver provides HW capability to decode
	  JPEG format

	  To compile this driver as a module, choose M here: the
	  module will be called mtk-jpeg

source "$(KCONFIG_EXT_PREFIX)drivers/media/platform/mtk-vcodec/Kconfig"
source "$(KCONFIG_EXT_PREFIX)drivers/media/platform/mtk-isp/Kconfig"
source "$(KCONFIG_EXT_PREFIX)drivers/media/platform/mtk-aie/Kconfig"
source "$(KCONFIG_EXT_PREFIX)drivers/media/platform/mtk-dpe/Kconfig"

config DEVICE_MODULES_VIDEO_MEDIATEK_VCODEC
	tristate "Mediatek Video Codec driver"
	depends on DEVICE_MODULES_MTK_IOMMU || COMPILE_TEST
	depends on VIDEO_DEV
	depends on ARCH_MEDIATEK || COMPILE_TEST
	depends on VIDEO_MEDIATEK_VPU || MTK_SCP || MTK_TINYSYS_VCP_SUPPORT || VIDEO_MEDIATEK_VCU
	# The two following lines ensure we have the same state ("m" or "y") as
	# our dependencies, to avoid missing symbols during link.
	depends on VIDEO_MEDIATEK_VPU || !VIDEO_MEDIATEK_VPU
	depends on MTK_SCP || !MTK_SCP
	depends on MTK_TINYSYS_VCP_SUPPORT || !MTK_TINYSYS_VCP_SUPPORT
	depends on DEVICE_MODULES_MTK_SMI || (COMPILE_TEST && DEVICE_MODULES_MTK_SMI=n)
	select VIDEOBUF2_DMA_CONTIG
	select V4L2_MEM2MEM_DEV
	select VB2_MEDIATEK_DMA_CONTIG
	select DEVICE_MODULES_VIDEO_MEDIATEK_VCODEC_VPU if VIDEO_MEDIATEK_VPU
	select DEVICE_MODULES_VIDEO_MEDIATEK_VCODEC_SCP if MTK_SCP
	help
	  Mediatek video codec driver provides HW capability to
	  encode and decode in a range of video formats on MT8173
	  and MT8183.

	  Note that support for MT8173 requires VIDEO_MEDIATEK_VPU to
	  also be selected. Support for MT8183 depends on MTK_SCP.

	  To compile this driver as modules, choose M here: the
	  modules will be called mtk-vcodec-dec and mtk-vcodec-enc.

config VIDEO_MEDIATEK_VCU
	tristate "Mediatek VCU driver"
	help
	  Mediatek video kernel driver for user space vpud.

	  The driver support communicate with user space video driver vpud
	  and allocate, free memory, etc.

	  To compile this driver as modules, choose M here: the
	  modules will be called mtk-vcu.

config MTK_TINYSYS_VCP_SUPPORT
	tristate "Mediatek VCP driver"
	help
	  Mediatek video kernel driver for micro-P.

	  The driver support control and communicate vcp and allocate,
	  free memory, etc.

	  To compile this driver as modules, choose M here: the
	  modules will be called vcp and vcp_status.

config DEVICE_MODULES_VIDEO_MEDIATEK_VCODEC_VPU
	bool

config DEVICE_MODULES_VIDEO_MEDIATEK_VCODEC_SCP
	bool

config MTK_CAMSYS_VEND_HOOK
	bool "Support Mediatek CAMSYS vnedor hook"
	depends on VIDEO_DEV
	help
	  If it is enabled, CAMSYS will have vendor hook

endif # V4L_PLATFORM_DRIVERS
```

## kernel/kernel_device_modules-6.1/drivers/memory/Kconfig
```kconfig
# SPDX-License-Identifier: GPL-2.0-only

config DEVICE_MODULES_MTK_SMI
	tristate "MediaTek SoC Memory Controller driver" if COMPILE_TEST
	depends on ARCH_MEDIATEK || COMPILE_TEST
	help
	  This driver is for the Memory Controller module in MediaTek SoCs,
	  mainly help enable/disable iommu and control the power domain and
	  clocks for each local arbiter.

config MTK_SMI_DEBUG
	tristate "enable mtk smi debug extension"
	help
	  This extension enables debug features for smi driver. We only default
	  enable this in userdebug/eng load. With this extension enabled, you
	  can use adb command to dynamically dump smi status, or do some
	  experiments like close some smi larbs. This extension is by default
	  disabled on user load for security concern.

source "$(KCONFIG_EXT_PREFIX)drivers/memory/mediatek/Kconfig"
```

## kernel/kernel_device_modules-6.1/drivers/mfd/Kconfig
```kconfig
# SPDX-License-Identifier: GPL-2.0-only

config MFD_MT6338
	tristate "MediaTek MT6338 PMIC Support"
	select MFD_CORE
	select REGMAP_I2C
	depends on I2C
	help
	  Say yes here to add support for MediaTek MT6338 PMIC.
	  This driver provides common support for accessing the MT6338 register.
	  Note, that this will only be useful paired with descriptions
	  of the independent functions as children nodes in the device tree.

config DEVICE_MODULES_MFD_MT6360
	tristate "Mediatek MT6360 SubPMIC"
	select MFD_CORE
	select REGMAP_I2C
	select REGMAP_IRQ
	select CRC8
	depends on I2C
	help
	  Say Y here to enable MT6360 PMU/PMIC/LDO functional support.
	  PMU part includes Charger, Flashlight, RGB LED
	  PMIC part includes 2-channel BUCKs and 2-channel LDOs
	  LDO part includes 4-channel LDOs

config DEVICE_MODULES_MFD_MT6397
	tristate "MediaTek MT6397 PMIC Support"
	select MFD_CORE
	select IRQ_DOMAIN
	help
	  Say yes here to add support for MediaTek MT6397 PMIC. This is
	  a Power Management IC. This driver provides common support for
	  accessing the device; additional drivers must be enabled in order
	  to use the functionality of the device.

config MFD_MT6375
	tristate "Mediatek MT6375 PMIC support"
	depends on OF && I2C
	select REGMAP_I2C
	select REGMAP_IRQ
	help
	  Say yes here to add support for Mediatek MT6375 PMIC. This is
	  a Power Management IC. This driver provides common support for
	  accessing the device; additional drivers must be enabled in order
	  to use the functionality of the device.

config MFD_MT6681
	tristate "MediaTek MT6681 PMIC Support"
	select MFD_CORE
	select REGMAP_I2C
	depends on I2C
	help
	  Say yes here to add support for MediaTek MT6681 PMIC.
	  This driver provides common support for accessing the MT6681 register.
	  Note, that this will only be useful paired with descriptions
	  of the independent functions as children nodes in the device tree.

config MT6685_AUDCLK
	tristate "MT6685 AUD CLK"
	depends on MFD_MT6685
	help
	  This enables support for MT6685 audio clk control.
	  These PMICs are currently used with the Mediatek series of
	  SoCs.  Note, that this will only be useful paired with descriptions
	  of the independent functions as children nodes in the device tree.

config MFD_MT6685
	tristate "MT6685 SPMI PMIC"
	depends on OF
	depends on SPMI
	select REGMAP_SPMI
	select REGMAP_IRQ
	help
	  This enables support for the Mediatek SPMI PMICs.
	  These PMICs are currently used with the Mediatek series of
	  SoCs.  Note, that this will only be useful paired with descriptions
	  of the independent functions as children nodes in the device tree.

config MFD_MTK_SPMI_PMIC
	tristate "Mediatek SPMI PMICs"
	depends on OF
	depends on SPMI
	select REGMAP_SPMI
	help
	  This enables support for the Mediatek SPMI PMICs.
	  These PMICs are currently used with the MT63xx series of
	  SoCs.  Note, that this will only be useful paired with descriptions
	  of the independent functions as children nodes in the device tree.

	  Say M here if you want to include support for the SPMI PMIC
	  series as a module.  The module will be called "mtk-spmi-pmic".

config MFD_RT9490
	tristate "Richtek RT9490 Buck-Boost Switching Battery Charger"
	depends on I2C
	select MFD_CORE
	select REGMAP_I2C
	select IRQ_DOMAIN
	help
	  Say Y here to support Richtek RT9490. The RT9490 is a high-integrated
	  5A Buck-Boost switch mode battery charge management and system power
	  path management device for 1 to 4 cell Li-Ion and Li-Polymer battery.
	  Except the charger circuit, it also includes ADCs to sense the
	  charger voltage and current like as VBUS/IBUS/VBAT/IBAT.
```
