## kernel/kernel_device_modules-6.1/drivers/gpu/drm/panel/Kconfig
```kconfig
# SPDX-License-Identifier: GPL-2.0-only

config DRM_PANEL_BOE_TS127QFMLL1DKP0
	tristate "BOE wqxga2944 vdo mode panel"
	depends on OF
	depends on DRM_MIPI_DSI
	depends on BACKLIGHT_CLASS_DEVICE
	help
		Say Y here if you want to enable support for boe
		vdo mode wqxga2944 panel. The panel has a 2944x1840
		resolution and uses 24-bits RGB per pixel. It provides a
		MIPI DSI interface to host.

config DRM_PANEL_BOE_TS127QFMLL1DKP0_120HZ
	tristate "BOE wqxga2944 120Hz vdo mode panel"
	depends on OF
	depends on DRM_MIPI_DSI
	depends on BACKLIGHT_CLASS_DEVICE
	help
		Say Y here if you want to enable support for boe
		vdo mode wqxga2944 120Hz DPHY panel. The panel has a 2944x1840
		resolution and uses 24-bits RGB per pixel. It provides a
		MIPI DSI interface to host.

config DRM_PANEL_HIMAX_HX83121A_VDO
	tristate "HIMAX wqxga vdo mode panel"
	depends on OF
	depends on DRM_MIPI_DSI
	depends on BACKLIGHT_CLASS_DEVICE
	help
		Say Y here if you want to enable support for himax
		vdo mode wqxga panel. The panel has a 1600x2560
		resolution and uses 24-bits RGB per pixel. It provides a
		MIPI DSI interface to host.

config DRM_PANEL_NOVATEK_NT35695B_VDO
	tristate "Novatek NT35695B AUO vdo mode panel"
	depends on OF
	depends on DRM_MIPI_DSI
	depends on BACKLIGHT_CLASS_DEVICE
	help
	  Say Y here if you want to enable support for NT35695B DPHY
	  vdo mode Full HD panel. The panel has a 1080x1920
	  resolution and uses 24-bits RGB per pixel. It provides a
	  MIPI DSI interface to host.

config DRM_PANEL_NOVATEK_NT36672A_VDO
	tristate "Novatek NT36672A FHD+ video mode panel"
	depends on OF
	depends on DRM_MIPI_DSI
	depends on BACKLIGHT_CLASS_DEVICE
	help
	  Say Y here if you want to enable support for NT36672A VDO
	  mode Full HD Plus panel. The panel has a 1080x2280 resolution
	  and uses 24-bits RGB per pixel. It provides a MIPI DSI interface
	  to host.

config DRM_PANEL_SAMSUNG_ANA6705_CMD
	tristate "ANA6705 amoled WQHD cmd mode panel"
	depends on OF
	depends on DRM_MIPI_DSI
	depends on BACKLIGHT_CLASS_DEVICE
	help
	  Say Y here if you want to enable support for ANA6705 DPHY
	  cmd mode WQHD panel. The panel has a 1440x3216
	  resolution and uses 24-bits RGB per pixel. It provides a
	  MIPI DSI interface to host.

config DRM_PANEL_SAMSUNG_ANA6705_CMD_FHDP
	tristate "ANA6705 amoled FHDP cmd mode panel"
	depends on OF
	depends on DRM_MIPI_DSI
	depends on BACKLIGHT_CLASS_DEVICE
	help
	  Say Y here if you want to enable support for ANA6705 DPHY
	  cmd mode FHDP panel. The panel has a 1440x3216
	  resolution and uses 24-bits RGB per pixel. It provides a
	  MIPI DSI interface to host.

config DRM_PANEL_HX_NT37701_DPHY_CMD
	tristate "NT37701 amoled dphy cmd mode panel"
	depends on OF
	depends on DRM_MIPI_DSI
	depends on BACKLIGHT_CLASS_DEVICE
	help
	  Say Y here if you want to enable support for NT37701 DPHY
	  cmd mode Full HD panel. The panel has a 1080x2400
	  resolution and uses 24-bits RGB per pixel. It provides a
	  MIPI DSI interface to host.

config DRM_PANEL_HX_NT37701_DPHY_CMD_120HZ
	tristate "NT37701 amoled dphy cmd mode panel"
	depends on OF
	depends on DRM_MIPI_DSI
	depends on BACKLIGHT_CLASS_DEVICE
	help
	  Say Y here if you want to enable support for NT37701 DPHY
	  cmd mode Full HD panel. The panel has a 1080x2400
	  resolution and uses 24-bits RGB per pixel. It provides a
	  MIPI DSI interface to host.

config DRM_PANEL_TRULY_TD4330_VDO
	tristate "TRULY  FHD+ video mode panel"
	depends on OF
	depends on DRM_MIPI_DSI
	depends on BACKLIGHT_CLASS_DEVICE
	help
	  Say Y here if you want to enable support for TRULY TD4330 VDO
	  mode Full HD Plus panel. The panel has a 1080x2280 resolution
	  and uses 24-bits RGB per pixel. It provides a MIPI DSI interface
	  to host.

config DRM_PANEL_TRULY_TD4330_CMD
	tristate "TRULY  FHD+ cmd mode panel"
	depends on OF
	depends on DRM_MIPI_DSI
	depends on BACKLIGHT_CLASS_DEVICE
	help
	  Say Y here if you want to enable support for TRULY TD4330 CMD
	  mode Full HD Plus panel. The panel has a 1080x2280 resolution
	  and uses 24-bits RGB per pixel. It provides a MIPI DSI interface
	  to host.

config DRM_PANEL_SAMSUNG_OP_CMD
	tristate "ANA6705 OP WQHD cmd mode panel"
	depends on OF
	depends on DRM_MIPI_DSI
	depends on BACKLIGHT_CLASS_DEVICE
	help
	  Say Y here if you want to enable support for ANA6705 DPHY
	  cmd mode WQHD panel. The panel has a 1440x3216
	  resolution and uses 24-bits RGB per pixel. It provides a
	  MIPI DSI interface to host.

config DRM_PANEL_SAMSUNG_OP_CMD_MSYNC2
	tristate "ANA6705 OP WQHD cmd msync2 mode panel"
	depends on OF
	depends on DRM_MIPI_DSI
	depends on BACKLIGHT_CLASS_DEVICE
	help
	  Say Y here if you want to enable support for ANA6705 DPHY
	  cmd mode WQHD panel. The panel has a 1440x3216
	  resolution and uses 24-bits RGB per pixel. It provides a
	  MIPI DSI interface to host.

config DRM_PANEL_TRULY_FT8756_VDO
	tristate "TRULY FHD+ vdo mode panel"
	depends on OF
	depends on DRM_MIPI_DSI
	depends on BACKLIGHT_CLASS_DEVICE
	help
	  Say Y here if you want to enable support for TRULY FT8756 VDO
	  mode Full HD Plus panel. The panel has a 1080x2300 resolution
	  and uses 24-bits RGB per pixel. It provides a MIPI DSI interface
	  to host.

config DRM_PANEL_ALPHA_JDI_NT36672C_CPHY_VDO
	tristate "ALPHA JDI FHD+ CPHY vdo mode panel"
	depends on OF
	depends on DRM_MIPI_DSI
	depends on BACKLIGHT_CLASS_DEVICE
	help
	  Say Y here if you want to enable support for ALPHA JDI NT36672C
	  CPHY vdo mode Full HD Plus panel. The panel has a 1080x2400
	  resolution and uses 24-bits RGB per pixel. It provides a
	  MIPI DSI interface to host.

config DRM_PANEL_SC_NT36672C_VDO_120HZ
	tristate "SC FHD+ vdo mode 120 HZ panel"
	depends on OF
	depends on DRM_MIPI_DSI
	depends on BACKLIGHT_CLASS_DEVICE
	help
	  Say Y here if you want to enable support for SC DPHY
	  vdo mode Full HD Plus 120HZ panel. The panel has a 1080x2400
	  resolution and uses 24-bits RGB per pixel. It provides a
	  MIPI DSI interface to host.

config DRM_PANEL_TIANMA_R66451_CMD_120HZ
	tristate "TIANMA  FHD+ cmd mode panel"
	depends on OF
	depends on DRM_MIPI_DSI
	depends on BACKLIGHT_CLASS_DEVICE
	help
	  Say Y here if you want to enable support for TIANMA R66451 CMD
	  mode 120HZ Full HD Plus panel. The panel has a 1080x2340 resolution
	  and uses 24-bits RGB per pixel. It provides a MIPI DSI interface
	  to host.

config DRM_PANEL_TIANMA_R66451_CMD_120HZ_WA
	tristate "TIANMA R66451 FHD+ cmd mode panel"
	depends on OF
	depends on DRM_MIPI_DSI
	depends on BACKLIGHT_CLASS_DEVICE
	help
	  Say Y here if you want to enable support for TIANMA R66451 CMD
	  mode 120HZ Full HD Plus panel. The panel has a 1080x2340 resolution
	  and uses 24-bits RGB per pixel. It provides a MIPI DSI interface
	  to host.

config DRM_PANEL_TIANMA_NT36672E_VDO_120HZ_HFP
	tristate "TIANMA FHD+ vdo mode 120 HZ HFP panel"
	depends on OF
	depends on DRM_MIPI_DSI
	depends on BACKLIGHT_CLASS_DEVICE
	help
	  Say Y here if you want to enable support for TIANMA DPHY
	  vdo mode HFP Full HD Plus 120HZ panel. The panel has a 1080x2408
	  resolution and uses 24-bits RGB per pixel. It provides a
	  MIPI DSI interface to host.

config DRM_PANEL_ALPHA_JDI_NT36672E_CPHY_VDO
	tristate "ALPHA JDI FHD+ CPHY vdo mode panel"
	depends on OF
	depends on DRM_MIPI_DSI
	depends on BACKLIGHT_CLASS_DEVICE
	help
	  Say Y here if you want to enable support for ALPHA JDI NT36672E
	  CPHY vdo mode Full HD Plus panel. The panel has a 1080x2400
	  resolution and uses 24-bits RGB per pixel. It provides a
	  MIPI DSI interface to host.

config DRM_PANEL_ALPHA_JDI_NT36672E_VDO_120HZ
	tristate "ALPHA JDI FHD+ DPHY vdo mode 120HZ panel"
	depends on OF
	depends on DRM_MIPI_DSI
	depends on BACKLIGHT_CLASS_DEVICE
	help
	  Say Y here if you want to enable support for ALPHA JDI NT36672E
	  DPHY vdo mode Full HD Plus 120HZ panel. The panel has a 1080x2400
	  resolution and uses 24-bits RGB per pixel. It provides a
	  MIPI DSI interface to host.

config DRM_PANEL_ALPHA_JDI_NT36672E_VDO_144HZ
	tristate "ALPHA JDI FHD+ DPHY vdo mode 144HZ panel"
	depends on OF
	depends on DRM_MIPI_DSI
	depends on BACKLIGHT_CLASS_DEVICE
	help
	  Say Y here if you want to enable support for ALPHA JDI NT36672E
	  DPHY vdo mode Full HD Plus 144HZ panel. The panel has a 1080x2400
	  resolution and uses 24-bits RGB per pixel. It provides a
	  MIPI DSI interface to host.

config DRM_PANEL_ALPHA_JDI_NT36672E_VDO_60HZ
	tristate "ALPHA JDI FHD+ DPHY vdo mode 60HZ panel"
	depends on OF
	depends on DRM_MIPI_DSI
	depends on BACKLIGHT_CLASS_DEVICE
	help
	  Say Y here if you want to enable support for ALPHA JDI NT36672E
	  DPHY vdo mode Full HD Plus 60HZ panel. The panel has a 1080x2400
	  resolution and uses 24-bits RGB per pixel. It provides a
	  MIPI DSI interface to host.

config DRM_PANEL_ALPHA_JDI_NT36672E_VDO_120HZ_HFP
	tristate "ALPHA JDI FHD+ DPHY vdo mode 120HZ hfp panel"
	depends on OF
	depends on DRM_MIPI_DSI
	depends on BACKLIGHT_CLASS_DEVICE
	help
	  Say Y here if you want to enable support for ALPHA JDI NT36672E
	  DPHY vdo mode Full HD Plus 120HZ hfp panel. The panel has a 1080x2400
	  resolution and uses 24-bits RGB per pixel. It provides a
	  MIPI DSI interface to host.

config DRM_PANEL_ALPHA_JDI_NT36672E_VDO_144HZ_HFP
	tristate "ALPHA JDI FHD+ DPHY vdo mode 144HZ hfp panel"
	depends on OF
	depends on DRM_MIPI_DSI
	depends on BACKLIGHT_CLASS_DEVICE
	help
	  Say Y here if you want to enable support for ALPHA JDI NT36672E
	  DPHY vdo mode Full HD Plus 144HZ hfp panel. The panel has a 1080x2400
	  resolution and uses 24-bits RGB per pixel. It provides a
	  MIPI DSI interface to host.

config DRM_PANEL_TRULY_NT35595_CMD
	tristate "TRULY  FHD+ cmd mode panel"
	depends on OF
	depends on DRM_MIPI_DSI
	depends on BACKLIGHT_CLASS_DEVICE
	help
	  Say Y here if you want to enable support for TRULY nt35595 CMD
	  mode Full HD Plus panel. The panel has a 1080x1920 resolution
	  and uses 24-bits RGB per pixel. It provides a MIPI DSI interface
	  to host.

config DRM_PANEL_NT37801_MSYNC2_RTE
	tristate "nt37801 fhdplus and wqhd dphy 120hz panel"
	depends on OF
	depends on DRM_MIPI_DSI
	depends on BACKLIGHT_CLASS_DEVICE
	help
	  Say Y here if you want to enable support for nt37801 fhdplus and
	  wqhd cmd panel. The panel has a 1080x2400 or 1440x3200 resolution
	  and uses 24-bits RGB per pixel. It provides a MIPI DSI
	  interface to host.

config DRM_PANEL_SAMSUNG_S68FC01_VDO_AOD
	tristate "samsung s68fc01 fhdp vdo aod panel"
	depends on OF
	depends on DRM_MIPI_DSI
	depends on BACKLIGHT_CLASS_DEVICE
	help
	  Say Y here if you want to enable support for samsung s68fc01
	  fhdp vdo aod panel. The panel has a 1080x2340 resolution
	  and uses 24-bits RGB per pixel. It provides a MIPI DSI
	  interface to host.

config DRM_PANEL_ALPHA_SAMSUNG_S6E3HAE_CMD_120HZ
	tristate "s6e3hae wqhd dphy 120hz panel"
	depends on OF
	depends on DRM_MIPI_DSI
	depends on BACKLIGHT_CLASS_DEVICE
	help
	  Say Y here if you want to enable support for samsung, s63shae
	  wqhd cmd panel. The panel has a 1440x3200 resolution
	  and uses 24-bits RGB per pixel. It provides a MIPI DSI
	  interface to host.

config DRM_PANEL_NT37801_CMD_FHD
	tristate "NT37801 cmd fhd mode panel"
	depends on OF
	depends on DRM_MIPI_DSI
	depends on BACKLIGHT_CLASS_DEVICE
	help
	  Say Y here if you want to enable support for NT37801 CMD FHD
	  cmd mode Full HD panel. The panel has a 1080x2400
	  resolution and uses 24-bits RGB per pixel. It provides a
	  MIPI DSI interface to host.

config DRM_PANEL_NT37801_CMD_LTPO
	tristate "nt37801 fhdplus and wqhd dphy 120hz panel"
	depends on OF
	depends on DRM_MIPI_DSI
	depends on BACKLIGHT_CLASS_DEVICE
	help
	  Say Y here if you want to enable support for nt37801 fhdplus and
	  wqhd cmd panel. The panel has a 1080x2400 or 1440x3200 resolution
	  and uses 24-bits RGB per pixel. It provides a MIPI DSI
	  interface to host.

config DRM_PANEL_NT37801_CMD_120HZ
	tristate "nt37801 fhdplus and wqhd dphy 120hz panel"
	depends on OF
	depends on DRM_MIPI_DSI
	depends on BACKLIGHT_CLASS_DEVICE
	help
	  Say Y here if you want to enable support for nt37801 fhdplus and
	  wqhd cmd panel. The panel has a 1080x2400 or 1440x3200 resolution
	  and uses 24-bits RGB per pixel. It provides a MIPI DSI
	  interface to host.

config DRM_PANEL_NT37801_CMD_SPR
	tristate "nt37801 fhdplus and wqhd dphy spr panel"
	depends on OF
	depends on DRM_MIPI_DSI
	depends on BACKLIGHT_CLASS_DEVICE
	help
	  Say Y here if you want to enable support for nt37801 fhdplus and
	  wqhd cmd panel. The panel has a 1080x2400 or 1440x3200 resolution
	  and uses 24-bits RGB per pixel. It provides a MIPI DSI
	  interface to host.

config DRM_PANEL_L12A_42_02_0A_DSC_CMD
	tristate "L12A 42 02 0A DSC cmd mode panel"
	depends on OF
	depends on DRM_MIPI_DSI
	depends on BACKLIGHT_CLASS_DEVICE
	help
	  Say Y here if you want to enable support for ALPHA JDI NT36672E
	  CPHY vdo mode Full HD Plus panel. The panel has a 1080x2400
	  resolution and uses 24-bits RGB per pixel. It provides a
	  MIPI DSI interface to host.

config DRM_PANEL_NT37701A_CMD
	tristate "NT37701A cmd mode panel"
	depends on OF
	depends on DRM_MIPI_DSI
	depends on BACKLIGHT_CLASS_DEVICE
	help
	  Say Y here if you want to enable support for ALPHA JDI NT36672E
	  CPHY vdo mode Full HD Plus panel. The panel has a 1080x2400
	  resolution and uses 24-bits RGB per pixel. It provides a
	  MIPI DSI interface to host.


config DRM_MEDIATEK_PANEL
	tristate "drm panel common driver"
	depends on OF
	depends on DRM_MIPI_DSI
	depends on BACKLIGHT_CLASS_DEVICE
	help
	  Say Y here if you want to enable support for panel common driver.
	  support C-PHY and D-PHY, support HD, FHD resolution,
	  support CMD and VDO mode, support high frame rate.
	  and uses 24-bits RGB per pixel. It provides a MIPI DSI interface
	  to host.

config DRM_PANEL_ILI7838E_ALPHA_CMD
	tristate "mt6985 ili7838e-alpha cmd panel"
	depends on OF
	depends on DRM_MIPI_DSI
	depends on BACKLIGHT_CLASS_DEVICE
	help
	  Say Y here if you want to enable support for mt6985
	  ili7838e-alpha fhd cmd panel. The panel has a 1260x2800
	  resolution and uses 24-bits RGB per pixel. It provides a
	  MIPI DSI interface to host.

config DRM_PANEL_ILI7838E_DV2_ALPHA_CMD
	tristate "mt6985 ili7838e-dv2-alpha cmd panel"
	depends on OF
	depends on DRM_MIPI_DSI
	depends on BACKLIGHT_CLASS_DEVICE
	help
	  Say Y here if you want to enable support for mt6985
	  ili7838e-dv2-alpha fhd cmd panel. The panel has a 1260x2800
	  resolution and uses 24-bits RGB per pixel. It provides a
	  MIPI DSI interface to host.

config DRM_PANEL_ILI7838E_DV2_SPR_CMD
	tristate "mt6985 ili7838e-dv2-spr cmd panel"
	depends on OF
	depends on DRM_MIPI_DSI
	depends on BACKLIGHT_CLASS_DEVICE
	help
	  Say Y here if you want to enable support for mt6989
	  ili7838e-dv2-alpha-spr fhd cmd panel. The panel has a 1260x2800
	  resolution and uses 24-bits RGB per pixel. It provides a
	  MIPI DSI interface to host.

config DRM_PANEL_ILI7838E_DV2_ALPHA_VDO
	tristate "mt6985 ili7838e-dv2-alpha vdo panel"
	depends on OF
	depends on DRM_MIPI_DSI
	depends on BACKLIGHT_CLASS_DEVICE
	help
	  Say Y here if you want to enable support for mt6985
	  ili7838e-dv2-alpha fhd vdo panel. The panel has a 1260x2800
	  resolution and uses 24-bits RGB per pixel. It provides a
	  MIPI DSI interface to host.

config DRM_PANEL_RM692H5_ALPHA_CMD
	tristate "mt6985 rm692h5-alpha cmd panel"
	depends on OF
	depends on DRM_MIPI_DSI
	depends on BACKLIGHT_CLASS_DEVICE
	help
	  Say Y here if you want to enable support for mt6989
	  rm692h5-alpha fhdplus cmd panel. The panel has a 1260x2800
	  resolution and uses 24-bits RGB per pixel. It provides a
	  MIPI DSI interface to host.

config DRM_PANEL_NT37705_ALPHA_CMD
	tristate "mt6985 nt37705-alpha cmd panel"
	depends on OF
	depends on DRM_MIPI_DSI
	depends on BACKLIGHT_CLASS_DEVICE
	help
	  Say Y here if you want to enable support for mt6985 nt37705-alpha
	  fhd cmd aod panel. The panel has a 1260x2800 resolution
	  and uses 24-bits RGB per pixel. It provides a MIPI DSI
	  interface to host.

config DRM_TD2204_WQHD_AMB678ZY01_S6E3HC3_CMD
	tristate "mt6985 wqhd amb678zy01-s6e3hc3 cmd panel"
	depends on OF
	depends on DRM_MIPI_DSI
	depends on BACKLIGHT_CLASS_DEVICE
	help
	  Say Y here if you want to enable support for mt6985 amb678zy01-s6e3hc3
	  wqhd cmd aod panel. The panel has a 1440x3200 resolution
	  and uses 24-bits RGB per pixel. It provides a MIPI DSI
	  interface to host.

config DRM_PANEL_NT37801_CMD_FHD_PLUS
	tristate "NT37801 cmd fhd plus mode panel"
	depends on OF
	depends on DRM_MIPI_DSI
	depends on BACKLIGHT_CLASS_DEVICE
	help
	  Say Y here if you want to enable support for NT37801 CMD FHD
	  cmd mode Full HD panel. The panel has a 1080x2400
	  resolution and uses 24-bits RGB per pixel. It provides a
	  MIPI DSI interface to host. It update for mt6989

config DRM_PANEL_ALPHA_NT37706_VDO_120HZ
	tristate "ALPHA DPHY vdo mode 120HZ panel"
	depends on OF
	depends on DRM_MIPI_DSI
	depends on BACKLIGHT_CLASS_DEVICE
	help
	  Say Y here if you want to enable support for ALPHA JDI NT37706
	  DPHY vdo mode Full HD Plus 120HZ panel. The panel has a 1220x2712
	  resolution and uses 24-bits RGB per pixel. It provides a
	  MIPI DSI interface to host.

config DRM_PANEL_BOE_BF130_DPHY_CMD_HD
	tristate "boe bf130 dphy cmd hd panel"
	depends on OF
	depends on DRM_MIPI_DSI
	depends on BACKLIGHT_CLASS_DEVICE
	help
	  Say Y here if you want to enable support for Alpha BF130
	  HD 60Hz panel.The panel has a 382x720 resolution and uses
	  24-bits RGB per pixel. It provides a MIPI DSI interface
	  to host.

config DRM_PANEL_NT37707_677_FHDP_DPHY_CMD
	tristate "NT37707 DPHY cmd mode 120HZ LTPO OLED panel"
	depends on OF
	depends on DRM_MIPI_DSI
	depends on BACKLIGHT_CLASS_DEVICE
	help
	  Say Y here if you want to enable support for NT37707 DPHY
	  cmd mode 120HZ LTPO OLED panel. The panel has a 1080x2640
	  resolution and uses 30-bits RGB per pixel. It provides a
	  MIPI DSI interface to host.

config DRM_PANEL_NT37705_1056_1068_DPHY_CMD
	tristate "NT37705 DPHY cmd mode 60HZ LTPO OLED panel"
	depends on OF
	depends on DRM_MIPI_DSI
	depends on BACKLIGHT_CLASS_DEVICE
	help
	  Say Y here if you want to enable support for NT37705
	  DPHY cmd mode 60HZ LTPO OLED panel. The panel has a 1056x1068
	  resolution and uses 24-bits RGB per pixel. It provides a
	  MIPI DSI interface to host.

config DRM_PANEL_SAMSUNG_AMF680CM01_CMD_FHD
	tristate "samsung amf680cm01 cmd fhd panel"
	depends on OF
	depends on DRM_MIPI_DSI
	depends on BACKLIGHT_CLASS_DEVICE
	help
	  Say Y here if you want to enable support for ALPHA AMF680CM01
	  DPHY vdo mode Full HD Plus 60HZ panel. The panel has a 1080x2520
	  resolution and uses 30-bits RGB per pixel. It provides a
	  MIPI DSI interface to host.

config DRM_PANEL_MOT_CSOT_NT37705_DPHY_CMD
	tristate "NT37705 dphy cmd mode panel"
	depends on OF
	depends on DRM_MIPI_DSI
	depends on BACKLIGHT_CLASS_DEVICE
	help
	  Say Y here if you want to enable support for Alpha NT37705
	  cmd mode panel.The panel has a XXXxXXX resolution and uses
	  XX-bits RGB per pixel. It provides a MIPI DSI interface
	  to host.

config DRM_PANEL_MOT_CSOT_NT37707_FHDP_DPHY_CMD
	tristate "NT37707 fhd plus dphy cmd mode panel"
	depends on OF
	depends on DRM_MIPI_DSI
	depends on BACKLIGHT_CLASS_DEVICE
	help
	  Say Y here if you want to enable support for ALPHA NT37707
	  DPHY cmd mode Full HD Plus panel. The panel has a XXXXxXXXX
	  resolution and uses XX-bits RGB per pixel. It provides a
	  MIPI DSI interface to host.

config DRM_PANEL_ALPHA_JDI_NT36672E_VDO_120HZ_THRESHOLD
	tristate "ALPHA JDI FHD+ DPHY vdo mode 120HZ panel threshold"
	depends on OF
	depends on DRM_MIPI_DSI
	depends on BACKLIGHT_CLASS_DEVICE
	help
	  Say Y here if you want to enable support for ALPHA JDI NT36672E
	  DPHY vdo mode Full HD Plus 120HZ panel. The panel has a 1080x2400
	  resolution and uses 24-bits RGB per pixel, vblank period of 156us.
	  It provides aMIPI DSI interface to host.

config DRM_PANEL_ANA38407_WQXGA_DPHY_CMD
	tristate "ANAPASS WQXGA DPHY CMD mode "
	depends on OF
	depends on DRM_MIPI_DSI
	depends on BACKLIGHT_CLASS_DEVICE
	help
	  Say Y here if you want to enable support for ANA38407
	  DPHY vdo mode Full HD Plus 120HZ panel. The panel has a 2800x1752
	  resolution and uses 24-bits RGB per pixel, vblank period of 156us.
	  It provides aMIPI DSI interface to host.

config DRM_PANEL_ANA38407_WQXGA_PLUS_DPHY_CMD
	tristate "ANAPASS WQXGA DPHY CMD mode "
	depends on OF
	depends on DRM_MIPI_DSI
	depends on BACKLIGHT_CLASS_DEVICE
	help
	  Say Y here if you want to enable support for ANA38407
	  DPHY vdo mode Full HD Plus 120HZ panel. The panel has a 2800x1752
	  resolution and uses 24-bits RGB per pixel, vblank period of 156us.
	  It provides aMIPI DSI interface to host.
```
