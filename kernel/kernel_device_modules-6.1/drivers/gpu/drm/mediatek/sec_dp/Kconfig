## kernel/kernel_device_modules-6.1/drivers/misc/mediatek/dcm/Kconfig
```kconfig
config MTK_DCM_COMMON
	tristate "Mediatek DCM COMMON"
	depends on ARCH_MEDIATEK && OF
	help
	  For Mediatek Dynamic Clock Management control. Provid a common interface to
	  adjust dcm setting. Setting will not keep after reboot
	  Select "y" if you want to use.
	  Select "n" if you are not sure.

config MTK_DCM_MT6985
	tristate "Mediatek MT6985 DCM control"
	depends on ARCH_MEDIATEK && OF
	select MTK_DCM_COMMON
	help
	  For Mediatek MT6985 Dynamic Clock Management HW control. Only enable when you
	  neet to change mt6985 dcm setting. Setting will not keep after reboot
	  Select "y" if you want to change mt6985 dcm setting.
	  Select "n" if you do not need to change

config MTK_DCM_MT6878
	tristate "Mediatek MT6878 DCM control"
	depends on ARCH_MEDIATEK && OF
	select MTK_DCM_COMMON
	help
	  For Mediatek MT6878 Dynamic Clock Management HW control. Only enable when you
	  neet to change mt6878 dcm setting. Setting will not keep after reboot
	  Select "y" if you want to change mt6878 dcm setting.
	  Select "n" if you do not need to change

config MTK_DCM_MT6897
	tristate "Mediatek MT6897 DCM control"
	depends on ARCH_MEDIATEK && OF
	select MTK_DCM_COMMON
	help
	  For Mediatek MT6897 Dynamic Clock Management HW control. Only enable when you
	  neet to change mt6897 dcm setting. Setting will not keep after reboot
	  Select "y" if you want to change mt6897 dcm setting.
	  Select "n" if you do not need to change

config MTK_DCM_MT6989
	tristate "Mediatek MT6989 DCM control"
	depends on ARCH_MEDIATEK && OF
	select MTK_DCM_COMMON
	help
	  For Mediatek MT6989 Dynamic Clock Management HW control. Only enable when you
	  neet to change mt6989 dcm setting. Setting will not keep after reboot
	  Select "y" if you want to change mt6897 dcm setting.
	  Select "n" if you do not need to change
```

## kernel/kernel_device_modules-6.1/drivers/misc/mediatek/hw_sem/Kconfig
```kconfig
# SPDX-License-Identifier: GPL-2.0

config MTK_HW_SEMAPHORE
	tristate "MediaTek mm hw semaphore driver"
	depends on ARCH_MEDIATEK || COMPILE_TEST
	help
	  This driver is for the Multimedia Infrastructure in MediaTek SoCs.
	  The hw semaphore driver mainly help power control, For checking the
	  real power status, such as mminfra, display, camera, mdp and video
	  codec.
```

## kernel/kernel_device_modules-6.1/drivers/misc/mediatek/imgsensor/src/Kconfig
```kconfig
config SPECIFY_IMGSENSOR
	bool "Specify image sensor name"
	depends on MTK_IMGSENSOR
	help
	  Specify name of each sensor to prevent obtaining wrong sensor driver
	  with same sensor ID. For example, imx258_mipi_raw and
	  imx258_mipi_mono are of same sensor ID. If not specifying sensor,
	  imx258_mipi_mono may be recognized as imx258_mipi_raw.

config IMGSENSOR_MAIN
	string "Custom main image sensor"
	depends on SPECIFY_IMGSENSOR
	help
	  Specify name of main sensor to prevent obtaining wrong sensor driver
	  with same sensor ID. For example, imx258_mipi_raw and
	  imx258_mipi_mono are of same sensor ID. If not specifying sensor,
	  imx258_mipi_mono may be recognized as imx258_mipi_raw.

config IMGSENSOR_MAIN2
	string "Custom main2 image sensor"
	depends on SPECIFY_IMGSENSOR
	help
	  Specify name of main2 sensor to prevent obtaining wrong sensor driver
	  with same sensor ID. For example, imx258_mipi_raw and
	  imx258_mipi_mono are of same sensor ID. If not specifying sensor,
	  imx258_mipi_mono may be recognized as imx258_mipi_raw.

config IMGSENSOR_SUB
	string "Custom sub image sensor"
	depends on SPECIFY_IMGSENSOR
	help
	  Specify name of sub sensor to prevent obtaining wrong sensor driver
	  with same sensor ID. For example, imx258_mipi_raw and
	  imx258_mipi_mono are of same sensor ID. If not specifying sensor,
	  imx258_mipi_mono may be recognized as imx258_mipi_raw.

config IMGSENSOR_SUB2
	string "Custom sub2 image sensor"
	depends on SPECIFY_IMGSENSOR
	help
	  Specify name of sub2 sensor to prevent obtaining wrong sensor driver
	  with same sensor ID. For example, imx258_mipi_raw and
	  imx258_mipi_mono are of same sensor ID. If not specifying sensor,
	  imx258_mipi_mono may be recognized as imx258_mipi_raw.

config IMGSENSOR_MAIN3
	string "Custom main3 image sensor"
	depends on SPECIFY_IMGSENSOR
	help
	  Specify name of main3 sensor to prevent obtaining wrong sensor driver
	  with same sensor ID. For example, imx258_mipi_raw and
	  imx258_mipi_mono are of same sensor ID. If not specifying sensor,
	  imx258_mipi_mono may be recognized as imx258_mipi_raw.

config IMGSENSOR_CUSTOM_CAMERA
	bool "Use custom camera set"
	help
	  Use custom camera set

config IMGSENSOR_SYSFS
	bool "Imgsensor sysfs"
	default n
	help
	  If CONFIG_IMGSENSOR_SYSFS is y, then "Samsung sysfs" is built.
	  This is for camera bringup without sysfs implementation.
	  Set this config to n, while bringup the camera.

config CAMERA_ADAPTIVE_MIPI
	bool "camera adaptive mipi"
	default n
	help
	  If CAMERA_ADAPTIVE_MIPI is y, then "Samsung adaptive mipi" is built.
	  This is for camera bringup without adaptive-mipi implementation.
	  Set this config to n, while bringup the camera.

if IMGSENSOR_CUSTOM_CAMERA
choice IMGSENSOR_CAMERA_SET_CHOICE
	prompt "Choose the proper camera set"
config CAMERA_STX_V10P
	bool "Camera stx _v10p"
	help
	  For STX_V10P camera set
config CAMERA_STX_V10U
	bool "Camera stx _v10u"
	help
	  For STX_V10U camera set
endchoice

config CAMERA_SAMSUNG_MODEL_NAME
	string "Camera samsung model name"
	help
	  Current model name.
endif
```

## kernel/kernel_device_modules-6.1/drivers/misc/mediatek/ips/Kconfig
```kconfig
config MTK_IPS_HELPER
	tristate "MTK IPS Helper debugging Support"
	help
	  This kernel config can be used to enable IPS support.
	  When enable this option, it support reporting current
	  measured Vmin value for voltage droop detector.
	  If unsure, say N.
```

## kernel/kernel_device_modules-6.1/drivers/misc/mediatek/ise_lpm/Kconfig
```kconfig
#
# ise_lpm
#

config MTK_ISE_LPM_SUPPORT
	tristate "Specify Interface Support iSE low power control"
	help
	  support iSE power control
	  Set Y to enable this feature.
	  If unsure,
	  Set N to stay with legancy feature.
```
