## kernel/kernel_device_modules-6.1/drivers/i2c/busses/Kconfig
```kconfig
# SPDX-License-Identifier: GPL-2.0-only
#
# Sensor device configuration
#

menu "I2C Hardware Bus support"
	depends on HAS_IOMEM

config DEVICE_MODULES_I2C_MT65XX
	tristate "MediaTek I2C adapter"
	depends on ARCH_MEDIATEK || COMPILE_TEST
	help
	  This selects the MediaTek(R) Integrated Inter Circuit bus driver
	  for MT65xx and MT81xx.
	  If you want to use MediaTek(R) I2C interface, say Y or M here.
	  If unsure, say N.

endmenu
```

## kernel/kernel_device_modules-6.1/drivers/iio/adc/Kconfig
```kconfig
# SPDX-License-Identifier: GPL-2.0-only

config MEDIATEK_MT6338_AUXADC
	tristate "MediaTek MT6338 PMIC AUXADC Support"
	depends on MFD_MT6338
	help
	  Say yes here to enable support for MediaTek MT6338 PMIC AUXADC.
	  The driver supports multiple channels read.

	  This driver can also be built as a module. If so, the module will be
	  called mt6338-auxadc.

config MEDIATEK_MT635X_AUXADC
	tristate "MediaTek MT635X PMIC AUXADC Support"
	depends on DEVICE_MODULES_MFD_MT6397
	help
	  Say yes here to enable support for MediaTek MT635X PMIC AUXADC.
	  The driver supports multiple channels read.

	  This driver can also be built as a module. If so, the module will be
	  called mt635x-auxadc.

config MEDIATEK_MT6362_ADC
	tristate "Mediatek MT6362 SPMI ADC driver"
	depends on MFD_MT6362
	select IIO_BUFFER
	select IIO_TRIGGERED_BUFFER
	help
	  Say yes here to have support for the MT6362 ADC.
	  Provide VBUS, VSYS, VBAT, IBUS, IBAT several channel.

	  The driver can also be build as a module.
	  If so, the module will be called mt6362_adc.

config MEDIATEK_MT6375_ADC
	tristate "MT6375 ADC driver"
	depends on MFD_MT6375
	select IIO_BUFFER
	select IIO_TRIGGERED_BUFFER
	help
	  Say yes here to have support for the MT6375 ADC.
	  The driver does support several channels, VBUS, VBAT, IBUS, etc...

	  The driver can also be build as a module.
	  If so, the module will be called mt6375-adc.

config MEDIATEK_MT6375_AUXADC
	tristate "MT6375 AUXADC driver"
	depends on MFD_MT6375
	help
	  Say yes here to have support for the MT6375 AUXADC.
	  The driver does support several channels TBAT, VBAT, etc...

	  The driver can also be build as a module.
	  If so, the module will be called mt6375-auxadc.

config MEDIATEK_MT6681_AUXADC
	tristate "MediaTek MT6681 PMIC AUXADC Support"
	depends on MFD_MT6681
	help
	  Say yes here to enable support for MediaTek MT6681 PMIC AUXADC.
	  The driver supports multiple channels read.

	  This driver can also be built as a module. If so, the module will be
	  called mt6681-auxadc.

config DEVICE_MODULES_MEDIATEK_MT6577_AUXADC
	tristate "MediaTek AUXADC driver"
	depends on ARCH_MEDIATEK || COMPILE_TEST
	depends on HAS_IOMEM
	help
	  Say yes here to enable support for MediaTek mt65xx AUXADC.

	  The driver supports immediate mode operation to read from one of sixteen
	  channels (external or internal).

	  This driver can also be built as a module. If so, the module will be
	  called mt6577_auxadc.

config MEDIATEK_SPMI_PMIC_ADC
	tristate "MediaTek SPMI PMIC ADC Support"
	depends on MFD_MTK_SPMI_PMIC
	help
	  Say yes here to enable support for MediaTek SPMI PMIC ADC.
	  The driver supports multiple channels read.

	  This driver can also be built as a module. If so, the module will be
	  called mtk-spmi-pmic-adc.

config MEDIATEK_SPMI_TIA_ADC
	tristate "MediaTek SPMI TIA ADC Support"
	depends on MEDIATEK_SPMI_PMIC_ADC
	help
	  Say yes here to enable support for MediaTek SPMI PMIC TIA ADC.
	  The driver supports multiple channels read.

	  This driver can also be built as a module. If so, the module will be
	  called mtk-spmi-tia-adc.

config RT9490_ADC
	tristate "Richtek RT9490 ADC"
	depends on MFD_RT9490 || COMPILE_TEST
	help
	  Say yes here to enable support rt9490 adc part.
	  It can be used to get monitoring datas for the charging sense
	  voltage and current.
	  Say N to disable.
```

## kernel/kernel_device_modules-6.1/drivers/input/keyboard/Kconfig
```kconfig
# SPDX-License-Identifier: GPL-2.0-only
#
# Input core configuration
#

if INPUT_KEYBOARD

config KEYBOARD_MTK_KPD
	tristate "MediaTek Keypad Support"
	depends on OF && HAVE_CLK
	help
	  Say Y here if you want to use the keypad on MediaTek SoCs.
	  If unsure, say N.
	  To compile this driver as a module, choose M here: the
	  module will be called mtk-kpd.

config DEVICE_MODULES_KEYBOARD_MTK_PMIC
	tristate "MediaTek PMIC keys support"
	depends on DEVICE_MODULES_MFD_MT6397
	help
	  Say Y here if you want to use the pmic keys (powerkey/homekey).

	  To compile this driver as a module, choose M here: the
	  module will be called mtk-pmic-keys.

endif
```

## kernel/kernel_device_modules-6.1/drivers/input/touchscreen/Kconfig
```kconfig
# SPDX-License-Identifier: GPL-2.0-only
#
# Touchscreen driver configuration
#

if INPUT_TOUCHSCREEN

config TOUCHSCREEN_MTK_TOUCH
       string "Touch IC name for Mediatek package"
       help
         Set touch IC name if you have touch panel.

         To compile this dirver for used touch IC.

config TOUCHSCREEN_MT6985_ALPHA_SUPPORT
       tristate "Specify Alpha Touch Platform is mt6985"
       help
         Select Alpha Touch Platform is mt6985.
         To compile this dirver for used touch IC.
         Set Y or M to select this feature for specific platform-mt6985,
         and set N to disable.

source "$(KCONFIG_EXT_PREFIX)drivers/input/touchscreen/NT36532/Kconfig"
source "$(KCONFIG_EXT_PREFIX)drivers/input/touchscreen/GT6936/Kconfig"

endif
```

## kernel/kernel_device_modules-6.1/drivers/interconnect/Kconfig
```kconfig
# SPDX-License-Identifier: GPL-2.0-only

if INTERCONNECT

source "$(KCONFIG_EXT_PREFIX)drivers/interconnect/mediatek/Kconfig"

endif
```

## kernel/kernel_device_modules-6.1/drivers/interconnect/mediatek/Kconfig
```kconfig
config INTERCONNECT_MTK
	bool "Mediatek Network-on-Chip interconnect drivers"
	depends on ARCH_MEDIATEK
	help
	  Support for Mediatek's Network-on-Chip interconnect hardware.

config INTERCONNECT_MTK_EMI
	tristate "Mediatek EMI interconnect driver"
	depends on INTERCONNECT_MTK
	depends on (MTK_DVFSRC && OF)
	help
	  This is a driver for the Mediatek Network-on-Chip on DVFSRC-based
	  platforms.

config INTERCONNECT_MTK_MMQOS_COMMON
	tristate "Mediatek MMQoS support"
	select INTERCONNECT_MTK_EXTENSION
	help
	  Support for multimedia QoS in Mediatek's SoCs.
	  The Mediatek MMQoS(Multimedia Quality of Service) Interconnect
	  driver will collect BW requests from MM users, such as display,
	  camera, mdp and video codec, and configure SMI settings dynamically
	  according to the aggregated BW.

config INTERCONNECT_MTK_MMQOS_MT6873
	tristate "Mediatek MT6873 MMQoS interconnect driver"
	depends on INTERCONNECT_MTK
	depends on DEVICE_MODULES_MTK_SMI
	select INTERCONNECT_MTK_MMQOS_COMMON
	help
	  Support MT6873 multimedia QoS.

config INTERCONNECT_MTK_MMQOS_MT6853
	tristate "Mediatek MT6853 MMQoS interconnect driver"
	depends on INTERCONNECT_MTK
	depends on DEVICE_MODULES_MTK_SMI
	select INTERCONNECT_MTK_MMQOS_COMMON
	help
	  Support MT6853 multimedia QoS.

config INTERCONNECT_MTK_MMQOS_MT6886
	tristate "Mediatek MT6886 MMQoS interconnect driver"
	depends on INTERCONNECT_MTK
	depends on DEVICE_MODULES_MTK_SMI
	select INTERCONNECT_MTK_MMQOS_COMMON
	help
	  Support MT6886 for multimedia QoS in Mediatek's SoCs.
	  The Mediatek MMQoS(Multimedia Quality of Service) Interconnect
	  driver will collect BW requests from MM users, such as display,
	  camera, mdp and video codec, and configure SMI settings dynamically
	  according to the aggregated BW.

config INTERCONNECT_MTK_MMQOS_MT6897
	tristate "Mediatek MT6897 MMQoS interconnect driver"
	depends on INTERCONNECT_MTK
	depends on DEVICE_MODULES_MTK_SMI
	select INTERCONNECT_MTK_MMQOS_COMMON
	help
	  Support MT6897 for multimedia QoS in Mediatek's SoCs.
	  The Mediatek MMQoS(Multimedia Quality of Service) Interconnect
	  driver will collect BW requests from MM users, such as display,
	  camera, mdp and video codec, and configure SMI settings dynamically
	  according to the aggregated BW.

config INTERCONNECT_MTK_MMQOS_MT6983
	tristate "Mediatek MT6983 MMQoS interconnect driver"
	depends on INTERCONNECT_MTK
	depends on DEVICE_MODULES_MTK_SMI
	select INTERCONNECT_MTK_MMQOS_COMMON
	help
	  Support MT6983 multimedia QoS.

config INTERCONNECT_MTK_MMQOS_MT6985
	tristate "Mediatek MT6985 MMQoS interconnect driver"
	depends on INTERCONNECT_MTK
	depends on DEVICE_MODULES_MTK_SMI
	select INTERCONNECT_MTK_MMQOS_COMMON
	help
	  Support MT6985 multimedia QoS.

config MTK_MMQOS_VCP
	tristate "MediaTek MMQOS VCP Support"
	depends on ARCH_MEDIATEK || COMPILE_TEST
	depends on INTERCONNECT_MTK
	depends on DEVICE_MODULES_MTK_SMI
	help
	  Say yes here to add support for the MediaTek Multimedia QoS (MMQOS)
	  for Video Control Processor (VCP). The MMQOS is used to set bw
	  for Mediatek multimedia hardwares, such as display, camera, mdp and
	  video codec. And VCP support is for video codec set bw in tinysys vcp.
	  Say no if your device does not need to MMQoS support in VCP.

config INTERCONNECT_MTK_MMQOS_MT6989
	tristate "Mediatek MT6989 MMQoS interconnect driver"
	depends on INTERCONNECT_MTK
	depends on DEVICE_MODULES_MTK_SMI
	select INTERCONNECT_MTK_MMQOS_COMMON
	help
	  Support MT6989 for multimedia QoS in Mediatek's SoCs.
	  The Mediatek MMQoS(Multimedia Quality of Service) Interconnect
	  driver will collect BW requests from MM users, such as display,
	  camera, mdp and video codec, and configure SMI settings dynamically
	  according to the aggregated BW.

config INTERCONNECT_MTK_MMQOS_MT6878
	tristate "Mediatek MT6878 MMQoS interconnect driver"
	depends on INTERCONNECT_MTK
	depends on DEVICE_MODULES_MTK_SMI
	select INTERCONNECT_MTK_MMQOS_COMMON
	help
	  Support MT6878 for multimedia QoS in Mediatek's SoCs.
	  The Mediatek MMQoS(Multimedia Quality of Service) Interconnect
	  driver will collect BW requests from MM users, such as display,
	  camera, mdp and video codec, and configure SMI settings dynamically
	  according to the aggregated BW.
```

## kernel/kernel_device_modules-6.1/drivers/iommu/Kconfig
```kconfig
# SPDX-License-Identifier: GPL-2.0-only

if IOMMU_SUPPORT

config DEVICE_MODULES_ARM_SMMU_V3
	tristate "ARM Ltd. System MMU Version 3 (SMMUv3) Support"
	depends on ARM64
	select IOMMU_API
	select IOMMU_IO_PGTABLE_LPAE
	select GENERIC_MSI_IRQ_DOMAIN
	help
	  Support for implementations of the ARM System MMU architecture
	  version 3 providing translation support to a PCIe root complex.

	  Say Y here if your system includes an IOMMU device implementing
	  the ARM SMMUv3 architecture.

config DEVICE_MODULES_MTK_IOMMU
	tristate "MediaTek IOMMU Support"
	depends on ARM || ARM64
	depends on ARCH_MEDIATEK || COMPILE_TEST
	select ARM_DMA_USE_IOMMU
	select IOMMU_API
	select IOMMU_IO_PGTABLE_ARMV7S
	select MEMORY
	select DEVICE_MODULES_MTK_SMI
	help
	  Support for the M4U on certain Mediatek SOCs. M4U is MultiMedia
	  Memory Management Unit. This option enables remapping of DMA memory
	  accesses for the multimedia subsystem.

	  If unsure, say N here.

config DEVICE_MODULES_MTK_SMMU_V3_PMU
	tristate "MediaTek SMMUV3 PMU Support"
	depends on DEVICE_MODULES_ARM_SMMU_V3

	help
	  Support for the SMMU v3 PMU on mediatek SOCs.

	  If unsure, say N here.

config DEVICE_MODULES_MTK_SMMU_V3_LMU
	tristate "MediaTek SMMUV3 LMU Support"
	depends on DEVICE_MODULES_ARM_SMMU_V3

	help
	  Support for the SMMU v3 Latency Meter Unit on mediatek SOCs.
	  LMU is used to get the information of how many cycles spent
	  for masters or a particular master in the SMMU.

	  If unsure, say N here.

config DEVICE_MODULES_MTK_SMMU_V3_MPAM_MON
	tristate "MediaTek SMMUV3 MPAM Resource Monitor Support"
	depends on DEVICE_MODULES_ARM_SMMU_V3

	help
	  Support for the SMMU v3 MPAM resource monitor on mediatek SOCs.
	  MPAM resource monitor is used to monitor the cache storage usage
	  in the SMMU TCU and TBUs.

	  If unsure, say N here.

endif # IOMMU_SUPPORT
```

## kernel/kernel_device_modules-6.1/drivers/irqchip/Kconfig
```kconfig
# SPDX-License-Identifier: GPL-2.0-only

config MTK_SYSIRQ
	tristate "Mediatek interrupt polarity controller"
	help
	  Interrupt polarity controller driver to swap polarity for
	  interrupts for Mediatek mobile chips.
```

## kernel/kernel_device_modules-6.1/drivers/leds/Kconfig
```kconfig
# SPDX-License-Identifier: GPL-2.0-only

if NEW_LEDS

config DEVICE_MODULES_LEDS_MT6360
	tristate "LED Support for Mediatek MT6360 PMIC"
	depends on LEDS_CLASS_FLASH && OF
	depends on V4L2_FLASH_LED_CLASS || !V4L2_FLASH_LED_CLASS
	depends on DEVICE_MODULES_MFD_MT6360
	help
	  This option enables support for dual Flash LED drivers found on
	  Mediatek MT6360 PMIC.
	  Support Torch and Strobe mode independently current source.
	  Include Low-VF and short protection.

config LEDS_MT6362
	tristate "MT6362 SPMI LEDS driver"
	depends on LEDS_CLASS_FLASH && OF
	depends on V4L2_FLASH_LED_CLASS || !V4L2_FLASH_LED_CLASS
	depends on MFD_MT6362
	help
	  Say yes here to have support for the MT6362 LEDS
	  Provide strobe and torch mode with flashlight, and
	  indicator and moonlight with rgbled.

	  The driver can also be build as a module.
	  If so, the module will be called leds_mt6362

config LEDS_MTK
	tristate "Mediatek COMMON LED support"
	depends on LEDS_CLASS
	help
	  This option enables support for Mediatek common LEDs
	  say 'y' to enable this

	  To compile this driver as a module, choose 'M' here: the module
	  will be called leds-mtk.

config LEDS_MTK_PWM
	tristate "Mediatek pwm LED support"
	depends on LEDS_CLASS && LEDS_MTK
	depends on DEVICE_MODULES_PWM_MTK_DISP
	help
	  This option enables support for Mediatek pwm LEDs.
	  say 'y' to enable this

	  To compile this driver as a module, choose 'M' here: the module
	  will be called leds-mtk-pwm.

config LEDS_MTK_DISP
	tristate "Mediatek DISP LED support"
	depends on LEDS_CLASS && LEDS_MTK
	depends on MTK_CMDQ_MBOX_EXT
	help
	  This option enables support for Mediatek OLED Display LEDs
	  say 'y' to enable this

	  To compile this driver as a module, choose 'M' here: the module
	  will be called leds-mtk-disp.

config LEDS_MT_BRIGHTNESS_HW_CHANGED
	bool "LED Class mt_brightness_hw_changed attribute support"
	depends on LEDS_CLASS
	help
	  This option enables support for the mt_brightness_hw_changed attribute
	  for LED sysfs class devices under /sys/class/leds.

	  See Documentation/ABI/testing/sysfs-class-led for details
	  this function is the same with brightness_hw_changed


config LEDS_REGULATOR_VIBRATOR
	tristate "LED regulator vibrator support"
	depends on LEDS_CLASS
	help
	  This option enables support for LED regulator vibrator.
	  say 'y' to enable this

	  To compile this driver as a module, choose 'M' here: the module
	  will be called regulator-vibrator.

config LEDS_SM5714
	tristate "LED support for the SM5714"
	depends on LEDS_CLASS && MFD_SM5714
	help
	  This option enables support for SM5714 led chip.
	  Say yes here to enable this.

	  This driver is invoked from SM5714 PMIC.
	  This driver will be called sm5714-fled

endif # NEW_LEDS
```
