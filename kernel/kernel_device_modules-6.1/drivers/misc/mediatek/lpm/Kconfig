## kernel/kernel_device_modules-6.1/drivers/misc/mediatek/lpm/Kconfig
```kconfig
config MTK_LOW_POWER_MODULE
	tristate "Meditaek Low Power Module"
	help
	  For MediaTek Low Power Module, such as CPU idle,
	  CPU suspend low power enhencement.
	  Select "y" if you want to enable low power features.
	  Select "n" if unsure.

config MTK_LPM_DBG_COMMON
	bool "Meditaek Low Power common debug Module"
	help
	  Select MTK_LPM_DBG_COMMON then Mediatek low module
	  common debug feature will be enabled. The common debug
	  feature will support basic debug control and show the
	  information to console.


config MTK_LPM_GS_DUMP_SUPPORT
	bool "Meditaek Low Power golden setting checker"
	help
	  Select MTK_LPM_GS_DUMP_SUPPORT then Mediatek low module
	  golden setting dump mechanism enable.
	  Select "y" if you want to enable gs dump features.
	  Select "n" if unsure.

config MTK_LPM_GS_DUMP_VERSION
	string "Meditaek Low Power golden setting checker version"
	default "v1"
	help
	  Set MTK_LPM_GS_DUMP_VERSION for Mediatek low module
	  golden setting dump mechanism version.

config MTK_LPM_MODULE_NAME
	string "Set mtk-lpm module output name"
	default "generic" if MTK_PLATFORM = ""
	default MTK_PLATFORM if MTK_PLATFORM != ""
	help
	  Customize the debug module output name.
	  Set the specific name for kernel module.
	  The platform name will be set as default
	  name if the MTK_LPM_MODULE_NAME didn't
	  set before.

config MTK_LPM_MT6878
	tristate "Specify Mediatek LPM Platform is MT6878"
	depends on MTK_LOW_POWER_MODULE
	select MTK_LPM_DBG_COMMON
	help
	  Select MediaTek Low Power Module Platform is MT6878
	  for power management.
	  Set Y to select this feature for specific platform-mt6878.
	  If unsure, set N to disable.

config MTK_LPM_MT6886
	tristate "Specify Mediatek LPM Platform is MT6886"
	depends on MTK_LOW_POWER_MODULE
	select MTK_LPM_DBG_COMMON
	help
	  Select MediaTek Low Power Module Platform is MT6886
	  for power management.
	  Set Y to select this feature for specific platform-mt6886.
	  If unsure, set N to disable.

config MTK_LPM_MT6897
	tristate "Specify Mediatek LPM Platform is MT6897"
	depends on MTK_LOW_POWER_MODULE
	select MTK_LPM_DBG_COMMON
	help
	  Select MediaTek Low Power Module Platform is MT6897
	  for power management.
	  Set Y to select this feature for specific platform-mt6897.
	  If unsure, set N to disable.

config MTK_LPM_MT6983
	tristate "Specify Mediatek LPM Platform is MT6983"
	depends on MTK_LOW_POWER_MODULE
	select MTK_LPM_DBG_COMMON
	help
	  Select MediaTek Low Power Module Platform is MT6983
	  for power management.
	  Set Y to select this feature for specific platform-mt6983.
	  If unsure, set N to disable.

config MTK_LPM_MT6985
	tristate "Specify Mediatek LPM Platform is MT6985"
	depends on MTK_LOW_POWER_MODULE
	select MTK_LPM_DBG_COMMON
	help
	  Select MediaTek Low Power Module Platform is MT6985
	  for power management.
	  Set Y to select this feature for specific platform-mt6985.
	  If unsure, set N to disable.

config MTK_LPM_MT6989
	tristate "Specify Mediatek LPM Platform is MT6989"
	depends on MTK_LOW_POWER_MODULE
	select MTK_LPM_DBG_COMMON
	help
	  Select MediaTek Low Power Module Platform is MT6989
	  for power management.
	  Set Y to select this feature for specific platform-mt6989.
	  If unsure, set N to disable.

config MTK_CPU_IDLE_GOV
	tristate "Meditaek cpuidle governor support"
	help
	  For MediaTek cpuidle policy.
	  The policy is used to select suitable cpu idle state.
	  Select "y/m" if you want to enable mtk cpuidle policy.
	  Select "n" if unsure.

config MTK_CPU_IDLE_GOV_VERSION
	string "Meditaek Idle governor version"
	default "MHSP"
	help
	  Set MTK_IDLE_GOV_VERSION for Mediatek cpuidle policy.

config MTK_CPU_IDLE_IPI_SUPPORT
	bool "Meditaek Idle governor support ipi prediction"
	default n
	help
	  Set MTK_CPU_IDLE_IPI_SUPPORT for
	  Mediatek cpuidle ipi prediction policy.
	  The mechanism is based on ipi duration to
	  predict this cpu idle time.

config MTK_SYS_RES_DBG_SUPPORT
	tristate "Meditaek System Resource Debug Info Support"
	help
	  Select MTK_SYS_RES_DBG_SUPPORT to enable
	  MediaTek system resource debug information dump.
	  Select "m" if you want to enable.
	  Select "n" if unsure.
```

## kernel/kernel_device_modules-6.1/drivers/misc/mediatek/mbraink/Kconfig
```kconfig
config MTK_MBRAINK
	tristate "MTK MBRAINK support"
	help
          MBRAINK is a MediaTek in-house kernel module which can
          communicate with android MBrain.
          Set Y to enable this feature.
          If unsure, Set N to stay with legancy feature.

config MTK_MBRAINK_EXPORT_DEPENDED
	tristate "MTK MBRAINK EXPORT DEPENDED support"
	help
	  MBRAINK EXPORT DEPENDED option which
	  needs to export extra function in upstram kernel.
	  Set Y to enable this feature.
	  If unsure, Set N to stay with legancy feature.
```

## kernel/kernel_device_modules-6.1/drivers/misc/mediatek/mmdebug/Kconfig
```kconfig
# SPDX-License-Identifier: GPL-2.0

config MTK_MMDEBUG
	tristate "MediaTek MMDebug Support"
	depends on ARCH_MEDIATEK || COMPILE_TEST
	help
	  Say yes here to add support for the MediaTek Multimedia DEBUG (MMDEBUG)
	  driver. The MMDEBUG is used to debug for Mediatek multimedia drivers
	  , such as smi and mmdvfs. Say no if your device does not need to do
	  DEBUG for Multimedia drivers.
```

## kernel/kernel_device_modules-6.1/drivers/misc/mediatek/pbm/Kconfig
```kconfig
config MTK_PBM
	tristate "MTK power budget management"
	select MTK_MDPM
	help
	  This kernel config can be used to enable power budget management.
	  When enable this option, pbm will allocate limit power budget to
	  CPU and GPU when battery voltage is low.
	  If unsure, say N.

config MTK_PEAK_POWER_BUDGET
	tristate "MTK peak power budget"
	help
	  For MediaTek peak power budgeting.
	  Select "y" if you want to enable MTK peak power budget
	  feature
	  Select "n" if unsure.
```

## kernel/kernel_device_modules-6.1/drivers/misc/mediatek/pgboost/Kconfig
```kconfig
config MTK_PGBOOST
	tristate "MTK pgboost feature"
	depends on DMA_CMA && SPARSEMEM
	help
	  A new option CONFIG_MTK_PGBOOST for the feature.
	  This is used for the improvement of dual rank impact
	  over some scenarios. If you are not sure about whether
	  to enable it or not, please set n.
```

## kernel/kernel_device_modules-6.1/drivers/misc/mediatek/pmic_tia/Kconfig
```kconfig
config DEVICE_MODULES_MTK_PMIC_TIA
	tristate "MediaTek MTK_PMIC_TIA driver"
	help
	  Say y here to control pmic driver add pmic_tia node.
	  This config add pmic_tia node for wifi only project co-tms, wifi
	  only project will read TIA2_GPS_TSX_DATA through pmic_tia node in
	  user layer.
```

## kernel/kernel_device_modules-6.1/drivers/misc/mediatek/sensor/2.0/Kconfig
```kconfig
# SPDX-License-Identifier: GPL-2.0

source "$(KCONFIG_EXT_PREFIX)drivers/misc/mediatek/sensor/2.0/mtk_nanohub/Kconfig"
source "$(KCONFIG_EXT_PREFIX)drivers/misc/mediatek/sensor/2.0/sensorhub/Kconfig"
source "$(KCONFIG_EXT_PREFIX)drivers/misc/mediatek/sensor/2.0/test/Kconfig"
source "$(KCONFIG_EXT_PREFIX)drivers/misc/mediatek/sensor/2.0/lsm6dsm_secondary/Kconfig"
```

## kernel/kernel_device_modules-6.1/drivers/misc/mediatek/usb/Kconfig
```kconfig
# SPDX-License-Identifier: GPL-2.0

source "$(KCONFIG_EXT_PREFIX)drivers/misc/mediatek/usb/usb_meta/Kconfig"
source "$(KCONFIG_EXT_PREFIX)drivers/misc/mediatek/usb/usb_rndis/Kconfig"
source "$(KCONFIG_EXT_PREFIX)drivers/misc/mediatek/usb/usb_boost/Kconfig"
source "$(KCONFIG_EXT_PREFIX)drivers/misc/mediatek/usb/usb_offload/Kconfig"
source "$(KCONFIG_EXT_PREFIX)drivers/misc/mediatek/usb/usb_xhci/Kconfig"
source "$(KCONFIG_EXT_PREFIX)drivers/misc/mediatek/usb/usb_logger/Kconfig"
```

## kernel/kernel_device_modules-6.1/drivers/misc/mediatek/usb/usb_logger/Kconfig
```kconfig
# SPDX-License-Identifier: GPL-2.0

config MTK_USB_LOGGER
	tristate "MediaTek USB LOGGER"
	depends on DEVICE_MODULES_USB_MTU3
	depends on DEVICE_MODULES_USB_XHCI_MTK
	help
	  USB logger would record usb-related event
	  for debug purpose. We can manual enable or
	  disable this function through debugfs or procfs.

	  If you don't know what this is, please say N.
```

## kernel/kernel_device_modules-6.1/drivers/misc/mediatek/usb/usb_offload/Kconfig
```kconfig
# SPDX-License-Identifier: GPL-2.0
#
# For MTK USB3.0 IP

config MTK_USB_OFFLOAD
	tristate "MediaTek USB Offload"
	help
	  Say Y or M here if your system runs on MediaTek SoCs with
	  'USB Offload' feature. The feature will use ADSP to transfer
	  Audio ISOC data.

	  If you don't know what this is, please say N.

	  Choose M here to compile this driver as a module, and it
	  will be called usb_offload.ko

config MTK_USB_OFFLOAD_DEBUG
	bool "Enable Medaitek USB Offload Debug Feature"
	help
	  Say Y if you need this feature while
	  the trace points of specific function in alsa,
	  ex usb_audio_probe, have not merged into upstream

	  Otherwise say N.
```

## kernel/kernel_device_modules-6.1/drivers/mmc/host/Kconfig
```kconfig
# SPDX-License-Identifier: GPL-2.0-only
#
# MMC/SD host controller drivers
#

comment "MMC/SD/SDIO Host Controller Drivers"

config DEVICE_MODULES_MMC_DEBUG
    tristate "MMC host drivers debugging"
    depends on MMC != n
    help
      This is an option for use by developers; most people should
      say N here. This enables MMC host driver debugging. And further
      added host drivers please don't invent their private macro for
      debugging.

config DEVICE_MODULES_MMC_MTK
	tristate "MediaTek SD/MMC Card Interface support"
	depends on HAS_DMA
	depends on COMMON_CLK
	select REGULATOR
	select DEVICE_MODULES_MMC_CQHCI
	help
	  This selects the MediaTek(R) Secure digital and Multimedia card Interface.
	  If you have a machine with a integrated SD/MMC card reader, say Y or M here.
	  This is needed if support for any SD/SDIO/MMC devices is required.
	  If unsure, say N.

config MMC_MTK_PRO
	tristate "MediaTek SD/MMC Card Proprietary Interface support"
	depends on !DEVICE_MODULES_MMC_MTK
	help
	  This selects the MediaTek(R) Secure digital and Multimedia card
	  Interface. If you have a machine with a integrated SD/MMC card
	  reader, say Y or M here.

	  If unsure, say N.

config SEC_MMC_FEATURE
	tristate "SEC specific MMC/SD feature"
	depends on MMC_MTK_PRO
	help
	  Enable Samsung MMC/SD feature support.
	  Enabling this allows kernel to use SEC specific feature
	  defined and implemented by SEC.

config DEVICE_MODULES_MMC_CQHCI
	tristate "Command Queue Host Controller Interface support"
	depends on HAS_DMA
	help
	  This selects the Command Queue Host Controller Interface (CQHCI)
	  support present in host controllers of Qualcomm Technologies, Inc
	  amongst others.
	  This controller supports eMMC devices with command queue support.

	  If you have a controller with this interface, say Y or M here.

	  If unsure, say N.

config MMC_AUTOK
	tristate "MediaTek SD/MMC Card Auto Calibration support"
	help
	  This selects the MediaTek(R) Secure digital and Multimedia card
	  Online Tune Interface. If you have a controller with this interface,
	  say Y or M here.
	  If unsure, say N.

config DEVICE_MODULES_MMC_MTK_WP
	tristate "MediaTek eMMC Write Protect Group support"
	help
	  Set read-only on the partitions belonging to eMMC write protect groups.
	  If you set write protect on eMMC,
	  say Y or M here.
	  If unsure, say N.
```

## kernel/kernel_device_modules-6.1/drivers/nvmem/Kconfig
```kconfig
# SPDX-License-Identifier: GPL-2.0-only

config MTK_DEVINFO
	tristate "Mediatek SoCs device information support"
	depends on ARCH_MEDIATEK || COMPILE_TEST
	depends on HAS_IOMEM
	help
	  This is a driver to access SOC related non-volatile data like
	  calibration data, FAB information etc.

	  This driver can also be built as a module. If so, the module
	  will be called devinfo-mtk.

config MT635X_EFUSE
	tristate "Mediatek MT635x PMIC EFUSE Support"
	depends on DEVICE_MODULES_MFD_MT6397 || COMPILE_TEST
	help
	  This is a simple driver to dump specified values of Mediatek
	  MT635X PMIC from EFUSE.

	  This driver can also be built as a module. If so, the module
	  will be called nvmem-mt635x-efuse.

config MT6338_EFUSE
	tristate "Mediatek MT6338 PMIC EFUSE Support"
	depends on MFD_MT6338 || COMPILE_TEST
	help
	  This is a simple driver to dump specified values of Mediatek
	  MT6338 PMIC from EFUSE.

	  This driver can also be built as a module. If so, the module
	  will be called nvmem-mt6338-efuse.

config MT6681_EFUSE
	tristate "Mediatek MT6681 PMIC EFUSE Support"
	depends on MFD_MT6681 || COMPILE_TEST
	help
	  This is a simple driver to dump specified values of Mediatek
	  MT6681 PMIC from EFUSE.

	  This driver can also be built as a module. If so, the module
	  will be called nvmem-mt6681-efuse.
```

## kernel/kernel_device_modules-6.1/drivers/pci/controller/Kconfig
```kconfig
# SPDX-License-Identifier: GPL-2.0

config DEVICE_MODULES_PCIE_MEDIATEK_GEN3
	tristate "MediaTek Gen3 PCIe controller"
	depends on ARCH_MEDIATEK || COMPILE_TEST
	depends on PCI_MSI_IRQ_DOMAIN
	help
	  Adds support for PCIe Gen3 MAC controller for MediaTek SoCs.
	  This PCIe controller is compatible with Gen3, Gen2 and Gen1 speed,
	  and support up to 256 MSI interrupt numbers for
	  multi-function devices.

	  Say Y here if you want to enable Gen3 PCIe controller support on
	  MediaTek SoCs.

config ANDROID_FIX_PCIE_SLAVE_ERROR
	bool "Android fix PCIe slave error"
	help
	  This is a temporary config used for mtk userdebug and eng load to
	  avoid Android GKI ABI rules. Once the patch be merged to ACK and
	  pull to our branch, will revert this.

	  ANDROID_FIX_PCIE_SLAVE_ERROR is the kernel config of vendor hooks.
	  Add vendor hooks for unusual abort cases to avoid system panic.
	  When PCIe encounters completion timeout, PCIe hardware will reply
	  slave error to bus, which will causes the system to panic.
```

## kernel/kernel_device_modules-6.1/drivers/pinctrl/Kconfig
```kconfig
config MTK_PINCTRL_DEBUG
    tristate "Mediatek Pinctrl Debug Setting"
    help
      This is the debug configuration of pin controller and gpio driver
      for mediatek internal usage. It will enable mediatek common v2,
      paris and eint core driver. And for another usage is for bypass
      Android GKI rule until upstream.
```
