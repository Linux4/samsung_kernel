## kernel/kernel_device_modules-6.1/drivers/regulator/Kconfig
```kconfig
# SPDX-License-Identifier: GPL-2.0-only
menuconfig REGULATOR
	bool "Voltage and Current Regulator Support"
	select LINEAR_RANGES
	help
	  Generic Voltage and Current Regulator support.

	  This framework is designed to provide a generic interface to voltage
	  and current regulators within the Linux kernel. It's intended to
	  provide voltage and current control to client or consumer drivers and
	  also provide status information to user space applications through a
	  sysfs interface.

	  The intention is to allow systems to dynamically control regulator
	  output in order to save power and prolong battery life. This applies
	  to both voltage regulators (where voltage output is controllable) and
	  current sinks (where current output is controllable).

	  This framework safely compiles out if not selected so that client
	  drivers can still be used in systems with no software controllable
	  regulators.

	  If unsure, say no.


if REGULATOR

config DEVICE_MODULES_REGULATOR_MT6315
	tristate "MediaTek MT6315 PMIC"
	depends on SPMI
	select REGMAP_SPMI
	help
	  Say y here to select this option to enable the power regulator of
	  MediaTek MT6315 PMIC.
	  This driver supports the control of different power rails of device
	  through regulator interface.

config DEVICE_MODULES_REGULATOR_MT6316
	tristate "MediaTek MT6316 PMIC"
	depends on SPMI
	select REGMAP_SPMI
	help
	  Say y here to select this option to enable the power regulator of
	  MediaTek MT6316 PMIC.
	  This driver supports the control of different power rails of device
	  through regulator interface.

config REGULATOR_MT6359P
	tristate "MediaTek MT6359P PMIC"
	depends on DEVICE_MODULES_MFD_MT6397
	help
	  Say y here to select this option to enable the power regulator of
	  MediaTek MT6359P PMIC.
	  This driver supports the control of different power rails of device
	  through regulator interface.

config DEVICE_MODULES_REGULATOR_MT6360
	tristate "MT6360 SubPMIC Regulator"
	depends on DEVICE_MODULES_MFD_MT6360
	help
	  Say Y here to enable MT6360 regulator support.
	  This is support MT6360 PMIC/LDO part include
	  2-channel buck with Thermal Shutdown and Overload Protection
	  6-channel High PSRR and Low Dropout LDO.

config REGULATOR_MT6362
	tristate "MT6362 SPMI Regulator driver"
	depends on MFD_MT6362
	help
	  Say yes here to have support for the MT6362 Regulator
	  Include six BUCKs and seven LDOs.

	  The driver can also be build as a module.
	  If so, the module will be called mt6362_regulator

config REGULATOR_MT6363
	tristate "MT6363 SPMI Regulator driver"
	depends on MFD_MTK_SPMI_PMIC
	help
	  Say y here to select this option to enable the power regulator of
	  MediaTek MT6363 PMIC.
	  This driver supports the control of different power rails of device
	  through regulator interface.

	  The driver can also be build as a module.
	  If so, the module will be called mt6363_regulator

config REGULATOR_MT6368
	tristate "MT6368 SPMI Regulator driver"
	depends on MFD_MTK_SPMI_PMIC
	help
	  Say y here to select this option to enable the power regulator of
	  MediaTek MT6368 PMIC.
	  This driver supports the control of different power rails of device
	  through regulator interface.

	  The driver can also be build as a module.
	  If so, the module will be called mt6368_regulator

config REGULATOR_MT6369
	tristate "MT6369 SPMI Regulator driver"
	depends on MFD_MTK_SPMI_PMIC
	help
	  Say y here to select this option to enable the power regulator of
	  MediaTek MT6369 PMIC.
	  This driver supports the control of different power rails of device
	  through regulator interface.

	  The driver can also be build as a module.
	  If so, the module will be called mt6369_regulator

config REGULATOR_MT6373
	tristate "MT6373 SPMI Regulator driver"
	depends on MFD_MTK_SPMI_PMIC
	help
	  Say y here to select this option to enable the power regulator of
	  MediaTek MT6373 PMIC.
	  This driver supports the control of different power rails of device
	  through regulator interface.

	  The driver can also be build as a module.
	  If so, the module will be called mt6373_regulator

config REGULATOR_MT6681
	tristate "MT6681 SPMI Regulator driver"
	depends on MFD_MTK_SPMI_PMIC
	help
	  Say y here to select this option to enable the power regulator of
	  MediaTek MT6681 PMIC.
	  This driver supports the control of different power rails of device
	  through regulator interface.

	  The driver can also be build as a module.
	  If so, the module will be called mt6681_regulator

config DEVICE_MODULES_REGULATOR_MTK_DVFSRC
	tristate "MediaTek DVFSRC regulator driver"
	depends on MTK_DVFSRC
	help
	  Say y here to control regulator by DVFSRC (dynamic voltage
	  and frequency scaling resource collector).
	  This driver supports to control regulators via the DVFSRC
	  of Mediatek. It allows for voting on regulator state
	  between multiple users.

config REGULATOR_MTK_VMM_ISP71
	tristate "MediaTek ISPDVFS regulator driver"
	depends on MTK_CCU_RPROC
	help
	  Say y here to control regulator by ISPDVFS (dynamic voltage
	  and frequency scaling resource collector).
	  This driver supports to control regulators via the ISPDVFS
	  of Mediatek. It allows for voting on regulator state
	  between multiple users.

config REGULATOR_RT4803
	tristate "Richtek RT4803 boost regualtor"
	depends on I2C
	select REGMAP_I2C
	help
	  This adds support for RT4803 boost converter that integrates the
	  bypass switch. If the input voltage is low than the required voltage,
	  RT4803 will enter boost mode. Otherwise, enable internal bypass
	  switch to enter bypass mode.

config REGULATOR_RT5133
	tristate "Richtek RT5133 regulator driver"
	depends on I2C && GPIOLIB
	select REGMAP
	select CRC8
	select OF_GPIO
	select REGULATOR_FIXED_VOLTAGE
	select MTK_SUBPMIC_MISC
	help
	  RT5133 is an integrated chip. It includes 8 LDOs and 3 GPIOs that
	  can be used to drive output high/low purpose. The dependency of the
	  GPIO block is internally LDO1 voltage. If LDO1 voltage output disabled,
	  GPIO cannot be used to drive output high. It need to pay more
	  attention on the usage.

config REGULATOR_MAX77816
	tristate "Maxim MAX77816 boost regualtor"
	depends on I2C
	select REGMAP_I2C
	help
	  This adds support for MAX77816 boost converter that integrates the
	  bypass switch. If the input voltage is low than the required voltage,
	  MAX77816 will enter boost mode. Otherwise, enable internal bypass
	  switch to enter bypass mode.

config DEVICE_MODULES_REGULATOR_RT6160
	tristate "Richtek RT6160 BuckBoost voltage regulator"
	depends on I2C
	select REGMAP_I2C
	help
	  This adds support for voltage regulator in Richtek RT6160.
	  This device automatically change voltage output mode from
	  Buck or Boost. The mode transition depend on the input source voltage.
	  The wide output range is from 2025mV to 5200mV and can be used on most
	  common application scenario.

config REGULATOR_MT6878_ALPHA_SUPPORT
	tristate "Specify Alpha REGULATOR Platform is mt6878"
	help
	  Select Alpha REGULATOR Platform is mt6878.
	  To compile this dirver for used touch IC.
	  Set Y or M to select this feature for specific platform-mt6878,
	  and set N to disable.
endif
```

## kernel/kernel_device_modules-6.1/drivers/remoteproc/Kconfig
```kconfig
# SPDX-License-Identifier: GPL-2.0-only
menu "Remoteproc drivers"

if REMOTEPROC

config MTK_CCD_REMOTEPROC
	tristate "MediaTek CCD driver"
	depends on RPMSG_MTK_CCD
	help
	  Say y here to enable support communication channels to remote
	  processors in MediaTek platforms. This uses MTK ccd driver to
	  communicate with Camera Control Daemon base on rpmsg framework. It
	  provide channels, endpoints creation and send operations.

config MTK_CCU_RPROC
	tristate "MediaTek CCU driver"
	depends on RPMSG_MTK_CCD
	help
	  Say y here to support Camera Control Unit's remote processors via
	  the remote processor framework. Support MTK Camera module using
	  CCU hardware to do hard-real time task. Offers speed up of 3A,
	  including faster control flow and stabler frame rate

config MTK_CCU_DEBUG
	bool "Debugging log for Mediatek CCU"
	depends on MTK_CCU_RPROC
	help
	  Select this to output the CCU uP log message on
	  engeering load or user debug load.The user space
	  logging procedure mmaps the ccu_rproc node.
	  For security concerns, register ccu_rproc node
	  only on engeering load or user debug load.

	  If unsure, say N.

endif # REMOTEPROC

endmenu
```

## kernel/kernel_device_modules-6.1/drivers/reset/Kconfig
```kconfig
# SPDX-License-Identifier: GPL-2.0-only
if RESET_CONTROLLER

config DEVICE_MODULES_RESET_TI_SYSCON
	tristate "TI SYSCON Reset Driver"
	depends on HAS_IOMEM
	select MFD_SYSCON
	help
	  This enables the reset driver support for TI devices with
	  memory-mapped reset registers as part of a syscon device node. If
	  you wish to use the reset framework for such memory-mapped devices,
	  say Y here. Otherwise, say N.

endif
```

## kernel/kernel_device_modules-6.1/drivers/rpmsg/Kconfig
```kconfig
# SPDX-License-Identifier: GPL-2.0

menu "Rpmsg drivers"

# RPMSG always gets selected by whoever wants it

config RPMSG_MTK
	tristate "MediaTek TinySys RPM driver"
	depends on MTK_MBOX
	select RPMSG
	help
	  Say y here to enable support communication channels to remote
	  processors in MediaTek platforms. This uses MTK MBOX driver to
	  communicate with remote processors base on rpmsg framework. It
	  provide channels, endpoints creation and send operations.

config RPMSG_MTK_CCD
	tristate "MediaTek CCD rpmsg driver"
	select RPMSG
	help
	  Say y here to enable support communication channels to remote
	  processors in MediaTek platforms. This uses MTK ccd driver to
	  communicate with Camera Control Daemon base on rpmsg framework. It
	  provide channels, endpoints creation and send operations.

endmenu
```

## kernel/kernel_device_modules-6.1/drivers/rtc/Kconfig
```kconfig
# SPDX-License-Identifier: GPL-2.0-only
#
# RTC class/drivers configuration
#

if RTC_CLASS

config DEVICE_MODULES_RTC_DRV_MT6397
	tristate "MediaTek PMIC based RTC"
	depends on DEVICE_MODULES_MFD_MT6397 || (COMPILE_TEST && IRQ_DOMAIN)
	help
	  This selects the MediaTek(R) RTC driver. RTC is part of MediaTek
	  MT6397 PMIC. You should enable MT6397 PMIC MFD before select
	  MediaTek(R) RTC driver.

	  If you want to use MediaTek(R) RTC interface, select Y or M here.

config RTC_DRV_MT6685
	tristate "Mediatek Real Time Clock driver"
	depends on MFD_MT6685 || (COMPILE_TEST && IRQ_DOMAIN)
	help
	  This selects the Mediatek(R) RTC driver. RTC is part of Mediatek
	  MT6685. You should enable MT6685 MFD before select
	  Mediatek(R) RTC driver.

	  If you want to use Mediatek(R) RTC interface, select Y or M here.

endif # RTC_CLASS
```

## kernel/kernel_device_modules-6.1/drivers/samsung/Kconfig
```kconfig
# drivers/samsung/Kconfig
#
# Copyright (c) 2010-2019 Samsung Electronics Co., Ltd.
#		http://www.samsung.com/
#
# Licensed under GPLv2

config SEC_EXT
	tristate "Samsung Extension Feature"
	default m

config SEC_REBOOT
	tristate "Enable TN reboot features"
	depends on SEC_EXT
	default m
	help
	  Samsung TN reboot extension Feature. Do additional work when reboot.

config SEC_PARAM
	tristate "Enable Param modification"
	depends on SEC_DEBUG
	default n
	help
	  Samsung TN Param Feature.

config CM_OFFSET
	int "Charging Mode Offset"
	default 0
	depends on SEC_PARAM
	help
	  set Charging Mode Offset when you enable SEC_PARAM.

config WC_OFFSET
	int "Wireless Charging IC Offset"
	default 0
	depends on SEC_PARAM
	help
	  set Wireless Charging IC Info Offset.

comment "Samsung sysfs Feature"
config DRV_SAMSUNG
	tristate "Samsung sec class/sysfs Feature"
	default m
	depends on SEC_EXT
	help
	  Samsung sysfs name 'sec' directory create.
	  
config SEC_KEY_NOTIFIER
	tristate "Enable Samsung key event notifier"
	depends on SEC_EXT
	default m
	help
	  Samsung Key input event notifier

config SEC_BOOTSTAT
	tristate "Enable Samsung Bootstat logging"
	default m
	help
	  Samsung TN Bootstat Feature.

config SEC_CHIPID
	tristate "Enable Samsung CHIPID"
	default m
	depends on SEC_EXT
	help
	  Samsung TN CHIPID Feature.

comment "Samsung TN Build Options"
config SEC_FACTORY
	bool "SAMSUNG Factory build option"
	depends on SEC_EXT && SEC_DEBUG
	default n
	help
	  Include some codes for Factory binary.
	  This option is enabled by Factory build option.
	  In samsung build script, '-F' enables this option.

config ENABLE_BOOTING_CLK_LIMIT
	bool "enable cpu max frequency limiting"
	default n
	help
	  This option is to enable the code for CPU_BOOTING_CLK_LIMIT

config CPU_BOOTING_CLK_LIMIT
	bool "limit cpu max frequency on booting"
	depends on SEC_FACTORY || ENABLE_BOOTING_CLK_LIMIT
	default y
	help
	  This option is enabled only for Factory build or
	  the build to limit cpu booting clk frequency

comment "Samsung TN BSP Options"
config SAMSUNG_PRODUCT_SHIP
	bool "set up for product shipping"
	depends on SEC_EXT
	default n

config ARGOS
	tristate "Throughput monitoring Feature"
	default n
	help
	  This option enables monitoring the data throughput and doing several actions for
	  enhancing the performance such as adjusting the CPU freqency, allocating the tasks
	  to the appropriate CPU and so on

source "$(KCONFIG_EXT_PREFIX)drivers/samsung/debug/Kconfig"
source "$(KCONFIG_EXT_PREFIX)drivers/samsung/misc/Kconfig"
source "$(KCONFIG_EXT_PREFIX)drivers/samsung/pm/Kconfig"
```

## kernel/kernel_device_modules-6.1/drivers/samsung/pm/Kconfig
```kconfig
# drivers/samsung/Kconfig
#
# Copyright (c) 2010-2022 Samsung Electronics Co., Ltd.
#		http://www.samsung.com/
#
# Licensed under GPLv2

config SEC_PM_DEBUG
    tristate "Enable Samsung Mobile Power management debug support"
    default n
    depends on SEC_PM
    help
      This option enables Samsung Mobile Power management debug support.
      Intended for test and debug only.
```

## kernel/kernel_device_modules-6.1/drivers/spi/Kconfig
```kconfig
# SPDX-License-Identifier: GPL-2.0-only
#
# SPI driver configuration
#

if SPI

config DEVICE_MODULES_SPI_MT65XX
	tristate "MediaTek SPI controller"
	depends on ARCH_MEDIATEK || COMPILE_TEST
	help
	  This selects the MediaTek(R) SPI bus driver.
	  If you want to use MediaTek(R) SPI interface,
	  say Y or M here.If you are not sure, say N.
	  SPI drivers for Mediatek MT65XX and MT81XX series ARM SoCs.

endif # SPI
```
