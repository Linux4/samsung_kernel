&gen_panel {
	dsi_hx8369b_grand_neo_55b890_vid: gen-panel-hx8369b-grand-neo-55b890-video {
		gen-panel-manu = "BOE";			/* condensed manufacturer name */
		gen-panel-name = "lcd_hx8369b_55B890_mipi";
		gen-panel-id = <0x55B890>;
		gen-panel-dev-id = <0>;			/* SPRDFB_MAINLCD_ID : MAIN 0, SUB 1 */
		gen-panel-type = <2>;			/* LCD_MODE_DSI: MCU 0, RGB 1, DSI 2 */
		gen-panel-refresh = <60>;
		gen-panel-xres = <480>;
		gen-panel-yres = <800>;
		gen-panel-width= <64>;			/* screen width in mm */
		gen-panel-height = <106>;		/* screen height in mm */
		gen-panel-work-mode = <1>;		/* SPRDFB_MIPI_MODE_VIDEO : CMD 0, VIDEO 1*/
		gen-panel-direction = <0>;		/* LCD_DIRECT_NORMAL : Normal 0, ROT90 1, ROT180 2, ROT270 3 */
		gen-panel-suspend-mode = <1>;	/* SEND_SLEEP_CMD : RST 0, SLEEP 1 */
		gen-panel-bus-width = <24>;
		gen-panel-lanes = <2>;
		gen-panel-phy-feq = <481000>;
		gen-panel-h-sync-pol = <0>;		/*SPRDFB_POLARITY_POS : POS 0, NEG 1 */
		gen-panel-v-sync-pol = <0>;		/*SPRDFB_POLARITY_POS : POS 0, NEG 1 */
		gen-panel-de-pol = <0>;			/*SPRDFB_POLARITY_POS : POS 0, NEG 1 */
		gen-panel-te-pol = <0>;			/*SPRDFB_POLARITY_POS : POS 0, NEG 1 */
		gen-panel-color-mode-pol = <1>;	/*SPRDFB_POLARITY_POS : POS 0, NEG 1 */
		gen-panel-shut-down-pol = <1>;	/*SPRDFB_POLARITY_POS : POS 0, NEG 1 */
		gen-panel-h-front-porch = <76>;	/* hfp */
		gen-panel-h-back-porch = <126>;	/* hbp */
		gen-panel-h-sync-width = <60>;	/* hsync */
		gen-panel-v-front-porch = <8>;	/* vfp */
		gen-panel-v-back-porch = <12>;	/* vbp */
		gen-panel-v-sync-width = <4>;	/* vsync */
		gen-panel-rst-high-in-sleep;

		/*
		 * DSI PACKET HEADER INFO
		 * @ delay(msec) : 2byte
		 * @ size of data : 2byte
		 */
		gen-panel-pkt-dinfo-addr-offset = <0>;
		gen-panel-pkt-dinfo-addr-length = <1>;
		gen-panel-pkt-dinfo-data-offset = <1>;
		gen-panel-pkt-dinfo-data-length = <1>;
		gen-panel-init-cmds = [
			39 00 00 0A 00 04		B9 FF 83 69
			39 00 00 00 00 0B		B1 0B 87 17 00 0F 0F 0F 15 0C 12
			39 00 00 00 00 04		C6 41 FF 7C
			39 00 00 00 00 05		E3 00 00 00 00
			39 00 00 00 00 07		C0 73 50 00 38 C4 08
			39 00 00 00 00 10		BA 31 00 16 CA B1 0A 00 10 28 02 21 21 9A 1A 8F
			15 00 00 00 00 02		3A 70
			39 00 00 00 00 05		B3 83 00 31 03
			15 00 00 00 00 02		B4 00
			15 00 00 00 00 02		CC 0E
			15 00 00 00 00 02		EA 72
			15 00 00 00 00 02		B2 03
			39 00 00 00 00 5D		D5 00 00 02 00 00 00 00 12 40 00 00 00 01 60 37 00 00 04 0E 0F 47 
									00 00 03 00 00 00 00 00 00 00 00 03 00 00 10 00 00 89 00 11 33 55 
									77 31 00 00 98 00 66 44 22 00 02 00 00 89 00 00 22 44 66 20 00 00 
									98 00 77 55 33 11 13 00 00 00 01 00 00 00 03 00 CF FF FF 03 00 CF 
									FF FF 00 80 5A  
			39 00 00 00 00 80		C1 03 00 07 0E 16 1D 26 2E 35 3E 46 4D 54 5B 61 68 6F 76 7E 85 8D 95 9D A4 AC B4 BB C2 C9 D1 
									D8 E0 E8 F0 1A 7B 95 17 DD 0F 97 2E 00 00 08 10 18 21 2B 32 3C 44 4C 54 5B 61 69 71 79 80 
									88 91 99 A1 A9 B1 B9 C0 C7 CF D7 DF E7 F0 F8 FF 0F CC E1 E4 F1 6C 38 A2 00 00 08 10 19 22 
									2B 33 3D 45 4D 54 5B 62 6A 72 7A 81 89 92 9A A2 AA B2 B9 C0 C8 CF D7 DF E7 F0 F8 FF 0C 64 
									9F A4 F1 1A DD F7 C0 
			39 00 00 00 00 24		E0 01 08 08 26 33 3F 08 28 05 09 0E 0F 0C 0E 11 10 16 02 07 08 26 33 3E 08 
									27 05 0A 0D 10 14 0F 12 10 16 01
			39 00 00 00 00 14		E5 04 00 08 08 0A 08 00 80 20 20 10 00 08 0C 0A 08 00 80 0A
			39 00 00 00 00 03		C9 0F 00
			39 00 00 00 00 03		51 FF 3C
			39 00 00 00 00 03		53 24 08
			39 00 00 14 00 03		55 00 2C
		];
		gen-panel-enable-cmds = [
			05 00 00 B4 00 01		11
			05 00 00 64 00 01		29
		];
		gen-panel-disable-cmds = [
			05 00 00 96 00 01		28
			05 00 00 96 00 01		10
		];
		gen-panel-mdnie-ui-mode-cmds = [
			39 00 00 00 00 71		E6
							5A 00 00 03 00 00 00 00 00 00 00 00 00 00 00 
							00 00 00 00 00 00 00 FF 00 FF 00 FF FF 00 00 
							FF 00 FF 00 FF FF 00 00 FF 00 FF 00 FF FF 00 
							02 20 00 20 00 20 00 20 00 20 00 20 00 20 00 
							20 00 20 00 20 00 20 00 20 00 20 00 20 00 20 
							00 20 00 20 00 20 00 20 00 20 00 20 00 20 00 
							20 00 20 00 06 21 1e 97 1f 48 1f ba 04 fe 1f 
							48 1f ba 1e 97 05 af
		];
		gen-panel-mdnie-video-mode-cmds = [
			39 00 00 00 00 71		E6
							5A 00 00 03 00 00 00 00 00 00 00 00 00 00 00 
							00 00 00 00 00 00 00 FF 00 FF 00 FF FF 00 00 
							FF 00 FF 00 FF FF 00 00 FF 00 FF 00 FF FF 00 
							06 20 00 20 00 20 00 20 00 20 00 20 00 20 00 
							20 00 20 00 20 00 20 00 20 00 20 00 20 00 20 
							00 20 00 20 00 20 00 20 00 20 00 20 00 20 00 
							20 00 20 00 05 10 1f 4c 1f a4 1f dd 04 7f 1f 
							a4 1f dd 1f 4c 04 d7
		];
		gen-panel-mdnie-camera-mode-cmds = [
			39 00 00 00 00 71		E6
							5A 00 00 03 00 00 00 00 00 00 00 00 00 00 00 
							00 00 00 00 00 00 00 FF 00 FF 00 FF FF 00 00 
							FF 00 FF 00 FF FF 00 00 FF 00 FF 00 FF FF 00 
							06 20 00 20 00 20 00 20 00 20 00 20 00 20 00 
							20 00 20 00 20 00 20 00 20 00 20 00 20 00 20 
							00 20 00 20 00 20 00 20 00 20 00 20 00 20 00 
							20 00 20 00 05 10 1f 4c 1f a4 1f dd 04 7f 1f 
							a4 1f dd 1f 4c 04 d7
		];
		gen-panel-mdnie-gallery-mode-cmds = [
			39 00 00 00 00 71		E6
							5A 00 00 03 00 00 00 00 00 00 00 00 00 00 00 
							00 00 00 00 00 00 00 FF 00 FF 00 FF FF 00 00 
							FF 00 FF 00 FF FF 00 00 FF 00 FF 00 FF FF 00 
							02 20 00 20 00 20 00 20 00 20 00 20 00 20 00 
							20 00 20 00 20 00 20 00 20 00 20 00 20 00 20 
							00 20 00 20 00 20 00 20 00 20 00 20 00 20 00 
							20 00 20 00 05 10 1f 4c 1f a4 1f dd 04 7f 1f 
							a4 1f dd 1f 4c 04 d7
		];
		gen-panel-mdnie-negative-mode-cmds = [
			39 00 00 00 00 71		E6
							5A 00 00 30 00 00 00 00 00 00 00 00 00 00 00 
							00 00 00 00 00 00 ff 00 ff 00 ff 00 00 ff ff 
							00 ff 00 ff 00 00 ff ff 00 ff 00 ff 00 00 ff 
							00 20 00 20 00 20 00 20 00 20 00 20 00 20 00 
							20 00 20 00 20 00 20 00 20 00 20 00 20 00 20 
							00 20 00 20 00 20 00 20 00 20 00 20 00 20 00 
							20 00 20 00 04 00 00 00 00 00 00 00 04 00 00 
							00 00 00 00 00 04 00
		];
		gen-panel-read-id = [
			DA 00 01
			DB 00 01
			DC 00 01
		];
		gen-panel-read-status-reg = [0A];
		gen-panel-read-status-ok = [9A];
		status = "okay";
	};
};
