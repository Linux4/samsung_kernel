&gen_panel {
	dsi_s6d77a1a01_wVGA_boe_vid: gen-panel-s6d77a1a01_w_boe-video {
		gen-panel-manu = "SDC";			/* condensed manufacturer name */
		gen-panel-name = "s6d77a1a01";
		gen-panel-id = <0x55b910>;
		gen-panel-dev-id = <0>;			/* SPRDFB_MAINLCD_ID : MAIN 0, SUB 1 */
		gen-panel-type = <2>;			/* LCD_MODE_DSI: MCU 0, RGB 1, DSI 2 */
		gen-panel-refresh = <60>;
		gen-panel-xres = <480>;
		gen-panel-yres = <800>;
		gen-panel-width= <60>;			/* screen width in mm */
		gen-panel-height = <100>;		/* screen height in mm */
		gen-panel-work-mode = <1>;		/* SPRDFB_MIPI_MODE_VIDEO : CMD 0, VIDEO 1*/
		gen-panel-direction = <0>;		/* LCD_DIRECT_NORMAL : Normal 0, ROT90 1, ROT180 2, ROT270 3 */
		gen-panel-suspend-mode = <1>;	/* SEND_SLEEP_CMD : RST 0, SLEEP 1 */
		gen-panel-bus-width = <24>;
		gen-panel-lanes = <2>;
		gen-panel-phy-feq = <416000>;
		gen-panel-h-sync-pol = <0>;		/*SPRDFB_POLARITY_POS : POS 0, NEG 1 */
		gen-panel-v-sync-pol = <0>;		/*SPRDFB_POLARITY_POS : POS 0, NEG 1 */
		gen-panel-de-pol = <0>;			/*SPRDFB_POLARITY_POS : POS 0, NEG 1 */
		gen-panel-te-pol = <0>;			/*SPRDFB_POLARITY_POS : POS 0, NEG 1 */
		gen-panel-color-mode-pol = <1>;	/*SPRDFB_POLARITY_POS : POS 0, NEG 1 */
		gen-panel-shut-down-pol = <1>;	/*SPRDFB_POLARITY_POS : POS 0, NEG 1 */
		gen-panel-h-front-porch = <84>; /* hfp */
		gen-panel-h-back-porch = <90>;	/* hbp */
		gen-panel-h-sync-width = <40>;	/* hsync */
		gen-panel-v-front-porch = <16>;	/* vfp */
		gen-panel-v-back-porch = <12>;	/* vbp */
		gen-panel-v-sync-width = <4>;	/* vsync */
		gen-panel-esd-mode = <1>;		/*ESD_DET_INTERRUPT : POLLING 0, INTERRUPT 1 */
		gen-panel-esd-gpio = <236>;
		gen-panel-esd-state = <0>;		/* ESD_DET_NOT_INITIALIZED : NOT_INT 0, OFF 1, ON 0 */
		gen-panel-esd-level = <1>;		/* ESD_DET_HIGH : LOW 0, HIGH 1 */

		/*
		 * DSI PACKET HEADER INFO
		 * @ delay(msec) : 2byte
		 * @ size of data : 2byte
		 */
		gen-panel-pkt-dinfo-addr-offset = <0>;
		gen-panel-pkt-dinfo-addr-length = <1>;
		gen-panel-pkt-dinfo-data-offset = <1>;
		gen-panel-pkt-dinfo-data-length = <1>;
		gen-panel-init-cmds = [
			39 00 00 00 00 05		03 00 F0 5A 5A
			39 00 00 00 00 05		03 00 FC A5 A5
			15 00 00 00 00 02		B3 01
			15 00 00 00 00 02		B5 10
			39 00 00 00 00 06		04 00 BC 00 29 51
			39 00 00 00 00 05		03 00 E3 24 2C
			05 00 00 00 00 01		21
			39 00 00 00 00 0A		08 00 F2 11 04 08 10 10 82 54
			39 00 00 00 00 08		06 00 F3 91 00 00 00 10
			39 00 00 00 00 2E		2C 00 F4 01 02 23 24 25 25 26 26 29 29 2C 2B 2C
								07 08 05 04 04 01 01 22 0A 17 0F 11 23 0D 0A 0B
								02 19 13 1E 1F 23 20 05 16 1A 16 1E 24 1E
			39 00 00 00 00 1F		1D 00 F5 5A 62 B9 21 35 55 06 08 00 39 00 00 0B
								4B C4 CB 4B 12 12 1A 00 10 E0 E2 0E 34 34 03
			39 00 00 14 00 14		12 00 FE 00 02 01 39 60 40 21 00 4B 00 80 00 F0
								00 00 00 02
			39 00 00 00 00 0D		0B 00 EE 86 00 86 00 00 00 00 00 00 00
			39 00 00 00 00 18		16 00 EF 34 12 00 00 0A 29 08 27 21 40 10 28 02
								21 21 03 03 40 00 00 00
			39 00 00 00 00 21		1F 00 F7 02 1B 1A 00 01 0D 0D 09 09 0C 0C 08 08
								04 06 02 1B 1A 00 01 0F 0F 0B 0B 0E 0E 0A 0A 05
								07
			39 00 00 00 00 09		07 00 F6 63 25 15 00 00 2E
			15 00 00 00 00 02		36 10
			39 00 00 00 00 14		12 00 FA 00 3F 09 10 08 0D 12 12 12 18 1B 1B 1D
								1E 21 25 2D
			39 00 00 00 00 14		12 00 FB 00 3F 09 11 08 0E 13 12 13 19 1B 1C 1D
								1E 21 25 2D
			39 00 00 00 00 0A		08 00 FD 00 10 11 20 21 1F CC
			39 00 00 00 00 05		03 00 FC 5A 5A
		];
		gen-panel-enable-cmds = [
			05 00 00 78 00 01		11
			05 00 00 78 00 01		29
		];
		gen-panel-disable-cmds = [
			05 00 00 00 00 01		28
			39 00 00 32 00 1F		1D 00 F5 5A 62 B9 21 35 55 06 08 00 39 00 00 0B
								4B 84 CB 4B 12 12 1A 00 10 E0 E2 0E 34 34 03
			39 00 00 00 00 1F		1D 00 F5 5A 62 B9 21 35 55 06 08 00 39 00 00 0B
								CB C4 CB 4B 12 12 1A 00 10 E0 E2 0E 34 34 03
			05 00 00 96 00 01		10
		];

		gen-panel-mdnie-ui-mode-cmds = [
			39 00 00 00 00 14		12 00 C3 00 00 00 00 00 00 00 00 00 00 00 00 00
								00 00 00 00
			39 00 00 00 00 09		07 00 C4 00 FF FF 00 FF 00
			39 00 00 00 00 09		07 00 C5 FF 00 00 FF FF 00
			39 00 00 00 00 09		07 00 C6 FF 00 FF 00 00 FF
			39 00 00 14 00 09		07 00 C7 FF 00 FF 00 FF 00
			39 00 00 00 00 0F		0D 00 C8 00 20 00 20 00 20 00 20 00 20 00 20
			39 00 00 00 00 0F		0D 00 C9 00 20 00 20 00 20 00 20 00 20 00 20
			39 00 00 00 00 0F		0D 00 CA 00 20 00 20 00 20 00 20 00 20 00 20
			39 00 00 14 00 0F		0D 00 CB 00 20 00 20 00 20 00 20 00 20 00 FF
			39 00 00 00 00 09		07 00 CC 04 8F 1F 88 1F E9
			39 00 00 00 00 09		07 00 CE 1F C3 04 54 1F E9
			39 00 00 00 00 09		07 00 CF 1F C3 1F 88 04 B5
			39 00 00 00 00 0B		09 00 C2 05 00 23 00 01 E0 03 20
			];
		gen-panel-mdnie-video-mode-cmds = [
			39 00 00 00 00 14		12 00 C3 00 00 00 00 00 00 00 00 00 00 00 00 00 00 00 00 00
			39 00 00 00 00 09		07 00 C4 00 FF FF 00 FF 00
			39 00 00 00 00 09		07 00 C5 FF 00 00 FF FF 00
			39 00 00 00 00 09		07 00 C6 FF 00 FF 00 00 FF
			39 00 00 14 00 09		07 00 C7 FF 00 FF 00 FF 00
			39 00 00 00 00 0F		0D 00 C8 00 14 00 14 00 14 00 14 03 9A 03 9A
			39 00 00 00 00 0F		0D 00 C9 03 9A 03 9A 07 9E 07 9E 07 9E 07 9E
			39 00 00 00 00 0F		0D 00 CA 0A A0 0A a0 0A A0 0A A0 16 A6 16 A6
			39 00 00 14 00 0F		0D 00 CB 16 A6 16 A6 16 A6 0F 20 BF 08 00 FF
			39 00 00 00 00 09		07 00 CC 04 8F 1F 88 1F E9
			39 00 00 00 00 09		07 00 CE 1F C3 04 54 1F E9
			39 00 00 00 00 09		07 00 CF 1F C3 1F 88 04 B5
			39 00 00 00 00 0B		09 00 C2 07 00 23 00 01 E0 03 20
		];
		gen-panel-mdnie-camera-mode-cmds = [
			39 00 00 00 00 14		12 00 C3 00 00 00 00 00 00 00 00 00 00 00 00 00 00 00 00 00
			39 00 00 00 00 09		07 00 C4 00 FF FF 00 FF 00
			39 00 00 00 00 09		07 00 C5 FF 00 00 FF FF 00
			39 00 00 00 00 09		07 00 C6 FF 00 FF 00 00 FF
			39 00 00 14 00 09		07 00 C7 FF 00 FF 00 FF 00
			39 00 00 00 00 0F		0D 00 C8 00 20 00 20 00 20 00 20 00 20 00 20
			39 00 00 00 00 0F		0D 00 C9 00 20 00 20 00 20 00 20 00 20 00 20
			39 00 00 00 00 0F		0D 00 CA 00 20 00 20 00 20 00 20 00 20 00 20
			39 00 00 14 00 0F		0D 00 CB 00 20 00 20 00 20 00 20 00 20 00 FF
			39 00 00 00 00 09		07 00 CC 04 8F 1F 88 1F E9
			39 00 00 00 00 09		07 00 CE 1F C3 04 54 1F E9
			39 00 00 00 00 09		07 00 CF 1F C3 1F 88 04 B5
			39 00 00 00 00 0B		09 00 C2 05 00 23 00 01 E0 03 20
		];
		gen-panel-mdnie-gallery-mode-cmds = [
			39 00 00 00 00 14		12 00 C3 00 00 00 00 00 00 00 00 00 00 00 00 00 00 00 00 00
			39 00 00 00 00 09		07 00 C4 00 FF FF 00 FF 00
			39 00 00 00 00 09		07 00 C5 FF 00 00 FF FF 00
			39 00 00 00 00 09		07 00 C6 FF 00 FF 00 00 FF
			39 00 00 14 00 09		07 00 C7 FF 00 FF 00 FF 00
			39 00 00 00 00 0F		0D 00 C8 00 20 00 20 00 20 00 20 00 20 00 20
			39 00 00 00 00 0F		0D 00 C9 00 20 00 20 00 20 00 20 00 20 00 20
			39 00 00 00 00 0F		0D 00 CA 00 20 00 20 00 20 00 20 00 20 00 20
			39 00 00 14 00 0F		0D 00 CB 00 20 00 20 00 20 00 20 00 20 00 FF
			39 00 00 00 00 09		07 00 CC 04 8F 1F 88 1F E9
			39 00 00 00 00 09		07 00 CE 1F C3 04 54 1F E9
			39 00 00 00 00 09		07 00 CF 1F C3 1F 88 04 B5
			39 00 00 00 00 0B		09 00 C2 05 00 23 00 01 E0 03 20
		];
		gen-panel-mdnie-negative-mode-cmds = [
			39 00 00 00 00 14		12 00 C3 00 00 00 00 00 00 00 00 00 00 00 00 00 00 00 00 00
			39 00 00 00 00 09		07 00 C4 FF 00 00 FF 00 FF
			39 00 00 00 00 09		07 00 C5 00 FF FF 00 00 FF
			39 00 00 00 00 09		07 00 C6 00 FF 00 FF FF 00
			39 00 00 14 00 09		07 00 C7 00 FF 00 FF 00 FF
			39 00 00 00 00 0F		0D 00 C8 00 20 00 20 00 20 00 20 00 20 00 20
			39 00 00 00 00 0F		0D 00 C9 00 20 00 20 00 20 00 20 00 20 00 20
			39 00 00 00 00 0F		0D 00 CA 00 20 00 20 00 20 00 20 00 20 00 20
			39 00 00 14 00 0F		0D 00 CB 00 20 00 20 00 20 00 20 00 20 00 FF
			39 00 00 00 00 09		07 00 CC 04 00 00 00 00 00
			39 00 00 00 00 09		07 00 CE 00 00 04 00 00 00
			39 00 00 00 00 09		07 00 CF 00 00 00 00 04 00
			39 00 00 00 00 0B		09 00 C2 01 00 32 00 01 E0 03 20
		];
		gen-panel-mdnie-vt-mode-cmds = [
			39 00 00 00 00 14		12 00 C3 00 00 00 00 00 00 00 00 00 00 00 00 00 00 00 00 00
			39 00 00 00 00 09		07 00 C4 00 FF FF 00 FF 00
			39 00 00 00 00 09		07 00 C5 FF 00 00 FF FF 00
			39 00 00 00 00 09		07 00 C6 FF 00 FF 00 00 FF
			39 00 00 14 00 09		07 00 C7 FF 00 FF 00 FF 00
			39 00 00 00 00 0F		0D 00 C8 00 20 00 20 00 20 00 20 00 20 00 20
			39 00 00 00 00 0F		0D 00 C9 00 20 00 20 00 20 00 20 00 20 00 20
			39 00 00 00 00 0F		0D 00 CA 00 20 00 20 00 20 00 20 00 20 00 20
			39 00 00 14 00 0F		0D 00 CB 00 20 00 20 00 20 00 20 00 20 00 FF
			39 00 00 00 00 09		07 00 CC 04 8F 1F 88 1F E9
			39 00 00 00 00 09		07 00 CE 1F C3 04 54 1F E9
			39 00 00 00 00 09		07 00 CF 1F C3 1F 88 04 B5
			39 00 00 00 00 0B		09 00 C2 05 00 23 00 01 E0 03 20
		];
		gen-panel-mdnie-browser-mode-cmds = [
			39 00 00 00 00 14		12 00 C3 00 00 00 00 00 00 00 00 00 00 00 00 00 00 00 00 00
			39 00 00 00 00 09		07 00 C4 00 FF FF 00 FF 00
			39 00 00 00 00 09		07 00 C5 FF 00 00 FF FF 00
			39 00 00 00 00 09		07 00 C6 FF 00 FF 00 00 FF
			39 00 00 14 00 09		07 00 C7 FF 00 FF 00 FF 00
			39 00 00 00 00 0F		0D 00 C8 00 20 00 20 00 20 00 20 00 20 00 20
			39 00 00 00 00 0F		0D 00 C9 00 20 00 20 00 20 00 20 00 20 00 20
			39 00 00 00 00 0F		0D 00 CA 00 20 00 20 00 20 00 20 00 20 00 20
			39 00 00 14 00 0F		0D 00 CB 00 20 00 20 00 20 00 20 00 20 00 FF
			39 00 00 00 00 09		07 00 CC 04 8F 1F 88 1F E9
			39 00 00 00 00 09		07 00 CE 1F C3 04 54 1F E9
			39 00 00 00 00 09		07 00 CF 1F C3 1F 88 04 B5
			39 00 00 00 00 0B		09 00 C2 05 00 23 00 01 E0 03 20
		];
		gen-panel-mdnie-ebook-mode-cmds = [
			39 00 00 00 00 14		12 00 C3 00 00 00 00 00 00 00 00 00 00 00 00 00 00 00 00 00
			39 00 00 00 00 09		07 00 C4 00 FF FF 00 FF 00
			39 00 00 00 00 09		07 00 C5 FF 00 00 FF FF 00
			39 00 00 00 00 09		07 00 C6 FF 00 FF 00 00 FF
			39 00 00 14 00 09		07 00 C7 D6 00 F5 00 FF 00
			39 00 00 00 00 0F		0D 00 C8 00 20 00 20 00 20 00 20 00 20 00 20
			39 00 00 00 00 0F		0D 00 C9 00 20 00 20 00 20 00 20 00 20 00 20
			39 00 00 00 00 0F		0D 00 CA 00 20 00 20 00 20 00 20 00 20 00 20
			39 00 00 14 00 0F		0D 00 CB 00 20 00 20 00 20 00 20 00 20 00 FF
			39 00 00 00 00 09		07 00 CC 04 8F 1F 88 1F E9
			39 00 00 00 00 09		07 00 CE 1F C3 04 54 1F E9
			39 00 00 00 00 09		07 00 CF 1F C3 1F 88 04 B5
			39 00 00 00 00 0B		09 00 C2 05 00 33 00 01 E0 03 20
		];
		gen-panel-mdnie-email-mode-cmds = [
			39 00 00 00 00 14		12 00 C3 00 00 00 00 00 00 00 00 00 00 00 00 00 00 00 00 00
			39 00 00 00 00 09		07 00 C4 00 FF FF 00 FF 00
			39 00 00 00 00 09		07 00 C5 FF 00 00 FF FF 00
			39 00 00 00 00 09		07 00 C6 FF 00 FF 00 00 FF
			39 00 00 14 00 09		07 00 C7 DE 00 F1 00 FF 00
			39 00 00 00 00 0F		0D 00 C8 00 20 00 20 00 20 00 20 00 20 00 20
			39 00 00 00 00 0F		0D 00 C9 00 20 00 20 00 20 00 20 00 20 00 20
			39 00 00 00 00 0F		0D 00 CA 00 20 00 20 00 20 00 20 00 20 00 20
			39 00 00 14 00 0F		0D 00 CB 00 20 00 20 00 20 00 20 00 20 00 FF
			39 00 00 00 00 09		07 00 CC 04 8F 1F 88 1F E9
			39 00 00 00 00 09		07 00 CE 1F C3 04 54 1F E9
			39 00 00 00 00 09		07 00 CF 1F C3 1F 88 04 B5
			39 00 00 00 00 0B		09 00 C2 05 00 33 00 01 E0 03 20
		];
		gen-panel-mdnie-outdoor-mode-cmds = [
			39 00 00 00 00 14		12 00 C3 00 00 00 00 00 00 00 00 00 00 00 00 00 00 00 00 00
			39 00 00 00 00 09		07 00 C4 00 FF FF 00 FF 00
			39 00 00 00 00 09		07 00 C5 FF 00 00 FF FF 00
			39 00 00 00 00 09		07 00 C6 FF 00 FF 00 00 FF
			39 00 00 14 00 09		07 00 C7 FF 00 FF 00 FF 00
			39 00 00 00 00 0F		0D 00 C8 00 7B 03 48 08 32 08 32 08 32 08 32
			39 00 00 00 00 0F		0D 00 C9 08 32 10 28 10 28 10 28 10 28 10 28
			39 00 00 00 00 0F		0D 00 CA 19 22 49 DF 49 DF 49 DF 49 DF 50 1C
			39 00 00 14 00 0F		0D 00 CB 5B 18 6A 14 7A 11 87 0F 87 0F 00 FF
			39 00 00 00 00 09		07 00 CC 04 8F 1F 88 1F E9
			39 00 00 00 00 09		07 00 CE 1F C3 04 54 1F E9
			39 00 00 00 00 09		07 00 CF 1F C3 1F 88 04 B5
			39 00 00 00 00 0B		09 00 C2 07 00 23 00 01 E0 03 20
		];
		gen-panel-read-id = [
			DA 00 01
			DB 00 01
			DC 00 01
		];
		gen-panel-read-status-reg = [0A];
		gen-panel-read-status-ok = [9A];
		status = "okay";
	};
};
