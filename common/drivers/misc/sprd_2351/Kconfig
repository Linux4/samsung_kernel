## drivers/battery/Kconfig
```kconfig
config BATTERY_SAMSUNG
	tristate "samsung battery driver"
	help
	 Say Y to include support for samsung battery driver
	 This battery driver integrated all battery-related functions
	 To see battery-related functions,
	 refer to sec_charging_common.h

config CHARGING_VZWCONCEPT
	tristate "VZW concept about the charging"
	default n
	depends on BATTERY_SAMSUNG
	help
	 Say Y to include support for the VZW concepts.

config DISABLE_WIRELESS_CHARGING
	tristate "disable wireless charging"
	default n
	help
	 Say Y to include support for the VZW concepts.

config BATTERY_SWELLING
	bool "prevent battery swelling"
	help
	  Say Y to include support for prevent battery swelling

config BATTERY_SWELLING_SELF_DISCHARGING
	bool "prevent battery swelling with self discharging"
	help
	  Say Y to include support for prevent battery swelling with self discharging
	  If you want to get debugging code for no chip, ask to VE GROUP.

config BATTERY_SWELLING_SELF_DISCHARGING_ZERO_ONLY
	bool "prevent battery swelling with self discharging only in zero"
	default n
	depends on BATTERY_SWELLING_SELF_DISCHARGING
	help
	  Say Y to include supporting feature regarding preventing battery swelling. 
	  It's only eligible for Zero projects, and it autonomously chooses the way of discharging
	  between AP policy method and discharging IC one.

config INBATTERY
       bool "prevent inbattery"
       default n
       depends on BATTERY_SAMSUNG
       help
	Say Y to include support for prevent inbattery

config CALC_TIME_TO_FULL
	tristate "calculate time to full"
	default n
	depends on BATTERY_SAMSUNG
	help
	Say Y to use calc time to full function.

config BATTERY_AGE_FORECAST
	tristate "battery age forecast"
	default n
	depends on BATTERY_SWELLING
	help
	Say Y to use calc time to full function.
config BATTERY_CISD
	bool "support for cisd"
	help
	 Say Y to include support for cisd
	 cisd means cell internal short detection

# Fuel Gauge

config FUELGAUGE_DUMMY
	tristate "dummy fuel gauge driver"
	default n
	depends on BATTERY_SAMSUNG
	help
	 Say Y to include support
	 for dummy fuel gauge driver.
	 This driver source code implemented
	 skeleton source code for fuel gauge functions.

config FUELGAUGE_MAX17042
	tristate "MAX17042 fuel gauge driver"
	default n
	depends on BATTERY_SAMSUNG
	help
	 Say Y to include support
	 for MAXIM MAX17042 fuel gauge driver.
	 This fuel-gauge can be used in voltage-tracking mode
	 or coulomb-counting mode.

config FUELGAUGE_MAX17042_VOLTAGE_TRACKING
	tristate "use MAX17042 fuel gauge only as voltage tracking"
	default n
	depends on FUELGAUGE_MAX17042
	help
	 Say Y to use MAX17042 fuel gauge
	 only as voltage tracking.
	 This mode is for target that consumes low current
	 like smart-phone.

config FUELGAUGE_MAX17042_COULOMB_COUNTING
	tristate "use MAX17042 fuel gauge as coulomb counting (including voltage tracking)"
	default n
	depends on FUELGAUGE_MAX17042
	help
	 Say Y to use MAX17042 fuel gauge
	 as coulomb counting (including voltage tracking).
	 This mode is for target that consumes high current
	 like tablet.

config FUELGAUGE_MAX17048
	tristate "MAX17048 fuel gauge driver"
	default n
	depends on BATTERY_SAMSUNG
	help
	 Say Y to include support
	 for MAXIM MAX17048 fuel gauge driver.
	 This fuel-gauge can be used
	 only in voltage-tracking mode.

config FUELGAUGE_MAX17050
	tristate "MAX17050 fuel gauge driver"
	default n
	depends on BATTERY_SAMSUNG
	help
	 Say Y to include support
	 for MAXIM MAX17047 or MAX17050 fuel gauge driver.
	 This fuel-gauge can be used in voltage-tracking mode
	 or coulomb-counting mode.

config FUELGAUGE_MAX17050_VOLTAGE_TRACKING
	tristate "use MAX17050 fuel gauge only as voltage tracking"
	default n
	depends on FUELGAUGE_MAX17050
	help
	 Say Y to use MAX17050 fuel gauge
	 only as voltage tracking.
	 This mode is for target that consumes low current
	 like smart-phone.

config FUELGAUGE_MAX17050_COULOMB_COUNTING
	tristate "use MAX17050 fuel gauge as coulomb counting (including voltage tracking)"
	default n
	depends on FUELGAUGE_MAX17050
	help
	 Say Y to use MAX17050 fuel gauge
	 as coulomb counting (including voltage tracking).
	 This mode is for target that consumes high current
	 like tablet.

config FUELGAUGE_MAX77823
	tristate "MAX77823 fuel gauge driver"
	default n
	depends on BATTERY_SAMSUNG
	help
	 Say Y to include support
	 for MAXIM MAX17047 or MAX17050 fuel gauge driver.
	 This fuel-gauge can be used in voltage-tracking mode
	 or coulomb-counting mode.

config FUELGAUGE_MAX77843
	tristate "MAX77843 fuel gauge driver"
	default n
	depends on BATTERY_SAMSUNG
	help
	 Say Y to include support
	 for MAXIM MAX17047 or MAX17050 fuel gauge driver.
	 This fuel-gauge can be used in voltage-tracking mode
	 or coulomb-counting mode.

config FUELGAUGE_MAX77833
	tristate "MAX77833 fuel gauge driver"
	default n
	depends on BATTERY_SAMSUNG
	help
	 Say Y to include support
	 for MAXIM MAX77833 fuel gauge driver.
	 This fuel-gauge can be used in coulomb-counting mode.

config FUELGAUGE_MAX77823_VOLTAGE_TRACKING
	tristate "use MAX77823 fuel gauge only as voltage tracking"
	default n
	depends on FUELGAUGE_MAX77823
	help
	 Say Y to use MAX17050 fuel gauge
	 only as voltage tracking.
	 This mode is for target that consumes low current
	 like smart-phone.

config FUELGAUGE_MAX77823_COULOMB_COUNTING
	tristate "use MAX77823 fuel gauge as coulomb counting (including voltage tracking)"
	default n
	depends on FUELGAUGE_MAX77823
	help
	 Say Y to use MAX77823 fuel gauge
	 as coulomb counting (including voltage tracking).
	 This mode is for target that consumes high current
	 like tablet.

# Charger

config CHARGER_DUMMY
	tristate "dummy charger driver"
	default n
	depends on BATTERY_SAMSUNG
	help
	 Say Y to include support
	 for dummy charger driver.
	 This driver source code implemented
	 skeleton source code for charger functions.

config CHARGER_MAX8903
	tristate "MAX8903 charger driver"
	default n
	depends on BATTERY_SAMSUNG
	help
	 Say Y to include support
	 for MAXIM MAX8903 charger driver.
	 This driver source code implemented
	 all functions for MAX8903 charger.

config CHARGER_SMB328
	tristate "SMB328 charger driver"
	default n
	depends on BATTERY_SAMSUNG
	help
	 Say Y to include support
	 for Summit SMB328 charger driver.
	 This driver source code implemented
	 all functions for SMB328 charger.

config CHARGER_SMB347
	tristate "SMB347 charger driver"
	default n
	depends on BATTERY_SAMSUNG
	help
	 Say Y to include support
	 for Summit SMB347 charger driver.
	 This driver source code implemented
	 all functions for SMB347 charger.

config CHARGER_BQ24157
	tristate "BQ24157 charger driver"
	default n
	depends on BATTERY_SAMSUNG
	help
	 Say Y to include support
	 for TI BQ24157 charger driver.
	 This driver source code implemented
	 all functions for BQ24157 charger.

config CHARGER_BQ24190
	tristate "BQ24190 charger driver"
	default n
	depends on BATTERY_SAMSUNG
	help
	 Say Y to include support
	 for TI BQ24190 charger driver.
	 This driver source code implemented
	 all functions for BQ24190 charger.

config CHARGER_BQ24191
	tristate "BQ24191 charger driver"
	default n
	depends on BATTERY_SAMSUNG
	help
	 Say Y to include support
	 for TI BQ24191 charger driver.
	 This driver source code implemented
	 all functions for BQ24191 charger.

config CHARGER_BQ24260
	tristate "BQ24260 charger driver"
	default n
	depends on BATTERY_SAMSUNG
	help
	 Say Y to include support
	 for TI BQ24260 charger driver.
	 This driver source code implemented
	 all functions for BQ24260 charger.

config CHARGER_MAX77693
	tristate "MAX77693 battery charger support"
	depends on MFD_MAX77693 && I2C
	help
	  Say Y here to enable support for the MAX77693 charger
	  MAX77693 incluse muic, pmic, haptic, led,
	  flash driver.
	  You have to define MFD_MAX77693

config CHARGER_MAX77823
	tristate "MAX77823 battery charger support"
	depends on BATTERY_SAMSUNG
	help
	  Say Y here to enable support for the MAX77823 charger

config CHARGER_MAX77843
	tristate "MAX77843 battery charger support"
	depends on BATTERY_SAMSUNG
	help
	  Say Y here to enable support for the MAX77843 charger

config CHARGER_MAX77833
	tristate "MAX77833 battery charger support"
	depends on BATTERY_SAMSUNG
	help
	  Say Y here to enable support for the MAX77833 charger

config CHARGER_MAX77804
	tristate "MAX77804 battery charger support"
	depends on (MFD_MAX77804 || MFD_MAX77804K) && I2C
	help
	  Say Y here to enable support for the MAX77804 charger
	  MAX77804 incluse muic, pmic, haptic, led,
	  flash driver.
	  You have to define MFD_MAX77804

config CHARGER_MAX77888
	tristate "MAX77888 battery charger support"
	depends on (MFD_MAX77888) && I2C
	help
	  Say Y here to enable support for the MAX77888 charger
	  MAX77888 incluse muic, pmic, haptic, led,
	  flash driver.
	  You have to define MFD_MAX77888

config CHARGER_S2MU003
        tristate "S2MU003 charger support"
        depends on (MFD_S2MU003) && I2C
        help
          Say Y here to enable support for the S2MU003 charger
          S2MU003 incluse pmic, led driver.
          You have to define MFD_S2MU003

config WIRELESS_CHARGER_INBATTERY
        tristate "wireless charger in battery support"
        depends on BATTERY_SAMSUNG && I2C
        help
          Say Y here to enable support for the wireless charger charger
          driver.

config WIRELESS_CHARGER_INBATTERY_CS100
        tristate "wireless charger in battery cs100 command support"
        depends on BATTERY_SAMSUNG && I2C
        help
          Say Y here to enable support for the wireless charger charger
          driver.

config WIRELESS_CHARGER_INBATTERY_5V_FIX
        tristate "wireless charger in battery had 5.0V voreg"
        depends on BATTERY_SAMSUNG && I2C
        help
          Say Y here to enable support for the wireless charger charger
          driver.

config WIRELESS_CHARGER_HIGH_VOLTAGE
        tristate "high voltage wireless charger"
        depends on BATTERY_SAMSUNG && I2C
        help
          Say Y here to enable support for the wireless charger charger
          driver.

config WIRELESS_CHARGER_BQ51221
        tristate "bq51221 battery charger support"
        depends on BATTERY_SAMSUNG && I2C
        help
          Say Y here to enable support for the bq51221 charger
          bq51221 wireless charger driver.

config WIRELESS_CHARGER_P9027S
        tristate "p9027s battery charger support"
        depends on BATTERY_SAMSUNG && I2C
        help
          Say Y here to enable support for the p9027s charger
          p9027s wireless charger driver.

config WIRELESS_CHARGER_P9220
        tristate "p9220 battery charger support"
        depends on BATTERY_SAMSUNG && I2C
        help
          Say Y here to enable support for the p9220 charger
          p9220 wireless charger driver.

config WIRELESS_FIRMWARE_UPDATE
        tristate "p9220 battery charger support"
        depends on WIRELESS_CHARGER_P9220
        help
          Say Y here to enable support for the p9220 charger firmware update
          p9220 wireless charger IC firmware update.

config WIRELESS_CHARGER_MAX77900
        tristate "max77900 battery charger support"
        depends on BATTERY_SAMSUNG && I2C
        help
          Say Y here to enable support for the max77900 charger
          max77900 wireless charger driver.

config AFC_CHARGER_MODE
	bool "afc charging support in sec battery driver"
	default n
	depends on BATTERY_SAMSUNG
	help
	  Say Y to include support for sec afc charging support

config SAMSUNG_LPM_MODE
	bool "Off charging mode support in sec battery driver"
	default n
	help
	  Say Y to include support for sec off charging support
	  This value defined at bootloader.
	  Before enable this feature,
	  implemet power off charging in the bootloader.

config WIRELESS_CHARGER_THM
	bool "Support wpc thermistor in sec battery driver"
	default n
	help
	  Say Y to include support for wpc thermistor

config EN_OOPS
	bool "enable oops filter"
	default n
	help
	  Say Y to enable oops filter

config DISABLE_SAVE_CAPACITY_MAX
	bool "Disable to save capacity max in efs"
	default n
	depends on BATTERY_SAMSUNG
	help
	  Say Y to include support to disable it
	  capacity_max is saved in /efs/FactoryApp/batt_capacity_max
	  capacity_max is restored after boot up
	  You can find the code in healthd

config FIX_CHG_FQ_4MHZ
	bool "fix charging frequency 4MHz"
	default n
	depends on CHARGER_MAX77843
	help
	  Say Y to fix charging frequency 4MHz

config STORE_MODE
       bool "enable store mode"
       default n
       help
	 Say Y to enable CONFIG_STORE_MODE
```

## drivers/battery/battery_auth/sle956681/Kconfig
```kconfig
#
# Infineon Authenticate IC
#

config BATTERY_AUTH_SLE956681
	tristate "Infineon Authenticate IC"
	default n
	help
	  Say Y to Infineon Authenticate IC.
```

## drivers/battery/charger/Kconfig
```kconfig
config CHARGER_SM5714
	tristate "SM5714 battery charger support"
	default n
	help
	  Say Y here to enable support for the SM5714 charger
	  SM5714 is charger systems for lithium-ion (Li+) batteries
	  in handheld and portable equipment.

config CHARGER_SM5440
	tristate "SM5440 direct charger support"
	depends on I2C
	help
	  Say Y here to enable support for the SM5440 direct charger.
	  SM5440 is a direct charging IC.
	  SM5440 is dependent on I2C
	  so it needs to be defined.

config CHARGER_PCA9468
	tristate "PCA9468 charger driver"
	default n
	depends on DIRECT_CHARGING
	help
	  Say Y here to enable support for the PCA9468 charger
	  PCA9468 is a direct charging IC.
	  PCA9468 is dependent on I2C
```

## drivers/battery/charger/mtk_charger/Kconfig
```kconfig
config CHARGER_MTK
	tristate "MTK in-PMIC battery driver"
	default n
	help
	 Say Y to include support
	 for MTK in-PMIC charger driver.
	 Ths driver is connecting with MTK
	 charger_class so we can use the in-PMIC
	 charger.
```

## drivers/battery/charger/pca9468_charger/Kconfig
```kconfig
config CHARGER_PCA9468
	tristate "PCA9468 charger driver"
	default n
	depends on DIRECT_CHARGING
	help
	  Say Y here to enable support for the PCA9468 charger

config SEND_PDMSG_IN_PPS_REQUEST_WORK
	tristate "PCA9468 send pdmsg in request work"
	default n
	depends on CHARGER_PCA9468
	help
	  Say Y here to send pdmsg in request work for non mcu pdic
```

## drivers/battery/charger/s2mu005_charger/Kconfig
```kconfig
config CHARGER_S2MU005
	tristate "S2MU005 charger support"
	depends on (MFD_S2MU005) && I2C
	help
	 Say Y here to enable support for the S2MU005 charger
	 S2MU005 includes pmic, led driver.
	 S2MU005 charger is dependent on MFD_S2MU005
	 so it needs to be defined.

config S2MU005_INNER_BATTERY
	tristate "S2MU005 inner battery type"
	depends on CHARGER_S2MU005
	help
	 Say Y here to enable support for the conditional execution
	 of code related to in-battery models using S2MU005 IFPMIC.
	 Some features of S2MU005 might not be necessary to be run for in-battery models.
	 Dependent on CHARGER_S2MU005

config S2MU005_DISABLE_BUCK_MODE
	bool "DISABLE buck on mode in S2MU005 charger"
	default n
	depends on CHARGER_S2MU005
	help
	 Say Y to disable use of buck on mode in S2MU005 IFPMIC.
	 When BUCK ON only mode is used it can have side-effects such as LCD flicker because of VSYS overshoot.
	 If model has to be compliant with BC1.2 spec we need to use this feature.
	 Enable feature based on model requirements.

config LSI_IFPMIC
	bool "support for lsi ifpmic"
	 help
	  Say Y to include support
	  for lsi ifpmic
	  This is only enable S.LSI IFPMIC.
	  to support S.LSI IFPMIC functions.
```
