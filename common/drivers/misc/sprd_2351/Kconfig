## common/drivers/misc/sprd_2351/Kconfig
```kconfig
menu "2351 modules"
config SPRD_2351
	bool "SPRD RF 2351 Driver"
	default n
	help
	  If you say yes here you can use the sprd 2351 rf.

config SHARK_CHIP_2351
	bool "shark chip 2351 Driver"
	depends on SPRD_2351
	help
	  If you say yes here you can use the sprd 2351 rf on shark chip.

config DOLPHIN_CHIP_2351
	bool "dolphin chip 2351 Driver"
	depends on SPRD_2351
	help
	  If you say yes here you can use the sprd 2351 rf on shark chip.
endmenu
```

## common/drivers/misc/sprd_vpp/Kconfig
```kconfig
# to add sprd vsp configs in the future
#config SPRD_VPP
#	tristate "SPRD VPP driver"
#	depends on ARCH_SCX35
#	default y

source "drivers/misc/sprd_vpp/sprd_deint/Kconfig"
```

## common/drivers/net/wireless/ittiam/Kconfig
```kconfig
config ITTIAM
	tristate "SPRD Wireless Network Support"
	depends on CFG80211 && SIPC
	---help---
	  Say Y to enable built-in wireless MAC controller in the
	  Spreadtrum SC88xx based System-on-Chip devices.

if ITTIAM
choice
	prompt "SPRD WLAN sleep policy"
	default ITM_WLAN_PM_IRRELEVANT

config ITM_WLAN_PM_IRRELEVANT
	depends on ITTIAM && PM
	bool "Irrelevant sleep policy"
	help
	  The WLAN power management is took care by firmware.

config ITM_WLAN_PM_POWERSAVE
	depends on ITTIAM && PM
	bool "Traditional sleep policy"
	help
	  The WLAN power management is took care by system.

endchoice
endif
```

## common/drivers/net/wireless/sprdwl/Kconfig
```kconfig
config SPRDWL
	tristate "SPRD Wireless Network Support"
	depends on CFG80211 && SIPC
	---help---
	  Say Y to enable built-in wireless MAC controller in the
	  Spreadtrum SC88xx based System-on-Chip devices.

config SPRDWL_FW_ZEROCOPY
	depends on SPRDWL
	bool "Enable WLAN zerocopy"
	default n
	help
	  Say Y to enable WLAN zerocopy.

config SPRDWL_WIFI_DIRECT
	depends on SPRDWL && PM
	bool "Wi-Fi Direct"
	help
	  Say Y to enable Wi-Fi Direct.

if SPRDWL
choice
	prompt "SPRD WLAN sleep policy"
	default SPRDWL_PM_IRRELEVANT

config SPRDWL_PM_IRRELEVANT
	depends on SPRDWL && PM
	bool "Irrelevant sleep policy"
	help
	  The WLAN power management is took care by firmware.

config SPRDWL_PM_POWERSAVE
	depends on SPRDWL && PM
	bool "Traditional sleep policy"
	help
	  The WLAN power management is took care by system.

endchoice
endif
```

## common/drivers/nfc/Kconfig
```kconfig
#
# Near Field Communication (NFC) devices
#

menuconfig NFC_DEVICES
	bool "Near Field Communication (NFC) devices"
	default n
	---help---
	  You'll have to say Y if your computer contains an NFC device that
	  you want to use under Linux.
	  You can say N here if you don't have any Near Field Communication devices connected to your computer.

if NFC_DEVICES

config PN544_NFC
	tristate "PN544 NFC driver"
	depends on I2C
	select CRC_CCITT
	default n
	---help---
	  Say yes if you want PN544 Near Field Communication driver.
	  This is for i2c connected version. If unsure, say N here.
	  To compile this driver as a module, choose m here. The module will be called pn544.

config BCM2079X_NFC_I2C
	tristate "BCM2079X NFC driver for I2C interface"
	depends on I2C
	default n
	---help---
	  Say yes if you want BCM2079X Near Field Communication driver.
	  This is for i2c connected version. If unsure, say N here.
	  To compile this driver as a module, choose m here. The module will be called bcm2079x-i2c.

config BCM2079X_NFC_SPI
	tristate "BCM2079X NFC driver for SPI interface"
	depends on SPI
	default n
	---help---
	  Say yes if you want BCM2079X Near Field Communication driver.
	  This is for spi connected version. If unsure, say N here.
	  To compile this driver as a module, choose m here. The module will be called bcm2079x-spi.

config SEC_NFC_I2C
    tristate "SEC NFC driver"
    default n
    help
      SAMSUNG NFC Driver.
      This driver provides support for SAMSUNG NFC products.
      You should select your NFC product and interface.

      Say Y here to compile support for SAMSUNG NFC driver into the
      kernel.
      
config SEC_NFC_CLK_REQ
    tristate "SEC NFC CLK REQ"
    default n
    help
      SAMSUNG NFC CLR REQ feature.
      This feature provides support for SAMSUNG NFC products.
      You should select this feature if your NFC product uses AP CLK.

      Say Y here to compile support for SAMSUNG NFC CLK REQ feature into the
      kernel.

config SEC_NFC_COMMON
	tristate "Samsung NFC driver"
	default n
	help
	  SAMSUNG NFC Driver.
	  This driver provides support for SAMSUNG NFC products.
	  You should select your NFC product and interface.

	  Say Y here to compile support for SAMSUNG NFC driver into the
	  kernel.
choice
	prompt "SEC NFC Products"
	depends on SEC_NFC_COMMON
	default SEC_NFC_PRODUCT_N5
config SEC_NFC_PRODUCT_N3
	bool "N3"
config SEC_NFC_PRODUCT_N5
	bool "N5"
endchoice

choice
	prompt "SEC NFC Interface"
	depends on SEC_NFC_COMMON
	default SEC_NFC_IF_I2C
config SEC_NFC_IF_UART
	bool "UART"
config SEC_NFC_IF_I2C
	bool "I2C"
config SEC_NFC_IF_I2C_GPIO
	bool "I2C-GPIO (S/W-I2C)"
	select I2C_ALGOBIT
endchoice

endif # NFC_DEVICES
```

## common/drivers/sensors/Kconfig
```kconfig
menuconfig NEW_SENSORS
	bool "Sensors Support"
	help
		Say Y to enable Sensors support. This allows control of supported
		Sensors.

if NEW_SENSORS
config SENSORS_CORE
         bool "sensors_core"
         depends on I2C

config SENSORS_K3DH
	tristate "K3DH acceleration sensor support"
	depends on I2C
	default n
	help
	  Driver for STMicroelectronic K3DH accelerometer.

config SENSOR_K3DH_INPUTDEV
	tristate "K3DH acceleration sensor input dev support"
	depends on I2C
	default n
	help
	  Driver for STMicroelectronic K3DH INPUTDEV accelerometer.

config SENSORS_K2HH
        depends on I2C
        tristate "SENSORS_K2HH"
        default n
        help
          Say Y here if you use SENSORS_K2HH.
          This option enables accelerometer sensors using
          STMicroelectronic K2HH device driver.

config SENSORS_EMUL_I2C
        tristate "Sensor module different HW version support"
        depends on I2C
        default n
        help
          Support gpio emulator i2c for sensor module different HW version
endif # NEW_SENSORS
```

## common/drivers/sipc/Kconfig
```kconfig
menu "SIPC modules"

config SIPC
	bool "Sprd IPC"
	default n
	help
	  SIPC is a module for spreadtrum AP/CP communicaiton system.

config SIPC_SPIPE
	bool "sprd pipe driver based on SBUF"
	default n
	depends on SIPC
	help
	  This driver is a pipe driver base on SBUF, which create
	  general pipes between AP & CP.

config SIPC_SPOOL
       bool "sprd pool driver based on SBLOCK"
       default n
       depends on SIPC
       help
        This driver is a pool driver base on SBLOCK, which create
        general pools between AP & CP.

config SIPC_SETH
       bool "Sprd Ethernet driver"
       default n
       depends on SIPC
       help
         This driver supports the Spreadtrum Ethernet based on share
         memory. Say Y here if you want to use it.

config SIPC_STTY
       bool "Sprd Stty driver"
       default n
       depends on SIPC
       help
         This driver supports the Spreadtrum Ethernet based on share
         memory. Say Y here if you want to use it.

endmenu
```

## common/drivers/video/sprdfb/Kconfig
```kconfig
if FB
config FB_SC8825
	boolean "SC8825 frame buffer support "
	depends on FB && ARCH_SC8825
	select FB_CFB_FILLRECT
	select FB_CFB_COPYAREA
	select FB_CFB_IMAGEBLIT
	help
          Frame buffer driver for sc8825 based boards.

config FB_SCX35
	boolean "SC8830 frame buffer support "
	depends on FB && ARCH_SCX35
	select FB_CFB_FILLRECT
	select FB_CFB_COPYAREA
	select FB_CFB_IMAGEBLIT
	help
          Frame buffer driver for sc8830 based boards.

config FB_SCX15
	boolean "SC7715 frame buffer support "
	depends on FB && ARCH_SCX15
	select FB_CFB_FILLRECT
	select FB_CFB_COPYAREA
	select FB_CFB_IMAGEBLIT
	help
          Frame buffer driver for sc7715 based boards.

config SPRD_FB_SIZE
	int "MB size for frame buffer, should larger or equal lcd_w*lcd_h*4*2"
	range 1 16
	default 8
	depends on FB_SC8825 || FB_SCX35

config FB_LCD_HX8363_MCU
	boolean "support HX8363 panel mcu"
	depends on FB_SC8825 || FB_SCX35 || FB_SCX15
	default n

config FB_LCD_HX8363_RGB_SPI
	boolean "support HX8363 panel rgb spi"
	depends on FB_SC8825 || FB_SCX35 || FB_SCX15
	default n

config FB_LCD_VIVA_RGB_SPI
	boolean "support VIVA panel rgb spi"
	depends on FB_SC8825 || FB_SCX35 || FB_SCX15
	default n

config FB_LCD_HX8369B_RGB_SPI
	boolean "support HX8369B panel rgb spi"
	depends on FB_SC8825 || FB_SCX35 || FB_SCX15
	default n

config FB_LCD_HX8369
	boolean "support HX8369 panel"
	depends on FB_SC8825 || FB_SCX35
	default n

config FB_LCD_S6D0139
	boolean "support S6D0139 panel"
	depends on FB_SC8825 || FB_SCX35
	default n

config FB_LCD_NT35516_MIPI
	boolean "support NT35516 mipi panel"
	depends on FB_SC8825 || FB_SCX35
	default n

config FB_LCD_NT35502_MIPI
	boolean "support NT35502 mipi panel"
	depends on FB_SC8825 || FB_SCX35
	default n

config FB_LCD_NT35516_RGB_I2C
	boolean "support NT35516 rgb (i2c) panel"
	depends on FB_SC8825 || FB_SCX35
	default n

config FB_LCD_NT35516_RGB_SPI
	boolean "support NT35516 rgb (spi) panel"
	depends on FB_SC8825 || FB_SCX35 || FB_SCX15
	default n

config FB_LCD_NT35516_MCU
	boolean "support NT35516 mcu panel"
	depends on FB_SC8825 || FB_SCX35 || FB_SCX15
	default n

config FB_LCD_NT35510_MIPI
	boolean "support NT35510 mipi panel"
	depends on FB_SC8825 || FB_SCX35
	default n

config FB_LCD_NT35512_MIPI
	boolean "support NT35512 mipi panel"
	depends on FB_SC8825 || FB_SCX35
	default n

config FB_LCD_OTM8018B_MIPI
	boolean "support otm 8018b mipi panel"
	depends on FB_SC8825 || FB_SCX35
	default n

config FB_LCD_SSD2075_MIPI
	boolean "support ssd2075 mipi panel"
	depends on FB_SC8825 || FB_SCX35
	default n

config FB_LCD_ILI9486
	boolean "support ILI9486 mcu panel"
	depends on FB_SC8825 || FB_SCX35 || FB_SCX15
	default n

config FB_LCD_ILI9486_RGB_SPI
	boolean "support ILI9486 rgb spi panel"
	depends on FB_SC8825 || FB_SCX35 || FB_SCX15
	default n

config FB_LCD_SC7798_RGB_SPI
        boolean "support SC7798 rgb spi panel"
        depends on FB_SC8825 || FB_SCX35 || FB_SCX15
        default n


config FB_LCD_ILI9341
	boolean "support ILI9341 mcu panel"
	depends on FB_SC8825 || FB_SCX35 || FB_SCX15
	default n

config FB_LCD_ST7789V_MCU
	boolean "support ST7789V mcu panel"
	depends on FB_SC8825 || FB_SCX35 || FB_SCX15
	default n

config FB_LCD_NT51017_MIPI_LVDS
        boolean "support nt51017 lvds panel"
        depends on FB_SC8825 || FB_SCX35
        default n

config FB_LCD_HX8369B_MIPI
	boolean "support hx8369b mipi panel"
	depends on FB_SC8825 || FB_SCX35
	default n

config FB_LCD_RESERVE_MEM
        boolean "support FB reserve mem"
        depends on FB_SC8825 || FB_SCX35
        default n

config FB_LCD_OVERLAY_SUPPORT
	boolean "support lcd overlay"
	depends on FB_SC8825 || FB_SCX35 || FB_SCX15
	default n

config FB_VSYNC_SUPPORT
	boolean "support wait for vsync io"
	depends on FB_SC8825 || FB_SCX35
	default n

config FB_ESD_SUPPORT
	boolean "support esd check"
	depends on FB_SC8825 || FB_SCX35
	default n

config FB_DYNAMIC_CLK_SUPPORT
	boolean "support close clk dynamically"
	depends on FB_SC8825 || FB_SCX35
	default n

config FB_DYNAMIC_FPS_SUPPORT
	boolean "support change fps dynamically"
	depends on FB_SC8825 || FB_SCX35
	default n

config FB_DISPC_DYNAMIC_PCLK_SUPPORT
        boolean "support dispc dynamic pclk"
        depends on FB_SCX15
        default n

config FB_MMAP_CACHED
	boolean "support fb_mmap with cach"
	depends on FB_SC8825 || FB_SCX35 ||FB_SCX15
	default n

config FB_LOW_RES_SIMU
	boolean "support low resolution simulator"
	depends on FB_SC8825 || FB_SCX35 ||FB_SCX15
	default n

config LCD_ESD_RECOVERY
	boolean "support esd detection for lcd"
	depends on FB_SC8825 || FB_SCX35 ||FB_SCX15
	default n

config LCD_18BIT_INTERFACE
	boolean "support 18bit data line for lcd"
	depends on FB_SC8825 || FB_SCX35 ||FB_SCX15
	default n

config MACH_YOUNG2_2G
	boolean "young2 2G specific flag"
	depends on FB_SC8825 || FB_SCX35 ||FB_SCX15
	default n

config FB_BL_EVENT_CTRL
	boolean "support esd detection for lcd"
	depends on FB_SC8825 || FB_SCX35 ||FB_SCX15
	default n

endif
```

## common/fs/proc/sprd_debug/Kconfig
```kconfig
config SPRD_DEBUG_FRAME
	bool "sprd debug proc interface support"
	depends on DEBUG_FS
	default y

config PHYMEM_INFO
	bool "physical memory show support"
	depends on SPRD_DEBUG_FRAME
	default y

config USRPROCMEM_INFO
	bool "user proc's memory show support"
	depends on SPRD_DEBUG_FRAME
	default y

config USRPROCSTACK_INFO
	bool "user proc's current stack show support"
	depends on SPRD_DEBUG_FRAME
	default y

config SPRD_CPU_RATE
	bool "open sprd cpu rate compute"
	depends on SPRD_DEBUG_FRAME
	default y
```

## common/sound/soc/sprd/Kconfig
```kconfig
menu "SoC Audio for the SPREADTRUM"
config SND_SOC_SPRD
	bool "sprd audio base"

config SND_SOC_SPRD_VBC_R1P0_SPRD_CODEC_V1
	tristate "VBC(R1P0)CODEC(V1)"
	select SND_SOC_SPRD_VBC_R1P0
	select SND_SOC_SPRD_VAUDIO
	select SND_SOC_SPRD_AUDIO_DMA
	select SND_SOC_SPRD_CODEC_V1
	help
	  Say Y if you want to built in to kernel, Say M for ko module.
	  use VBC(R1P0) and  SPRD CODEC(V1) for the audio system.

config SND_SOC_SPRD_VBC_R2P0_SPRD_CODEC_V3
	tristate "VBC(R2P0)CODEC(V3)"
	select SND_SOC_SPRD_VBC_R2P0
	select SND_SOC_SPRD_VAUDIO
	select SND_SOC_SPRD_AUDIO_DMA
	select SND_SOC_SPRD_CODEC_V3
	help
	  Say Y if you want to built in to kernel, Say M for ko module.
	  use VBC(R2P0) and  SPRD CODEC(V3) for the audio system.

config SND_SOC_SPRD_VBC_R2P0_SPRD_CODEC_V4
	tristate "VBC(R2P0)CODEC(V4)"
	select SND_SOC_SPRD_VBC_R2P0
	select SND_SOC_SPRD_VAUDIO
	select SND_SOC_SPRD_AUDIO_DMA
	select SND_SOC_SPRD_CODEC_V4
	help
	  Say Y if you want to built in to kernel, Say M for ko module.
	  use VBC(R2P0) and  SPRD CODEC(V4) for the audio system.

config SND_SOC_SPRD_I2S_V0_NULL_CODEC
	tristate "I2S(V0)NC"
	select SND_SOC_SPRD_I2S
	select SND_SOC_SPRD_AUDIO_DMA
	select SND_SOC_NULL_CODEC
	help
	  Say Y if you want to built in to kernel, Say M for ko module.
	   this option will build spreadtrum I2S driver for external codec
           or like BT/Digital FM etc.

config SND_SOC_SPRD_AUDIO_DEBUG
	bool "sprd audio debug"
	help
          Say Y if defined this will include more
	    print debug information for detail.
	    Or, maybe could reduce the code size.

source "sound/soc/sprd/dai/Kconfig"
source "sound/soc/sprd/dai/vbc/Kconfig"
source "sound/soc/sprd/dai/vaudio/Kconfig"
source "sound/soc/sprd/dai/i2s/Kconfig"
source "sound/soc/sprd/codec/sprd/Kconfig"
source "sound/soc/sprd/codec/null-codec/Kconfig"

endmenu
```

## common/sound/soc/sprd/dai/Kconfig
```kconfig
menu "SPRD AUDIO DMA"
config SND_SOC_SPRD_AUDIO_DMA
	tristate

config SND_SOC_SPRD_AUDIO_BUFFER_USE_IRAM
	bool "Use IRAM when sound playback"
	help
	  Say Y if you want use IRAM replacment RAM when playback.
	   sometimes, use IRAM maybe reduce power consumption.
           but, it will cause system more busy, becuase the buffer smaller.

config SND_SOC_SPRD_IRAM_BACKUP
	bool "Backup IRAM when sound playback"
	depends on SND_SOC_SPRD_AUDIO_BUFFER_USE_IRAM
	help
	  Say Y if you want backup IRAM when playback. sometimes,
	   IRAM maybe shared with other modules,
	   then you need to open this.
endmenu
```

## common/sound/soc/sprd/dai/vbc/Kconfig
```kconfig
menu "VBC"

source "sound/soc/sprd/dai/vbc/r1p0/Kconfig"
source "sound/soc/sprd/dai/vbc/r2p0/Kconfig"

config SND_SOC_SPRD_VBC_LR_INVERT
	bool "VBC Support L/R invert"
	help
	 say Y then the VBC will support invert the L/R channel.

endmenu
```
