## drivers/adsp_factory/Kconfig
```kconfig
#
# factory sensor drivers configuration
#
config ADSP_FACTORY
	tristate "MSM ADSP factory driver"
	default n
	help
	  This driver communicate with SSC DAEMON.
	  register each sensor device.
	  send selftest request using netlink.
	  receive test result using netlink.

config LSM6DSO_FACTORY
	tristate "factory test for SSC - LSM6DSO"
	default n
	help
	  lsm6dso factory driver.
	  provide sysfs for factory test.
	  request selftest to adsp_factory.
	  receive test result from adsp_factory.

config LSM6DSL_FACTORY
	tristate "factory test for SSC - LSM6DSL"
	default n
	help
	  lsm6dsl factory driver.
	  provide sysfs for factory test.
	  request selftest to adsp_factory.
	  receive test result from adsp_factory.

config AK09918_FACTORY
	tristate "factory test for SSC - ak09918"
	default n
	help
	  ak09918 factory driver.
	  provide sysfs for factory test.
	  request selftest to adsp_factory.
	  receive test result from adsp_factory.

config LPS22HH_FACTORY
	tristate "factory test for SSC - lps22hh"
	default n
	help
	  lps22hh factory driver.
	  provide sysfs for factory test.
	  request selftest to adsp_factory.
	  receive test result from adsp_factory.

config TMD490X_FACTORY
	tristate "factory test for SSC - tmd490x"
	default n
	help
	  tmd490x factory driver.
	  provide sysfs for factory test.
	  request selftest to adsp_factory.
	  receive test result from adsp_factory.

config SUPPORT_TMD4906_FACTORY
	tristate "factory test for SSC - tmd4906"
	depends on TMD490X_FACTORY
	default n
	help
	  tmd4906 factory driver
	  provide sysfs for factory test.
	  request selftest to adsp_factory.
	  receive test result from adsp_factory.

config SUPPORT_TMD4907_FACTORY
	tristate "factory test for SSC - tmd4907"
	depends on TMD490X_FACTORY
	default n
	help
	  tmd4907 factory driver
	  provide sysfs for factory test.
	  request selftest to adsp_factory.
	  receive test result from adsp_factory.

config TCS3701_FACTORY
	tristate "factory test for SSC - TCS3701"
	default n
	help
	  tcs3701 factory driver.
	  provide sysfs for factory test.
	  request selftest to adsp_factory.
	  receive test result from adsp_factory.

config STK3331_FACTORY
	tristate "factory test for SSC - STK3331"
	default n
	help
	  stk3331 factory driver.
	  provide sysfs for factory test.
	  request selftest to adsp_factory.
	  receive test result from adsp_factory.

config STK3A9X_FACTORY
	tristate "factory test for SSC - stk3a9x"
	default n
	help
	  stk3a9x factory driver.
	  provide sysfs for factory test.
	  request selftest to adsp_factory.
	  receive test result from adsp_factory.

config SUPPORT_PROX_AUTO_CAL
	tristate "Support Auto Calibration for proximity sensor - tmd490x"
	default n
	depends on TMD490X_FACTORY
	help
	  Support the Auto Calibration function in tmd490x.
	  provide sysfs for factory test.
	  request selftest to adsp_factory.
	  receive test result from adsp_factory.

config SUPPORT_HIDDEN_HOLE
	tristate "Support Hidden Hole function for proximity sensor"
	default n
	depends on ADSP_FACTORY
	help
	  Support the Hidden Hole function.
	  provide sysfs for factory test.
	  request selftest to adsp_factory.
	  receive test result from adsp_factory.

config SUPPORT_HIDDEN_HOLE_SUB
	tristate "Support Hidden Hole Sub function for proximity sensor"
	default n
	depends on ADSP_FACTORY
	help
	  Support the Hidden Hole Sub function.
	  provide sysfs for factory test.
	  request selftest to adsp_factory.
	  receive test result from adsp_factory.

config SLPI_MOTOR
	tristate "Sensors support motor"
	default n
	help
	  Support the motor state function
	  provide sysfs for factory test.
	  request selftest to adsp_factory.
	  receive test result from adsp_factory.

config SUPPORT_MOTOR_NOTIFIER
	tristate "Sensors support motor notifier"
	depends on SLPI_MOTOR
	default n
	help
	  Support the motor notifier function
	  receive motor start setting.

config SUPPORT_MOBEAM
	tristate "Sensors support mobeam"
	default n
	help
	  Support the mobeam
	  provide sysfs for factory test.
	  request selftest to adsp_factory.
	  receive test result from adsp_factory.

config SUPPORT_SUB_MOBEAM
	tristate "Sensors support sub mobeam"
	depends on SUPPORT_MOBEAM
	help
	  Support the sub mobeam
	  provide sysfs for factory test.
	  request selftest to adsp_factory.
	  receive test result from adsp_factory.

config SUPPORT_PROX_POWER_ON_CAL
	tristate "Sensors support proximity sensor power on cal"
	default n
	help
	  Support power on calibration for proximity sensor
	  make calibration process done as the device power up.

config SUPPORT_PROX_CALIBRATION
	tristate "prox cal for SSC"
	default n
	help
	  prox calibration feature.
	  provide sysfs for prox calibration.
	  request prox cal to adsp_factory.
	  receive cal value from adsp_factory.

config SUPPORT_BHL_COMPENSATION_FOR_LIGHT_SENSOR
	tristate "Sensors support BHL compensation"
	default n
	help
	  Support BHL compensation for light sensor
	  provide sysfs for LCD service.
	  receive aor and brightness level from lcd driver.

config SUPPORT_BRIGHT_COMPENSATION_LUX
	tristate "Sensors support lux compensation based on brightness"
	default n
	help
	  Support lux compensation based on brightness
	  provide sysfs for LCD service.
	  receive aor and brightness level from lcd driver.

config SUPPORT_BRIGHT_SYSFS_COMPENSATION_LUX
	tristate "Sensors support lux compensation based on brightness"
	default n
	help
	  Support lux compensation based on brightness sysfs.
	  receive aor and brightness level from hal injection.

config SUPPORT_DUAL_6AXIS
	tristate "Sensors support dual 6axis"
	default n
	help
	  Support the dual accel and gyro function. 
	  provide sysfs for factory test.
	  request selftest to adsp_factory.
	  receive test result from adsp_factory.

config SUPPORT_DUAL_OPTIC
	tristate "Sensors support dual optic"
	default n
	help
	  Support the dual prox and light function. 
	  provide sysfs for factory test.
	  request selftest to adsp_factory.
	  receive test result from adsp_factory.

config SUPPORT_VIRTUAL_OPTIC
	tristate "Sensors support virtual optic"
	default n
	help
	  Support the virtual prox and light function. 
	  provide sysfs for factory test.
	  request selftest to adsp_factory.
	  receive test result from adsp_factory.

config SUPPORT_DEVICE_MODE
	tristate "Support device mode"
	default n
	help
	  Support device mode.

config SUPPORT_AK0997X
	tristate "Support ak0997x"
	default n
	help
	  Support ak0997x.

config VEML3328_FACTORY
	tristate "factory test for SSC - veml3328"
	default n
	help
	  veml3328 factory driver.
	  provide sysfs for factory test.
	  request selftest to adsp_factory.
	  receive test result from adsp_factory.

config SUPPORT_SSC_MODE
	tristate "Support ssc mode function for adsp sensor"
	default n
	help
	  Support the ssc mode function.

config SUPPORT_SSC_MODE_FOR_MAG
	tristate "Support ssc mode for mag function for mag sensor"
	default n
	help
	  Support the ssc mode for mag function.

config SUPPORT_SLPI_NACK_FORCE_SSR
	tristate "Support the force ssr when the slpi is no response."
	default n
	help
	  Support the force ssr when the slpi is no response	  

config SUPPORT_SSC_AOD_RECT
	tristate "Support getting AOD rect"
	default n
	help
	  Support getting AOD rec.
```

## drivers/afc/Kconfig
```kconfig
#
# AFC devices
#

comment "AFC configs"

config AFC
	bool "Using AFC device driver"
	default n
	help
	  If you say yes here you will get support for
	  the AFC device driver.

config PM6150_AFC
	bool "Using PM6150_AFC device driver"
	default n
	help
	  If you say yes here you will get support for
	  the PM6150_AFC device driver.
```

## drivers/barcode_emul/Kconfig
```kconfig
#
# SEC_FPGA
#
menu "SEC_FPGA and IRDA FPGA"

config SEC_FPGA
	tristate "this feature allows Barcode emulator"
	default n
	help
	  This is a driver for barcode emulator driver based on Lattice chip.
	  Lattice FPGA can support Barcode emulator.
	  To compile this driver as a module, choose M here.
	  If unsure, say N.

config IR_REMOCON_FPGA
	tristate "this feature allows IR LED"
	depends on SEC_FPGA
	default n
	help
	  This is a driver for IR LED driver based on Lattice chip.
	  Lattice FPGA can support IR LED.
	  To compile this driver as a module, choose M here.
	  If unsure, say N.

config SEC_FPGA_CTS_444
    bool "Used to pass cts test_timing"
    depends on SEC_FPGA
    default n
	help
	  Used for CTS test case test_timing in 4.4.4.
endmenu
```
