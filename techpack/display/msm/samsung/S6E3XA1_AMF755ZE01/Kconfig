## techpack/display/msm/samsung/S6E3XA1_AMF755ZE01/Kconfig
```kconfig
config PANEL_S6E3XA1_AMF755ZE01_QXGA
	depends on DISPLAY_SAMSUNG
	bool "LSI S6E3XA1 LDI"
	default n
	---help---
	LSI S6E3XA1 LDI Q2 MAIN TEMP
```

## techpack/display/msm/samsung/S6E3XA1_AMF759VG01/Kconfig
```kconfig
config PANEL_S6E3XA1_AMF759VG01_QXGA
	depends on DISPLAY_SAMSUNG
	bool "LSI S6E3XA1 LDI"
	default n
	---help---
	LSI S6E3XA1 LDI F2 MAIN
```

## techpack/display/msm/samsung/S6E3XA2_AMF755ZE01/Kconfig
```kconfig
config PANEL_S6E3XA2_AMF755ZE01_QXGA
	depends on DISPLAY_SAMSUNG
	bool "LSI S6E3XA2 LDI"
	default n
	---help---
	LSI S6E3XA2 LDI Q2 MAIN REAL
```

## techpack/display/msm/samsung/S6E8FC1_AMS660XR01/Kconfig
```kconfig
config PANEL_S6E8FC1_AMS660XR01_HD
	depends on DISPLAY_SAMSUNG
	bool "LSI S6E8FC1 LDI"
	default n
	---help---
	LSI S6E8FC1 LDI 720_1600 A42XQ
```

## techpack/display/msm/samsung/SW83109_BF067XMM_A73/Kconfig
```kconfig
config PANEL_SW83109_BF067XMM_A73_FHD
	depends on DISPLAY_SAMSUNG
	bool "SiliconWorks 83109 LDI and BOE PANEL"
	default n
	---help---
	SW 83109 LDI 1080_2400 A73XQ
```

## techpack/display/msm/samsung/SW83109_WM6676Z21/Kconfig
```kconfig
config PANEL_SW83109_WM6676Z21_FHD
	depends on DISPLAY_SAMSUNG
	bool "SiliconWorks 83109 LDI"
	default n
	---help---
	SW 83109 LDI 1080_2400 A73XQ
```

## techpack/display/msm/samsung/XCP2_NT36672C_PM6585JB2/Kconfig
```kconfig
config PANEL_XCP2_NT36672C_PM6585JB2_FHD
	depends on DISPLAY_SAMSUNG
	bool "NOVATEK NT36672C XCOVER PRO 2 TDDI"
	default n
	---help---
	NOVATEK NT36672C TDDI 1080_2408 XCOVER PRO 2
```

## vendor/mediatek/kernel_modules/connectivity/wlan/core/gen4m/configs/MT6639/ce/defconfig
```kconfig
CONFIG_SUPPORT_WIFI_DL_BT_PATCH=y
CONFIG_MTK_MDDP_SUPPORT=
CONFIG_MTK_WIFI_WFDMA_BK_RS=n
CONFIG_SUPPORT_FW_IDX_LOG_TRANS=y
CONFIG_SUPPORT_FW_IDX_LOG_SAVE=y
CONFIG_SUPPORT_CE_COREDUMP=y
CONFIG_UPDATE_STATIC_DBDC_QUOTA=y
CONFIG_TX_MGMT_BY_DATA_Q=y
CONFIG_SUPPORT_DEBUG_SOP=y
CONFIG_IP_FRAG_DISABLE_HW_CHECKSUM=y
CONFIG_SUPPORT_DUAL_WTBL_GTK_REKEY_OFFLOAD=y
CONFIG_SUPPORT_KERNEL_MAPPING_TXQ=y
```

## vendor/mediatek/kernel_modules/connectivity/wlan/core/gen4m/configs/MT6639/mobile/defconfig
```kconfig
CONFIG_MTK_WIFI_PMIC_QUERY=y
CONFIG_SUPPORT_TX_HIF_CREDIT_FEATURE=y
CONFIG_TX_HIF_PORT_QUEUE_SUPPORT=y
CONFIG_SUPPORT_PRE_ON_PHY_ACTION=y
CONFIG_MTK_WIFI_WFD_SCC_BALANCE=y
CONFIG_WFD_SCC_BALANCE_DEF_ENABLE=y
CONFIG_CONTROL_ASPM_BY_FW=y
CONFIG_SUPPORT_PCIE_ASPM=y
CONFIG_SUPPORT_PCIE_PLAT_INT_FLOW=y
CONFIG_WIFI_DRIVER_OWN_DELAY_SUPPORT=y
CONFIG_RX_ZERO_COPY=y
CONFIG_SUPPORT_THERMAL_QUERY=y
CONFIG_SUPPORT_BTM_OFFLOAD=y
CONFIG_SUPPORT_WIFI_DL_BT_PATCH=n
CONFIG_DEVICE_SUSPEND_BY_MOBILE=y
CONFIG_P2P_UAPSD_SUPPORT=n
CONFIG_FILS_SK_OFFLOAD_SUPPORT=y
CONFIG_TX_CUSTOMIZE_LTO=y
CONFIG_BCN_PROT=y
CONFIG_PCIE_GEN_SWITCH=y
CONFIG_SS_PCIE_GEN_SWITCH=y
```

## vendor/mediatek/kernel_modules/connectivity/wlan/core/gen4m/configs/MT6653/mobile/defconfig
```kconfig
CONFIG_MTK_WIFI_PMIC_QUERY=y
CONFIG_SUPPORT_TX_HIF_CREDIT_FEATURE=y
CONFIG_TX_HIF_PORT_QUEUE_SUPPORT=y
CONFIG_CONTROL_ASPM_BY_FW=y
CONFIG_SUPPORT_PCIE_ASPM=n
CONFIG_SUPPORT_PCIE_PLAT_INT_FLOW=y
CONFIG_WIFI_DRIVER_OWN_DELAY_SUPPORT=y
CONFIG_RX_ZERO_COPY=y
CONFIG_SUPPORT_THERMAL_QUERY=y
CONFIG_SUPPORT_BTM_OFFLOAD=y
CONFIG_SUPPORT_WIFI_DL_BT_PATCH=n
CONFIG_DEVICE_SUSPEND_BY_MOBILE=y
CONFIG_MTK_WIFI_CONNAC3X_DS_VER=3600
```

## vendor/mediatek/kernel_modules/connectivity/wlan/core/gen4m/configs/MT7925/defconfig
```kconfig
CONFIG_MTK_WIFI_11AX_SUPPORT=y
CONFIG_MTK_WIFI_11BE_SUPPORT=y
CONFIG_MTK_WIFI_11BE_MLO_SUPPORT=y
CONFIG_MTK_WIFI_APS_SUPPORT=y
CONFIG_MTK_WIFI_CONNAC3X=y
CONFIG_MTK_WIFI_CONNAC3X_DS_VER=3500
CONFIG_NUM_OF_WFDMA_RX_RING=2
CONFIG_NUM_OF_WFDMA_TX_RING=0
CONFIG_MTK_WIFI_UNIFIED_COMMND_SUPPORT=y
CONFIG_MTK_WIFI_TWT_SUPPORT=y
CONFIG_MTK_WIFI_TWT_STA_DIRECT_TEARDOWN=y
CONFIG_MTK_WIFI_TWT_SMART_STA=n
CONFIG_MTK_WIFI_TWT_HOTSPOT_SUPPORT=n
CONFIG_MTK_WIFI_TWT_HOTSPOT_AC_SUPPORT=n
CONFIG_MTK_WIFI_BTWT_SUPPORT=y
CONFIG_MTK_WIFI_11BE_ML_TWT_SUPPORT=y
CONFIG_MLD_LINK_MAX=2
CONFIG_MTK_WIFI_6G_SUPPORT=y
CONFIG_MTK_WIFI_DBDC_6G=y
CONFIG_MTK_HOST_OFFLOAD_SUPPORT=n
CONFIG_SUPPORT_FORCE_ALTX=y
CONFIG_SUPPORT_TX_DATA_DELAY=y
CONFIG_SUPPORT_WIFI_DL_BT_PATCH=y
CONFIG_MTK_MDDP_SUPPORT=
CONFIG_SUPPORT_FW_IDX_LOG_TRANS=y
CONFIG_SUPPORT_CE_COREDUMP=y
CONFIG_SUPPORT_DBDC_DOWNGRADE_NSS=y
CONFIG_SUPPORT_DEBUG_SOP=y
CONFIG_SUPPORT_OSHARE=n
CONFIG_SUPPORT_LOWLATENCY_MODE=n
```

## vendor/qcom/opensource/audio-kernel/asoc/codecs/tfa9878/Kconfig
```kconfig
menu "Goodix TFA9878 amplifier configuration"

if SND_SOC_TFA9878
config TFA_STEREO_NODE
        bool "Stereo sysfs node support"
        default y
        help
          Extend sysfs nodes for stereo support.
          In application, it's necessary to differ nodes between channels.
          In mono case, it provides with 'NODE_NAME', and
          in stereo case, it provides 'NODE_NAME' for left and 'NODE_NAME'_r for right.

config PLATFORM_QUALCOMM
        bool "Qualcomm platform support"
        default y
        help
          Enable compile options for Qualcomm platform.
          It adapts codec driver to the target platform.
          It encloses the options, used in codec driver, for Qualcomm platform.
          It differs the configuration between Qualcom platform and the others.

endif # SND_SOC_TFA9878

endmenu
```

## vendor/qcom/opensource/camera-kernel/Kconfig
```kconfig
config SPECTRA_ISP
	bool "enable camera ISP module"
	help
	  This is enabling camera ISP module.
	  IFE camera driver file be included.
	  This will enable camera ISP driver to handle IFE driver.
	  Core camera driver to handle VFE HW.

config SPECTRA_ICP
	bool "enable camera ICP module"
	help
	  This is enabling camera ICP module.
	  Camera ICP driver file be included.
	  This will enable camera ICP driver to interact with,
	  ICP FW. Which can control IPE and BPS HW.

config SPECTRA_JPEG
	bool "enable camera jpeg module"
	help
	  This is enabling camera JPEG module.
	  camera jpeg module will be functional.
	  This module interact with jpeg HW for
	  snapshot processing.

config SPECTRA_SENSOR
	bool "enable camera sensor module"
	help
	  This is enabling camera sensor module.
	  sensor module files will be included to enable the driver.
	  eeprom, flash, csiphy all other module will be included
	  to make the sensor functional.

config SPECTRA_USE_CLK_CRM_API
	bool "enable camera cesta clk feature"
	help
	  This is enabling camera cesta feature.
	  kernel clk driver api will cache the clk value
	  send by camera hw and apply to CRM hw.
	  CRM hw will consolidate and apply the clk to camera HW.

config SPECTRA_USE_RPMH_DRV_API
	bool "enable camera new ICC BW api"
	help
	  This is helping to set BW through kernel icc driver.
	  Kernel icc driver do caching the bw information.
	  icc driver will update the bw information RPMH,
	  to apply proper bw voting for camera to mmnoc

config SPECTRA_LLCC_STALING
	bool "enable camera new LLCC staling feature"
	help
	  This will enable to call LLCC driver cache notification API
	  and increment count API.
	  Which will enable LLCC staling feature,based on counter
	  invalidate the cache slice.

config TARGET_SYNX_ENABLE
	bool "enable HW synx"
	help
	  This is enabling HW syx feature.
	  synx hw signaling external to camera,
	  like EVA and other.
	  This is to avoid sw signaling latency.

config MSM_MMRM
	bool "enable MSM MMRM"
	help
	  This is enabling mmrm api access.
	  mmrm to cahce the clk voting.
	  mmrm knows about all clients' clock rates.
	  MMRM can decide whether new peak power usage is within allowed value

config INTERCONNECT_QCOM
	bool "enabling icc bus driver"
	help
		This is to access icc driver api.
		To cache AB and IB vote will
		use ICC kernel driver API.
		So that ICC driver can consolidate the vote

config DOMAIN_ID_SECURE_CAMERA
	bool "enable domain ID based secure camera flow"
	help
		This is to enable domain ID based secure
		camera flow on the hardware platforms with
		domain ID based security architecture.
		VC based security can be achieved with this.

config SAMSUNG_OIS_MCU_STM32
	bool "enable camera mcu stm32 module"
	help
	  This is enabling camera mcu stm32 module.
	  camera mcu module will be functional.
	  This module interact with mcu HW to
	  control ois and actuator.

config CAMERA_SYSFS_V2
	bool "enable camera sysfs v2 module"
	help
	  This is enabling camera sysfs v2 module.
	  camera sysfs v2 module will be functional.
	  This module provide sysfs node for factory test.

config CAMERA_FRAME_CNT_DBG
	bool "enable camera frame count debug"
	help
	  This is enabling frame count debug feature.
	  camera frame count will be functional.

config CAMERA_FRAME_CNT_CHECK
	bool "enable frame count check feature"
	help
	  This is enabling frame count check to ensure that
	  sensor streams at least one frame before stream off.

config SAMSUNG_FRONT_EEPROM
	bool "enable front eeprom"
	help
	  This is enabling front eeprom feature.

config SAMSUNG_REAR_DUAL
	bool "enable rear dual"
	help
	  This is enabling samsung rear dual feature.
	  device has at least two cameras facing rear.

config SAMSUNG_REAR_TRIPLE
	bool "enable rear triple"
	help
	  This is enabling samsung rear triple feature.
	  device has at least three cameras facing rear.

config SAMSUNG_REAR_QUADRA
	bool "enable rear quadra"
	help
	  This is enabling samsung rear quadra feature.
	  device has at least four cameras facing rear.

config SAMSUNG_CAMERA
	bool "enable samsung camera"
	help
	  This is enabling samsung camera feature.
	  samsung specialized functions will be functional.

config SENSOR_RETENTION
	bool "enable sensor retention"
	help
	  This is enabling sensor retention feature.
	  sensor retention will be functional.

config CAMERA_ADAPTIVE_MIPI
	bool "enable adaptive mipi module"
	help
	  This is enabling adaptive mipi module.
	  adaptive mipi module will be functional.
	  MIPI data rate of sensor will be adjusted depends on RF.

config CAMERA_RF_MIPI
	bool "enable RF mipi"
	help
	  This is enabling RF mipi feature.

config SAMSUNG_ACTUATOR_READ_HALL_VALUE
	bool "enable read hall value of actuator"
	help
	  This is enabling actuator read hall value feature.
	  actuator will provide api to read hall value.

config SAMSUNG_DEBUG_SENSOR_I2C
	bool "enable sensor i2c debug"
	help
	  This is enabling sensor i2c debug feature.
	  sensor will provide api to debug i2c.

config SAMSUNG_DEBUG_SENSOR_TIMING
	bool "enable sensor timing debug"
	help
	  This is enabling sensor timing debug feature.
	  sensor will provide api to debug timing.

config SAMSUNG_DEBUG_HW_INFO
	bool "enable sensor hw info debug"
	help
	  This is enabling feature to debug sensor hw information.
	  sensor will provide api to debug hardware information.

config USE_CAMERA_HW_BIG_DATA
	bool "enable hardware big data"
	help
	  This is enabling feature to gather H/W big data.
	  all sensor subdevices will provide error information
	  related to H/W.

config CAMERA_CDR_TEST
	bool "enable CDR test"
	help
	  This is enabling CDR test feature.

config CAMERA_HW_ERROR_DETECT
	bool "enable HW error detect"
	help
	  This is enabling HW error detect.

config SAMSUNG_ACTUATOR_PREVENT_SHAKING
	bool "enable actuator prevent shaking"
	help
	  This is enabling actuator prevent shaking feature.

config SAMSUNG_READ_BPC_FROM_OTP
	bool "enable read BPC from OTP"
	help
	  This is enabling read BPC from OTP.

config SEC_E1Q_PROJECT
	bool "enable E1"
	help
	  This is enabling E1 feature.

config SEC_E2Q_PROJECT
	bool "enable E2"
	help
	  This is enabling E2 feature.

config SEC_E3Q_PROJECT
	bool "enable E3"
	help
	  This is enabling E1 feature.
```
