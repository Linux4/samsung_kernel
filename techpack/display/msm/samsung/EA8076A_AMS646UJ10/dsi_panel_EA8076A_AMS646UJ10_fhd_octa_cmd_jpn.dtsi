/* Copyright (c) 2020, Samsung Electronics Corporation. All rights reserved.
 *
 * This program is free software; you can redistribute it and/or modify
 * it under the terms of the GNU General Public License version 2 and
 * only version 2 as published by the Free Software Foundation.
 *
 * This program is distributed in the hope that it will be useful,
 * but WITHOUT ANY WARRANTY; without even the implied warranty of
 * MERCHANTABILITY or FITNESS FOR A PARTICULAR PURPOSE.  See the
 * GNU General Public License for more details.
 */

&ss_dsi_panel_EA8076A_AMS646UJ10_FHD {
		/* *************************************************************
		 * candela to index mappings for JAPAN
		 * **************************************************************
		 */

		samsung,gamma_mode2_candela_map_table_revA = < /* THIS TABLE USED FOR DIMMING */
		/*<idx>	  <from>  <till> <scaled_level>  <Panel_Real_CD> */
			0		0		0		3			2
			1		1		1		4			2
			2		2		2		5			3
			3		3		3		6			3
			4		4		4		7			4
			5		5		5		8			4
			6		6		6		9			4
			7		7		7		10			5
			8		8		8		11			5
			9		9		9		11			5
			10		10		10		12			6
			11		11		11		13			6
			12		12		12		14			6
			13		13		13		15			7
			14		14		14		16			7
			15		15		15		17			8
			16		16		16		18			8
			17		17		17		19			8
			18		18		18		20			9
			19		19		19		21			9
			20		20		20		22			10
			21		21		21		23			10
			22		22		22		24			10
			23		23		23		25			11
			24		24		24		25			11
			25		25		25		26			11
			26		26		26		27			12
			27		27		27		28			12
			28		28		28		29			12
			29		29		29		30			13
			30		30		30		31			13
			31		31		31		32			14
			32		32		32		33			14
			33		33		33		34			14
			34		34		34		35			15
			35		35		35		36			15
			36		36		36		37			16
			37		37		37		38			16
			38		38		38		39			16
			39		39		39		40			17
			40		40		40		40			17
			41		41		41		41			17
			42		42		42		42			18
			43		43		43		43			18
			44		44		44		44			18
			45		45		45		45			19
			46		46		46		46			19
			47		47		47		47			20
			48		48		48		48			20
			49		49		49		49			21
			50		50		50		50			21
			51		51		51		51			21
			52		52		52		52			22
			53		53		53		53			22
			54		54		54		54			23
			55		55		55		55			23
			56		56		56		55			23
			57		57		57		56			23
			58		58		58		57			24
			59		59		59		58			24
			60		60		60		59			25
			61		61		61		60			25
			62		62		62		61			25
			63		63		63		62			26
			64		64		64		63			26
			65		65		65		64			27
			66		66		66		65			27
			67		67		67		66			27
			68		68		68		67			28
			69		69		69		68			28
			70		70		70		69			29
			71		71		71		70			29
			72		72		72		70			29
			73		73		73		71			29
			74		74		74		72			30
			75		75		75		73			30
			76		76		76		74			31
			77		77		77		75			31
			78		78		78		76			31
			79		79		79		77			32
			80		80		80		78			32
			81		81		81		79			33
			82		82		82		80			33
			83		83		83		81			33
			84		84		84		82			34
			85		85		85		83			34
			86		86		86		84			35
			87		87		87		85			35
			88		88		88		85			35
			89		89		89		86			35
			90		90		90		87			36
			91		91		91		88			36
			92		92		92		89			37
			93		93		93		90			37
			94		94		94		91			37
			95		95		95		92			38
			96		96		96		93			38
			97		97		97		94			39
			98		98		98		95			39
			99		99		99		96			39
			100		100		100		97			40
			101		101		101		98			40
			102		102		102		99			41
			103		103		103		100			41
			104		104		104		100			41
			105		105		105		101			41
			106		106		106		102			42
			107		107		107		103			42
			108		108		108		104			43
			109		109		109		105			43
			110		110		110		106			43
			111		111		111		107			44
			112		112		112		108			44
			113		113		113		109			45
			114		114		114		110			45
			115		115		115		111			45
			116		116		116		112			46
			117		117		117		113			46
			118		118		118		114			47
			119		119		119		115			47
			120		120		120		115			47
			121		121		121		116			47
			122		122		122		117			48
			123		123		123		118			48
			124		124		124		119			49
			125		125		125		120			49
			126		126		126		121			49
			127		127		127		122			50
			128		128		128		123			50
			129		129		129		130			53
			130		130		130		137			56
			131		131		131		144			59
			132		132		132		151			62
			133		133		133		158			64
			134		134		134		165			67
			135		135		135		173			70
			136		136		136		180			73
			137		137		137		187			76
			138		138		138		194			79
			139		139		139		201			82
			140		140		140		208			84
			141		141		141		215			87
			142		142		142		222			90
			143		143		143		229			93
			144		144		144		236			96
			145		145		145		243			99
			146		146		146		251			102
			147		147		147		258			105
			148		148		148		265			107
			149		149		149		272			110
			150		150		150		279			113
			151		151		151		286			116
			152		152		152		293			119
			153		153		153		300			121
			154		154		154		307			124
			155		155		155		314			127
			156		156		156		321			130
			157		157		157		328			133
			158		158		158		336			136
			159		159		159		343			139
			160		160		160		350			142
			161		161		161		357			144
			162		162		162		364			147
			163		163		163		371			150
			164		164		164		378			153
			165		165		165		385			156
			166		166		166		392			158
			167		167		167		399			161
			168		168		168		406			164
			169		169		169		414			167
			170		170		170		421			170
			171		171		171		428			173
			172		172		172		435			176
			173		173		173		442			179
			174		174		174		449			181
			175		175		175		456			184
			176		176		176		463			187
			177		177		177		470			190
			178		178		178		477			193
			179		179		179		484			196
			180		180		180		491			199
			181		181		181		499			202
			182		182		182		506			205
			183		183		183		513			208
			184		184		184		520			211
			185		185		185		527			214
			186		186		186		534			217
			187		187		187		541			220
			188		188		188		548			222
			189		189		189		555			225
			190		190		190		562			228
			191		191		191		569			231
			192		192		192		577			235
			193		193		193		584			237
			194		194		194		591			240
			195		195		195		598			243
			196		196		196		605			246
			197		197		197		612			249
			198		198		198		619			252
			199		199		199		626			255
			200		200		200		633			258
			201		201		201		640			261
			202		202		202		647			264
			203		203		203		654			267
			204		204		204		662			270
			205		205		205		669			273
			206		206		206		676			276
			207		207		207		683			279
			208		208		208		690			282
			209		209		209		697			284
			210		210		210		704			287
			211		211		211		711			290
			212		212		212		718			293
			213		213		213		725			296
			214		214		214		732			299
			215		215		215		740			302
			216		216		216		747			305
			217		217		217		754			308
			218		218		218		761			311
			219		219		219		768			314
			220		220		220		775			317
			221		221		221		782			320
			222		222		222		789			323
			223		223		223		796			326
			224		224		224		803			329
			225		225		225		810			331
			226		226		226		817			334
			227		227		227		825			338
			228		228		228		832			341
			229		229		229		839			343
			230		230		230		846			346
			231		231		231		853			349
			232		232		232		860			352
			233		233		233		867			355
			234		234		234		874			358
			235		235		235		881			361
			236		236		236		888			364
			237		237		237		895			367
			238		238		238		902			370
			239		239		239		910			373
			240		240		240		917			376
			241		241		241		924			379
			242		242		242		931			382
			243		243		243		938			385
			244		244		244		945			388
			245		245		245		952			390
			246		246		246		959			393
			247		247		247		966			396
			248		248		248		973			399
			249		249		249		980			402
			250		250		250		988			405
			251		251		251		995			408
			252		252		252		1002		411
			253		253		253		1009		414
			254		254		254		1016		417
			255		255		255		1023		420
			256		256		256		3			422
			257		257		257		7			423
			258		258		258		11			425
			259		259		259		15			427
			260		260		260		18			428
			261		261		261		22			430
			262		262		262		26			432
			263		263		263		29			433
			264		264		264		33			435
			265		265		265		37			436
			266		266		266		40			438
			267		267		267		44			440
			268		268		268		48			441
			269		269		269		51			443
			270		270		270		55			444
			271		271		271		59			446
			272		272		272		62			448
			273		273		273		66			449
			274		274		274		70			451
			275		275		275		73			452
			276		276		276		77			454
			277		277		277		81			456
			278		278		278		84			457
			279		279		279		88			459
			280		280		280		92			461
			281		281		281		95			462
			282		282		282		99			464
			283		283		283		103			466
			284		284		284		107			468
			285		285		285		110			469
			286		286		286		114			471
			287		287		287		118			473
			288		288		288		121			474
			289		289		289		125			476
			290		290		290		129			477
			291		291		291		132			479
			292		292		292		136			481
			293		293		293		140			482
			294		294		294		143			484
			295		295		295		147			485
			296		296		296		151			487
			297		297		297		154			489
			298		298		298		158			490
			299		299		299		162			492
			300		300		300		165			493
			301		301		301		169			495
			302		302		302		173			497
			303		303		303		176			498
			304		304		304		180			500
			305		305		305		184			502
			306		306		306		187			503
			307		307		307		191			505
			308		308		308		195			507
			309		309		309		198			508
			310		310		310		202			510
			311		311		311		206			512
			312		312		312		209			513
			313		313		313		213			515
			314		314		314		217			517
			315		315		315		220			518
			316		316		316		224			520
			317		317		317		228			522
			318		318		318		231			523
			319		319		319		235			525
			320		320		320		239			526
			321		321		321		242			528
			322		322		322		246			530
			323		323		323		250			531
			324		324		324		253			533
			325		325		325		257			534
			326		326		326		261			536
			327		327		327		264			538
			328		328		328		268			539
			329		329		329		272			541
			330		330		330		275			543
			331		331		331		279			544
			332		332		332		283			546
			333		333		333		286			547
			334		334		334		290			549
			335		335		335		294			551
			336		336		336		297			552
			337		337		337		301			554
			338		338		338		305			556
			339		339		339		309			558
			340		340		340		312			559
			341		341		341		316			561
			342		342		342		320			563
			343		343		343		323			564
			344		344		344		327			566
			345		345		345		331			567
			346		346		346		334			569
			347		347		347		338			571
			348		348		348		342			572
			349		349		349		345			574
			350		350		350		349			575
			351		351		351		353			577
			352		352		352		356			579
			353		353		353		360			580
			354		354		354		364			582
			355		355		355		367			584
			356		356		356		371			585
			357		357		357		375			587
			358		358		358		378			588
			359		359		359		382			590
			360		360		360		386			592
			361		361		361		389			593
			362		362		362		393			595
			363		363		363		397			597
			364		364		364		400			598
			365		365		365		404			600
		>;
};
