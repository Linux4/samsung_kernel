## techpack/display/msm/samsung/B4_S6E3FAC_AMF670BS01/Kconfig
```kconfig
config PANEL_B4_S6E3FAC_AMF670BS01_FHD
	depends on DISPLAY_SAMSUNG
	bool "LSI S6E3FAC LDI"
	default n
	---help---
	LSI S6E3FAC LDI 1080_2400 B4
```

## techpack/display/msm/samsung/EA8082_AMB641ZR01/Kconfig
```kconfig
config PANEL_EA8082_AMB641ZR01_FHD
	depends on DISPLAY_SAMSUNG
	bool "MAGNA EA8082 LDI"
	default n
	---help---
	MAGNA EA8082 LDI 1080_2340 R9
```

## techpack/display/msm/samsung/FT8203_TS124QDM/Kconfig
```kconfig
config  PANEL_FT8203_TS124QDM_WQXGA
	depends on DISPLAY_SAMSUNG
	bool "Focaltech FT8203 TDDI"
	default n
	---help---
	Focaltech FT8203 TDDI 1600_2560 Tabs7+Lite
```

## techpack/display/msm/samsung/GTACT4PRO_HX8279_TV101WUM/Kconfig
```kconfig
config PANEL_GTACT4PRO_HX8279_TV101WUM_WUXGA
	depends on DISPLAY_SAMSUNG
	bool "HIMAX HX8279 TAP ACTIVE4 PRO"
	default n
	---help---
	HIMAX HX8279 BOE 1920_1200 TAP_ACTIVE4_PRO
```

## techpack/display/msm/samsung/HX83102_TV104WUM/Kconfig
```kconfig
config  PANEL_HX83102_TV104WUM_WUXGA
	depends on DISPLAY_SAMSUNG
	bool "HIMAX HX83102 TDDI"
	default n
	---help---
	HIMAX HX83102 TDDI 1200_2000 Tabs7+Lite Bringup
```

## techpack/display/msm/samsung/HX83121_PPC357DB11/Kconfig
```kconfig
config  PANEL_HX83121_PPC357DB11_WQXGA
	depends on DISPLAY_SAMSUNG
	bool "HIMAX HX83121 TDDI"
	default n
	---help---
	HIMAX HX83121 TDDI 1600_2560 Tabs7+Lite
```

## techpack/display/msm/samsung/Kconfig
```kconfig
config SAMSUNG_DEBUG_DISPLAY
	bool "Add Samsung Debugging code"
	default n

config DISPLAY_SAMSUNG
	bool "mdss config for samsung product"
	default n
	---help---
	Mdss config signature for samsung product

config PANEL_KUNIT
    bool "KUnit test for panel"
    depends on SEC_KUNIT
	---help---
	config for Panel KUnit Test

#
#	PANEL UNIQUE FEATURE
#
config DUAL_PANEL
	depends on DISPLAY_SAMSUNG
	bool "dual paneloperation"
	default n
	---help---
	dual panel operation support

config PARTIAL_UPDATE
	depends on DISPLAY_SAMSUNG
	bool "partial update operation"
	default n
	---help---
	partial update operation support

config CABC_FUNCTION
	depends on DISPLAY_SAMSUNG
	bool "DDI cabc operation"
	default n
	---help---
	DDI cabc operation support

config SUPPORT_POC_FLASH
	depends on DISPLAY_SAMSUNG
	bool "SUPPORT POC FLASH"
	default n
	---help---
	SUPPORT_POC_FLASH FOR DREAM2 ONLY
```

## techpack/display/msm/samsung/NT36672C_PM6585JB3_M23/Kconfig
```kconfig
config  PANEL_NT36672C_PM6585JB3_M23_FHD
	depends on DISPLAY_SAMSUNG
	bool "NOVATEK NT36672C M23 TDDI"
	default n
	---help---
	NOVATEK NT36672C TDDI 1080_2408 M23
```

## techpack/display/msm/samsung/NT36672C_TL066FVMC02/Kconfig
```kconfig
config  PANEL_NT36672C_TL066FVMC02_FHD
	depends on DISPLAY_SAMSUNG
	bool "NOVATEK NT36672C TDDI"
	default n
	---help---
	NOVATEK NT36672C TDDI 1080_2408 M23
```

## techpack/display/msm/samsung/PBA_BOOTING_DSI1/Kconfig
```kconfig
config PANEL_PBA_FHD_DSI1
	depends on DISPLAY_SAMSUNG
    bool "pba config for dual display"
    default n
    ---help---
    DSI_1 PBA config dual display
```

## techpack/display/msm/samsung/S6E36W3_AMB114EU09/Kconfig
```kconfig
config PANEL_S6E36W3_AMB114EU09_116X300
	depends on DISPLAY_SAMSUNG
	bool "LSI S6E36W3 LDI"
	default n
	---help---
	LSI S6E36W3 LDI 120_300 B1
```

## techpack/display/msm/samsung/S6E36W3_AMB190ZB01/Kconfig
```kconfig
config PANEL_S6E36W3_AMB190ZB01_260X488
	depends on DISPLAY_SAMSUNG
	bool "LSI S6E36W3 LDI"
	default n
	---help---
	LSI S6E36W3 LDI 120_300 B1
```

## techpack/display/msm/samsung/S6E3FA7_AMB623VH01/Kconfig
```kconfig
config PANEL_S6E3FA7_AMB623VH01_HD
	depends on DISPLAY_SAMSUNG
	bool "LSI S6E3FA7 LDI"
	default n
	---help---
	LSI S6E3FA7 LDI F2 SUB
```

## techpack/display/msm/samsung/S6E3FA9_AMB667UM36/Kconfig
```kconfig
config PANEL_S6E3FA9_AMB667UM36_FHD
	depends on DISPLAY_SAMSUNG
	bool "LSI S6E3FC3 LDI"
	default n
	---help---
	LSI S6E3FA9 LDI 1080_2400 M52XQ_REV01
```

## techpack/display/msm/samsung/S6E3FAB_AMB623ZF01/Kconfig
```kconfig
config PANEL_S6E3FAB_AMB623ZF01_HD
	depends on DISPLAY_SAMSUNG
	bool "LSI S6E3FAB LDI"
	default n
	---help---
	LSI S6E3FAB LDI 832_2268 Q2 SUB
```

## techpack/display/msm/samsung/S6E3FAB_AMB667XU01/Kconfig
```kconfig
config PANEL_S6E3FAB_AMB667XU01_FHD
	depends on DISPLAY_SAMSUNG
	bool "LSI S6E3FAB LDI"
	default n
	---help---
	LSI S6E3FAB LDI 1080_2400 Unbound_N2
```

## techpack/display/msm/samsung/S6E3FC3_AMB641ZR02/Kconfig
```kconfig
config PANEL_S6E3FC3_AMB641ZR02_FHD
	depends on DISPLAY_SAMSUNG
	bool "LSI S6E3FC3 LDI"
	default n
	---help---
	LSI S6E3FC3 LDI 1080_2400 R9
```

## techpack/display/msm/samsung/S6E3FC3_AMS646YD01_LO/Kconfig
```kconfig
config PANEL_S6E3FC3_AMS646YD01_LO_FHD
	depends on DISPLAY_SAMSUNG
	bool "LSI S6E3FC3 LDI"
	default n
	---help---
	LSI S6E3FC3 LDI 1080_2400 A52SXQ
```

## techpack/display/msm/samsung/S6E3HA9_AMF670UH01/Kconfig
```kconfig
config PANEL_S6E3HA9_AMF670UH01_FHD
	depends on DISPLAY_SAMSUNG
	bool "LSI AMF670UH01 LDI"
	default n
	---help---
	LSI AMF670UH01 LDI 2636_1080 B1
```

## techpack/display/msm/samsung/S6E3HAB_AMB623TS01/Kconfig
```kconfig
config PANEL_S6E3HAB_AMB623TS01_WQHD
	depends on DISPLAY_SAMSUNG
	bool "LSI S6E3HAB LDI"
	default n
	---help---
	LSI S6E3HAB LDI 1440_3200
```

## techpack/display/msm/samsung/S6E3HAB_AMB667AN01/Kconfig
```kconfig
config PANEL_S6E3HAB_AMB667AN01_FHD
	depends on DISPLAY_SAMSUNG
	bool "LSI S6E3HAB LDI"
	default n
	---help---
	LSI S6E3HAB LDI 1080_2400 M52XQ
```

## techpack/display/msm/samsung/S6E3HAB_AMB667AN01_A73/Kconfig
```kconfig
config PANEL_S6E3HAB_AMB667AN01_A73_FHD
	depends on DISPLAY_SAMSUNG
	bool "LSI S6E3HAB LDI and SDC Panel"
	default n
	---help---
	LSI S6E3HAB LDI 1080_2400 A73XQ
```

## techpack/display/msm/samsung/S6E3HAB_AMB677TY01/Kconfig
```kconfig
config PANEL_S6E3HAB_AMB677TY01_WQHD
	depends on DISPLAY_SAMSUNG
	bool "LSI S6E3HAB LDI"
	default n
	---help---
	LSI S6E3HAB LDI 1440_3200
```

## techpack/display/msm/samsung/S6E3HAD_AMB681XV01/Kconfig
```kconfig
config PANEL_S6E3HAD_AMB681XV01_WQHD
	depends on DISPLAY_SAMSUNG
	bool "LSI S6E3HAD LDI"
	default n
	---help---
	LSI S6E3HAD LDI 1440_3200 Unbound_O3
```

## techpack/display/msm/samsung/S6E3HAD_AMF670ZA01/Kconfig
```kconfig
config PANEL_S6E3HAD_AMF670ZA01_FHD
	depends on DISPLAY_SAMSUNG
	bool "LSI S6E3HAD LDI"
	default n
	---help---
	LSI S6E3HAD LDI 1080_2640 B2
```
