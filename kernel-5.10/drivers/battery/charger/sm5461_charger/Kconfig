## kernel-5.15/drivers/battery/fuelgauge/bq27z746_fuelgauge/Kconfig
```kconfig
menu "Fuelgauge drivers"

config FUELGAUGE_BQ27Z746
	tristate "BQ27Z746 fuel gauge driver"
	default n
	depends on BATTERY_SAMSUNG && I2C
	help
	 Say Y or M here, to enable
	  support for TI BQ27Z746 fuel gauge driver.
	  This is fuel-gauge systems for monitoring batteries.
	  This fuel-gauge can be used in coulomb-counting mode.

config BQ27Z746_I2C_ERR_SW_WA
	bool "I2C SW WA Concept"
	default n
	help
	  Say Y here to enable
	  Support for I2C read fail.
	  This is to enable SW WA incase of I2C error.

config BQ27Z746_LOW_TEMP_COMP
	bool "Low temperature Compensation Concept"
	default n
	help
	  Say Y here to enable
	  Support for low temperature sudden discharge problem.
	  This is to enable Low temperature compensation concept.

endmenu
```

## kernel-5.15/drivers/gpu/drm/panel/mcd_panel/Kconfig
```kconfig
config DRM_PANEL_MCD_COMMON
	tristate "Samsung MCD Common panel"
	depends on OF
	depends on DRM_MIPI_DSI
	select VIDEOMODE_HELPERS
```

## kernel-5.15/drivers/gpu/drm/samsung/panel/tft_common/Kconfig
```kconfig
menuconfig USDM_PANEL_TFT_COMMON
	tristate "TFT_COMMON DDI Panel Driver"
	depends on USDM_PANEL
	default n
	help
		This enables TFT_COMMON DDI dependent panel drivers of
		common panel driver. say Y, if you have a panel based on
		the TFT_COMMON DDI.


menuconfig USDM_PANEL_NT36672C_XCOVER7_00
	tristate "NT36672C_XCOVER7_00 DDI Panel Driver"
	depends on USDM_PANEL_TFT_COMMON
	default n
	help
		This enables NT36672C_XCOVER7_00 DDI dependent panel drivers of
		common panel driver. say Y, if you have a panel based on
		the NT36672C_XCOVER7_00 DDI.
```

## kernel-5.15/drivers/input/fingerprint/goodix/Kconfig
```kconfig
#
#Fingerprint
#
menu "Fingerprint support"
	depends on INPUT

config MTK_FINGERPRINT
	bool "Mediatek Fingerprint"
	default n
	help
	  Fingerprint mtk driver enable/disable
	  in the kernel.Say Y here if you want to
	  use mediatek fingerprint driver,fingerprint
	  driver will support fingerprint function


config MTK_FINGERPRINT_GOODIX
	tristate "GOODIX Fingerprint"
        default n
        help
        Support GOODIX capacitive fingerprint sensor device.
endmenu
```

## kernel-5.15/drivers/input/stk501xx/Kconfig
```kconfig
config INPUT_STK501XX
	tristate "STK501XX for MediaTek package"
	default n
	help
	  Say Y to enable the SAR detection application, if N here not to use the
          this SAR sensor
```

## kernel-5.15/drivers/input/touchscreen/FT3419U/Kconfig
```kconfig
#
# Focaltech Touchscreen driver configuration
#

config TOUCHSCREEN_FTS_FT3419
    tristate "Focaltech Touchscreen"
    default n
    help
      Say Y here if you have Focaltech touch panel.
      If unsure, say N.
```
