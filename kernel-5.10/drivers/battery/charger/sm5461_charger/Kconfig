## kernel-5.15/arch/arm64/configs/m15x_00_defconfig
```kconfig
CONFIG_BUILD_CONFIG_FILE="build.config.mtk.aarch64"
CONFIG_MODULE_SIG_KEY="certs/mtk_signing_key.pem"
# CONFIG_MODULE_SIG_ALL is not set
CONFIG_ARCH_MEDIATEK=y
CONFIG_ABI_MONITOR=y
CONFIG_MTK_TIMER=m
CONFIG_MTK_CLKBUF=m
CONFIG_MTK_CLKBUF_V1=y
CONFIG_MTK_DCM_MT6835=m
CONFIG_MTK_DCM_MT6879=m
CONFIG_MTK_DCM_MT6895=m
CONFIG_MTK_DCM_MT6886=m
CONFIG_MTK_DCM_MT6983=m
CONFIG_MTK_DCM_MT6985=m
CONFIG_ZRAM_WRITEBACK=y
CONFIG_MTK_SRCLKEN_RC_V1=y
CONFIG_MTK_DVFSRC_HELPER=m
CONFIG_MTK_DVFSRC_MET_MT6873=m
CONFIG_DMABUF_HEAPS_MTK_MM=m
CONFIG_DMABUF_HEAPS_SYSTEM=m
CONFIG_DMABUF_HEAPS_DEBUG=m
CONFIG_MTK_BATTERY_OC_POWER_THROTTLING=m
CONFIG_MTK_BATTERY_PERCENT_THROTTLING=m
CONFIG_MTK_DYNAMIC_LOADING_POWER_THROTTLING=m
CONFIG_MTK_LOW_BATTERY_POWER_THROTTLING=m
CONFIG_MTK_MD_POWER_THROTTLING=m
CONFIG_MTK_CPU_POWER_THROTTLING=m
CONFIG_MTK_PBM=m
CONFIG_MTK_IOMMU_MISC=m
CONFIG_MTK_IOMMU_MISC_DBG=m
CONFIG_MTK_IOMMU_MISC_TEST=m
CONFIG_MTK_IOMMU_MISC_SECURE=m
CONFIG_MTK_CMDQ_MBOX_EXT=m
CONFIG_MTK_MMINFRA=m
CONFIG_MTK_MDP=m
CONFIG_MTK_MDP_MT6893=m
CONFIG_MTK_MDP_MT6983=m
CONFIG_MTK_MML=m
CONFIG_MTK_MKP=m
CONFIG_MMPROFILE=m
CONFIG_MTK_TRUSTED_MEMORY_SUBSYSTEM=m
CONFIG_MTK_LENS=m
CONFIG_MTK_V4L2_LENS=m
CONFIG_HAVE_MTK_ENABLE_GENIEZONE=y
CONFIG_MTK_ENABLE_GENIEZONE=m
CONFIG_MTK_GZ_MAIN=m
CONFIG_MTK_GZ_LOG=m
CONFIG_MTK_GZ_VIRTIO=m
CONFIG_MTK_GZ_VIRTIO_IPC=m
CONFIG_MTK_GZ_IRQ=m
CONFIG_MTK_GZ_TZ_SYSTEM=m
CONFIG_HAVE_MTK_GZ_LOG=y
CONFIG_MTK_DRAM_LOG_STORE=m
CONFIG_MTK_DRAM_LOG_STORE_ADDR=0x0011DF00
CONFIG_MTK_DRAM_LOG_STORE_SIZE=0x100
CONFIG_MTPROF=m
CONFIG_MTK_CCCI_DEVICES=y
CONFIG_MTK_MD1_SUPPORT=25
CONFIG_MTK_ECCCI_DRIVER=m
CONFIG_MTK_ECCCI_C2K=y
CONFIG_MTK_ECCCI_C2K_USB=m
CONFIG_MTK_SRIL_SUPPORT=y
CONFIG_MTK_BTIF=m
CONFIG_MTK_UARTHUB=m
CONFIG_MTK_CONN_SCP=m
CONFIG_MTK_COMBO=m
CONFIG_MTK_COMBO_CHIP_CONSYS_6835=y
CONFIG_MTK_COMBO_CHIP_CONSYS_6886=y
CONFIG_MTK_COMBO_CHIP_CONSYS_6893=y
CONFIG_MTK_COMBO_CHIP_CONSYS_6983=y
CONFIG_MTK_COMBO_CHIP_CONSYS_6879=y
CONFIG_MTK_COMBO_CHIP_CONSYS_6895=y
CONFIG_MTK_COMBO_CHIP_CONSYS_6985=y
CONFIG_MTK_COMBO_BT=m
CONFIG_MTK_COMBO_GPS=m
CONFIG_MTK_COMBO_WIFI=m
CONFIG_MTK_DHCPV6C_WIFI=y
# CONFIG_MTK_CONN_LTE_IDC_SUPPORT is not set
CONFIG_MTK_GPS_SUPPORT=y
CONFIG_MTK_GPS_EMI=m
CONFIG_MTK_FMRADIO=m
CONFIG_MTK_FM_CHIP="MT6635_FM"
CONFIG_MTK_CONNSYS_DEDICATED_LOG_PATH=y
CONFIG_TCPC_CLASS=m
CONFIG_USB_POWER_DELIVERY=m
CONFIG_TCPC_MT6360=m
CONFIG_MTK_TYPEC_WATER_DETECT=m
CONFIG_EXTCON_MTK_USB=m
CONFIG_SCSI_UFS_MEDIATEK=m
CONFIG_SEC_UFS_FEATURE=m
CONFIG_SCSI_UFS_MEDIATEK_DBG=m
CONFIG_UFS_MEDIATEK_INTERNAL=y
CONFIG_UFSFEATURE=n
CONFIG_UFSSHPB=n
CONFIG_HPB_DEBUG=n
CONFIG_HPB_DEBUG_SYSFS=n
CONFIG_HPB_ERR_INJECTION=n
CONFIG_UFSTW=n
CONFIG_UFSTW_IGNORE_GUARANTEE_BIT=n
CONFIG_UFSTW_BOOT_ENABLED=n
CONFIG_UFSHID=n
CONFIG_UFSHID_POC=n
CONFIG_UFSHID_DEBUG=n
CONFIG_UFSRINGBUF=n
CONFIG_UFSRINGBUF_POC=n
CONFIG_RPMB=m
CONFIG_KEYBOARD_MTK_KPD=m
CONFIG_KEYBOARD_MTK_PMIC=m
CONFIG_TOUCHSCREEN_MT6983_ALPHA_SUPPORT=m
CONFIG_TOUCHSCREEN_MT6895_ALPHA_SUPPORT=m
CONFIG_TOUCHSCREEN_MT6985_ALPHA_SUPPORT=m
CONFIG_SERIAL_8250_MT6577=m
CONFIG_I2C_MT65XX=m
CONFIG_SPI_MT65XX=m
CONFIG_SPMI_MTK_PMIF=m
# CONFIG_PINCTRL_MT2712 is not set
# CONFIG_PINCTRL_MT6797 is not set
# CONFIG_PINCTRL_MT6779 is not set
CONFIG_PINCTRL_MT6373=m
CONFIG_PINCTRL_MT6835=m
CONFIG_PINCTRL_MT6886=m
CONFIG_PINCTRL_MT6983=m
CONFIG_PINCTRL_MT6985=m
# CONFIG_PINCTRL_MT7622 is not set
# CONFIG_PINCTRL_MT8167 is not set
# CONFIG_PINCTRL_MT8173 is not set
# CONFIG_PINCTRL_MT8183 is not set
CONFIG_PINCTRL_MT8188=m
# CONFIG_PINCTRL_MT8192 is not set
# CONFIG_PINCTRL_MT8195 is not set
# CONFIG_PINCTRL_MT8365 is not set
# CONFIG_PINCTRL_MT8516 is not set
# CONFIG_PINCTRL_MT6397 is not set
CONFIG_HAVE_MTK_MC=y
CONFIG_MTK_DRAMC=m
CONFIG_SYSCON_REBOOT_MODE=m
CONFIG_CHARGER_MT6360=m
CONFIG_MTK_CHARGER_TYPE_DETECT=m
CONFIG_MTK_CHARGER=m
CONFIG_MTK_NO_BAT_BOOT_SUPPORT=y
# CONFIG_MTK_CHGLOG_SUPPORT is not set
CONFIG_MTK_PERF_COMMON=m
CONFIG_MTK_PERF_TRACKER=y
CONFIG_MTK_PUMP_EXPRESS_PLUS_SUPPORT=m
CONFIG_MTK_PUMP_EXPRESS_PLUS_20_SUPPORT=m
CONFIG_MTK_PUMP_EXPRESS_40_SUPPORT=m
CONFIG_MTK_PUMP_EXPRESS_50_SUPPORT=m
CONFIG_MTK_PUMP_EXPRESS_50_PLUS_SUPPORT=m
CONFIG_MTK_HVBP_SUPPORT=m
CONFIG_MFD_RT9490=m
CONFIG_CHARGER_RT9490=m
CONFIG_RT9490_ADC=m
CONFIG_MMSTAT_TRACER=m
CONFIG_CHARGER_RT9758=m
CONFIG_CHARGER_RT9759=m
CONFIG_MTK_TASK_TURBO=m
CONFIG_MTK_THERMAL=y
CONFIG_MTK_TINYSYS_MBOX=m
CONFIG_MTK_TINYSYS_SCMI=m
CONFIG_MTK_SOC_THERMAL_LVTS=m
CONFIG_MTK_PMIC_THERMAL=m
CONFIG_MTK_MD_THERMAL=m
CONFIG_MTK_THERMAL_TRACE=m
CONFIG_MTK_THERMAL_INTERFACE=m
CONFIG_MTK_THERMAL_JATM=m
CONFIG_MTK_VTSKIN_THERMAL=m
CONFIG_MTK_CHARGER_THERMAL=m
CONFIG_MTK_BACKLIGHT_THERMAL=m
CONFIG_MTK_BOARD_THERMAL=m
CONFIG_MTK_WIFI_THERMAL=m
CONFIG_GENERIC_ADC_THERMAL=m
CONFIG_MEDIATEK_WATCHDOG=m
CONFIG_MFD_MT6338=m
CONFIG_MFD_MT6360=m
CONFIG_MFD_MT6397=m
CONFIG_MFD_MT6685=m
CONFIG_MFD_MTK_SPMI_PMIC=m
CONFIG_REGULATOR_MT6315=m
CONFIG_REGULATOR_MT6359P=m
CONFIG_REGULATOR_MT6360=m
CONFIG_REGULATOR_MT6363=m
CONFIG_REGULATOR_MT6368=m
CONFIG_REGULATOR_MT6373=m
CONFIG_REGULATOR_MT6377=m
CONFIG_REGULATOR_MTK_DVFSRC=m
CONFIG_REGULATOR_MTK_VMM_ISP71=m
CONFIG_REGULATOR_RT5133=m
CONFIG_REGULATOR_RT6160=m
CONFIG_REGULATOR_MT6983_ALPHA_SUPPORT=m
CONFIG_MTK_VMM_SPM=m
CONFIG_MTK_VMM_NOTIFIER=m
CONFIG_MTK_PMIC_PROTECT=m
CONFIG_DRM_MEDIATEK_PANEL=m
CONFIG_DRM_MEDIATEK=m
CONFIG_DRM_MEDIATEK_V2=y
CONFIG_MTK_GATE_IC=y
CONFIG_RT4831A_I2C=m
CONFIG_MTK_GPU_SUPPORT=m
CONFIG_MTK_GPU_MT6835_SUPPORT=m
CONFIG_MTK_GPU_MT6879_SUPPORT=m
CONFIG_MTK_GPU_MT6886_SUPPORT=m
CONFIG_MTK_GPU_MT6893_SUPPORT=m
CONFIG_MTK_GPU_MT6895_SUPPORT=m
CONFIG_MTK_GPU_MT6983_SUPPORT=m
CONFIG_MTK_GPU_MT6985_SUPPORT=m
CONFIG_MTK_GPUFREQ_V2=y
CONFIG_MTK_GPU_COMMON_DVFS_SUPPORT=y
CONFIG_MTK_IMGSENSOR=m
CONFIG_MTK_SECURITY_SW_SUPPORT=m
CONFIG_SND_SOC_MT6338_ACCDET=m
CONFIG_SND_SOC_MT6368_ACCDET=m
CONFIG_SND_SOC_MT6377_ACCDET=m
CONFIG_SND_SOC_MT6359P_ACCDET=m
CONFIG_SND_SOC_MT6885=m
CONFIG_SND_SOC_MT6885_MT6359P=m
CONFIG_SND_SOC_MT6879=m
CONFIG_SND_SOC_MT6879_MT6368=m
CONFIG_SND_SOC_MT6886=m
CONFIG_SND_SOC_MT6886_MT6368=m
CONFIG_SND_SOC_MT6895=m
CONFIG_SND_SOC_MT6895_MT6368=m
CONFIG_SND_SOC_MT6983=m
CONFIG_SND_SOC_MT6983_MT6338=m
CONFIG_SND_SOC_MT6985=m
CONFIG_SND_SOC_MT6985_MT6338=m
CONFIG_SND_SOC_MT6835=m
CONFIG_SND_SOC_MT6835_MT6368=m
CONFIG_SND_SOC_MT6835_MT6377=m
CONFIG_SND_SOC_MTK_BTCVSD=m
CONFIG_SND_SOC_AA006=m
CONFIG_USB_MTU3=m
CONFIG_MTK_USB_BOOST=m
CONFIG_MTK_USB_CONFIGFS_RNDIS=m
CONFIG_USB_CONFIGFS_F_DM=m
CONFIG_USB_CONFIGFS_F_CONN_GADGET=m
CONFIG_USB_CONFIGFS_F_SS_MON_GADGET=m
CONFIG_USB_NOTIFY_LAYER=m
CONFIG_USB_HOST_NOTIFY=y
CONFIG_USB_EXTERNAL_NOTIFY=y
CONFIG_USB_NOTIFY_PROC_LOG=y
CONFIG_USB_DEBUG_DETAILED_LOG=y
CONFIG_USB_HOST_SAMSUNG_FEATURE=y
CONFIG_USB_HW_PARAM=y
CONFIG_USB_INTERFACE_LPM_LIST=y
CONFIG_USB_NOTIFIER=m
CONFIG_USB_EHSET_TEST_FIXTURE=m
CONFIG_USB_NET_SMSC75XX=m
CONFIG_USB_NET_SMSC95XX=m
CONFIG_USB_NET_CDC_MBIM=m
CONFIG_USB_PRINTER=m
CONFIG_USB_SERIAL=m
CONFIG_USB_SERIAL_FTDI_SIO=m
CONFIG_USB_SERIAL_PL2303=m
CONFIG_HID_A4TECH=m
CONFIG_HID_ACCUTOUCH=m
CONFIG_HID_ACRUX=m
CONFIG_HID_ACRUX_FF=y
CONFIG_HID_APPLEIR=m
CONFIG_HID_ASUS=m
CONFIG_HID_AUREAL=m
CONFIG_HID_BELKIN=m
CONFIG_HID_BETOP_FF=m
CONFIG_HID_CHERRY=m
CONFIG_HID_CHICONY=m
CONFIG_HID_CORSAIR=m
CONFIG_HID_MACALLY=m
CONFIG_HID_CMEDIA=m
CONFIG_HID_CREATIVE_SB0540=m
CONFIG_HID_CYPRESS=m
CONFIG_HID_DRAGONRISE=m
CONFIG_DRAGONRISE_FF=y
CONFIG_HID_EMS_FF=m
CONFIG_HID_ELAN=m
CONFIG_HID_ELO=m
CONFIG_HID_EZKEY=m
CONFIG_HID_GEMBIRD=m
CONFIG_HID_GLORIOUS=m
CONFIG_HID_HOLTEK=m
CONFIG_HOLTEK_FF=y
CONFIG_HID_VIVALDI_COMMON=m
CONFIG_HID_GOOGLE_HAMMER=m
CONFIG_HID_VIVALDI=m
CONFIG_HID_GT683R=m
CONFIG_HID_KEYTOUCH=m
CONFIG_HID_KYE=m
CONFIG_HID_WALTOP=m
CONFIG_HID_VIEWSONIC=m
CONFIG_HID_VRC2=m
CONFIG_HID_XIAOMI=m
CONFIG_HID_GYRATION=m
CONFIG_HID_ICADE=m
CONFIG_HID_ITE=m
CONFIG_HID_JABRA=m
CONFIG_HID_TWINHAN=m
CONFIG_HID_KENSINGTON=m
CONFIG_HID_LCPOWER=m
CONFIG_HID_LED=m
CONFIG_HID_LETSKETCH=m
CONFIG_HID_MALTRON=m
CONFIG_HID_MAYFLASH=m
CONFIG_HID_MEGAWORLD_FF=m
CONFIG_HID_REDRAGON=m
CONFIG_HID_MONTEREY=m
CONFIG_NINTENDO_FF=y
CONFIG_HID_NTI=m
CONFIG_HID_NTRIG=m
CONFIG_HID_ORTEK=m
CONFIG_HID_PANTHERLORD=m
CONFIG_PANTHERLORD_FF=y
CONFIG_HID_PENMOUNT=m
CONFIG_HID_PETALYNX=m
CONFIG_HID_PICOLCD_FB=y
CONFIG_HID_PICOLCD_BACKLIGHT=y
CONFIG_HID_PICOLCD_LCD=y
CONFIG_HID_PICOLCD_LEDS=y
CONFIG_HID_PICOLCD_CIR=y
CONFIG_HID_PXRC=m
CONFIG_HID_RAZER=m
CONFIG_HID_PRIMAX=m
CONFIG_HID_RETRODE=m
CONFIG_HID_SAITEK=m
CONFIG_HID_SEMITEK=m
CONFIG_HID_SIGMAMICRO=m
CONFIG_HID_SPEEDLINK=m
CONFIG_HID_SUNPLUS=m
CONFIG_HID_RMI=m
CONFIG_HID_GREENASIA=m
CONFIG_GREENASIA_FF=y
CONFIG_HID_HYPERV_MOUSE=m
CONFIG_HID_SAMSUNG=y
CONFIG_HID_SMARTJOYPLUS=m
CONFIG_SMARTJOYPLUS_FF=y
CONFIG_HID_TIVO=m
CONFIG_HID_TOPSEED=m
CONFIG_HID_TOPRE=m
CONFIG_HID_THINGM=m
CONFIG_HID_THRUSTMASTER=m
CONFIG_THRUSTMASTER_FF=y
CONFIG_HID_UDRAW_PS3=m
CONFIG_HID_U2FZERO=m
CONFIG_HID_XINMO=m
CONFIG_ZEROPLUS_FF=y
CONFIG_HID_ZYDACRON=m
CONFIG_HID_ALPS=m
CONFIG_HID_MCP2221=m
CONFIG_INPUT_TABLET=y
CONFIG_TABLET_USB_ACECAD=m
CONFIG_TABLET_USB_AIPTEK=m
CONFIG_TABLET_USB_HANWANG=m
CONFIG_TABLET_USB_KBTAB=m
CONFIG_TABLET_USB_PEGASUS=m
CONFIG_MTK_USB_META=m
CONFIG_DEVICE_MODULES_USB_XHCI_MTK=m
CONFIG_MTK_USB_OFFLOAD=m
CONFIG_LEDS_MT_BRIGHTNESS_HW_CHANGED=y
CONFIG_LEDS_MTK=m
CONFIG_LEDS_MTK_DISP=m
CONFIG_LEDS_MTK_PWM=m
CONFIG_LEDS_PWM=m
#CONFIG_LEDS_REGULATOR_VIBRATOR=m
#CONFIG_LEDS_MT6360=m
#CONFIG_MTK_VIDEO_LM3643=m
CONFIG_MTK_VIDEO_LM3644=m
CONFIG_MTK_VIDEO_SY7806=m
CONFIG_MTK_FLASHLIGHT=m
CONFIG_MTK_FLASHLIGHT_PT=y
CONFIG_MTK_FLASHLIGHT_PT_STRICT=y
CONFIG_MTK_FLASHLIGHT_DLPT=y
#CONFIG_MTK_V4L2_FLASHLIGHT=m
CONFIG_V4L2_FLASH_LED_CLASS=m
CONFIG_RTC_DRV_MT6397=m
CONFIG_RTC_DRV_MT6685=m
CONFIG_MTK_UART_APDMA=m
CONFIG_COMMON_CLK_MT6835=m
CONFIG_COMMON_CLK_MT6835_ADSP=m
CONFIG_COMMON_CLK_MT6835_CAM=m
CONFIG_COMMON_CLK_MT6835_MMSYS=m
CONFIG_COMMON_CLK_MT6835_IMGSYS1=m
CONFIG_COMMON_CLK_MT6835_PERI=m
CONFIG_COMMON_CLK_MT6835_BUS=m
CONFIG_COMMON_CLK_MT6835_IMG=m
CONFIG_COMMON_CLK_MT6835_MDPSYS=m
CONFIG_COMMON_CLK_MT6835_MFG=m
CONFIG_COMMON_CLK_MT6835_NEMI_REG=m
CONFIG_COMMON_CLK_MT6835_SCP_IIC=m
CONFIG_COMMON_CLK_MT6835_SRAMRC_APB=m
CONFIG_COMMON_CLK_MT6835_VCODEC=m
CONFIG_COMMON_CLK_MT6879=m
CONFIG_COMMON_CLK_MT6879_ADSP=m
CONFIG_COMMON_CLK_MT6879_CAM=m
CONFIG_COMMON_CLK_MT6879_CCU=m
CONFIG_COMMON_CLK_MT6879_IMG=m
CONFIG_COMMON_CLK_MT6879_MMSYS=m
CONFIG_COMMON_CLK_MT6879_PERI=m
CONFIG_COMMON_CLK_MT6879_BUS=m
CONFIG_COMMON_CLK_MT6879_MDPSYS=m
CONFIG_COMMON_CLK_MT6879_MFG=m
CONFIG_COMMON_CLK_MT6879_VCODEC=m
CONFIG_COMMON_CLK_MT6893=m
CONFIG_COMMON_CLK_MT6893_APU0=m
CONFIG_COMMON_CLK_MT6893_APU1=m
CONFIG_COMMON_CLK_MT6893_APU2=m
CONFIG_COMMON_CLK_MT6893_APU_VCORE=m
CONFIG_COMMON_CLK_MT6893_APU_CONN=m
CONFIG_COMMON_CLK_MT6893_APU_MDLA0=m
CONFIG_COMMON_CLK_MT6893_APU_MDLA1=m
CONFIG_COMMON_CLK_MT6893_AUDIOSYS=m
CONFIG_COMMON_CLK_MT6893_CAMSYS_MAIN=m
CONFIG_COMMON_CLK_MT6893_CAMSYS_RAWA=m
CONFIG_COMMON_CLK_MT6893_CAMSYS_RAWB=m
CONFIG_COMMON_CLK_MT6893_CAMSYS_RAWC=m
CONFIG_COMMON_CLK_MT6893_IMGSYS1=m
CONFIG_COMMON_CLK_MT6893_IMGSYS2=m
CONFIG_COMMON_CLK_MT6893_IMP_IIC_WRAP_C=m
CONFIG_COMMON_CLK_MT6893_IMP_IIC_WRAP_E=m
CONFIG_COMMON_CLK_MT6893_IMP_IIC_WRAP_N=m
CONFIG_COMMON_CLK_MT6893_IMP_IIC_WRAP_S=m
CONFIG_COMMON_CLK_MT6895=m
CONFIG_COMMON_CLK_MT6895_ADSP=m
CONFIG_COMMON_CLK_MT6895_CAM=m
CONFIG_COMMON_CLK_MT6895_CCU=m
CONFIG_COMMON_CLK_MT6895_IMG=m
CONFIG_COMMON_CLK_MT6895_MMSYS=m
CONFIG_COMMON_CLK_MT6895_PERI=m
CONFIG_COMMON_CLK_MT6895_BUS=m
CONFIG_COMMON_CLK_MT6895_MDPSYS=m
CONFIG_COMMON_CLK_MT6895_MFG=m
CONFIG_COMMON_CLK_MT6895_VCODEC=m
CONFIG_COMMON_CLK_MT6893_IPESYS=m
CONFIG_COMMON_CLK_MT6893_MDPSYS=m
CONFIG_COMMON_CLK_MT6893_MFGCFG=m
CONFIG_COMMON_CLK_MT6893_MMSYS=m
CONFIG_COMMON_CLK_MT6893_SCP_ADSP=m
CONFIG_COMMON_CLK_MT6893_VDECSYS=m
CONFIG_COMMON_CLK_MT6893_VDECSYS_SOC=m
CONFIG_COMMON_CLK_MT6893_VENCSYS_C1=m
CONFIG_COMMON_CLK_MT6893_VENCSYS=m
CONFIG_COMMON_CLK_MT6886=m
CONFIG_COMMON_CLK_MT6886_ADSP=m
CONFIG_COMMON_CLK_MT6886_CAM=m
CONFIG_COMMON_CLK_MT6886_CCU=m
CONFIG_COMMON_CLK_MT6886_IMG=m
CONFIG_COMMON_CLK_MT6886_MMSYS=m
CONFIG_COMMON_CLK_MT6886_PERI=m
CONFIG_COMMON_CLK_MT6886_BUS=m
CONFIG_COMMON_CLK_MT6886_MDPSYS=m
CONFIG_COMMON_CLK_MT6886_SCP=m
CONFIG_COMMON_CLK_MT6886_VCODEC=m
CONFIG_COMMON_CLK_MT6983=m
CONFIG_COMMON_CLK_MT6983_ADSP=m
CONFIG_COMMON_CLK_MT6983_CCU=m
CONFIG_COMMON_CLK_MT6983_IMG=m
CONFIG_COMMON_CLK_MT6983_IMP_IIC_WRAP=m
CONFIG_COMMON_CLK_MT6983_VCODEC=m
CONFIG_COMMON_CLK_MT6983_MDPSYS=m
CONFIG_COMMON_CLK_MT6983_MFG=m
CONFIG_COMMON_CLK_MT6983_MMSYS=m
CONFIG_COMMON_CLK_MT6983_CAM=m
CONFIG_COMMON_CLK_MT6985=m
CONFIG_COMMON_CLK_MT6985_ADSP=m
CONFIG_COMMON_CLK_MT6985_CAM=m
CONFIG_COMMON_CLK_MT6985_CCU=m
CONFIG_COMMON_CLK_MT6985_IMG=m
CONFIG_COMMON_CLK_MT6985_MMSYS=m
CONFIG_COMMON_CLK_MT6985_PERI=m
CONFIG_COMMON_CLK_MT6985_BUS=m
CONFIG_COMMON_CLK_MT6985_MDPSYS=m
CONFIG_COMMON_CLK_MT6985_VLP=m
CONFIG_COMMON_CLK_MT6985_VCODEC=m
CONFIG_COMMON_CLK_MT8188=m
CONFIG_COMMON_CLK_MT8188_AUDSYS=m
CONFIG_COMMON_CLK_MT8188_AUDSYS_SRC=m
CONFIG_COMMON_CLK_MT8188_CAMSYS=m
CONFIG_COMMON_CLK_MT8188_IMGSYS=m
CONFIG_COMMON_CLK_MT8188_IMP_IIC_WRAP=m
CONFIG_COMMON_CLK_MT8188_IPESYS=m
CONFIG_COMMON_CLK_MT8188_VDECSYS=m
CONFIG_COMMON_CLK_MT8188_VDOSYS0=m
CONFIG_COMMON_CLK_MT8188_VDOSYS1=m
CONFIG_COMMON_CLK_MT8188_VENCSYS=m
CONFIG_COMMON_CLK_MT8188_VPPSYS0=m
CONFIG_COMMON_CLK_MT8188_VPPSYS1=m
CONFIG_COMMON_CLK_MT8188_WPESYS=m
CONFIG_COMMON_CLK_MT8188_CCUSYS=m
CONFIG_COMMON_CLK_MT8188_MFGCFG=m
# COMMON_CLK_MT8167 is not set
# CONFIG_COMMON_CLK_MT8167 is not set
# CONFIG_COMMON_CLK_MT8167_AUDSYS is not set
# CONFIG_COMMON_CLK_MT8167_IMGSYS is not set
# CONFIG_COMMON_CLK_MT8167_MFGCFG is not set
# CONFIG_COMMON_CLK_MT8167_MMSYS is not set
# CONFIG_COMMON_CLK_MT8167_VDECSYS is not set
# COMMON_CLK_MT8183 is not set
CONFIG_COMMON_CLK_MEDIATEK=m
CONFIG_COMMON_CLK_MTK_FREQ_HOPPING=m
CONFIG_COMMON_CLK_MTK_FREQ_HOPPING_MCUPM=y
CONFIG_COMMON_CLK_MTK_FREQ_HOPPING_GPUEB=y
CONFIG_MTK_APUSYS_SUPPORT=m
CONFIG_MTK_APUSYS_DEBUG=y
CONFIG_MTK_APUSYS_RT_SUPPORT=y
CONFIG_MTK_APUSYS_MDLA_SUPPORT=y
CONFIG_MTK_APUSYS_VPU=y
CONFIG_MTK_APUSYS_VPU_DEBUG=y
CONFIG_MTK_EMI=m
CONFIG_MTK_DEVMPU=m
CONFIG_MTK_EMI_MPU_TEST=m
CONFIG_MTK_VPU_SUPPORT=y
CONFIG_MTK_VOW_SUPPORT=m
CONFIG_MTK_VOW_DSP_VERSION="ver02"
CONFIG_MTK_VOW_DUAL_MIC_SUPPORT=y
CONFIG_MTK_VOW_MAX_PDK_NUMBER=2
CONFIG_MTK_APUSYS_EDMA_SUPPORT=y
CONFIG_MTK_IOMMU=m
CONFIG_MTK_DVFSRC=m
CONFIG_MTK_PMIC_WRAP=m
CONFIG_MTK_SCHEDULER=m
CONFIG_MTK_OPP_CAP_INFO=y
CONFIG_NONLINEAR_FREQ_CTL=y
CONFIG_MTK_EAS=y
CONFIG_MTK_THERMAL_AWARE_SCHEDULING=y
CONFIG_MTK_LEAKAGE_AWARE_TEMP=y
CONFIG_MTK_NEWIDLE_BALANCE=y
CONFIG_MTK_CORE_PAUSE=y
CONFIG_MTK_SCHED_BIG_TASK_ROTATE=y
CONFIG_MTK_CPUFREQ_SUGOV_EXT=m
CONFIG_MTK_OPP_MIN=y
CONFIG_MTK_CORE_CTL=m
CONFIG_MTK_LEAKAGE_HIT=m
CONFIG_MTK_GEARLESS_SUPPORT=y
CONFIG_MTK_GEARLESS_SWITCH=m
CONFIG_MTK_CPUQOS_V3=m
CONFIG_MTK_SCPSYS=m
CONFIG_MTK_SCPSYS_PM_DOMAINS=m
CONFIG_MTK_IPI=m
CONFIG_MTK_MBOX=m
CONFIG_RPMSG_MTK=m
CONFIG_MTK_TINYSYS_SCP_SUPPORT=m
CONFIG_MTK_TINYSYS_SCP_LOGGER_SUPPORT=y
CONFIG_MTK_TINYSYS_SSPM_SUPPORT=m
CONFIG_MTK_TINYSYS_SSPM_V3=y
CONFIG_MTK_TINYSYS_VCP_SUPPORT=m
CONFIG_MTK_AUDIO_IPI=m
CONFIG_SND_SOC_MTK_AUDIO_DSP=m
CONFIG_MTK_AUDIODSP_SUPPORT=m
CONFIG_SND_SOC_MTK_OFFLOAD=m
CONFIG_MTK_ADSP_V1=m
CONFIG_MTK_ADSP_V2=m
CONFIG_MTK_TINYSYS_MCUPM_SUPPORT=m
CONFIG_DEVAPC_MT6835=m
CONFIG_DEVAPC_MT6879=m
CONFIG_DEVAPC_MT6886=m
CONFIG_DEVAPC_MT6893=m
CONFIG_DEVAPC_MT6895=m
CONFIG_DEVAPC_MT6983=m
CONFIG_DEVAPC_MT6985=m
CONFIG_HW_RANDOM_SECURE=m
# CONFIG_HW_RANDOM_MTK is not set
# CONFIG_MST_IRQ is not set
CONFIG_MTK_DVFSRC_DEVFREQ=m
CONFIG_MEDIATEK_MT6338_AUXADC=m
CONFIG_MEDIATEK_MT635X_AUXADC=m
CONFIG_MEDIATEK_MT6360_AUXADC=m
CONFIG_MEDIATEK_MT6577_AUXADC=m
CONFIG_MEDIATEK_SPMI_PMIC_ADC=m
CONFIG_MEDIATEK_SPMI_PMIC_TIA_ADC=m
CONFIG_PWM_MTK_DISP=m
CONFIG_RESET_TI_SYSCON=m
CONFIG_PHY_MTK_TPHY=m
CONFIG_PHY_MTK_XSPHY=m
CONFIG_PHY_MTK_FPGAPHY=m
CONFIG_PCIE_MEDIATEK_GEN3=m
CONFIG_MTK_DEVINFO=m
CONFIG_TEE=m
CONFIG_TEE_PERF_SUPPORT=m
CONFIG_TRUSTONIC_TEE_SUPPORT=n
CONFIG_TRUSTONIC_TRUSTED_UI=n
CONFIG_MICROTRUST_TEE_SUPPORT=n
CONFIG_TEEGRIS_TEE_SUPPORT=m
CONFIG_MTK_TEE_GP_SUPPORT=y

#TEEgris
CONFIG_TZDEV_USE_ARM_CALLING_CONVENTION=y
CONFIG_TZDEV=m
CONFIG_TZDEV_IWI_EVENT=580
CONFIG_TZDEV_IWI_PANIC=581
CONFIG_TZDEV_KTHREADS_SMPBOOT=y
CONFIG_TZDEV_SK_MULTICORE=y
CONFIG_TZIRS=y
CONFIG_TZLOG=y
CONFIG_TZLOG_PG_CNT=8
CONFIG_TZ_BOOT_LOG=y
CONFIG_TZ_BOOT_LOG_PG_CNT=2
CONFIG_TZ_TRANSPORT=y
CONFIG_TZ_TRANSPORT_PG_CNT=2
CONFIG_TZDEV_SWD_PANIC_IS_CRITICAL=y
CONFIG_TEEGRIS_VERSION=5
CONFIG_SAMSUNG_GKI_KERNEL=y
CONFIG_TZDEV_CPUFREQ_TRANSITION=n

CONFIG_MT6685_AUDCLK=m
CONFIG_MT6338_EFUSE=m
CONFIG_MT635X_EFUSE=m
CONFIG_INTERCONNECT_MTK=y
CONFIG_INTERCONNECT_MTK_EMI=m
CONFIG_MTK_MDDP_SUPPORT=m
CONFIG_MTK_ADVANCED_80211_MLO=y
CONFIG_CFG80211=m
CONFIG_NL80211_TESTMODE=y
CONFIG_MAC80211=m
CONFIG_MTK_PRINTK_UART_CONSOLE=y
CONFIG_MTK_PRINTK=m
CONFIG_MTK_LOW_POWER_MODULE=m
CONFIG_MTK_LPM_MT6835=m
CONFIG_MTK_LPM_MT6983=m
CONFIG_MTK_LPM_MT6985=m
CONFIG_MTK_LPM_MT6886=m
CONFIG_MTK_LPM_GS_DUMP_SUPPORT=n
CONFIG_MTK_PMSR=m
CONFIG_MTK_GPU_SWPM_SUPPORT=y
CONFIG_MTK_SWPM_PERF_ARMV8_PMU=m
CONFIG_MTK_SWPM_MODULE=m
CONFIG_MTK_SWPM_MT6985=m
CONFIG_MTK_SWPM_MT6983=m
CONFIG_MTK_SWPM_MT6886=m
CONFIG_MTK_SWPM_MT6835=m
CONFIG_MTK_SLBC=m
CONFIG_MTK_SLBC_MT6893=m
CONFIG_MTK_SLBC_MT6983=m
CONFIG_MTK_SLBC_MT6895=m
CONFIG_MTK_SLBC_MT6985=m
CONFIG_MTK_SLBC_MT6886=m
CONFIG_MTK_SLBC_IPI=m
CONFIG_MTK_SLBC_MMSRAM=m
CONFIG_INTERCONNECT_MTK_MMQOS_MT6893=m
CONFIG_MTK_MMDVFS=m
CONFIG_MTK_MMINFRA=m
CONFIG_MTK_CAM_TIMESYNC=m
CONFIG_MTK_CAMERA_ISP_SUPPORT=m
CONFIG_MTK_CAMERA_ISP_PDA_SUPPORT=m
CONFIG_MTK_CCU=m
CONFIG_MTK_CCU_RPROC=m
CONFIG_MTK_V4L2_IMGSENSOR=m
CONFIG_VIDEO_MTK_ISP_AOV=m
CONFIG_VIDEO_MEDIATEK_VCODEC=m
CONFIG_VIDEO_MEDIATEK_VCODEC_V1=y
CONFIG_VIDEO_MEDIATEK_VCODEC_V2=y
CONFIG_VIDEO_MEDIATEK_VCU=m
CONFIG_VIDEO_MEDIATEK_JPEG=m
CONFIG_VB2_MEDIATEK_DMA_CONTIG=m
CONFIG_MTK_LPM_MT6893=m
CONFIG_MTK_MMSYS=m
CONFIG_MTK_MET=m
CONFIG_MTK_ET=m
CONFIG_ZSMALLOC=m
CONFIG_ZRAM=m
CONFIG_MTK_USB_TYPEC_MUX=m
CONFIG_TYPEC_MUX_FUSB304=m
CONFIG_TYPEC_MUX_PTN36241G=m
CONFIG_TYPEC_MUX_PS5169=m
CONFIG_TYPEC_MUX_PS5170=m
CONFIG_TYPEC_MUX_DP_SELECTOR=m
CONFIG_TYPEC_MUX_ALPHA_FSA4480=m
CONFIG_MMSTAT_TRACER=m
CONFIG_MTK_CM_MGR=m
CONFIG_MTK_CM_IPI=m
CONFIG_MTK_CM_MGR_MT6835=m
CONFIG_MTK_CM_MGR_MT6879=m
CONFIG_MTK_CM_MGR_MT6886=m
CONFIG_MTK_CM_MGR_MT6893=m
CONFIG_MTK_CM_MGR_MT6895=m
CONFIG_MTK_CM_MGR_MT6983=m
CONFIG_MTK_CM_MGR_MT6985=m
CONFIG_MTK_QOS_FRAMEWORK=m
CONFIG_MTK_QOS_MT6893=y
CONFIG_MMC_MTK=m
CONFIG_MMC_MTK_PRO=m
CONFIG_SEC_MMC_FEATURE=m
CONFIG_MMC_CQHCI=m
CONFIG_MMC_AUTOK=m
CONFIG_MMC_DEBUG=m
CONFIG_MTK_FPSGO_V3=m
CONFIG_MTK_PERFORMANCE_MODULE=m
CONFIG_MTK_FRS=m
CONFIG_MTK_PERF_IOCTL_MAGT=m
CONFIG_MTK_BLOCK_IO_TRACER=m
CONFIG_MTK_PWM=m
CONFIG_MTK_IRTX_PWM_SUPPORT=m
CONFIG_MTK_PID_MAP=m
CONFIG_MTK_ATF_LOGGER=m
CONFIG_MTK_NEWIDLE_BALANCE=y
CONFIG_MTK_SOCINFO=m
CONFIG_ARM_DSU_PMU=m
CONFIG_MTK_CAM_CAL=m
CONFIG_MTK_DBGTOP=m
CONFIG_MFD_MT6375=m
CONFIG_CHARGER_MT6985_ALPHA_SUPPORT=m
CONFIG_CHARGER_MT6375=m
CONFIG_GAUGE_MT6375=m
CONFIG_GAUGE_BQ28Z610=m
CONFIG_MEDIATEK_MT6375_ADC=m
CONFIG_MEDIATEK_MT6375_AUXADC=m
CONFIG_TCPC_RT1711H=m
CONFIG_TCPC_MT6375=m
CONFIG_MTK_SUBPMIC_MISC=m
CONFIG_SUBPMIC_DBG=m
CONFIG_MTK_JPEG=m
CONFIG_MTK_SDA=y
CONFIG_MTK_IRQ_DBG=m
CONFIG_MEDIATEK_CPUFREQ_DEBUG_LITE=m
CONFIG_MTK_CQDMA=m
CONFIG_NL80211_TESTMODE=y
CONFIG_MTK_CAMERA_MEM_SUPPORT=m
CONFIG_MTK_CAMERA_ISP_RAW_SUPPORT=m
CONFIG_MTK_CAMERA_ISP_SUPPORT=m
CONFIG_VIDEO_MTK_ISP_HCP=m
CONFIG_VIDEO_MTK_ISP_CAMSYS=m
CONFIG_VIDEO_MTK_ISP_IMGSYS=m
CONFIG_VIDEO_MTK_ISP_IPESYS=m
CONFIG_VIDEO_MTK_ISP_IMGSYS_7S=m
CONFIG_VIDEO_MTK_ISP_IMGSYS_CMDQ=m
CONFIG_V4L2_FWNODE=m
CONFIG_V4L2_ASYNC=m
CONFIG_RPMSG_MTK_CCD=m
CONFIG_MTK_CCD_REMOTEPROC=m
CONFIG_MTK_SSC_MODULE=m
CONFIG_MTK_SSC_DBG_V1=m
CONFIG_MTK_SSC_DBG_V2=m
CONFIG_MTK_WIDEVINE_DRM=m
CONFIG_MTK_LOAD_TRACKER=m
CONFIG_MTK_ULTRASND_PROXIMITY=m
CONFIG_MTK_VDEC_FMT=m
CONFIG_INTERCONNECT_MTK_MMQOS_MT6983=m
CONFIG_INTERCONNECT_MTK_MMQOS_MT6879=m
CONFIG_INTERCONNECT_MTK_MMQOS_MT6886=m
CONFIG_INTERCONNECT_MTK_MMQOS_MT6895=m
CONFIG_INTERCONNECT_MTK_MMQOS_MT6985=m
CONFIG_INTERCONNECT_MTK_MMQOS_MT6835=m
CONFIG_MTK_BUS_PARITY_CHECK=m
CONFIG_MTK_CACHE_PARITY_CHECK=m
CONFIG_GAUGE_MT6983_ALPHA_SUPPORT=m
CONFIG_NFC_CHIP_SUPPORT=y
CONFIG_NFC_ST21NFC=m
CONFIG_NFC_ST54_SPI=m
CONFIG_MTK_CAMERA_DPE_ISP7S=m
CONFIG_MTK_CAMERA_DPE_ISP7=m
CONFIG_MTK_CAMERA_FD_ISP7S=m
CONFIG_MTK_CAMERA_FD_ISP6S=m
CONFIG_MTK_CAMERA_DIP_ISP6S=m
CONFIG_MTK_CAMERA_DUAL_DIP_ISP6S=m
CONFIG_MTK_CAMERA_ISP_SUPPORT=m
CONFIG_MTK_AEE_FEATURE=m
CONFIG_MTK_AEE_AED=m
CONFIG_MTK_AEE_HANGDET=m
CONFIG_MTK_AEE_IPANIC=m
CONFIG_MTK_HANG_DETECT=m
CONFIG_MTK_HANG_DETECT_DB=y
CONFIG_EXT_MODULES="../vendor/mediatek/kernel_modules/connectivity/common ../vendor/mediatek/kernel_modules/connectivity/conninfra ../vendor/mediatek/kernel_modules/connectivity/connfem ../vendor/mediatek/kernel_modules/connectivity/gps/gps_stp ../vendor/mediatek/kernel_modules/connectivity/gps/data_link/plat/v010 ../vendor/mediatek/kernel_modules/connectivity/gps/data_link/plat/v030 ../vendor/mediatek/kernel_modules/connectivity/gps/data_link/plat/v050 ../vendor/mediatek/kernel_modules/connectivity/gps/data_link/plat/v051 ../vendor/mediatek/kernel_modules/connectivity/gps/data_link/plat/v060 ../vendor/mediatek/kernel_modules/connectivity/gps/data_link/plat/v061 ../vendor/mediatek/kernel_modules/connectivity/gps/gps_pwr ../vendor/mediatek/kernel_modules/connectivity/gps/gps_scp ../vendor/mediatek/kernel_modules/gpu ../vendor/mediatek/kernel_modules/connectivity/fmradio ../vendor/mediatek/kernel_modules/connectivity/wlan/adaptor ../vendor/mediatek/kernel_modules/connectivity/wlan/adaptor/wlan_page_pool ../vendor/mediatek/kernel_modules/connectivity/bt/linux_v2 ../vendor/mediatek/kernel_modules/hbt_driver_cus"
CONFIG_MTK_BTM_V1=m
CONFIG_MTK_BTM_SUPPORT=m
CONFIG_TYPEC_MUX_FLIP_ALPHA_FSA4480=m
CONFIG_MTK_SECURITY_SW_SUPPORT=m
CONFIG_MTK_TC10_FEATURE=y
CONFIG_HWMON=m
# Power Configs
CONFIG_SEC_PM=y
CONFIG_CPU_FREQ_LIMIT=m
CONFIG_SEC_PM_DEBUG=m

# I/O
CONFIG_MQ_IOSCHED_SSG=m
CONFIG_MQ_IOSCHED_SSG_CGROUP=m
CONFIG_MQ_IOSCHED_SSG_WB=m
CONFIG_BLK_SEC_STATS=m
CONFIG_BLK_SEC_WB=m

#VOLD ASEC
CONFIG_CRYPTO_TWOFISH=y

# SEC_PRODUCT_FEATURE_KNOX_SUPPORT_NPA {
CONFIG_KNOX_NCM=y
# SEC_PRODUCT_FEATURE_KNOX_SUPPORT_NPA }

# Network Feature
CONFIG_TCP_CONG_ADVANCED=y
# CONFIG_TCP_CONG_WESTWOOD is not set
# CONFIG_TCP_CONG_HTCP is not set
CONFIG_TCP_CONG_BIC=y
CONFIG_DEFAULT_BIC=y
CONFIG_DEFAULT_TCP_CONG="bic"
####[LEGO-START] DO NOT SUBMIT

CONFIG_SEC_PANEL_NOTIFIER_V2=m
CONFIG_USB_TYPEC_MANAGER_NOTIFIER=m
CONFIG_IF_CB_MANAGER=m
CONFIG_VIBRATOR_VIB_INFO=m
CONFIG_SEC_VIBRATOR=m
CONFIG_DEV_RIL_BRIDGE=m
CONFIG_SECURITY_DEFEX=y
CONFIG_MUIC_NOTIFIER=m
CONFIG_VBUS_NOTIFIER=m
CONFIG_HICCUP_CC_DISABLE=y
CONFIG_HICCUP_CHARGER=y
CONFIG_MUIC_COMMON_SYSFS=y
CONFIG_MUIC_HV=y
CONFIG_MUIC_SUPPORT_PDIC=y
CONFIG_USE_MUIC=y
CONFIG_SEC_NFC_LOGGER=y
CONFIG_SECURITY_DSMS=y
CONFIG_INPUT_SEC_INPUT=m
CONFIG_INPUT_SEC_NOTIFIER=m
CONFIG_SEC_DEBUG_TSP_LOG=m
CONFIG_TOUCHSCREEN_DUMP_MODE=m
# CONFIG_INPUT_SEC_SECURE_TOUCH is not set
# CONFIG_INPUT_SEC_TRUSTED_TOUCH is not set
CONFIG_INPUT_TOUCHSCREEN_TCLMV2=m
# CONFIG_SEC_INPUT_MULTI_DEVICE is not set
# CONFIG_SEC_INPUT_RAWDATA is not set
CONFIG_SEC_MTK_CHARGER=m
CONFIG_USDM_PANEL_OLED_COMMON=m
CONFIG_USDM_PANEL_S6E8FC3=m
CONFIG_SEC_STI=y
CONFIG_SEC_INPUT_BOOSTER=m
CONFIG_SEC_INPUT_BOOSTER_MTK=y
CONFIG_SEC_INPUT_BOOSTER_HANDLER=y
CONFIG_SB_CORE=m
CONFIG_SB_PQUEUE=y
CONFIG_SB_NOTIFY=y
CONFIG_SB_SYSFS=y
CONFIG_SB_VOTE=y
CONFIG_SENSORS_FINGERPRINT=m
CONFIG_FUELGAUGE_MTK=m
CONFIG_SEC_ABC_SPEC_TYPE1=m
CONFIG_PDIC_NOTIFIER=m
CONFIG_PDIC_USE_MODULE_PARAM=y
# CONFIG_DRM_PANEL_SAMSUNG_COMMON is not set
CONFIG_USDM_PANEL_JSON=y
CONFIG_VIRTUAL_MUIC=m
CONFIG_SEC_ABC=m
CONFIG_SEC_ABC_HUB=m
CONFIG_SEC_ABC_COMMON=m
CONFIG_SEC_ABC_HUB_CORE=m
CONFIG_SEC_ABC_HUB_BOOTC=m
CONFIG_SEC_ABC_MOTTO=m
CONFIG_REGULATOR_S2MPB03=m
CONFIG_I2C_GPIO=m
CONFIG_SEC_PM_THERMISTOR=m
CONFIG_SHUB_MODULE=y
CONFIG_SHUB_AP_STATUS_CMD=y
CONFIG_SHUB_MTK=y
CONFIG_CHARGER_SM5461=m
CONFIG_MST_LDO=m
CONFIG_MST_ARCH_MTK=y
CONFIG_MST_NONSECURE=y
CONFIG_MST_DUMMY_DRV=y
CONFIG_SENSORS_SX9385=m
# CONFIG_SENSORS_SX9385_SUB is not set
# CONFIG_SENSORS_SX9385_SUB2 is not set
CONFIG_SENSORS_GRIP_FAILURE_DEBUG=y
CONFIG_MULTI_CHANNEL=y
CONFIG_REGULATOR_FIXED_VOLTAGE=y
CONFIG_TOUCHSCREEN_ZINITIX_ZT7650M=m
CONFIG_DIRECT_CHARGING=m
CONFIG_IIO=y
CONFIG_IIO_BUFFER=y
CONFIG_SHUB=m
CONFIG_STAR_K250A_LEGO=m
CONFIG_SEC_SNVM_WAKELOCK_METHOD=2
# CONFIG_STAR_MEMORY_LEAK is not set
CONFIG_DC_VIBRATOR=m
# CONFIG_MTK_VIBRATOR is not set
CONFIG_SENSORS_EC6XX=m
CONFIG_SENSORS_FINGERPRINT_MODULE=y
CONFIG_FINGERPRINT_SECURE=y
CONFIG_SENSORS_FINGERPRINT_MTK=y
CONFIG_TOUCHSCREEN_FTS_FT3418=m
CONFIG_SAMSUNG_NFC=m
CONFIG_NFC_PN547=y
# CONFIG_NFC_PN547_ESE_SUPPORT is not set
CONFIG_NFC_FEATURE_SN100U=y
# CONFIG_ESE_SECURE is not set
CONFIG_MTK_NFC_CLKBUF_ENABLE=y
CONFIG_MTK_CLKBUF_NFC=y
CONFIG_SEC_NFC_WAKELOCK_METHOD=0
CONFIG_NFC_PVDD_LATE_ENABLE=y
# CONFIG_SEC_NFC_COMPAT_IOCTL is not set
# CONFIG_MAKE_NODE_USING_PLATFORM_DEVICE is not set
CONFIG_BATTERY_SAMSUNG=m
CONFIG_SEC_PD=m
CONFIG_BATTERY_GKI=y
CONFIG_BATTERY_AGE_FORECAST=y
CONFIG_BATTERY_CISD=y
CONFIG_AFC_CHARGER_MODE=y
CONFIG_BATTERY_LOGGING=y
CONFIG_ENABLE_FULL_BY_SOC=y
CONFIG_STEP_CHARGING=y
CONFIG_SUPPORT_HV_CTRL=y
CONFIG_USB_FACTORY_MODE=y
####[LEGO-END] DO NOT SUBMIT
CONFIG_IMGSENSOR_CUSTOM_CAMERA=y
CONFIG_CAMERA_AAX_V15X=y
CONFIG_CAMERA_SAMSUNG_MODEL_NAME="aax_v15x"
CONFIG_CUSTOM_KERNEL_IMGSENSOR="hi5022q_mipi_raw s5kjn1_mipi_raw gc13a0_mipi_raw sc501cs_mipi_raw gc02m2_mipi_raw"
CONFIG_CAMERA_SENSOR0="s5kjn1_mipi_raw"
CONFIG_CAMERA_SENSOR1="gc13a0_mipi_raw"
CONFIG_CAMERA_SENSOR2="sc501cs_mipi_raw"
CONFIG_CAMERA_SENSOR3="gc02m2_mipi_raw"
CONFIG_IMGSENSOR_SYSFS=y
CONFIG_LEDS_AW36518=m
CONFIG_MTK_FLASHLIGHT_AW36518=m
#CONFIG_LEDS_SM5714=m
#CONFIG_MTK_SM5714_FLASHLIGHT=m
CONFIG_CAMERA_ADAPTIVE_MIPI=y
#CONFIG_CAMERA_OIS=y
# CONFIG_SND_SOC_TFA9874 is not set
# CONFIG_SND_SOC_RT5512 is not set
CONFIG_SND_SOC_SMA1305=m
CONFIG_SND_SOC_SAMSUNG_AUDIO=m
CONFIG_MTK_AFC_SUPPORT=y
CONFIG_DRM_PANEL_MCD_COMMON=m
CONFIG_USDM_PANEL=m
CONFIG_USDM_PANEL_DISPLAY_MODE=y
CONFIG_USDM_PANEL_DPUI=y
CONFIG_USDM_MDNIE=y
CONFIG_USDM_FACTORY_GCT_TEST=y
CONFIG_USDM_FACTORY_CCD_TEST=y
# CONFIG_USDM_PANEL_FREQ_HOP is not set
CONFIG_USDM_PANEL_SELF_DISPLAY=y
CONFIG_USDM_PANEL_DIMMING=y
CONFIG_USDM_FACTORY_DSC_CRC_TEST=y
CONFIG_USDM_PANEL_BIG_LOCK=y
CONFIG_USDM_PANEL_TESTMODE=y
# CONFIG_DRM_PANEL_TRULY_TD4330_VDO is not set
# CONFIG_DRM_PANEL_TRULY_TD4330_CMD is not set
# CONFIG_DRM_PANEL_TRULY_FT8756_VDO is not set
# CONFIG_DRM_PANEL_NT37801_CMD_LTPO is not set
# CONFIG_DRM_PANEL_ALPHA_JDI_NT36672C_CPHY_VDO is not set
# CONFIG_DRM_PANEL_NT37801_CMD_120HZ is not set
# CONFIG_DRM_PANEL_NT37801_CMD_SPR is not set
# CONFIG_DRM_PANEL_SC_NT36672C_VDO_120HZ is not set
# CONFIG_DRM_PANEL_TIANMA_R66451_CMD_120HZ is not set
# CONFIG_DRM_PANEL_TIANMA_R66451_CMD_120HZ_WA is not set
# CONFIG_DRM_PANEL_TIANMA_NT36672E_VDO_120HZ_HFP is not set
# CONFIG_DRM_PANEL_ALPHA_JDI_NT36672E_CPHY_VDO is not set
# CONFIG_DRM_PANEL_ALPHA_JDI_NT36672E_CPHY_VDO_NO_DSC is not set
# CONFIG_DRM_PANEL_ALPHA_JDI_NT36672E_CPHY_VDO_WO_DSC_60HZ is not set
# CONFIG_DRM_PANEL_ALPHA_JDI_NT36672E_CPHY_VDO_WO_DSC_HFP is not set
# CONFIG_DRM_PANEL_ALPHA_JDI_NT36672E_VDO_120HZ is not set
# CONFIG_DRM_PANEL_ALPHA_JDI_NT36672E_VDO_144HZ is not set
# CONFIG_DRM_PANEL_ALPHA_JDI_NT36672E_VDO_60HZ is not set
# CONFIG_DRM_PANEL_SAMSUNG_S68FC01_VDO_AOD is not set
# CONFIG_DRM_PANEL_ALPHA_JDI_NT36672E_VDO_120HZ_HFP is not set
# CONFIG_DRM_PANEL_ALPHA_JDI_NT36672E_VDO_120HZ_6382 is not set
# CONFIG_DRM_PANEL_ALPHA_JDI_NT36672E_VDO_144HZ_HFP is not set
# CONFIG_DRM_PANEL_HX_NT37701_DPHY_CMD is not set
# CONFIG_DRM_PANEL_HX_NT37701_DPHY_CMD_120HZ is not set
# CONFIG_DRM_PANEL_TRULY_NT35595_CMD is not set
# CONFIG_DRM_PANEL_SAMSUNG_ANA6705_CMD is not set
# CONFIG_DRM_PANEL_SAMSUNG_ANA6705_CMD_FHDP is not set
# CONFIG_DRM_PANEL_SAMSUNG_OP_CMD is not set
# CONFIG_DRM_PANEL_SAMSUNG_OP_CMD_MSYNC2 is not set
# CONFIG_DRM_PANEL_K6895V1_64_95T_ALPHA_CMD is not set
# CONFIG_DRM_TD2204_WQHD_AMB678ZY01_S6E3HC3_CMD is not set
# CONFIG_DRM_PANEL_NT37705_ALPHA_CMD is not set
# CONFIG_DRM_PANEL_NT37705_ALPHA_CMD_SPR is not set
# CONFIG_DRM_PANEL_L12A_42_02_0A_DSC_CMD is not set
# CONFIG_DRM_PANEL_NT37801_CMD_FHD is not set
# CONFIG_DRM_PANEL_BOE_NT37705_DPHY_CMD_FHD is not set
# CONFIG_DRM_PANEL_BOE_BF130_DPHY_CMD_HD is not set
# CONFIG_DRM_PANEL_SAMSUNG_AMF680CM01_CMD_FHD is not set
# CONFIG_DRM_PANEL_S6E8FC3_VDO_NO_DSC is not set
# CONFIG_DRM_PANEL_S6E8FC3_VDO_NO_DSC_2400 is not set
# CONFIG_DRM_PANEL_NT36672C_KTZ8864_VDO is not set
# CONFIG_DRM_PANEL_NT36672C_KTZ8864_TIANMA_VDO is not set
CONFIG_SAMSUNG_TUI=m
CONFIG_UH=y
CONFIG_RKP=y
CONFIG_RKP_TEST=y
CONFIG_KDP=y
CONFIG_KDP_CRED=y
CONFIG_KDP_NS=y
CONFIG_KDP_TEST=y
CONFIG_SAMSUNG_PRODUCT_SHIP=y


CONFIG_FIVE=y


CONFIG_PROCA=y


CONFIG_PROCA_S_OS=y


CONFIG_FIVE_GKI_10=y


# CONFIG_FIVE_TEE_DRIVER is not set


# CONFIG_FIVE_PA_FEATURE is not set


CONFIG_GAF=y


CONFIG_GAF_V6=y






CONFIG_F2FS_FS=y


CONFIG_F2FS_FS_SECURITY=y


CONFIG_F2FS_FS_ENCRYPTION=y


CONFIG_F2FS_FS_COMPRESSION=y


CONFIG_EXT4_FS_POSIX_ACL=y


CONFIG_NTFS_FS=y


CONFIG_NTFS_DEBUG=y


CONFIG_NLS=y


CONFIG_EROFS_FS=y
```
