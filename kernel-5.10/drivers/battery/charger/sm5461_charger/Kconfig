## kernel-5.10/drivers/battery/charger/sm5461_charger/Kconfig
```kconfig
config CHARGER_SM5461
	tristate "SM5461 charger driver"
	default n
	depends on DIRECT_CHARGING
	help
	  Say Y or M here,
	  to enable support for the SM5461 charger.
	  This is 2:1 switched capacitor direct charger.
	  To compile the driver as a module, choose M here.
```

## kernel-5.10/drivers/input/sar/Kconfig
```kconfig
config INPUT_SAR
    tristate "Support for sar"
    help
      Say Y here if you have sar driver.

config SAR_SX933X
    tristate "Support for sx933x sar"
    help
      Say Y here if you have sar driver.
```

## kernel-5.10/drivers/input/touchscreen/ZT7650M/Kconfig
```kconfig
#
# Zinitix touchscreen driver configuration
#
menuconfig TOUCHSCREEN_ZINITIX_ZT7650M
	tristate "Zinitix 7650M touchscreen"
	help
	  Say Y here if you have a Zinitix 7650M touch controller
	  to your system.
```

## kernel-5.10/drivers/input/touchscreen/ot11/touch_common/Kconfig
```kconfig
config ODM_SEC_COMMON
    tristate "add touch common sec"
    help
        this will add touch common sec.

        If unsure, say N.
```

## kernel-5.10/drivers/input/touchscreen/zinitix/zt7650m/Kconfig
```kconfig
#
# Zinitix Touchscreen driver configuration
#

config TOUCHSCREEN_ZINITIX_ZT7650M
	tristate "Zinitix ZT7650M touchscreen"
	depends on I2C
  help
   Say Y here if you want support for ZINITIX_ZT7650M touchscreen controllers.
   To compile this driver as a module, choose M here: the
   module will be called zinitix_ts.
```

## kernel-5.10/drivers/misc/combine_key/Kconfig
```kconfig
config TRIGGER_CRASH_BY_KEY
  	tristate "Enable trigger crash by keys"
	  help
	    You can trigger crash by pressing keys in strict order:
	    VOLUMEUP twice + VOLUMEDOWN twice + POWER twice.
```

## kernel-5.10/drivers/misc/grdm/Kconfig
```kconfig
config GRDM_POWER
    tristate "regulatore control of grdm"
    help
      Say m here if you have a grdm.
      If unsure, say N.
```

## kernel-5.10/drivers/misc/huaqin/Kconfig
```kconfig
#
# for huaqin misc info
#

# Tab A9 code for SR-AX6739A-01-348 by Niebingling at 20230506 start
config HQ_SIM_TRAY_CHECK
	tristate "check sim stry status"
        default y
	help
	  this will create a node to show sim tray status.

	  If unsure, say N.
# Tab A9 code for SR-AX6739A-01-348 by Niebingling at 20230506 end
```

## kernel-5.10/drivers/misc/mediatek/board_id/Kconfig
```kconfig
# Tab A9 code for AX6739A-30 by qiaodan at 20230502 start
config ODM_BOARD_ID_STATUS_SUPPORT
    tristate "check board id  status"
    help
        this will add a global var to show board id status.

        If unsure, say N.
# Tab A9 code for AX6739A-30 by qiaodan at 20230502 end
```

## kernel-5.10/drivers/misc/mediatek/imgsensor/src/Kconfig
```kconfig
config SPECIFY_IMGSENSOR
	bool "Specify image sensor name"
	depends on MTK_IMGSENSOR
	help
	  Specify name of each sensor to prevent obtaining wrong sensor driver
	  with same sensor ID. For example, imx258_mipi_raw and
	  imx258_mipi_mono are of same sensor ID. If not specifying sensor,
	  imx258_mipi_mono may be recognized as imx258_mipi_raw.

config IMGSENSOR_MAIN
	string "Custom main image sensor"
	depends on SPECIFY_IMGSENSOR
	help
	  Specify name of main sensor to prevent obtaining wrong sensor driver
	  with same sensor ID. For example, imx258_mipi_raw and
	  imx258_mipi_mono are of same sensor ID. If not specifying sensor,
	  imx258_mipi_mono may be recognized as imx258_mipi_raw.

config IMGSENSOR_MAIN2
	string "Custom main2 image sensor"
	depends on SPECIFY_IMGSENSOR
	help
	  Specify name of main2 sensor to prevent obtaining wrong sensor driver
	  with same sensor ID. For example, imx258_mipi_raw and
	  imx258_mipi_mono are of same sensor ID. If not specifying sensor,
	  imx258_mipi_mono may be recognized as imx258_mipi_raw.

config IMGSENSOR_SUB
	string "Custom sub image sensor"
	depends on SPECIFY_IMGSENSOR
	help
	  Specify name of sub sensor to prevent obtaining wrong sensor driver
	  with same sensor ID. For example, imx258_mipi_raw and
	  imx258_mipi_mono are of same sensor ID. If not specifying sensor,
	  imx258_mipi_mono may be recognized as imx258_mipi_raw.

config IMGSENSOR_SUB2
	string "Custom sub2 image sensor"
	depends on SPECIFY_IMGSENSOR
	help
	  Specify name of sub2 sensor to prevent obtaining wrong sensor driver
	  with same sensor ID. For example, imx258_mipi_raw and
	  imx258_mipi_mono are of same sensor ID. If not specifying sensor,
	  imx258_mipi_mono may be recognized as imx258_mipi_raw.

config IMGSENSOR_MAIN3
	string "Custom main3 image sensor"
	depends on SPECIFY_IMGSENSOR
	help
	  Specify name of main3 sensor to prevent obtaining wrong sensor driver
	  with same sensor ID. For example, imx258_mipi_raw and
	  imx258_mipi_mono are of same sensor ID. If not specifying sensor,
	  imx258_mipi_mono may be recognized as imx258_mipi_raw.

config IMGSENSOR_CUSTOM_CAMERA
	bool "Use custom camera set"
	help
	  Use custom camera set

if IMGSENSOR_CUSTOM_CAMERA
choice IMGSENSOR_CAMERA_SET_CHOICE
	prompt "Choose the proper camera set"
config CAMERA_AAV_V23
	bool "Camera aav_v23"
	help
	  For AAV V23 camera set
config CAMERA_AAW_V24
	bool "Camera aaw_v24"
	help
	  For AAW V24 camera set
config CAMERA_AAX_V15
	bool "Camera aax_v15"
	help
	  For AAX V15 camera set
endchoice

config CAMERA_SAMSUNG_MODEL_NAME
	string "Camera samsung model name"
	help
	  Current model name. Set string by IMGSENSOR_CAMERA_SET_CHOICE.

config CAMERA_SENSOR0
	string "Camera Sensor 0"
	help
	  Camera image sensor 0
config CAMERA_SENSOR1
	string "Camera Sensor 1"
	help
	  Camera image sensor 1
config CAMERA_SENSOR2
	string "Camera Sensor 2"
	help
	  Camera image sensor 2
config CAMERA_SENSOR3
	string "Camera Sensor 3"
	help
	  Camera image sensor 3
config CAMERA_SENSOR4
	string "Camera Sensor 4"
	help
	  Camera image sensor 4
config CAMERA_SENSOR5
	string "Camera Sensor 5"
	help
	  Camera image sensor 5
config CAMERA_SENSOR0_2
	string "Camera Sensor 0_2"
	help
	  Camera image sensor 0_2
config CAMERA_SENSOR1_2
	string "Camera Sensor 1_2"
	help
	  Camera image sensor 1_2
config CAMERA_SENSOR2_2
	string "Camera Sensor 2_2"
	help
	  Camera image sensor 2_2
config CAMERA_SENSOR3_2
	string "Camera Sensor 3_2"
	help
	  Camera image sensor 3_2
config CAMERA_SENSOR4_2
	string "Camera Sensor 4_2"
	help
	  Camera image sensor 4_2
config CAMERA_SENSOR5_2
	string "Camera Sensor 5_2"
	help
	  Camera image sensor 5_2
config CAMERA_SENSOR0_3
	string "Camera Sensor 0_3"
	help
	  Camera image sensor 0_3
config CAMERA_SENSOR1_3
	string "Camera Sensor 1_3"
	help
	  Camera image sensor 1_3
config CAMERA_SENSOR2_3
	string "Camera Sensor 2_3"
	help
	  Camera image sensor 2_3
config CAMERA_SENSOR3_3
	string "Camera Sensor 3_3"
	help
	  Camera image sensor 3_3
config CAMERA_SENSOR4_3
	string "Camera Sensor 4_3"
	help
	  Camera image sensor 4_3
config CAMERA_SENSOR5_3
	string "Camera Sensor 5_3"
	help
	  Camera image sensor 5_3
endif

source "drivers/misc/mediatek/imgsensor/src/common/sysfs/Kconfig"
source "drivers/misc/mediatek/imgsensor/src/common/adaptive_mipi/Kconfig"
```

## kernel-5.10/drivers/misc/mediatek/imgsensor/src/common/adaptive_mipi/Kconfig
```kconfig
config CAMERA_ADAPTIVE_MIPI
	bool "Camera adaptive mipi"
	depends on MTK_IMGSENSOR
	help
	  for using Adaptive MIPI.
	  use CONFIG_CAMERA_ADAPTIVE_MIPI
```

## kernel-5.10/drivers/misc/mediatek/imgsensor/src/common/sysfs/Kconfig
```kconfig
config IMGSENSOR_SYSFS
	bool "Imgsensor sysfs"
	default n
	help
	  If CONFIG_IMGSENSOR_SYSFS is y, then "imgsensor/src/common/sysfs/" is built.
	  This is for camera bringup without sysfs implementation.
	  Set this config to n, while bringup the camera.
```

## kernel-5.10/drivers/misc/mediatek/tui/Kconfig
```kconfig
config TEEGRIS_TUI
	tristate "Trustzone Teegris UI"
	default n
	help
		Provide methods for TUI such as acquisition of buffer
		to be used as secure frame buffer in Secure World and
		synchronization of display and touch device between
		Normal World and Secure World.

config TEEGRIS_TUI_LOWLEVEL
	bool "TUI HW Low Level mode"
	default n
	depends on TEEGRIS_TUI
	help
		Enables tui low level API.

config TEEGRIS_TUI_TEST
	bool "Testing module for TUI HW handler"
	default n
	depends on TEEGRIS_TUI
	help
		support TUI Driver Test
```

## kernel-5.10/drivers/misc/mediatek/typec/tcpc/tcpc_aw35615/Kconfig
```kconfig
#
# awinic driver configuration
#

config TCPC_AW35615
    tristate "Awinic Pd"
    depends on I2C
    help
        this option enables support for the AW35615 PD connected
        through I2C. Say Y to enable support for the AW35615 PD
```

## kernel-5.10/drivers/samsung/debug/Kconfig
```kconfig
# drivers/staging/samsung/Kconfig
#
# Copyright (c) 2010-2016 Samsung Electronics Co., Ltd.
#		http://www.samsung.com/
#
# Licensed under GPLv2


config SEC_DEBUG
	tristate "Enable Samsung debugging feature"
	default m
	help
	  Samsung TN debugging feature.

config SEC_DEBUG_AUTO_COMMENT
	tristate "Enable Samsung kernel fault auto comment"
	depends on PRINTK
	depends on SEC_DEBUG
	default y
	help
	  This option enables kernel fault auto comment feature.
	  This option also requires bootloader change that enables auto comment
	  extraction along with ramdump.

config SEC_DEBUG_HISTORY_LOG
	tristate "support storing debug history log"
	depends on SEC_DEBUG
	default y
	help
	  This option enables to store debug history log.

config SEC_DEBUG_EXTRA_INFO
	tristate "Enable Samsung reset reason extra info"
	depends on SEC_DEBUG
	default m
	help
	  This option enables storing reset reason extra info
	  This option enables ap reset info bigdata based on reset reason extra info

config SEC_DEBUG_HW_PARAM
	tristate "Enable Samsung HW PARAM bigdata info"
	depends on SEC_DEBUG && SEC_DEBUG_EXTRA_INFO
	default n
	help
	  This option enables storing hw param bigdata info

config SEC_DEBUG_SOFTDOG_PWDT
	tristate "Enable Soft Watchdog for Platform"
	default m
	depends on WATCHDOG
	select SOFT_WATCHDOG	
	help
	  This option enables soft watchdog device and soft_panic.

config SEC_DEBUG_SOFTDOG
	tristate "Enable enhanced softdog info"
	depends on SEC_DEBUG && SOFT_WATCHDOG
	default n
	help
	  This option enables enhanced softdog info.
	  Select the option to show related task info.

config SEC_DEBUG_BUG_ON_SLUB_CORRUPTION
	bool "Trigger a BUG when slub corruption is detected"
	depends on SEC_DEBUG
	default n
	help
	  Select this option if the kernel should BUG when it encounters
	  slub corruption when they get checked for validity.

config SEC_DEBUG_PRINT_UART_TXRX
	bool "Print UART TX/RX to kernel log"
	depends on SEC_FACTORY	
	default y
	help
	  This option is enabled by Factory build option and
	  print uart tx/rx information to kernel log
```

## kernel-5.10/drivers/sensorhub/vendor/Kconfig
```kconfig
config SHUB_MTK
	tristate "Mediatek project"
	default y

config SHUB_MTK_SCP_INCLUDE
	tristate "Mediatek project scp include folder"
	default y
```

## kernel-5.15/arch/arm64/configs/lego_defconfig
```kconfig
CONFIG_SEC_PANEL_NOTIFIER_V2=m
CONFIG_USB_TYPEC_MANAGER_NOTIFIER=m
CONFIG_IF_CB_MANAGER=m
CONFIG_VIBRATOR_VIB_INFO=m
CONFIG_SEC_VIBRATOR=m
CONFIG_DEV_RIL_BRIDGE=m
# CONFIG_SECURITY_DEFEX is not set
CONFIG_MUIC_NOTIFIER=m
CONFIG_VBUS_NOTIFIER=m
CONFIG_HICCUP_CC_DISABLE=y
CONFIG_HICCUP_CHARGER=y
CONFIG_MUIC_COMMON_SYSFS=y
CONFIG_MUIC_HV=y
CONFIG_MUIC_SUPPORT_PDIC=y
CONFIG_USE_MUIC=y
CONFIG_SEC_NFC_LOGGER=y
# CONFIG_SECURITY_DSMS is not set
CONFIG_INPUT_SEC_INPUT=m
CONFIG_INPUT_SEC_NOTIFIER=m
CONFIG_SEC_DEBUG_TSP_LOG=m
CONFIG_TOUCHSCREEN_DUMP_MODE=m
# CONFIG_INPUT_SEC_SECURE_TOUCH is not set
# CONFIG_INPUT_SEC_TRUSTED_TOUCH is not set
CONFIG_INPUT_TOUCHSCREEN_TCLMV2=m
# CONFIG_SEC_INPUT_MULTI_DEVICE is not set
# CONFIG_SEC_INPUT_RAWDATA is not set
CONFIG_SEC_MTK_CHARGER=m
CONFIG_USDM_PANEL_OLED_COMMON=m
CONFIG_USDM_PANEL_S6E8FC3=m
CONFIG_SEC_STI=y
CONFIG_SEC_INPUT_BOOSTER=m
CONFIG_SEC_INPUT_BOOSTER_MTK=y
CONFIG_SEC_INPUT_BOOSTER_HANDLER=y
CONFIG_SB_CORE=m
CONFIG_SB_PQUEUE=y
CONFIG_SB_NOTIFY=y
CONFIG_SB_SYSFS=y
CONFIG_SB_VOTE=y
CONFIG_SENSORS_FINGERPRINT=m
CONFIG_FUELGAUGE_MTK=m
CONFIG_SEC_ABC_SPEC_TYPE1=m
CONFIG_PDIC_NOTIFIER=m
CONFIG_PDIC_USE_MODULE_PARAM=y
CONFIG_DRM_PANEL_MCD_COMMON=m
# CONFIG_DRM_PANEL_SAMSUNG_COMMON is not set
CONFIG_USDM_PANEL_JSON=y
CONFIG_VIRTUAL_MUIC=m
CONFIG_SEC_ABC=m
CONFIG_SEC_ABC_HUB=m
CONFIG_SEC_ABC_COMMON=m
CONFIG_SEC_ABC_HUB_CORE=m
CONFIG_SEC_ABC_HUB_BOOTC=m
CONFIG_SEC_ABC_MOTTO=m
CONFIG_REGULATOR_S2MPB03=m
CONFIG_I2C_GPIO=m
CONFIG_SEC_PM_THERMISTOR=m
CONFIG_SHUB_MODULE=y
CONFIG_SHUB_AP_STATUS_CMD=y
CONFIG_SHUB_MTK=y
CONFIG_CHARGER_SM5461=m
CONFIG_MST_LDO=m
CONFIG_MST_ARCH_MTK=y
CONFIG_MST_NONSECURE=y
CONFIG_MST_DUMMY_DRV=y
CONFIG_SENSORS_SX9385=m
# CONFIG_SENSORS_SX9385_SUB is not set
# CONFIG_SENSORS_SX9385_SUB2 is not set
CONFIG_SENSORS_GRIP_FAILURE_DEBUG=y
CONFIG_MULTI_CHANNEL=y
CONFIG_REGULATOR_FIXED_VOLTAGE=y
CONFIG_TOUCHSCREEN_ZINITIX_ZT7650M=m
CONFIG_DIRECT_CHARGING=m
CONFIG_IIO=y
CONFIG_IIO_BUFFER=y
CONFIG_SHUB=m
CONFIG_STAR_K250A_LEGO=m
CONFIG_SEC_SNVM_WAKELOCK_METHOD=2
# CONFIG_STAR_MEMORY_LEAK is not set
CONFIG_DC_VIBRATOR=m
# CONFIG_MTK_VIBRATOR is not set
CONFIG_SENSORS_EC6XX=m
CONFIG_SENSORS_FINGERPRINT_MODULE=y
CONFIG_FINGERPRINT_SECURE=y
CONFIG_SENSORS_FINGERPRINT_MTK=y
CONFIG_TOUCHSCREEN_FTS_FT3418=m
CONFIG_SAMSUNG_NFC=m
CONFIG_NFC_PN547=y
# CONFIG_NFC_PN547_ESE_SUPPORT is not set
CONFIG_NFC_FEATURE_SN100U=y
# CONFIG_ESE_SECURE is not set
CONFIG_MTK_NFC_CLKBUF_ENABLE=y
CONFIG_MTK_CLKBUF_NFC=y
CONFIG_SEC_NFC_WAKELOCK_METHOD=0
CONFIG_NFC_PVDD_LATE_ENABLE=y
# CONFIG_SEC_NFC_COMPAT_IOCTL is not set
# CONFIG_MAKE_NODE_USING_PLATFORM_DEVICE is not set
CONFIG_BATTERY_SAMSUNG=m
CONFIG_SEC_PD=m
CONFIG_BATTERY_GKI=y
CONFIG_BATTERY_AGE_FORECAST=y
CONFIG_BATTERY_CISD=y
CONFIG_AFC_CHARGER_MODE=y
CONFIG_BATTERY_LOGGING=y
CONFIG_ENABLE_FULL_BY_SOC=y
CONFIG_STEP_CHARGING=y
CONFIG_SUPPORT_HV_CTRL=y
CONFIG_USB_FACTORY_MODE=y
```
