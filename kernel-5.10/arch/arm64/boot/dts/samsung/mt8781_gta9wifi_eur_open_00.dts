/* 
 * Generated by Samsung 
 * If these files should be changed, then please make a sync with MTK
*/

/dts-v1/;
/plugin/;

#include "../mediatek/ot11_wifi.dts"
#include "mt8781-gta9_common.dtsi"

/* Add Samsung configuration over here */
/ {
	compatible = "Samsung,GTA9 WiFi EUR OPEN 00", "Mediatek,MT8781";
	dtbo-hw_rev = <0x0>;
	dtbo-hw_rev_end = <0x20>;	
};

/*End of this file, DO NOT ADD ANYTHING HERE*/

