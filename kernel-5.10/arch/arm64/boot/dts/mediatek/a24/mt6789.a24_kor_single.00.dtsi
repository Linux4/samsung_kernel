/* 
 * Generated by Samsung 
 * If these files should be changed, then please make a sync with MTK
*/

#include "mt6789-a24_common.dtsi"
#include "mt6789-a24_camera_04.dtsi"

/*End of this file, DO NOT ADD ANYTHING HERE*/
