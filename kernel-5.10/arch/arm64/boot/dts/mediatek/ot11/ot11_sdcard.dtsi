/*Tab A9 code for SR-AX6739A-01-348 by Niebingling at 20230506 start*/
&odm {
	sdcard_det: sdcard-det-pin {
		compatible = "mediatek,sdcard-detect-pin";
		mediatek,sdcard-detect-pin-no = <&pio 7 0>;
	};
};
/*Tab A9 code for SR-AX6739A-01-348 by Niebingling at 20230506 end*/