/* Generated by Samsung for MTK vendor board 

 * If these files should be changed, then please make a sync with MTK
*/

#include "mt6835_a16xm_fingerprint_sensor_00.dtsi"

/* Add Samsung configuration over here */

/ {
	fragment@model {
		target-path = "/";
		__overlay__ {
			usb_notifier {
				compatible = "samsung,usb-notifier";
				disable_host_wakelock;
			};
		};
	};
};


&mmc1 {
	sec-sd-slot-type = <3>; /* Hybrid Tray SD slot */
};