/* 
 * Generated by Samsung 
 * If these files should be changed, then please make a sync with MTK
*/

#include "mt6835-a15x_common.dtsi"
#include "mt6835-a15x_camera_03.dtsi"

/*End of this file, DO NOT ADD ANYTHING HERE*/
