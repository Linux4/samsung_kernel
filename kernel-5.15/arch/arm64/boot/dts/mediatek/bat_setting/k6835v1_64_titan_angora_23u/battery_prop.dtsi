// SPDX-License-Identifier: GPL-2.0
/*
 * Copyright (c) 2021 MediaTek Inc.
 * Author: Wy Chuang<wy.chuang@mediatek.com>
 *
 */

&mtk_gauge {
	RBAT_TYPE = <(100)>;
	RBAT_PULL_UP_R = <(100000)>;

	rbat_temperature_table_num = <21>;
	rbat_battery_temperature =
	<
		(-40) 4397119
		(-35) 3088598
		(-30) 2197225
		(-25) 1581880
		(-20) 1151036
		(-15) 846578
		(-10) 628988
		(-5) 471632
		0 357011
		5 272499
		10 209709
		15 162650
		20 127080
		25 100000
		30 79221
		35 63167
		40 50676
		45 40903
		50 33194
		55 27090
		60 22224 >;
	/* battery temperature table type - NTC table */
	batteryid-gpio1 = <&pio 0 0>; /* BAT_ID1 */
	batteryid-gpio = <&pio 12 0>; /* BAT_ID2 */
	/* Battery ID distinction */
	DIFFERENCE_FULLOCV_ITH = <(300)>; /* A15 5G : 250mA +50mA */
	/* Charging termination current */
	SHUTDOWN_1_TIME = <(90)>;
	/* If ui_soc shows 1% more than X minites, system will shutdown */
	KEEP_100_PERCENT = <(1)>;
	CURR_MEASURE_20A = <(0)>;
	UNIT_MULTIPLE = <(1)>;
	R_FG_VALUE = <(2)>;
	/* R_sense resistance */
	EMBEDDED_SEL = <(0)>;
	/* Configures whether using embedded battery or not */
	PMIC_SHUTDOWN_CURRENT = <(20)>;
	/* System shutdown current */
	FG_METER_RESISTANCE = <(70)>;
	/* The resistance of PCB */
	CAR_TUNE_VALUE = <(100)>;
	/* Tune value for current measurement */
	PMIC_MIN_VOL = <(33500)>;
	/* vboot voltage for gauge 0%*/
	POWERON_SYSTEM_IBOOT = <(500)>;
	/* power on system iboot */
	SHUTDOWN_GAUGE0 = <(0)>;
	/*Shutdown condition2 switch*/
	SHUTDOWN_GAUGE0_VOLTAGE = <(34000)>;
	/* shutdown gauge 0% voltage */
	TEMPERATURE_T0 = <(50)>;
	/* Battery temperature T0 */
	TEMPERATURE_T1 = <(25)>;
	/* Battery temperature T1 */
	TEMPERATURE_T2 = <(10)>;
	/* Battery temperature T2 */
	TEMPERATURE_T3 = <(0)>;
	/* Battery temperature T3 */
	TEMPERATURE_T4 = <(-10)>;
	/* Battery temperature T4 */
	TEMPERATURE_T5 = <(-20)>;
	/* Battery temperature T5 */
	g_FG_PSEUDO100_T0 = <(100)>;
	/* Pseudo 100% percentage at T0 */
	g_FG_PSEUDO100_T1 = <(100)>;
	/* Pseudo 100% percentage at T1 */
	g_FG_PSEUDO100_T2 = <(100)>;
	/* Pseudo 100% percentage at T2 */
	g_FG_PSEUDO100_T3 = <(100)>;
	/* Pseudo 100% percentage at T3 */
	g_FG_PSEUDO100_T4 = <(100)>;
	/* Pseudo 100% percentage at T4 */
	g_FG_PSEUDO100_T5 = <(100)>;
/*	Pseudo 100% percentage at T5*/
	Q_MAX_SYS_VOLTAGE_BAT0 = <(3350)>;
	/* Pseudo1 for hide percentage */
	Q_MAX_SYS_VOLTAGE_BAT1 = <(3350)>;
	/* Pseudo1 for hide percentage */
	Q_MAX_SYS_VOLTAGE_BAT2 = <(3350)>;
	/* Pseudo1 for hide percentage */
	Q_MAX_SYS_VOLTAGE_BAT3 = <(3350)>;
	/* Pseudo1 for hide percentage */
	baton-external-ntc = <(1)>;
	/* compensate The resistance of PCB for external ntc */
	COM_FG_METER_RESISTANCE = <(30)>;
	/* compensate The resistance of PCB */
	COM_R_FG_VALUE = <(2)>;
	/* compensate R_sense resistance */
	enable_tmp_intr_suspend = <(0)>;
	/* Enable update temp when suspend */
	ACTIVE_TABLE = <(6)>;
	/* Table numbers per battery */
	MULTI_TEMP_GAUGE0 = <(1)>;
	/* Multi gauge0 enable */
	HWOCV_OLDOCV_DIFF = <(100)>;
	/* Diff of HWOCV and SWOCV*/
	UI_FULL_LIMIT_EN = <(1)>;
	UI_FULL_LIMIT_SOC0 = <(9545)>;
	UI_FULL_LIMIT_ITH0 = <(11000)>;
	UI_FULL_LIMIT_SOC1 = <(9645)>;
	UI_FULL_LIMIT_ITH1 = <(10000)>;
	UI_FULL_LIMIT_SOC2 = <(9745)>;
	UI_FULL_LIMIT_ITH2 = <(9000)>;
	UI_FULL_LIMIT_SOC3 = <(9845)>;
	UI_FULL_LIMIT_ITH3 = <(7500)>;
	UI_FULL_LIMIT_SOC4 = <(9945)>;
	UI_FULL_LIMIT_ITH4 = <(5500)>;
	RBAT_PULL_UP_VOLT = <(1840)>;
	/* Using current to limit uisoc in 100% case*/
	UI_LOW_LIMIT_EN = <(1)>;
	UI_LOW_LIMIT_SOC0 = <(100)>;
	UI_LOW_LIMIT_VTH0 = <(34000)>;
	UI_LOW_LIMIT_SOC1 = <(100)>;
	UI_LOW_LIMIT_VTH1 = <(34000)>;
	UI_LOW_LIMIT_SOC2 = <(100)>;
	UI_LOW_LIMIT_VTH2 = <(34000)>;
	UI_LOW_LIMIT_SOC3 = <(100)>;
	UI_LOW_LIMIT_VTH3 = <(34000)>;
	UI_LOW_LIMIT_SOC4 = <(100)>;
	UI_LOW_LIMIT_VTH4 = <(34000)>;
	/* using voltage to limit uisoc in 1% case */
	DYNAMIC_CV_FACTOR = <(0)>;
	/* Dynamic CV offset */
	CHARGER_IEOC = <(150)>;
	/* Charger termination current for Dynamic CV */
	nouse-baton-undet;
	/* no use battery undetect by baton */
#include "battery_table.dtsi"
#include "battery_prop_dim2_ext.dtsi"
};
