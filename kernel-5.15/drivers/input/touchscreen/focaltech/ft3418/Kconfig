## kernel/arch/arm64/configs/lego_defconfig
```kconfig
CONFIG_SEC_PANEL_NOTIFIER_V2=m
CONFIG_USB_TYPEC_MANAGER_NOTIFIER=m
CONFIG_IF_CB_MANAGER=m
CONFIG_SBU_SWITCH_CONTROL=y
CONFIG_DEV_RIL_BRIDGE=m
# CONFIG_SECURITY_DEFEX is not set
CONFIG_INPUT_SEC_INPUT=m
CONFIG_INPUT_SEC_NOTIFIER=m
CONFIG_SEC_DEBUG_TSP_LOG=m
CONFIG_TOUCHSCREEN_DUMP_MODE=m
# CONFIG_INPUT_SEC_SECURE_TOUCH is not set
# CONFIG_INPUT_SEC_TRUSTED_TOUCH is not set
CONFIG_INPUT_TOUCHSCREEN_TCLMV2=m
# CONFIG_SEC_INPUT_MULTI_DEVICE is not set
# CONFIG_SEC_INPUT_RAWDATA is not set
CONFIG_USDM_PANEL_OLED_COMMON=m
CONFIG_USDM_PANEL_ANA6710=m
CONFIG_MUIC_NOTIFIER=m
CONFIG_HICCUP_CHARGER=y
CONFIG_MUIC_AFC_RETRY=y
CONFIG_MUIC_HV=y
CONFIG_MUIC_SUPPORT_PDIC=y
CONFIG_MUIC_USE_MODULE_PARAM=y
CONFIG_USE_MUIC=y
CONFIG_ANDROID_SWITCH=m
# CONFIG_ANDROID_SWITCH_GPIO is not set
CONFIG_SEC_DEBUG=m
CONFIG_WIRELESS_CHARGER_STWLC89=m
CONFIG_WIRELESS_AUTH=y
CONFIG_WIRELESS_CHARGER_HIGH_VOLTAGE=y
CONFIG_WIRELESS_TX_MODE=y
CONFIG_WIRELESS_FIRMWARE_UPDATE=y
CONFIG_WIRELESS_IC_PARAM=y
CONFIG_TX_GEAR_PHM_VOUT_CTRL=y
CONFIG_WIRELESS_RX_PHM_CTRL=y
CONFIG_SEC_NFC_LOGGER=y
# CONFIG_SECURITY_KUMIHO is not set
# CONFIG_SECURITY_DSMS is not set
CONFIG_SEC_INPUT_BOOSTER=m
CONFIG_SEC_INPUT_BOOSTER_MODE=y
CONFIG_SEC_INPUT_BOOSTER_SLSI=y
CONFIG_SEC_INPUT_BOOSTER_HANDLER=y
CONFIG_SDP=m
CONFIG_VBUS_NOTIFIER=m
CONFIG_SUPPORT_DROPDUMP=m
CONFIG_SEC_REBOOT=m
CONFIG_VIBRATOR_VIB_INFO=m
CONFIG_SEC_STI=y
CONFIG_SENSORS_FLICKER_SELF_TEST=m
CONFIG_NANOHUB=m
CONFIG_SENSOR_DRV=n
CONFIG_SHUB_PANEL_NOTIFY=y
CONFIG_SHUB_MODULE=y
CONFIG_SB_CORE=m
CONFIG_SB_PQUEUE=y
CONFIG_SB_NOTIFY=y
CONFIG_SB_SYSFS=y
CONFIG_SB_VOTE=y
CONFIG_SEC_KQ_MESH=m
CONFIG_KPERFMON=y
CONFIG_KPERFMON_BUILD=m
CONFIG_SEC_VIBRATOR_INPUTFF=m
# CONFIG_SEC_VIB_FOLD_MODEL is not set
CONFIG_USB_NOTIFY_LAYER=m
CONFIG_USB_AUDIO_ENHANCED_DETECT_TIME=y
CONFIG_USB_DEBUG_DETAILED_LOG=y
CONFIG_USB_EXTERNAL_NOTIFY=y
CONFIG_USB_HMT_SAMSUNG_INPUT=y
CONFIG_USB_HOST_CERTI=y
CONFIG_USB_HOST_NOTIFY=y
CONFIG_USB_HOST_SAMSUNG_FEATURE=y
CONFIG_USB_HW_PARAM=y
CONFIG_USB_INTERFACE_LPM_LIST=y
CONFIG_USB_NOTIFY_PROC_LOG=y
CONFIG_USB_USING_ADVANCED_USBLOG=y
CONFIG_DRV_SAMSUNG_PMIC=m
CONFIG_USB_VENDOR_NOTIFY=y
CONFIG_USB_VENDOR_RECEIVER=m
CONFIG_SENSORS_FINGERPRINT=m
CONFIG_CHARGER_MAX77775=m
CONFIG_SHIPMODE_BY_VBAT=y
CONFIG_USB_REPEATER=m
CONFIG_SEC_ABC_SPEC_TYPE1=m
CONFIG_PDIC_NOTIFIER=m
CONFIG_PDIC_USE_MODULE_PARAM=y
CONFIG_DRM_PANEL_MCD_COMMON=m
# CONFIG_DRM_PANEL_SAMSUNG_COMMON is not set
CONFIG_USDM_PANEL_JSON=y
CONFIG_USB_NOTIFIER=m
CONFIG_SEC_ABC=m
CONFIG_SEC_ABC_HUB=m
CONFIG_SEC_ABC_COMMON=m
CONFIG_SEC_ABC_HUB_CORE=m
CONFIG_SEC_ABC_HUB_BOOTC=m
CONFIG_SEC_ABC_MOTTO=m
CONFIG_USB_REPEATER_PTN3222=m
CONFIG_REGULATOR_DIO8018=m
CONFIG_INPUT_HALL_IC=m
CONFIG_HALL_NOTIFIER=m
CONFIG_HALL_LOGICAL=m
# CONFIG_HALL_DUMP_KEY_MODE is not set
CONFIG_INPUT_AW8624X_HAPTIC=m
CONFIG_AW8624X_SAMSUNG_FEATURE=y
CONFIG_USB_REPEATER_TUSB2E11=m
CONFIG_CHARGER_NU2111A=m
CONFIG_MFD_MAX77775=m
CONFIG_SENSORS_STK6D2X=m
CONFIG_BATTERY_AUTH_DS28E30=m
CONFIG_DIRECT_CHARGING=m
CONFIG_FUELGAUGE_MAX77775=m
CONFIG_UI_SOC_PROLONGING=y
CONFIG_IIO=y
CONFIG_IIO_BUFFER=y
CONFIG_SHUB=m
CONFIG_BATTERY_AUTH_SLE956681=m
CONFIG_CCIC_MAX77775=m
CONFIG_MAX77775_CCIC_ALTERNATE_MODE=y
CONFIG_MAX77775_GET_UNMASK_VBUS_HWPARAM=y
CONFIG_TOUCHSCREEN_GOODIX_BRL=m
CONFIG_SENSORS_GW9558X=m
CONFIG_SENSORS_FINGERPRINT_MODULE=y
CONFIG_FINGERPRINT_SECURE=y
CONFIG_SENSORS_FINGERPRINT_LSI=y
CONFIG_SENSORS_FINGERPRINT_NORMALSPI=y
CONFIG_SAMSUNG_NFC=m
CONFIG_SEC_MX_NFC=y
# CONFIG_MTK_CLKBUF_NFC is not set
CONFIG_SEC_NFC_WAKELOCK_METHOD=2
# CONFIG_SEC_NFC_DUPLICATED_IRQ_WQ is not set
# CONFIG_SEC_NFC_TEST_ON_PROBE is not set
CONFIG_ESE_P3_LSI=y
CONFIG_ESE_COLDRESET=y
# CONFIG_ESE_USE_REGULATOR is not set
# CONFIG_MAKE_NODE_USING_PLATFORM_DEVICE is not set
CONFIG_TOUCHSCREEN_SYNAPTICS_S3908T_I2C=m
CONFIG_BATTERY_SAMSUNG=m
CONFIG_SEC_PD=m
CONFIG_BATTERY_GKI=y
CONFIG_BATTERY_AGE_FORECAST=y
CONFIG_BATTERY_CISD=y
CONFIG_AFC_CHARGER_MODE=y
CONFIG_BATTERY_LOGGING=y
CONFIG_ENABLE_FULL_BY_SOC=y
CONFIG_STEP_CHARGING=y
CONFIG_SUPPORT_HV_CTRL=y
CONFIG_SUPPORT_SHIP_MODE=y
CONFIG_WIRELESS_CHARGER_CPS4038=m
CONFIG_HV_MUIC_MAX77775_AFC=y
CONFIG_MUIC_MAX77775=y
```

## kernel/arch/arm64/configs/r12sxxx_01_defconfig
```kconfig
CONFIG_SND_SOC_CIRRUS_AMP=m
CONFIG_SND_SOC_SAMSUNG_AUDIO=m
CONFIG_SND_SOC_SAMSUNG_ABOX_CHANGE_RMEM_SIZE=y
# CONFIG_SND_SOC_SAMSUNG_EXYNOS_CS35L43_I2C is not set
# CONFIG_SND_SOC_CS35L43_I2C is not set
# CONFIG_SND_SOC_SAMSUNG_EXYNOS_CS40L26_I2C is not set
# CONFIG_SND_SOC_CIRRUS_AMP is not set
CONFIG_SND_SOC_TFA98XX=m
CONFIG_SND_SOC_TFA9878=m
CONFIG_FW_LOADER_USER_HELPER=m
CONFIG_SEC_SND_SYNCHRONIZED_IPC=m
CONFIG_TFA_STEREO_NODE=y
CONFIG_DRM_MCD_COMMON=y
CONFIG_USDM_PANEL=m
CONFIG_USDM_SDP_ADAPTIVE_MIPI=y
# CONFIG_USDM_ADAPTIVE_MIPI is not set
CONFIG_USDM_MDNIE=y
CONFIG_USDM_PANEL_DISPLAY_MODE=y
CONFIG_USDM_PANEL_ID_READ_BY_HSDT=y
CONFIG_USDM_PANEL_ID_READ_REG_04=y
CONFIG_USDM_PANEL_LPM=y
CONFIG_USDM_PANEL_AOD_BL=y
CONFIG_USDM_PANEL_DPUI=y
CONFIG_USDM_PANEL_UEVENT_RECOVERY=y
CONFIG_USDM_FACTORY_DSC_CRC_TEST=y
CONFIG_USDM_FACTORY_CCD_TEST=y
CONFIG_USDM_FACTORY_ECC_TEST=y
CONFIG_USDM_PANEL_BACKLIGHT_PAC_3_0=y
CONFIG_USDM_PANEL_TESTMODE=y
CONFIG_CAMERA_RSX_V12=y
CONFIG_CAMERA_CIS_GN3_OBJ=m
CONFIG_CAMERA_VENDOR_MCD=y
CONFIG_CAMERA_CIS_3L6_OBJ=m
CONFIG_CAMERA_CIS_3J1_OBJ=m
CONFIG_CAMERA_CIS_OV08A10_OBJ=m
CONFIG_CAMERA_CIS_IMX374_OBJ=m
CONFIG_CAMERA_ACT_AK737X_OBJ=m
CONFIG_LEDS_AW36518_FLASH=m
CONFIG_CAMERA_FLASH_AW36518_OBJ=m
CONFIG_AF_HOST_CONTROL=y
CONFIG_OIS_USE=y
CONFIG_CAMERA_USE_INTERNAL_MCU=y
CONFIG_CAMERA_HW_BIG_DATA=y
# CONFIG_TRUSTONIC_TEE is not set
# CONFIG_TRUSTONIC_TRUSTED_UI is not set
# CONFIG_SECURE_OS_CONTROL is not set
# CONFIG_SECURE_OS_BOOSTER_API is not set
# CONFIG_TZ_NWFS is not set
# CONFIG_TZDEV_BOOST is not set
# CONFIG_ION_FD2PHYS is not set
# CONFIG_TZDEV_DEPLOY_TZAR is not set
# CONFIG_TZDEV_TEST is not set
# CONFIG_TZDEV_CPUFREQ_TRANSITION is not set
CONFIG_TZDEV_USE_ARM_CALLING_CONVENTION=y
CONFIG_TZDEV=m
CONFIG_TZDEV_IWI_EVENT=260
CONFIG_TZDEV_IWI_PANIC=261
CONFIG_TZIRS=y
CONFIG_TZLOG=y
CONFIG_TZLOG_PG_CNT=8
CONFIG_TZ_BOOT_LOG=y
CONFIG_TZ_BOOT_LOG_PG_CNT=1
CONFIG_TZ_TRANSPORT=y
CONFIG_TZ_TRANSPORT_PG_CNT=2
CONFIG_TZDEV_SWD_PANIC_IS_CRITICAL=y
CONFIG_TEEGRIS_VERSION=5
CONFIG_SAMSUNG_GKI_KERNEL=y
CONFIG_TZDEV_SK_MULTICORE=y
CONFIG_SAMSUNG_TUI=m
CONFIG_SAMSUNG_TUI_LOWLEVEL=y
CONFIG_SOC_S5E9945=y
CONFIG_QCOM_QMI_HELPERS=m
CONFIG_CNSS_UTILS=m
CONFIG_WCNSS_MEM_PRE_ALLOC=m
CONFIG_CNSS_GENL=m
CONFIG_CNSS2=m
# CONFIG_CNSS2_DEBUG is not set
CONFIG_CNSS2_QMI=y
CONFIG_CNSS_QMI_SVC=m
CONFIG_CNSS_PLAT_IPC_QMI_SVC=m
CONFIG_MHI_BUS=m
CONFIG_MHI_BUS_DEBUG=y
CONFIG_QRTR_MHI=m
CONFIG_QRTR=m
CONFIG_MHI_BUS_MISC=y
CONFIG_SEC_SS_CNSS_FEATURE_SYSFS=y
CONFIG_CNSS_KIWI_V2=y
CONFIG_QCA_CLD_WLAN=m
CONFIG_BUS_AUTO_SUSPEND=y
CONFIG_IPC_LOGGING=m
CONFIG_NL80211_TESTMODE=y
CONFIG_WLAN_DEBUG=y
```
