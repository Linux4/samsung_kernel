## kernel-5.15/drivers/input/touchscreen/focaltech/ft3418/Kconfig
```kconfig
#
# Focaltech Touchscreen driver configuration
#

config TOUCHSCREEN_FTS_FT3418
    tristate "Focaltech Touchscreen"
    default n
    help
      Say Y here if you have Focaltech touch panel.
      If unsure, say N.
```

## kernel-5.15/drivers/sensors/Kconfig
```kconfig
config SENSORS
	tristate "Sensors Class Support"
	default n
	help
	This option enables the sensor sysfs class in /sys/class/sensors.
	You'll need this to do anything useful with sensors. If unsure, say N.
```

## kernel-5.15/drivers/wt_security/Kconfig
```kconfig
config WT_SECURITY_MODULE
	default n
	tristate "Enable WT Secure Module in Kernel."
	help
	  WT_SECURITY_MODULE is the kernel config of security module designed by WT.
	  If we config this, we can enable some other security feature of WT DEVLOP .

config WT_SECUREBOOT_FUSE
	default n
	tristate "Enable Get Secure Boot Status in Kernel."
	help
	  WT_SECUREBOOT_FUSE is the kernel config of secureboot feature designed by WT.
	  If we enable this, we can get secureboot status in /proc/secboot_fuse_reg.

config WT_SERIAL_NUM
	default n
	tristate "Enable Get serial num in Kernel."
	help
	  WT_SERIAL_NUM is the kernel config of serial num feature designed by WT.
	  If we enable this, we can get serial num status in /proc/serial_num.

config WT_EM
	default n
	tristate "Enable Get Device Type Status in Kernel."
	help
	  WT_EM is the kernel config of get device type feature designed by WT.
	  If we enable this, we can get device type status in /proc/wt_em.

config WT_RP_VALUE
	default n
	tristate "Enable Get rp_value in Kernel."
	help
	  WT_RP_VALUE is the kernel config of rp value feature designed by WT.
	  If we enable this, we can get rp value in /proc/wt_rp.
```

## kernel/Kconfig.freezer
```kconfig
config FREEZER
	def_bool PM_SLEEP || CGROUP_FREEZER

config ARM64_THREADINFO_SLABCACHE
	def_bool y

config THREADINFO_MEMPOOL
	def_bool y
```

## kernel/arch/arm64/configs/a55xnsxx_00_defconfig
```kconfig
CONFIG_CAMERA_AAX_V55X=y
CONFIG_CAMERA_CIS_IMX616_OBJ=m
CONFIG_CAMERA_CIS_IMX906_OBJ=m
CONFIG_CAMERA_CIS_GN5_OBJ=m
CONFIG_CAMERA_CIS_IMX258_OBJ=m
CONFIG_CAMERA_CIS_GC05A3_OBJ=m
CONFIG_CAMERA_ACT_AK737X_OBJ=m
CONFIG_CAMERA_FLASH_SM5714_OBJ=m
CONFIG_LEDS_SM5714=m
CONFIG_LEDS_S2MF301_FLASH=m
CONFIG_CAMERA_FLASH_S2MF301_OBJ=m
CONFIG_OIS_USE=y
CONFIG_AF_HOST_CONTROL=y
CONFIG_CAMERA_USE_INTERNAL_MCU=y
CONFIG_CAMERA_HW_BIG_DATA=y
CONFIG_DRM_MCD_COMMON=y
CONFIG_USDM_PANEL=m
CONFIG_USDM_PANEL_DISPLAY_MODE=y
CONFIG_USDM_PANEL_DPUI=y
CONFIG_USDM_MDNIE=y
CONFIG_USDM_PANEL_ID_READ_BY_HSDT=y
CONFIG_USDM_PANEL_ID_READ_REG_04=y
CONFIG_USDM_PANEL_LPM=y
CONFIG_USDM_PANEL_AOD_BL=y
CONFIG_USDM_FACTORY_DSC_CRC_TEST=y
CONFIG_USDM_FACTORY_CCD_TEST=y
CONFIG_USDM_FACTORY_ECC_TEST=y
CONFIG_USDM_PANEL_MASK_LAYER=y
CONFIG_USDM_SDP_ADAPTIVE_MIPI=y
CONFIG_USDM_PANEL_LATE_PROBE=y
CONFIG_SND_SOC_SAMSUNG_AUDIO=m
CONFIG_SND_SOC_SAMSUNG_ABOX_CHANGE_RMEM_SIZE=y
# CONFIG_TRUSTONIC_TEE is not set
# CONFIG_TRUSTONIC_TRUSTED_UI is not set
# CONFIG_SECURE_OS_CONTROL is not set
# CONFIG_SECURE_OS_BOOSTER_API is not set
# CONFIG_TZ_NWFS is not set
# CONFIG_SAMSUNG_TUI is not set
# CONFIG_TZDEV_BOOST is not set
# CONFIG_ION_FD2PHYS is not set
# CONFIG_TZDEV_DEPLOY_TZAR is not set
# CONFIG_TZDEV_TEST is not set
# CONFIG_TZDEV_CPUFREQ_TRANSITION is not set
# CONFIG_SAMSUNG_TUI is not set
# CONFIG_SAMSUNG_TUI_LOWLEVEL is not set
CONFIG_TZDEV_USE_ARM_CALLING_CONVENTION=y
CONFIG_TZDEV=m
CONFIG_TZDEV_IWI_EVENT=260
CONFIG_TZDEV_IWI_PANIC=261
CONFIG_TZIRS=y
CONFIG_TZLOG=y
CONFIG_TZLOG_PG_CNT=8
CONFIG_TZ_BOOT_LOG=y
CONFIG_TZ_BOOT_LOG_PG_CNT=1
CONFIG_TZ_TRANSPORT=y
CONFIG_TZ_TRANSPORT_PG_CNT=2
CONFIG_TZDEV_SWD_PANIC_IS_CRITICAL=y
CONFIG_TEEGRIS_VERSION=5
CONFIG_SAMSUNG_GKI_KERNEL=y
CONFIG_TZDEV_SK_MULTICORE=y
CONFIG_SAMSUNG_TUI=m
CONFIG_SAMSUNG_TUI_LOWLEVEL=n
CONFIG_RTC_AUTO_PWRON=m
```

## kernel/arch/arm64/configs/e1sksx_01_defconfig
```kconfig
CONFIG_SND_SOC_CIRRUS_AMP=m
CONFIG_SND_SOC_SAMSUNG_AUDIO=m
CONFIG_SND_SOC_SAMSUNG_ABOX_CHANGE_RMEM_SIZE=y
CONFIG_EXYNOS_UEVENT_RECOVERY_SOLUTION=y
CONFIG_DRM_MCD_COMMON=y
CONFIG_USDM_PANEL=m
CONFIG_USDM_SDP_ADAPTIVE_MIPI=y
# CONFIG_USDM_ADAPTIVE_MIPI is not set
CONFIG_USDM_PANEL_DISPLAY_MODE=y
CONFIG_USDM_PANEL_ID_READ_BY_HSDT=y
CONFIG_USDM_PANEL_ID_READ_REG_04=y
CONFIG_USDM_PANEL_LPM=y
CONFIG_USDM_PANEL_AOD_BL=y
CONFIG_USDM_PANEL_SELF_DISPLAY=y
CONFIG_USDM_PANEL_DPUI=y
CONFIG_USDM_PANEL_COPR=y
CONFIG_USDM_MDNIE=y
CONFIG_USDM_PANEL_MAFPC=y
CONFIG_USDM_PANEL_UEVENT_RECOVERY=y
CONFIG_USDM_FACTORY_GCT_TEST=y
CONFIG_USDM_FACTORY_CCD_TEST=y
CONFIG_USDM_FACTORY_ECC_TEST=y
CONFIG_USDM_FACTORY_SSR_TEST=y
CONFIG_USDM_FACTORY_MST_TEST=y
CONFIG_USDM_FACTORY_BRIGHTDOT_TEST=y
CONFIG_USDM_FACTORY_VGLHIGHDOT_TEST=y
CONFIG_USDM_FACTORY_DSC_CRC_TEST=y
CONFIG_USDM_PANEL_BACKLIGHT_PAC_3_0=y
CONFIG_USDM_PANEL_TESTMODE=y
CONFIG_USDM_PANEL_ERRFG_RECOVERY=y
CONFIG_CAMERA_ESX_V01=y
CONFIG_CAMERA_CIS_GN3_OBJ=m
CONFIG_CAMERA_CIS_3K1_OBJ=m
CONFIG_CAMERA_CIS_IMX564_OBJ=m
CONFIG_CAMERA_CIS_3LU_OBJ=m
CONFIG_CAMERA_ACT_AK737X_OBJ=m
CONFIG_CAMERA_FLASH_S2MPB02_I2C_OBJ=m
CONFIG_LEDS_S2MPB02=m
CONFIG_LEDS_S2MPB02_FLASH=m
CONFIG_CAMERA_VENDOR_MCD=y
CONFIG_AF_HOST_CONTROL=y
CONFIG_OIS_USE=y
CONFIG_CAMERA_USE_INTERNAL_MCU=y
CONFIG_CAMERA_HW_BIG_DATA=y
# CONFIG_TRUSTONIC_TEE is not set
# CONFIG_TRUSTONIC_TRUSTED_UI is not set
# CONFIG_SECURE_OS_CONTROL is not set
# CONFIG_SECURE_OS_BOOSTER_API is not set
# CONFIG_TZ_NWFS is not set
# CONFIG_SAMSUNG_TUI is not set
# CONFIG_TZDEV_BOOST is not set
# CONFIG_ION_FD2PHYS is not set
# CONFIG_TZDEV_DEPLOY_TZAR is not set
# CONFIG_TZDEV_TEST is not set
# CONFIG_TZDEV_CPUFREQ_TRANSITION is not set
# CONFIG_SAMSUNG_TUI is not set
# CONFIG_SAMSUNG_TUI_LOWLEVEL is not set
CONFIG_TZDEV_USE_ARM_CALLING_CONVENTION=y
CONFIG_TZDEV=m
CONFIG_TZDEV_IWI_EVENT=260
CONFIG_TZDEV_IWI_PANIC=261
CONFIG_TZIRS=y
CONFIG_TZLOG=y
CONFIG_TZLOG_PG_CNT=8
CONFIG_TZ_BOOT_LOG=y
CONFIG_TZ_BOOT_LOG_PG_CNT=1
CONFIG_TZ_TRANSPORT=y
CONFIG_TZ_TRANSPORT_PG_CNT=2
CONFIG_TZDEV_SWD_PANIC_IS_CRITICAL=y
CONFIG_TEEGRIS_VERSION=5
CONFIG_SAMSUNG_GKI_KERNEL=y
CONFIG_TZDEV_SK_MULTICORE=y
CONFIG_SAMSUNG_TUI=m
CONFIG_SAMSUNG_TUI_LOWLEVEL=n
CONFIG_SOC_S5E9945=y
CONFIG_QCOM_QMI_HELPERS=m
CONFIG_CNSS_UTILS=m
CONFIG_WCNSS_MEM_PRE_ALLOC=m
CONFIG_CNSS_GENL=m
CONFIG_CNSS2=m
# CONFIG_CNSS2_DEBUG is not set
CONFIG_CNSS2_QMI=y
CONFIG_CNSS_QMI_SVC=m
CONFIG_CNSS_PLAT_IPC_QMI_SVC=m
CONFIG_MHI_BUS=m
CONFIG_MHI_BUS_DEBUG=y
CONFIG_QRTR_MHI=m
CONFIG_QRTR=m
CONFIG_MHI_BUS_MISC=y
CONFIG_SEC_SS_CNSS_FEATURE_SYSFS=y
CONFIG_CNSS_KIWI_V2=y
CONFIG_QCA_CLD_WLAN=m
CONFIG_BUS_AUTO_SUSPEND=y
CONFIG_IPC_LOGGING=m
CONFIG_NL80211_TESTMODE=y
```

## kernel/arch/arm64/configs/erd8845_u_defconfig
```kconfig
CONFIG_TOUCHSCREEN_SEC_TS=m

# PMIC
CONFIG_MFD_S2MPU15_8845=m
CONFIG_MFD_S2MPU16_8845=m
CONFIG_REGULATOR_S2MPU15_8845=m
CONFIG_REGULATOR_S2MPU16_8845=m
CONFIG_RTC_DRV_S2MPU15_8845=m
CONFIG_KEYBOARD_S2MPU15_8845=m
CONFIG_S2MPU15_ADC_8845=m
CONFIG_PINCTRL_SAMSUNG_S2MPU15_8845=m
CONFIG_PINCTRL_SAMSUNG_S2MPU16_8845=m
CONFIG_MFD_S2MPB06=m
CONFIG_REGULATOR_S2MPB06=m
CONFIG_REGULATOR_S2MPB03=m
CONFIG_REGULATOR_S2DOS05=m

# CPIF/GNSSIF
CONFIG_EXYNOS_MODEM_IF=m
CONFIG_SEC_MODEM_S5000AP=m
CONFIG_EXYNOS_CPIF_IOMMU_V9=m
CONFIG_CP_PKTPROC=m
CONFIG_CP_PKTPROC_LRO=m
CONFIG_CP_PKTPROC_UL=m
CONFIG_MODEM_IF_QOS=m
CONFIG_CP_BTL=m
# CONFIG_CP_LLC is not set
CONFIG_HW_REV_DETECT=m
CONFIG_CPIF_TP_MONITOR=m
CONFIG_REINIT_VSS=m
CONFIG_VERIFY_VSS=m
CONFIG_CPIF_DIRECT_DM=m
CONFIG_CPIF_VENDOR_HOOK=m
CONFIG_CH_EXTENSION=m
# CONFIG_CP_UART_NOTI is not set
CONFIG_CP_RESET_NOTI=y

#GNSSIF
CONFIG_GNSS_PMUCAL=m
CONFIG_EXYNOS_GNSS_IF=m

#USB
CONFIG_USB_NOTIFY_LAYER_LSI=y
CONFIG_USB_NOTIFY_LAYER_MODULE=m
CONFIG_USB_NOTIFIER=m

#Audio
CONFIG_SND_SOC_SAMSUNG_EXYNOS_CS35L43_I2C=m
CONFIG_SND_SOC_SAMSUNG_EXYNOS8845_SOUND=m
CONFIG_SND_SOC_SAMSUNG_EXYNOS8845_S5M3700X_I2C=m

# CAMERA
CONFIG_CAMERA_CIS_2LD_OBJ=m
CONFIG_CAMERA_CIS_GW2_OBJ=m
CONFIG_CAMERA_CIS_2LA_OBJ=m
CONFIG_CAMERA_CIS_3L6_OBJ=m
CONFIG_CAMERA_FLASH_S2MF301_OBJ=m
CONFIG_CAMERA_ACT_AK737X_OBJ=m

#CHUB
CONFIG_NANOHUB=m
CONFIG_SENSOR_DRV=y
```

## kernel/arch/arm64/configs/erd9935_u_defconfig
```kconfig
CONFIG_TOUCHSCREEN_SEC_TS=m

# PMIC
CONFIG_KEYBOARD_S2MPS25_9935=m
CONFIG_MFD_S2MPS25_9935=m
CONFIG_MFD_S2MPS26_9935=m
CONFIG_MFD_S2MPB02=m
CONFIG_MFD_S2MPM07_9935=m
CONFIG_MFD_S2MPA05_9935=m
CONFIG_REGULATOR_S2MPS25_9935=m
CONFIG_REGULATOR_S2MPS26_9935=m
CONFIG_REGULATOR_S2MPM07_9935=m
CONFIG_REGULATOR_S2MPA05_9935=m
CONFIG_REGULATOR_S2MPB02=m
CONFIG_REGULATOR_S2MPB03=m
CONFIG_REGULATOR_S2DOS05=m
CONFIG_RTC_DRV_S2MPS25_9935=m
CONFIG_S2MPS25_ADC_9935=m
CONFIG_SND_SOC_SAMSUNG_EXYNOS_CS35L41_I2C=m
CONFIG_SND_SOC_SAMSUNG_EXYNOS_CS40L26_I2C=m
CONFIG_SND_SOC_SAMSUNG_EXYNOS9935_SOUND=m
CONFIG_PINCTRL_SAMSUNG_S2MPS26_9935=m
CONFIG_PINCTRL_SAMSUNG_S2MPM07_9935=m

# IFPMIC
CONFIG_S2MF301X=m

CONFIG_MFD_SAMSUNG_IFPMIC=m
CONFIG_PWR_SAMSUNG_IFPMIC=m
CONFIG_FLED_SAMSUNG_IFPMIC=m
CONFIG_MUIC_SAMSUNG_IFPMIC=m
CONFIG_TYPEC_SAMSUNG_IFPMIC=m

CONFIG_USE_S2M_MUIC=m
CONFIG_MUIC_SYSFS=y
CONFIG_MUIC_CORE=y
CONFIG_MUIC_MANAGER=y
CONFIG_MUIC_S2MF301=m
CONFIG_MUIC_SUPPORT_CCIC=y
CONFIG_MUIC_SUPPORT_PRSWAP=y
CONFIG_S2MF301_MUIC_SDP_OVP_OFF=y

CONFIG_USE_S2M_PDIC=m
CONFIG_PDIC_S2MF301=y
CONFIG_PDIC_AUDIO_ACC=y
CONFIG_CHECK_CTYPE_SIDE=y
CONFIG_SUPPORT_USB_TYPEC_OPS=y
CONFIG_PDIC_SUPPORT_DP=y
CONFIG_PDIC_PD30=y

CONFIG_IFCONN_NOTIFIER_MODULE=m
CONFIG_IFCONN_NOTIFIER=y
CONFIG_IFCONN_MANAGER=y

CONFIG_FUELGAUGE_S2MF301=m
CONFIG_CHARGER_S2MF301=m
CONFIG_MFD_S2MF301=m
CONFIG_LEDS_S2MF301_FLASH=m
CONFIG_PM_S2MF301=m
CONFIG_MANAGER_S2M_CHARGER=m
CONFIG_S2M_THERMAL=m
CONFIG_TOP_S2MF301=m
CONFIG_TOP_S2MF301_SUPPORT_S2MC501=y
CONFIG_CHARGER_S2MC501=m
CONFIG_DIRECT_CHARGER=n
CONFIG_SYSFS_S2MF301=m

CONFIG_USB_NOTIFY_LAYER_LSI=y
CONFIG_USB_NOTIFY_LAYER_MODULE=m
CONFIG_USB_NOTIFIER=m

# DRM Displayport
# CONFIG_DRM_SAMSUNG_DP is not set
```

## kernel/arch/arm64/configs/erd9945_evt0_u_defconfig
```kconfig
# SGPU
CONFIG_DRM_SGPU_EMULATOR_WORKAROUND=n

# IFPMIC
CONFIG_MFD_SAMSUNG_IFPMIC=m
CONFIG_PWR_SAMSUNG_IFPMIC=m
CONFIG_FLED_SAMSUNG_IFPMIC=m
CONFIG_MUIC_SAMSUNG_IFPMIC=m
CONFIG_TYPEC_SAMSUNG_IFPMIC=m

CONFIG_USE_S2M_MUIC=m
CONFIG_MUIC_SYSFS=y
CONFIG_MUIC_CORE=y
CONFIG_MUIC_MANAGER=y
CONFIG_MUIC_S2MF301=m
CONFIG_MUIC_SUPPORT_CCIC=y
CONFIG_MUIC_SUPPORT_PRSWAP=y
CONFIG_S2MF301_MUIC_SDP_OVP_OFF=y

CONFIG_SND_SOC_SAMSUNG_EXYNOS_CS35L43_I2C=m
CONFIG_SND_SOC_SAMSUNG_EXYNOS_CS40L26_I2C=m
CONFIG_SND_SOC_SAMSUNG_EXYNOS9945_SOUND=m

CONFIG_USE_S2M_PDIC=m
CONFIG_PDIC_S2MF301=y
CONFIG_PDIC_AUDIO_ACC=y
CONFIG_CHECK_CTYPE_SIDE=y
CONFIG_SUPPORT_USB_TYPEC_OPS=y
CONFIG_PDIC_SUPPORT_DP=y
CONFIG_PDIC_PD30=y

CONFIG_IFCONN_NOTIFIER_MODULE=m
CONFIG_IFCONN_NOTIFIER=y
CONFIG_IFCONN_MANAGER=y

CONFIG_FUELGAUGE_S2MF301=m
CONFIG_CHARGER_S2MF301=m
CONFIG_MFD_S2MF301=m
CONFIG_LEDS_S2MF301_FLASH=m
CONFIG_PM_S2MF301=m
CONFIG_MANAGER_S2M_CHARGER=m
CONFIG_S2M_THERMAL=m
CONFIG_TOP_S2MF301=m
CONFIG_TOP_S2MF301_SUPPORT_S2MC501=y
CONFIG_CHARGER_S2MC501=m
CONFIG_DIRECT_CHARGER=n
CONFIG_SYSFS_S2MF301=m

# PMIC
CONFIG_MFD_S2MPS27=m
CONFIG_REGULATOR_S2MPS27=m
CONFIG_KEYBOARD_S2MPS27=m
CONFIG_RTC_DRV_S2MPS27=m
CONFIG_S2MPS27_ADC=m
CONFIG_MFD_S2MPS28=m
CONFIG_REGULATOR_S2MPS28=m
CONFIG_PINCTRL_SAMSUNG_S2MPS28=m
CONFIG_MFD_S2MPM07_9945=m
CONFIG_REGULATOR_S2MPM07_9945=m
CONFIG_PINCTRL_SAMSUNG_S2MPM07_9945=m
CONFIG_MFD_S2MPA05_9945=m
CONFIG_REGULATOR_S2MPA05_9945=m
CONFIG_PINCTRL_SAMSUNG_S2MPA05_9945=m
CONFIG_MFD_S2MPB02=m
CONFIG_REGULATOR_S2MPB02=m
CONFIG_REGULATOR_S2MPB03=m
CONFIG_REGULATOR_S2DOS05=m

# CHUB
CONFIG_NANOHUB=m
CONFIG_SENSOR_DRV=y

# Touch
CONFIG_TOUCHSCREEN_SEC_TS=m

#USB
CONFIG_USB_NOTIFY_LAYER_LSI=y
CONFIG_USB_NOTIFY_LAYER_MODULE=m
CONFIG_USB_NOTIFIER=m

# CPIF/GNSSIF
CONFIG_EXYNOS_MODEM_IF=m
CONFIG_SEC_MODEM_S5000AP=m
CONFIG_EXYNOS_CPIF_IOMMU_V9=m
CONFIG_CP_PKTPROC=m
CONFIG_CP_PKTPROC_LRO=m
CONFIG_CP_PKTPROC_UL=m
CONFIG_MODEM_IF_QOS=m
CONFIG_CP_BTL=m
# CONFIG_CP_LLC is not set
CONFIG_HW_REV_DETECT=m
CONFIG_CPIF_TP_MONITOR=m
CONFIG_REINIT_VSS=m
CONFIG_VERIFY_VSS=m
CONFIG_CPIF_DIRECT_DM=m
CONFIG_CPIF_VENDOR_HOOK=m
CONFIG_CH_EXTENSION=m
CONFIG_GNSS_PMUCAL=m
CONFIG_EXYNOS_GNSS_IF=m
# CONFIG_CP_UART_NOTI is not set
CONFIG_CP_RESET_NOTI=y

# Camera
CONFIG_CAMERA_CIS_HP2_OBJ=m
CONFIG_CAMERA_CIS_IMX754_OBJ=m
CONFIG_CAMERA_CIS_IMX564_OBJ=m
CONFIG_CAMERA_CIS_3LU_OBJ=m
CONFIG_CAMERA_FLASH_S2MF301_OBJ=m
CONFIG_CAMERA_ACT_AK737X_OBJ=m
CONFIG_CAMERA_FLASH_S2MPB02_I2C_OBJ=m
CONFIG_LEDS_S2MPB02=m
CONFIG_LEDS_S2MPB02_FLASH=m

# DRM Displayport
CONFIG_DRM_SAMSUNG_DP=y
```

## kernel/arch/arm64/configs/erd9945_s5400_u_defconfig
```kconfig
# SGPU
CONFIG_DRM_SGPU_EMULATOR_WORKAROUND=n

# IFPMIC
CONFIG_MFD_SAMSUNG_IFPMIC=m
CONFIG_PWR_SAMSUNG_IFPMIC=m
CONFIG_FLED_SAMSUNG_IFPMIC=m
CONFIG_MUIC_SAMSUNG_IFPMIC=m
CONFIG_TYPEC_SAMSUNG_IFPMIC=m

CONFIG_USE_S2M_MUIC=m
CONFIG_MUIC_SYSFS=y
CONFIG_MUIC_CORE=y
CONFIG_MUIC_MANAGER=y
CONFIG_MUIC_S2MF301=m
CONFIG_MUIC_SUPPORT_CCIC=y
CONFIG_MUIC_SUPPORT_PRSWAP=y
CONFIG_S2MF301_MUIC_SDP_OVP_OFF=y

CONFIG_SND_SOC_SAMSUNG_EXYNOS_CS35L43_I2C=m
CONFIG_SND_SOC_SAMSUNG_EXYNOS_CS40L26_I2C=m
CONFIG_SND_SOC_SAMSUNG_EXYNOS9945_SOUND=m

CONFIG_USE_S2M_PDIC=m
CONFIG_PDIC_S2MF301=y
CONFIG_PDIC_AUDIO_ACC=y
CONFIG_CHECK_CTYPE_SIDE=y
CONFIG_SUPPORT_USB_TYPEC_OPS=y
CONFIG_PDIC_SUPPORT_DP=y
CONFIG_PDIC_PD30=y

CONFIG_IFCONN_NOTIFIER_MODULE=m
CONFIG_IFCONN_NOTIFIER=y
CONFIG_IFCONN_MANAGER=y

CONFIG_FUELGAUGE_S2MF301=m
CONFIG_CHARGER_S2MF301=m
CONFIG_MFD_S2MF301=m
CONFIG_LEDS_S2MF301_FLASH=m
CONFIG_PM_S2MF301=m
CONFIG_MANAGER_S2M_CHARGER=m
CONFIG_S2M_THERMAL=m
CONFIG_TOP_S2MF301=m
CONFIG_TOP_S2MF301_SUPPORT_S2MC501=y
CONFIG_CHARGER_S2MC501=m
CONFIG_DIRECT_CHARGER=n
CONFIG_SYSFS_S2MF301=m

# PMIC
CONFIG_MFD_S2MPS27=m
CONFIG_REGULATOR_S2MPS27=m
CONFIG_KEYBOARD_S2MPS27=m
CONFIG_RTC_DRV_S2MPS27=m
CONFIG_S2MPS27_ADC=m
CONFIG_MFD_S2MPS28=m
CONFIG_MFD_S2MPS28_2=m
CONFIG_MFD_S2MPS28_3=m
CONFIG_MFD_S2MPS28_4=m
CONFIG_MFD_S2MPS28_5=m
CONFIG_REGULATOR_S2MPS28=m
CONFIG_REGULATOR_S2MPS28_2=m
CONFIG_REGULATOR_S2MPS28_3=m
CONFIG_REGULATOR_S2MPS28_4=m
CONFIG_REGULATOR_S2MPS28_5=m
CONFIG_PINCTRL_SAMSUNG_S2MPS28=m
CONFIG_PINCTRL_SAMSUNG_S2MPS28_2=m
CONFIG_PINCTRL_SAMSUNG_S2MPS28_3=m
CONFIG_PINCTRL_SAMSUNG_S2MPS28_4=m
CONFIG_PINCTRL_SAMSUNG_S2MPS28_5=m
CONFIG_MFD_S2MPM07_9945=m
CONFIG_REGULATOR_S2MPM07_9945=m
CONFIG_PINCTRL_SAMSUNG_S2MPM07_9945=m
CONFIG_MFD_S2MPA05_9945=m
CONFIG_REGULATOR_S2MPA05_9945=m
CONFIG_PINCTRL_SAMSUNG_S2MPA05_9945=m
CONFIG_MFD_S2MPB02=m
CONFIG_REGULATOR_S2MPB02=m
CONFIG_REGULATOR_S2MPB03=m
CONFIG_REGULATOR_S2DOS05=m

# CHUB
CONFIG_NANOHUB=m
CONFIG_SENSOR_DRV=y

# Touch
CONFIG_TOUCHSCREEN_SEC_TS=m

#USB
CONFIG_USB_NOTIFY_LAYER_LSI=y
CONFIG_USB_NOTIFY_LAYER_MODULE=m
CONFIG_USB_NOTIFIER=m

# CPIF/GNSSIF
CONFIG_EXYNOS_MODEM_IF=m
# CONFIG_SEC_MODEM_S5100 is not set
CONFIG_SHM_IPC=m
CONFIG_MODEM_IF_QOS=m
CONFIG_CP_PKTPROC=m
CONFIG_CP_PKTPROC_UL=m
CONFIG_LINK_DEVICE_PCIE_IOMMU=m
CONFIG_CH_EXTENSION=m
CONFIG_SEC_MODEM_S5400=m
CONFIG_CPIF_DIRECT_DM=m
CONFIG_CPIF_TP_MONITOR=m
CONFIG_EXYNOS_GNSS_IF_SPI=m

# Camera
CONFIG_CAMERA_CIS_HP2_OBJ=m
CONFIG_CAMERA_CIS_IMX754_OBJ=m
CONFIG_CAMERA_CIS_IMX564_OBJ=m
CONFIG_CAMERA_CIS_3LU_OBJ=m
CONFIG_CAMERA_FLASH_S2MF301_OBJ=m
CONFIG_CAMERA_ACT_AK737X_OBJ=m
CONFIG_CAMERA_FLASH_S2MPB02_I2C_OBJ=m
CONFIG_LEDS_S2MPB02=m
CONFIG_LEDS_S2MPB02_FLASH=m

# DRM Displayport
CONFIG_DRM_SAMSUNG_DP=y

# WLBT disable
# CONFIG_CFG80211 is not set
# CONFIG_SCSC_CORE is not set
# CONFIG_SCSC_WLAN is not set
```
