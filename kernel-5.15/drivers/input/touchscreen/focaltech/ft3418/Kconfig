## kernel/arch/arm64/configs/s5e8845-bazel_defconfig
```kconfig
#
# please don't remove new line on this file
#

# SEC COMMON
CONFIG_DRV_SAMSUNG=m
CONFIG_SEC_BOOTSTAT=m
CONFIG_SEC_KEY_NOTIFIER=m

# DEBUG_SNAPSHOT
CONFIG_DEBUG_SNAPSHOT_API=y

# CONFIG_CPIF_VENDOR_HOOK is not set
CONFIG_TOUCHSCREEN_SEC_TS=m

# PMIC
CONFIG_MFD_S2MPU15_8845=m
CONFIG_MFD_S2MPU16_8845=m
CONFIG_REGULATOR_S2MPU15_8845=m
CONFIG_REGULATOR_S2MPU16_8845=m
CONFIG_RTC_DRV_S2MPU15_8845=m
CONFIG_KEYBOARD_S2MPU15_8845=m
CONFIG_S2MPU15_ADC_8845=m
CONFIG_PINCTRL_SAMSUNG_S2MPU15_8845=m
CONFIG_PINCTRL_SAMSUNG_S2MPU16_8845=m

# USB modularization
CONFIG_USB_CONFIGFS_F_SS_MON_GADGET=m
CONFIG_USB_CONFIGFS_F_CONN_GADGET=m

# Samsung Mobile Power Management
CONFIG_PM_DEBUG=y
CONFIG_SEC_PM=y
CONFIG_SEC_PM_DEBUG=m
CONFIG_SEC_WAKEUP_CPU_ALLOCATOR=m

# CPIF/GNSSIF
CONFIG_EXYNOS_MODEM_IF=m
CONFIG_SEC_MODEM_S5000AP=m
CONFIG_EXYNOS_CPIF_IOMMU_V9=m
CONFIG_CP_PKTPROC=m
CONFIG_CP_PKTPROC_UL=m
CONFIG_MODEM_IF_QOS=m
CONFIG_CP_BTL=m
# CONFIG_CP_LLC is not set
CONFIG_HW_REV_DETECT=m
CONFIG_CPIF_TP_MONITOR=m
CONFIG_REINIT_VSS=m
CONFIG_VERIFY_VSS=m
CONFIG_CPIF_DIRECT_DM=m
# CONFIG_CPIF_VENDOR_HOOK is not set
CONFIG_CH_EXTENSION=m
# CONFIG_CP_UART_NOTI is not set
CONFIG_CP_RESET_NOTI=y

# Modem Interface
CONFIG_LINK_DEVICE_WITH_SBD_ARCH=m
CONFIG_CP_PKTPROC_LRO=m

#GNSSIF
CONFIG_GNSS_PMUCAL=m
CONFIG_EXYNOS_GNSS_IF=m

#USB
CONFIG_USB_NOTIFY_LAYER_LSI=y
CONFIG_USB_NOTIFY_LAYER_MODULE=m
CONFIG_USB_NOTIFIER=m

#Audio
# CONFIG_SND_SOC_SAMSUNG_EXYNOS_CS35L43_I2C is not set
CONFIG_SND_SOC_SAMSUNG_EXYNOS8845_AUDIO=m
CONFIG_SND_SOC_SAMSUNG_EXYNOS8845_S5M3700X_I2C=m
CONFIG_SND_SOC_SAMSUNG_EXYNOS_TFA9878=m
CONFIG_SND_SOC_SAMSUNG_EXYNOS_TAS25XX=m
# CONFIG_SND_SOC_CIRRUS_AMP is not set

# CAMERA
CONFIG_CAMERA_VENDOR_MCD=y
#CONFIG_CAMERA_CIS_2LD_OBJ is not set
#CONFIG_CAMERA_CIS_GW2_OBJ is not set
#CONFIG_CAMERA_CIS_2LA_OBJ is not set
#CONFIG_CAMERA_CIS_3L6_OBJ is not set

# UFS
CONFIG_SEC_UFS_FEATURE=y

# SD
CONFIG_SEC_MMC_FEATURE=y

#CHUB
CONFIG_NANOHUB=m
CONFIG_SENSOR_DRV=y

# DISPLAY
# CONFIG_EXYNOS_CMD_SVSYNC is not set
# CONFIG_EXYNOS_CMD_SVSYNC_ONOFF is not set

#
# please don't remove new line on this file
#

# I/O
CONFIG_MQ_IOSCHED_SSG=m
CONFIG_MQ_IOSCHED_SSG_CGROUP=m
CONFIG_MQ_IOSCHED_SSG_WB=m
CONFIG_BLK_SEC_STATS=m
CONFIG_BLK_SEC_COMMON=m
CONFIG_BLK_SEC_WB=m

# Network Feature
CONFIG_TCP_CONG_ADVANCED=y
# CONFIG_TCP_CONG_WESTWOOD is not set
# CONFIG_TCP_CONG_HTCP is not set
CONFIG_TCP_CONG_BIC=y
CONFIG_DEFAULT_BIC=y
CONFIG_DEFAULT_TCP_CONG="bic" 

#VOLD ASEC
CONFIG_CRYPTO_TWOFISH=y

# uH
CONFIG_UH=y
CONFIG_RKP=y
CONFIG_KDP=y
CONFIG_KDP_CRED=y
CONFIG_RKP_TEST=y
CONFIG_KDP_TEST=y

# SEC_PRODUCT_FEATURE_KNOX_SUPPORT_NPA {
CONFIG_KNOX_NCM=y
# SEC_PRODUCT_FEATURE_KNOX_SUPPORT_NPA }
#freecess
CONFIG_SAMSUNG_FREECESS=y

##end
####[LEGO-START] DO NOT SUBMIT

CONFIG_SEC_PANEL_NOTIFIER_V2=m
CONFIG_USB_TYPEC_MANAGER_NOTIFIER=m
CONFIG_IF_CB_MANAGER=m
CONFIG_FUELGAUGE_SM5714=m
CONFIG_UI_SOC_PROLONGING=y
CONFIG_USDM_PANEL_OLED_COMMON=m
CONFIG_USDM_PANEL_S6E3FC5=m
CONFIG_DEV_RIL_BRIDGE=m
CONFIG_SECURITY_DEFEX=y
CONFIG_USDM_PANEL_ANA6710=m
CONFIG_MUIC_NOTIFIER=m
CONFIG_HICCUP_CC_DISABLE=y
CONFIG_HICCUP_CHARGER=y
CONFIG_MUIC_COMMON_SYSFS=y
CONFIG_MUIC_AFC_RETRY=y
CONFIG_MUIC_HV=y
CONFIG_MUIC_SUPPORT_PDIC=y
CONFIG_MUIC_USE_MODULE_PARAM=y
CONFIG_USE_MUIC=y
CONFIG_ANDROID_SWITCH=m
# CONFIG_ANDROID_SWITCH_GPIO is not set
CONFIG_SEC_DEBUG=m
CONFIG_IIO=y
CONFIG_IIO_BUFFER=y
CONFIG_SHUB=m
CONFIG_SEC_NFC_LOGGER=y
CONFIG_SECURITY_DSMS=y
CONFIG_SDP=m
CONFIG_VBUS_NOTIFIER=m
CONFIG_INPUT_SEC_INPUT=m
CONFIG_INPUT_SEC_NOTIFIER=m
CONFIG_SEC_DEBUG_TSP_LOG=m
CONFIG_TOUCHSCREEN_DUMP_MODE=m
# CONFIG_INPUT_SEC_SECURE_TOUCH is not set
# CONFIG_INPUT_SEC_TRUSTED_TOUCH is not set
CONFIG_INPUT_TOUCHSCREEN_TCLMV2=m
# CONFIG_SEC_INPUT_MULTI_DEVICE is not set
CONFIG_SEC_INPUT_RAWDATA=m
CONFIG_MFD_SM5714=m
CONFIG_TOUCHSCREEN_SYNAPTICS_I2C=m
CONFIG_SEC_REBOOT=m
CONFIG_VIBRATOR_VIB_INFO=m
CONFIG_SEC_STI=y
CONFIG_MUIC_PLATFORM=m
CONFIG_HV_MUIC_VOLTAGE_CTRL=y
CONFIG_MUIC_SUPPORT_POWERMETER=y
CONFIG_MUIC_SUPPORT_PRSWAP=y
CONFIG_PDIC_S2MF301=m
CONFIG_S2MF301_PDIC_TRY_SNK=y
CONFIG_S2MF301_TYPEC_WATER=y
CONFIG_SEC_INPUT_BOOSTER=m
CONFIG_SEC_INPUT_BOOSTER_MODE=y
CONFIG_SEC_INPUT_BOOSTER_SLSI=y
CONFIG_SEC_INPUT_BOOSTER_HANDLER=y
CONFIG_SB_CORE=m
CONFIG_SB_PQUEUE=y
CONFIG_SB_NOTIFY=y
CONFIG_SB_SYSFS=y
CONFIG_SB_VOTE=y
CONFIG_SEC_VIBRATOR_INPUTFF=m
# CONFIG_SEC_VIB_FOLD_MODEL is not set
CONFIG_USB_NOTIFY_LAYER=m
CONFIG_USB_DEBUG_DETAILED_LOG=y
CONFIG_USB_EXTERNAL_NOTIFY=y
CONFIG_USB_HMT_SAMSUNG_INPUT=y
CONFIG_USB_HOST_NOTIFY=y
CONFIG_USB_HOST_SAMSUNG_FEATURE=y
CONFIG_USB_HW_PARAM=y
CONFIG_USB_INTERFACE_LPM_LIST=y
CONFIG_USB_NOTIFY_PROC_LOG=y
CONFIG_USB_USING_ADVANCED_USBLOG=y
CONFIG_DRV_SAMSUNG_PMIC=m
CONFIG_NANOHUB=m
CONFIG_SENSOR_DRV=n
CONFIG_SHUB_PANEL_NOTIFY=yCONFIG_SHUB_MODULE=y
CONFIG_SENSORS_FINGERPRINT=m
CONFIG_PDIC_SLSI_NON_MCU=m
CONFIG_PDIC_PD30=y
CONFIG_SUPPORT_USB_TYPEC_OPS=y
CONFIG_S2M_PDIC_MANUAL_RETRY=y
CONFIG_CHARGER_SM5714=m
CONFIG_USB_REPEATER=m
CONFIG_SEC_ABC_SPEC_TYPE1=m
CONFIG_REGULATOR_FIXED_VOLTAGE=y
CONFIG_PDIC_NOTIFIER=m
CONFIG_PDIC_USE_MODULE_PARAM=y
CONFIG_MUIC_SM5714=m
CONFIG_MUIC_BCD_RESCAN=y
CONFIG_DRM_PANEL_MCD_COMMON=m
# CONFIG_DRM_PANEL_SAMSUNG_COMMON is not set
CONFIG_USDM_PANEL_JSON=y
CONFIG_USB_NOTIFIER=m
CONFIG_SEC_ABC=m
CONFIG_SEC_ABC_HUB=m
CONFIG_SEC_ABC_COMMON=m
CONFIG_SEC_ABC_HUB_CORE=m
CONFIG_SEC_ABC_HUB_BOOTC=m
CONFIG_SEC_ABC_MOTTO=m
CONFIG_MFD_S2MF301=m
CONFIG_REGULATOR_DIO8018=m
CONFIG_INPUT_ZM918_HAPTIC=m
CONFIG_CHARGER_SM5461=m
CONFIG_INPUT_HALL_IC=m
CONFIG_HALL_NOTIFIER=m
CONFIG_HALL_LOGICAL=m
# CONFIG_HALL_DUMP_KEY_MODE is not set
CONFIG_SENSORS_EL7XX=m
CONFIG_SENSORS_FINGERPRINT_MODULE=y
CONFIG_FINGERPRINT_SECURE=y
CONFIG_SENSORS_FINGERPRINT_LSI=y
CONFIG_PDIC_SM5714=m
CONFIG_SM5714_FACTORY_MODE=y
CONFIG_USB_REPEATER_PTN3222=m
CONFIG_TOUCHSCREEN_GOODIX_BRL=m
CONFIG_FUELGAUGE_S2MF301=m
CONFIG_FUELGAUGE_S2MF301_USE_5MILLIOHM=y
CONFIG_SEC_PM_THERMISTOR=m
CONFIG_STAR_K250A_LEGO=m
CONFIG_SEC_SNVM_PLATFORM_DRV=y
# CONFIG_SEC_SNVM_I2C_CLOCK_CONTROL is not set
CONFIG_SEC_SNVM_WAKELOCK_METHOD=2
# CONFIG_STAR_MEMORY_LEAK is not set
CONFIG_MUIC_S2MF301=m
CONFIG_HV_MUIC_S2MF301_AFC=y
CONFIG_MUIC_S2MF301_RID=y
CONFIG_TOP_S2MF301=y
CONFIG_SAMSUNG_NFC=m
CONFIG_SEC_MX_NFC=y
# CONFIG_MTK_CLKBUF_NFC is not set
CONFIG_SEC_NFC_WAKELOCK_METHOD=2
# CONFIG_SEC_NFC_DUPLICATED_IRQ_WQ is not set
# CONFIG_SEC_NFC_TEST_ON_PROBE is not set
CONFIG_ESE_P3_LSI=y
CONFIG_ESE_COLDRESET=y
# CONFIG_ESE_USE_REGULATOR is not set
# CONFIG_MAKE_NODE_USING_PLATFORM_DEVICE is not set
CONFIG_LSI_IFPMIC=y
CONFIG_CHARGER_S2MF301=m
CONFIG_PM_S2MF301=m
CONFIG_DIRECT_CHARGING=m
CONFIG_BATTERY_SAMSUNG=m
CONFIG_SEC_PD=m
CONFIG_BATTERY_GKI=y
CONFIG_BATTERY_AGE_FORECAST=y
CONFIG_BATTERY_CISD=y
CONFIG_AFC_CHARGER_MODE=y
CONFIG_BATTERY_LOGGING=y
CONFIG_BATTERY_SAMSUNG_REBOOT=y
CONFIG_ENABLE_FULL_BY_SOC=y
CONFIG_STEP_CHARGING=y
CONFIG_SUPPORT_HV_CTRL=y
####[LEGO-END] DO NOT SUBMIT
CONFIG_CAMERA_AAX_V55X=y
CONFIG_CAMERA_CIS_IMX616_OBJ=m
CONFIG_CAMERA_CIS_IMX906_OBJ=m
CONFIG_CAMERA_CIS_GN5_OBJ=m
CONFIG_CAMERA_CIS_IMX258_OBJ=m
CONFIG_CAMERA_CIS_GC05A3_OBJ=m
CONFIG_CAMERA_ACT_AK737X_OBJ=m
CONFIG_CAMERA_FLASH_SM5714_OBJ=m
CONFIG_LEDS_SM5714=m
CONFIG_LEDS_S2MF301_FLASH=m
CONFIG_CAMERA_FLASH_S2MF301_OBJ=m
CONFIG_OIS_USE=y
CONFIG_AF_HOST_CONTROL=y
CONFIG_CAMERA_USE_INTERNAL_MCU=y
CONFIG_CAMERA_HW_BIG_DATA=y
CONFIG_DRM_MCD_COMMON=y
CONFIG_USDM_PANEL=m
CONFIG_USDM_PANEL_DISPLAY_MODE=y
CONFIG_USDM_PANEL_DPUI=y
CONFIG_USDM_MDNIE=y
CONFIG_USDM_PANEL_ID_READ_BY_HSDT=y
CONFIG_USDM_PANEL_ID_READ_REG_04=y
CONFIG_USDM_PANEL_LPM=y
CONFIG_USDM_PANEL_AOD_BL=y
CONFIG_USDM_FACTORY_DSC_CRC_TEST=y
CONFIG_USDM_FACTORY_CCD_TEST=y
CONFIG_USDM_FACTORY_ECC_TEST=y
CONFIG_USDM_PANEL_MASK_LAYER=y
CONFIG_USDM_SDP_ADAPTIVE_MIPI=y
CONFIG_USDM_PANEL_LATE_PROBE=y
CONFIG_SND_SOC_SAMSUNG_AUDIO=m
CONFIG_SND_SOC_SAMSUNG_ABOX_CHANGE_RMEM_SIZE=y
# CONFIG_TRUSTONIC_TEE is not set
# CONFIG_TRUSTONIC_TRUSTED_UI is not set
# CONFIG_SECURE_OS_CONTROL is not set
# CONFIG_SECURE_OS_BOOSTER_API is not set
# CONFIG_TZ_NWFS is not set
# CONFIG_SAMSUNG_TUI is not set
# CONFIG_TZDEV_BOOST is not set
# CONFIG_ION_FD2PHYS is not set
# CONFIG_TZDEV_DEPLOY_TZAR is not set
# CONFIG_TZDEV_TEST is not set
# CONFIG_TZDEV_CPUFREQ_TRANSITION is not set
# CONFIG_SAMSUNG_TUI is not set
# CONFIG_SAMSUNG_TUI_LOWLEVEL is not set
CONFIG_TZDEV_USE_ARM_CALLING_CONVENTION=y
CONFIG_TZDEV=m
CONFIG_TZDEV_IWI_EVENT=260
CONFIG_TZDEV_IWI_PANIC=261
CONFIG_TZIRS=y
CONFIG_TZLOG=y
CONFIG_TZLOG_PG_CNT=8
CONFIG_TZ_BOOT_LOG=y
CONFIG_TZ_BOOT_LOG_PG_CNT=1
CONFIG_TZ_TRANSPORT=y
CONFIG_TZ_TRANSPORT_PG_CNT=2
CONFIG_TZDEV_SWD_PANIC_IS_CRITICAL=y
CONFIG_TEEGRIS_VERSION=5
CONFIG_SAMSUNG_GKI_KERNEL=y
CONFIG_TZDEV_SK_MULTICORE=y
CONFIG_SAMSUNG_TUI=m
CONFIG_SAMSUNG_TUI_LOWLEVEL=n
CONFIG_RTC_AUTO_PWRON=m

CONFIG_F2FS_FS=y

CONFIG_F2FS_FS_SECURITY=y

CONFIG_F2FS_FS_ENCRYPTION=y

CONFIG_F2FS_FS_COMPRESSION=y

CONFIG_EXT4_FS_POSIX_ACL=y

CONFIG_NTFS_FS=y

CONFIG_NTFS_DEBUG=y

CONFIG_NLS=y

CONFIG_EROFS_FS=y

CONFIG_FIVE=y

CONFIG_PROCA=y

CONFIG_PROCA_S_OS=y

CONFIG_FIVE_GKI_10=y

# CONFIG_FIVE_TEE_DRIVER is not set

# CONFIG_FIVE_PA_FEATURE is not set

CONFIG_GAF_V6=y

CONFIG_SAMSUNG_PRODUCT_SHIP=y


CONFIG_SECURITY_DEFEX_USER=y


CONFIG_SECURITY_KUMIHO=y
```

## kernel/arch/arm64/configs/s5e8845-eng_defconfig
```kconfig
# Power Management
CONFIG_PINCTRL_SEC_GPIO_DVS=m
CONFIG_SEC_PM_REGULATOR=m

# Debugging
CONFIG_DEBUG_PREEMPT=y
CONFIG_DEBUG_RWSEMS=y
CONFIG_DEBUG_ATOMIC_SLEEP=y
CONFIG_SLUB_DEBUG_ON=y
CONFIG_DEBUG_RT_MUTEXES=y
CONFIG_DEBUG_SPINLOCK=y
CONFIG_DEBUG_MUTEXES=y

# Watchdog Device Drivers
CONFIG_S3C2410_BUILTIN_WATCHDOG=y

# SensorHub
CONFIG_SHUB_DEBUG=y

#
# please don't remove new line on this file
#
```
