## kernel/arch/arm64/configs/s5e9945-base_defconfig
```kconfig
# CONFIG_MODULE_SIG_ALL is not set
CONFIG_ARCH_EXYNOS=y
CONFIG_SERIAL_EXYNOS=m
CONFIG_I2C_CHARDEV=m
CONFIG_I2C_EXYNOS5=m
CONFIG_SPI_S3C64XX=m
CONFIG_SPI_SPIDEV=m
CONFIG_EXYNOS_USI_V2=m
CONFIG_I3C_HCI_EXYNOS=m
CONFIG_SOC_S5E9945=y
CONFIG_DEBUG_LOCK_ALLOC=y
CONFIG_PINCTRL_SAMSUNG=m
CONFIG_EXYNOS_CHIPID=n
CONFIG_EXYNOS_CHIPID_V2=m
CONFIG_POWER_RESET_EXYNOS=m
CONFIG_CLKSRC_EXYNOS_MCT_V3=m
CONFIG_EXYNOS_GIC=y
CONFIG_ARM_GIC_V3_VENDORHOOK=m
CONFIG_S3C2410_WATCHDOG=m
CONFIG_S3C2410_BUILTIN_WATCHDOG=y
CONFIG_S3C2410_SHUTDOWN_REBOOT=y
CONFIG_SND_SOC_SAMSUNG=m
CONFIG_SND_SOC_SAMSUNG_ABOX_DEBUG=y
CONFIG_DEBUG_FS=y
CONFIG_COMPOSITE_CLK_SAMSUNG=m
CONFIG_EXYNOS_PMU_IF=m
CONFIG_CAL_IF=m
CONFIG_CMUCAL_DEBUG=y
CONFIG_CMUCAL_V2=y
CONFIG_EXYNOS_PD=m
CONFIG_EXYNOS_PD_DBG=m
CONFIG_PMUCAL_CMU_INIT=y
CONFIG_EXYNOS_ACPM=m
CONFIG_EXYNOS_ACPM_PLGDBG=m
CONFIG_EXYNOS_ACPM_MFD_BUS=m
CONFIG_EXYNOS_MFD_SPMI=y
CONFIG_EXYNOS_ESCA=m
CONFIG_EXYNOS_PM=m
CONFIG_EXYNOS_S2I=m
CONFIG_EXYNOS_FLEXPMU_DBG=m
CONFIG_PM_DEBUG=y
CONFIG_CORESIGHT=y
CONFIG_CORESIGHT_LINK_AND_SINK_TMC=y
CONFIG_CORESIGHT_CATU=y
CONFIG_CORESIGHT_SINK_TPIU=y
CONFIG_CORESIGHT_SINK_ETBV10=y
CONFIG_CORESIGHT_STM=y
CONFIG_STM_PROTO_BASIC=y
CONFIG_ZSMALLOC=m
CONFIG_ZRAM=m
CONFIG_PRINTK_PROCESS=y
CONFIG_DEBUG_NOTIFIERS=y
CONFIG_SLUB_DEBUG_ON=y
CONFIG_CFI_CLANG=y
CONFIG_EXYNOS_PROFILER_LEGACY=n
CONFIG_EXYNOS_MAIN_PROFILER=m
CONFIG_EXYNOS_CPU_PROFILER=m
CONFIG_EXYNOS_GPU_PROFILER=m
CONFIG_EXYNOS_MIF_PROFILER=m
CONFIG_EXYNOS_PROFILER_GFLOW=m
# CONFIG_EXYNOS_MCINFO is not set
# CONFIG_EXYNOS_CRYPTOMANAGER is not set
# CONFIG_LTO_CLANG_FULL is not set
CONFIG_EXYNOS_SSP=m
CONFIG_EXYNOS_SECURE_LOG=m
CONFIG_EXYNOS_TZASC_FAIL_DETECTOR=m
# CONFIG_EXYNOS_PPMPU_FAIL_DETECTOR is not set
CONFIG_EXYNOS_SEH=m
CONFIG_EXYNOS_HDCP2=m
CONFIG_EXYNOS_ICM=m
CONFIG_HW_RANDOM_EXYNOS_SWD=m
CONFIG_TRUSTONIC_TEE=m
CONFIG_SAMSUNG_IOMMU_V9=m
CONFIG_HPA=y
CONFIG_DMABUF_SAMSUNG_HEAPS=m
CONFIG_DMABUF_HEAPS_SAMSUNG_CMA=y
CONFIG_DMABUF_HEAPS_SAMSUNG_CARVEOUT=y
CONFIG_DMABUF_HEAPS_SAMSUNG_SYSTEM=y
CONFIG_DMABUF_HEAPS_SAMSUNG_HPA=y
CONFIG_PAGE_TABLE_CHECK=y
CONFIG_PAGE_TABLE_CHECK_ENFORCED=y
CONFIG_VTS_DEBUG=y
# CONFIG_ARM64_AMU_EXTN is not set

# CPU
CONFIG_EXYNOS_UFCC=m
CONFIG_EXYNOS_AFM=m
CONFIG_EXYNOS_MPAM_ARCH=m
CONFIG_EXYNOS_MPAM_POLICY=m

# EMS
CONFIG_VENDOR_NR_CPUS=10
CONFIG_SCHED_CLUSTER=y
CONFIG_SCHED_EMS=m
CONFIG_SCHED_EMS_FREQ_SELECT=y
CONFIG_SCHED_EMS_CORE_SELECT=y
CONFIG_SCHED_EMS_IDLE_SELECT=y
CONFIG_SCHED_EMS_DEBUG=y
CONFIG_SCHED_EMS_PAGO=y
CONFIG_SCHED_EMS_DSU_FREQ_SELECT=y
CONFIG_SCHED_EMS_TASK_GROUP=y

#CPUHP
CONFIG_EXYNOS_CPUHP=m

# CPUIDLE
CONFIG_EXYNOS_CPUPM=m

# CPUFREQ
CONFIG_ARM_EXYNOS_CPU_FREQ=m
CONFIG_ARM_FREQ_QOS_TRACER=m
CONFIG_CPU_FREQ_GOV_ENERGYSTEP=y
CONFIG_CPU_FREQ_GOV_ENERGYAWARE=y
CONFIG_ARM_EXYNOS_DSU_FREQ=m

# DPU
CONFIG_DRM_SAMSUNG_DPU=m
CONFIG_PHY_EXYNOS_MIPI_DSIM=m
CONFIG_DRM_PANEL_SAMSUNG_COMMON=m
CONFIG_DRM_PANEL_SAMSUNG_EMUL=m
# CONFIG_BOARD_EMULATOR is not set
# CONFIG_DRM_SAMSUNG_KUNIT_TEST_DPU_DMA is not set
CONFIG_EXYNOS_DMA_DSIMFC=y
CONFIG_DRM_SAMSUNG_HIBERNATION_EARLY_WAKEUP=y
CONFIG_EXYNOS_PLL_SLEEP=y
# CONFIG_EXYNOS_BIAS_SLEEP is not set
CONFIG_DRM_SAMSUNG_DQE=y
# SVSYNC(_ONOFF) can be enabled only when TE start timing is advanced
CONFIG_EXYNOS_CMD_SVSYNC=y
CONFIG_EXYNOS_DPU_DEBUG_MODE=y

CONFIG_DRM=y

# SGPU
CONFIG_DRM_SGPU=m
CONFIG_DRM_SGPU_DVFS=y
CONFIG_DRM_SGPU_AFM=y
CONFIG_DRM_SGPU_WORKTIME=y
CONFIG_DRM_SGPU_EXYNOS=y
CONFIG_DRM_SGPU_VENDOR_HOOKS=y
CONFIG_DRM_SGPU_BPMD=y
CONFIG_DRM_SGPU_BPMD_OUTPUT_DEFAULT="/data/local/tmp"
CONFIG_DRM_SGPU_BPMD_MEMLOGGER_TEXT=y
CONFIG_DRM_AMDGPU_DUMP=n

# PMIC
CONFIG_MFD_SAMSUNG_PMIC=m
CONFIG_REGULATOR_SAMSUNG_PMIC=m
CONFIG_KEYBOARD_SAMSUNG_PMIC=m
CONFIG_PINCTRL_SAMSUNG_PMIC=m
CONFIG_RTC_SAMSUNG_PMIC=m
CONFIG_ADC_SAMSUNG_PMIC=m
CONFIG_DRV_SAMSUNG_PMIC=m

#UFS
CONFIG_SCSI_UFS_EXYNOS=m
CONFIG_SCSI_UFS_EXYNOS_FMP=y

#RPMB
CONFIG_UFS_SRPMB=m
CONFIG_SCSI_UFS_EXYNOS_SRPMB=y

#PCIE
CONFIG_PCI_EXYNOS=m
CONFIG_PCI_EXYNOS=m
CONFIG_PCI_EXYNOS_PHYCAL=m
CONFIG_PCI_EXYNOS_PHYCAL_DEBUG=m
CONFIG_PCIE_EXYNOS_DWPHY=m
CONFIG_EXYNOS_PCIE_IOMMU=m
CONFIG_EXYNOS_PHYCAL_IF=m
# CONFIG_PCIE_IOMMU_HISTORY_LOG=m

# DEBUG
# CONFIG_PRINTK_CALLER is not set
CONFIG_PRINTK_PROCESS=y
CONFIG_EXYNOS_DEBUG=y
CONFIG_DEBUG_SNAPSHOT=m
CONFIG_DEBUG_SNAPSHOT_NR_CPUS=10
CONFIG_DEBUG_SNAPSHOT_DEBUG_KINFO=m
CONFIG_EXYNOS_DEBUG_TEST=m
CONFIG_EXYNOS_CORESIGHT=m
CONFIG_EXYNOS_ECC_HANDLER=m
CONFIG_EXYNOS_HARDLOCKUP_WATCHDOG=m
CONFIG_EXYNOS_ITMON_V2=m
CONFIG_EXYNOS_SSLD=m
CONFIG_EXYNOS_GETCPUSTATE=m
CONFIG_EXYNOS_MEMORY_LOGGER=m
CONFIG_EXYNOS_SYSTEM_EVENT=m
CONFIG_EXYNOS_IMGLOADER=m
CONFIG_EXYNOS_ADV_TRACER=m
CONFIG_EXYNOS_ADV_TRACER_S2D=m
CONFIG_EXYNOS_EHLD=m
CONFIG_EXYNOS_PED=m

# CHUB
CONFIG_CHUB_PMUCAL=m

# USB
CONFIG_USB_DWC3_EXYNOS_MODULE=m
CONFIG_EXYNOS_USBDRD_PHY30=y
CONFIG_USB_XHCI_EXYNOS=m
CONFIG_USB_CONFIGFS_F_DM=m
CONFIG_USB_CONFIGFS_RNDIS=y
CONFIG_USB_USE_IOCOHERENCY=m
CONFIG_SND_EXYNOS_USB_AUDIO_MODULE=m
CONFIG_SND_EXYNOS_USB_AUDIO_GIC=y
CONFIG_SND_EXYNOS_USB_AUDIO=y
CONFIG_PHY_EXYNOS_USBDRD_EUSB=m
CONFIG_PHY_SAMSUNG_USB_CAL=y

# BTS
CONFIG_EXYNOS_BTS=m

# PDMA
CONFIG_SAMSUNG_PDMA=m

# PWM
CONFIG_PWM_SAMSUNG=m

# DEVFREQ/DM/DTM
CONFIG_ACPM_DVFS=m
CONFIG_EXYNOS_ESCA_DVFS_MANAGER=m
CONFIG_ARM_EXYNOS_DEVFREQ=m
CONFIG_ARM_EXYNOS_DEVFREQ_DEBUG=m
# CONFIG_EXYNOS_ALT_DVFS is not set
CONFIG_EXYNOS_LEALT_DVFS=m
CONFIG_ECT=m
CONFIG_EXYNOS_PM_QOS=m
CONFIG_EXYNOS_THERMAL_V2=m
CONFIG_EXYNOS_ACPM_THERMAL=m
CONFIG_EXYNOS_ESCA_THERMAL=m
CONFIG_EXYNOS_CPU_THERMAL=m
CONFIG_GPU_THERMAL=m
CONFIG_DEV_THERMAL=m
CONFIG_ISP_THERMAL=m
CONFIG_EXYNOS_AMB_CONTROL=m
CONFIG_EXYNOS_MCINFO=m

# SCI
CONFIG_EXYNOS_SCI=m
CONFIG_EXYNOS_SCI_DBG=m

# NPU
CONFIG_VISION_CORE=y
CONFIG_VISION_SUPPORT=y
CONFIG_EXYNOS_NPU=m
CONFIG_NPU_MAILBOX_VERSION=10
CONFIG_NPU_COMMAND_VERSION=12
CONFIG_NPU_NCP_VERSION=27
CONFIG_NPU_INTERFACE=y
CONFIG_NPU_HARDWARE=y
CONFIG_NPU_USE_MAILBOX_GROUP=n
CONFIG_NPU_USE_HW_DEVICE=y
CONFIG_NPU_USE_BOOT_IOCTL=y
CONFIG_NPU_USE_LLC=y
CONFIG_NPU_USE_LLC_PRESET=y
CONFIG_NPU_USE_PI_DTM=y
CONFIG_NPU_USE_PI_DTM_DEBUG=y
CONFIG_NPU_SET_DNC_FREQ=y
CONFIG_DSP_USE_VS4L=y
#CONFIG_NPU_USE_VOTF=y
CONFIG_NPU_STM=y
CONFIG_NPU_USE_UTIL_STATS=y
CONFIG_NPU_USE_IMB_ALLOCATOR=y
CONFIG_NPU_IMB_ASYNC_ALLOC=y
CONFIG_NPU_NUM_CORES=2
CONFIG_NPU_IMB_THRESHOLD=y
CONFIG_NPU_USE_FENCE_SYNC=y
CONFIG_NPU_USE_ASYNC=y
CONFIG_NPU_USE_IFD=n
CONFIG_NPU_AFM=y
CONFIG_NPU_GOVERNOR=y

# STM
CONFIG_CORESIGHT=y
CONFIG_CORESIGHT_LINK_AND_SINK_TMC=y
CONFIG_CORESIGHT_CATU=y
CONFIG_CORESIGHT_SINK_TPIU=y
CONFIG_CORESIGHT_SINK_ETBV10=y
CONFIG_CORESIGHT_STM=y
CONFIG_STM_PROTO_BASIC=y

# MULTIMEDIA
CONFIG_VIDEO_EXYNOS_SCALER=m
CONFIG_VIDEO_EXYNOS_SMFC=m
CONFIG_VIDEO_EXYNOS_MFC=m
CONFIG_VIDEO_EXYNOS_TSMUX=m
CONFIG_VIDEO_EXYNOS_REPEATER=m

# CAMERA
CONFIG_VIDEO_EXYNOS_PABLO_ISP=m
CONFIG_VIDEO_EXYNOS_CAMERA_POSTPROCESS=m
CONFIG_VIDEO_EXYNOS_CAMERA_POSTPROCESS_GDC=m
CONFIG_VIDEO_EXYNOS_PABLO_LIB_VOTF=m
CONFIG_CAMERA_PP_GDC_V12_0_0_OBJ=m
CONFIG_CAMERA_DVFS_V2=y
CONFIG_PABLO_OBTE_SUPPORT=m
CONFIG_PHY_EXYNOS_MIPI=m

# BCM
CONFIG_EXYNOS_BCM_DBG=m

# EXYNOS HYPERVISOR
CONFIG_EXYNOS_EL2=m
CONFIG_EXYNOS_S2MPU=m
CONFIG_EXYNOS_HYP=y
CONFIG_EXYNOS_HYP_MODULE=m

# XPERF
CONFIG_EXYNOS_PERF=m

# WLBT
CONFIG_CFG80211=m
CONFIG_SCSC_CORE_CM=m
CONFIG_SCSC_CORE=m
CONFIG_SCSC_INDEPENDENT_SUBSYSTEM=m
CONFIG_SCSC_WLBT_CONFIG_PLATFORM="paean_s630a_root_erd_dualfem"
CONFIG_SCSC_PLATFORM=m
CONFIG_SCSC_CM_MX_CLIENT_TEST=y
CONFIG_SCSC_MMAP=m
CONFIG_SCSC_QOS=n
CONFIG_SCSC_MXLOGGER=y
CONFIG_SCSC_SMAPPER=n
CONFIG_SCSC_DEBUG=n
CONFIG_SCSC_DBG_SAMPLER=n
CONFIG_SCSC_WLAN=m
CONFIG_SCSC_WLAN_MAX_INTERFACES=13
CONFIG_SCSC_WLAN_SUPPORT_6G=y
CONFIG_SCSC_MX450_GDB_SUPPORT=y
CONFIG_SCSC_PRINTK=y
CONFIG_SCSC_CORE_FW_LOCATION="/vendor/etc/wifi"
CONFIG_SCSC_DEBUG_COMPATIBILITY=y
CONFIG_SCSC_LOGRING=m
CONFIG_SCSC_LOG_COLLECTION=m
CONFIG_SCSC_WLBTD=y
#CONFIG_SCSC_FM=n
#CONFIG_SCSC_FM_TEST=n
CONFIG_SCSC_STATIC_RING=y
CONFIG_SCSC_STATIC_RING_SIZE=4194304
CONFIG_SCSC_WIFILOGGER=y
CONFIG_SCSC_WLAN_WIFI_SHARING=y
CONFIG_SCSC_WLAN_SAE_CONFIG=y
#CONFIG_SCSC_WLAN_ENABLE_MAC_RANDOMISATION=y
CONFIG_SCSC_WLAN_SINGLE_ANTENNA is not set
CONFIG_SCSC_WIFI_NAN_ENABLE=y
CONFIG_SCSC_WLAN_OCE=y
CONFIG_SCSC_WLAN_RTT=y
CONFIG_SCSC_COMMON_HCF=y
# CONFIG_SCSC_FLASH_SERVICE_ON_BOOT is not set
CONFIG_WLBT_WARN_ON=y
# CONFIG_SCSC_BT is not set
CONFIG_SCSC_QOS=y
CONFIG_SCSC_WLAN_RX_NAPI_GRO=y
CONFIG_SCSC_WLAN_HE=y
CONFIG_SCSC_WLAN_SAP_POWER_SAVE=y
CONFIG_SCSC_WLAN_MHS_STATIC_INTERFACE=y
CONFIG_SCSC_WLAN_ANDROID=y
# CONFIG_SCSC_LOGRING_DEBUGFS is not set
# CONFIG_SCSC_WIFILOGGER_DEBUGFS is not set
CONFIG_SCSC_MEMLOG=n
CONFIG_SCSC_PCIE=n
CONFIG_SCSC_LAST_PANIC_IN_DRAM=y
# CONFIG_SCSC_BT_BLUEZ is not set
# CONFIG_SCSC_BT_ADDRESS_IN_FILE is not set
CONFIG_SCSC_BT_ADDRESS_FILENAME="/mnt/vendor/efs/bluetooth/bt_addr"
CONFIG_SLSI_BT=m
CONFIG_SLSI_BT_USE_UART_INTERFACE=y
#CONFIG_SLSI_BT_USE_MIF_INTERFACE is not set
CONFIG_SLSI_BT_TTY_DEVICE_NAME="ttySAC1"
CONFIG_SLSI_BT_TTY_BAUD_RATE=4800000
CONFIG_SLSI_BT_H4=y
CONFIG_SLSI_BT_BCSP=y
#CONFIG_SLSI_BT_3WUTL is not set
#CONFIG_SLSI_BT_ADDRESS_IN_FILE is not set

# NFC
CONFIG_NFC=m
CONFIG_SEC_NFC=m
CONFIG_SEC_NFC_PRODUCT_N5=y
CONFIG_SEC_NFC_IF_I2C=y
#CONFIG_SEC_NFC_DEDICATED_CLK=y
CONFIG_SEC_NFC_PMIC_LDO=y

# MHDVFS
CONFIG_SAMSUNG_MHDVFS=m
CONFIG_HTS=m

# TCP congestion control
CONFIG_TCP_CONG_ADVANCED=y
CONFIG_TCP_CONG_BIC=y
CONFIG_TCP_CONG_WESTWOOD=y
CONFIG_TCP_CONG_HTCP=y
CONFIG_DEFAULT_BIC=y
```
