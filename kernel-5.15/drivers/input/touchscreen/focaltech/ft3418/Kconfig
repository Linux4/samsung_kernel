## kernel/arch/arm64/configs/s5e9945-bazel_defconfig
```kconfig
#
# please don't remove new line on this file
#

# SGPU
CONFIG_DRM_SGPU_EMULATOR_WORKAROUND=n

# IFPMIC
# CONFIG_MFD_SAMSUNG_IFPMIC is not set
# CONFIG_PWR_SAMSUNG_IFPMIC is not set
# CONFIG_FLED_SAMSUNG_IFPMIC is not set
# CONFIG_MUIC_SAMSUNG_IFPMIC is not set
# CONFIG_TYPEC_SAMSUNG_IFPMIC is not set

# CONFIG_USE_S2M_MUIC is not set
# CONFIG_MUIC_SYSFS is not set
# CONFIG_MUIC_CORE is not set
# CONFIG_MUIC_MANAGER is not set
# CONFIG_MUIC_S2MF301 is not set
# CONFIG_MUIC_SUPPORT_CCIC is not set
# CONFIG_MUIC_SUPPORT_PRSWAP is not set
# CONFIG_S2MF301_MUIC_SDP_OVP_OFF is not set

CONFIG_SND_SOC_SAMSUNG_EXYNOS9945_AUDIO=m

# CONFIG_USE_S2M_PDIC is not set
# CONFIG_PDIC_S2MF301 is not set
# CONFIG_PDIC_AUDIO_ACC is not set
# CONFIG_CHECK_CTYPE_SIDE is not set
# CONFIG_SUPPORT_USB_TYPEC_OPS is not set
# CONFIG_PDIC_SUPPORT_DP is not set
# CONFIG_PDIC_PD30 is not set

# CONFIG_IFCONN_NOTIFIER_MODULE is not set
# CONFIG_IFCONN_NOTIFIER is not set
# CONFIG_IFCONN_MANAGER is not set

# CONFIG_FUELGAUGE_S2MF301 is not set
# CONFIG_CHARGER_S2MF301 is not set
# CONFIG_MFD_S2MF301 is not set
# CONFIG_LEDS_S2MF301_FLASH is not set
# CONFIG_PM_S2MF301 is not set
# CONFIG_MANAGER_S2M_CHARGER is not set
# CONFIG_S2M_THERMAL is not set
# CONFIG_TOP_S2MF301 is not set
# CONFIG_TOP_S2MF301_SUPPORT_S2MC501 is not set
# CONFIG_CHARGER_S2MC501 is not set
# CONFIG_DIRECT_CHARGER is not set
# CONFIG_SYSFS_S2MF301 is not set


# Samsung Mobile Power Management
CONFIG_PM_DEBUG=y
CONFIG_SEC_PM=y
CONFIG_FOTA_LIMIT=y
CONFIG_SEC_PM_DEBUG=m
CONFIG_SEC_PM_THERMISTOR=m
CONFIG_SEC_PM_SMPL_WARN=m

# PMIC
CONFIG_MFD_S2MPS27=m
CONFIG_REGULATOR_S2MPS27=m
CONFIG_KEYBOARD_S2MPS27=m
CONFIG_RTC_DRV_S2MPS27=m
CONFIG_S2MPS27_ADC=m
CONFIG_MFD_S2MPS28=m
CONFIG_MFD_S2MPS28_2=m
CONFIG_MFD_S2MPS28_3=m
CONFIG_MFD_S2MPS28_4=m
CONFIG_MFD_S2MPS28_5=m
CONFIG_REGULATOR_S2MPS28=m
CONFIG_REGULATOR_S2MPS28_2=m
CONFIG_REGULATOR_S2MPS28_3=m
CONFIG_REGULATOR_S2MPS28_4=m
CONFIG_REGULATOR_S2MPS28_5=m
CONFIG_PINCTRL_SAMSUNG_S2MPS28=m
CONFIG_PINCTRL_SAMSUNG_S2MPS28_2=m
CONFIG_PINCTRL_SAMSUNG_S2MPS28_3=m
CONFIG_PINCTRL_SAMSUNG_S2MPS28_4=m
CONFIG_PINCTRL_SAMSUNG_S2MPS28_5=m
CONFIG_MFD_S2MPM07_9945=m
CONFIG_REGULATOR_S2MPM07_9945=m
CONFIG_PINCTRL_SAMSUNG_S2MPM07_9945=m
CONFIG_MFD_S2MPA05_9945=m
CONFIG_REGULATOR_S2MPA05_9945=m
CONFIG_PINCTRL_SAMSUNG_S2MPA05_9945=m
CONFIG_MFD_S2MPB02=m
CONFIG_REGULATOR_S2MPB02=m
CONFIG_REGULATOR_S2MPB03=m
CONFIG_REGULATOR_S2DOS05=m

# CHUB
CONFIG_NANOHUB=m
CONFIG_SENSOR_DRV=y

# USB
CONFIG_GKI_USB=y
CONFIG_USB_CONFIGFS_F_SS_MON_GADGET=m
CONFIG_USB_CONFIGFS_F_CONN_GADGET=m

# SEC COMMON
CONFIG_DRV_SAMSUNG=m
CONFIG_SEC_BOOTSTAT=m
CONFIG_SEC_KEY_NOTIFIER=m
CONFIG_SEC_PMIC_PWRKEY_DTNAME="s2mps27-keys"

# KNOX-DDAR
CONFIG_DDAR=y

# KNOX-ZT
CONFIG_KZT=y

# CPIF/GNSSIF
CONFIG_EXYNOS_MODEM_IF=m
CONFIG_SEC_MODEM_S5000AP=m
CONFIG_EXYNOS_CPIF_IOMMU_V9=m
CONFIG_CP_PKTPROC=m
CONFIG_CP_PKTPROC_LRO=m
CONFIG_CP_PKTPROC_UL=m
CONFIG_MODEM_IF_QOS=m
CONFIG_CP_BTL=m
# CONFIG_CP_LLC is not set
CONFIG_HW_REV_DETECT=m
CONFIG_CPIF_TP_MONITOR=m
CONFIG_REINIT_VSS=m
CONFIG_VERIFY_VSS=m
CONFIG_CPIF_DIRECT_DM=m
CONFIG_CPIF_VENDOR_HOOK=m
CONFIG_CH_EXTENSION=m
CONFIG_GNSS_PMUCAL=m
CONFIG_EXYNOS_GNSS_IF=m
# CONFIG_CP_UART_NOTI is not set
CONFIG_CP_RESET_NOTI=y

# DRM Displayport
CONFIG_DRM_SAMSUNG_DP=y
CONFIG_SEC_DISPLAYPORT=y
CONFIG_USE_DISPLAYPORT_PDIC_EVENT_QUEUE=y
CONFIG_SEC_DISPLAYPORT_EXT_FUNCTION=m
CONFIG_SEC_DISPLAYPORT_LOGGER=y
CONFIG_SEC_DISPLAYPORT_BIGDATA=y
CONFIG_HDCP2_FUNC_TEST_MODE=y

# DEBUG_SNAPSHOT
CONFIG_DEBUG_SNAPSHOT_API=y

# Bluetooth
CONFIG_BT=m
CONFIG_MSM_BT_POWER=m

# Modem Interface
CONFIG_LINK_DEVICE_WITH_SBD_ARCH=m

# Network Feature
CONFIG_INET6_AH=y
CONFIG_IP_NF_MATCH_AH=y
CONFIG_IP_NF_MATCH_RPFILTER=y

# NFC
# CONFIG_SEC_NFC is not set
# CONFIG_SEC_NFC_PRODUCT_N5 is not set
# CONFIG_SEC_NFC_IF_I2C is not set
# CONFIG_SEC_NFC_DEDICATED_CLK is not set
# CONFIG_SEC_NFC_PMIC_LDO is not set

# block layer
CONFIG_BLK_SEC_COMMON=m
CONFIG_BLK_SEC_STATS=m
CONFIG_BLK_SEC_WB=m
CONFIG_MQ_IOSCHED_SSG=m
CONFIG_MQ_IOSCHED_SSG_CGROUP=m
CONFIG_MQ_IOSCHED_SSG_WB=m

# UFS
CONFIG_SEC_UFS_FEATURE=y

# WiFi
CONFIG_SCSC_CORE_CM=n
CONFIG_SCSC_CORE=n
CONFIG_SCSC_INDEPENDENT_SUBSYSTEM=n
CONFIG_SCSC_WLBT_CONFIG_PLATFORM="paean_s630a_root_erd_dualfem"
CONFIG_SCSC_PLATFORM=n
CONFIG_SCSC_CM_MX_CLIENT_TEST=n
CONFIG_SCSC_MMAP=n
CONFIG_SCSC_QOS=n
CONFIG_SCSC_MXLOGGER=n
CONFIG_SCSC_SMAPPER=n
CONFIG_SCSC_DEBUG=n
CONFIG_SCSC_DBG_SAMPLER=n
CONFIG_SCSC_WLAN=n
CONFIG_SCSC_WLAN_MAX_INTERFACES=13
CONFIG_SCSC_WLAN_SUPPORT_6G=n
CONFIG_SCSC_MX450_GDB_SUPPORT=n
CONFIG_SCSC_PRINTK=n
CONFIG_SCSC_CORE_FW_LOCATION="/vendor/etc/wifi"
CONFIG_SCSC_DEBUG_COMPATIBILITY=n
CONFIG_SCSC_LOGRING=n
CONFIG_SCSC_LOG_COLLECTION=n
CONFIG_SCSC_WLBTD=n
#CONFIG_SCSC_FM=n
#CONFIG_SCSC_FM_TEST=n
CONFIG_SCSC_STATIC_RING=n
CONFIG_SCSC_STATIC_RING_SIZE=4194304
CONFIG_SCSC_WIFILOGGER=n
CONFIG_SCSC_WLAN_WIFI_SHARING=n
CONFIG_SCSC_WLAN_SAE_CONFIG=n
#CONFIG_SCSC_WLAN_ENABLE_MAC_RANDOMISATION=n
CONFIG_SCSC_WLAN_SINGLE_ANTENNA is not set
CONFIG_SCSC_WIFI_NAN_ENABLE=n
CONFIG_SCSC_WLAN_RTT=n
CONFIG_SCSC_COMMON_HCF=n
# CONFIG_SCSC_FLASH_SERVICE_ON_BOOT is not set
CONFIG_WLBT_WARN_ON=n
# CONFIG_SCSC_BT is not set
CONFIG_SCSC_QOS=n
CONFIG_SCSC_WLAN_RX_NAPI_GRO=n
CONFIG_SCSC_WLAN_HE=n
CONFIG_SCSC_WLAN_SAP_POWER_SAVE=n
CONFIG_SCSC_WLAN_MHS_STATIC_INTERFACE=n
CONFIG_SCSC_WLAN_ANDROID=n
# CONFIG_SCSC_LOGRING_DEBUGFS is not set
# CONFIG_SCSC_WIFILOGGER_DEBUGFS is not set
CONFIG_SCSC_MEMLOG=n
CONFIG_SCSC_PCIE=n
CONFIG_SCSC_LAST_PANIC_IN_DRAM=n
# CONFIG_SCSC_BT_BLUEZ is not set
# CONFIG_SCSC_BT_ADDRESS_IN_FILE is not set
CONFIG_SCSC_BT_ADDRESS_FILENAME="/mnt/vendor/efs/bluetooth/bt_addr"
CONFIG_SLSI_BT=n
CONFIG_SLSI_BT_USE_UART_INTERFACE=n
#CONFIG_SLSI_BT_USE_MIF_INTERFACE is not set
CONFIG_SLSI_BT_TTY_DEVICE_NAME="ttySAC1"
CONFIG_SLSI_BT_TTY_BAUD_RATE=4800000
CONFIG_SLSI_BT_H4=n
CONFIG_SLSI_BT_BCSP=n
#CONFIG_SLSI_BT_3WUTL is not set
#CONFIG_SLSI_BT_ADDRESS_IN_FILE is not set

CONFIG_EXYNOS_CMD_SVSYNC=n

# uH
CONFIG_UH=y
CONFIG_RKP=y
# CONFIG_RKP_TEST is not set
CONFIG_KDP=y
CONFIG_KDP_CRED=y
# CONFIG_KDP_NS is not set
CONFIG_NVHE_STACK_SHIFT=13

# SEC_PRODUCT_FEATURE_KNOX_SUPPORT_NPA {
CONFIG_KNOX_NCM=y
# SEC_PRODUCT_FEATURE_KNOX_SUPPORT_NPA }

# DAMON configs
CONFIG_DAMON=y
CONFIG_DAMON_PADDR=y
CONFIG_DAMON_RECLAIM=y

#freecess
CONFIG_SAMSUNG_FREECESS=y

# FIPS
CONFIG_CRYPTO_SKC_FIPS=y

# KNOX ER
CONFIG_NGKSM=y
CONFIG_NGKPAD=y
CONFIG_HDM=m

#
# please don't remove new line on this file
#
####[LEGO-START] DO NOT SUBMIT

CONFIG_SEC_PANEL_NOTIFIER_V2=m
CONFIG_USB_TYPEC_MANAGER_NOTIFIER=m
CONFIG_IF_CB_MANAGER=m
CONFIG_SBU_SWITCH_CONTROL=y
CONFIG_DEV_RIL_BRIDGE=m
CONFIG_SECURITY_DEFEX=y
CONFIG_INPUT_SEC_INPUT=m
CONFIG_INPUT_SEC_NOTIFIER=m
CONFIG_SEC_DEBUG_TSP_LOG=m
CONFIG_TOUCHSCREEN_DUMP_MODE=m
# CONFIG_INPUT_SEC_SECURE_TOUCH is not set
# CONFIG_INPUT_SEC_TRUSTED_TOUCH is not set
CONFIG_INPUT_TOUCHSCREEN_TCLMV2=m
# CONFIG_SEC_INPUT_MULTI_DEVICE is not set
# CONFIG_SEC_INPUT_RAWDATA is not set
CONFIG_USDM_PANEL_OLED_COMMON=m
CONFIG_USDM_PANEL_ANA6710=m
CONFIG_MUIC_NOTIFIER=m
CONFIG_HICCUP_CHARGER=y
CONFIG_MUIC_AFC_RETRY=y
CONFIG_MUIC_HV=y
CONFIG_MUIC_SUPPORT_PDIC=y
CONFIG_MUIC_USE_MODULE_PARAM=y
CONFIG_USE_MUIC=y
CONFIG_ANDROID_SWITCH=m
# CONFIG_ANDROID_SWITCH_GPIO is not set
CONFIG_SEC_DEBUG=m
CONFIG_WIRELESS_CHARGER_STWLC89=m
CONFIG_WIRELESS_AUTH=y
CONFIG_WIRELESS_CHARGER_HIGH_VOLTAGE=y
CONFIG_WIRELESS_TX_MODE=y
CONFIG_WIRELESS_FIRMWARE_UPDATE=y
CONFIG_WIRELESS_IC_PARAM=y
CONFIG_TX_GEAR_PHM_VOUT_CTRL=y
CONFIG_WIRELESS_RX_PHM_CTRL=y
CONFIG_SEC_NFC_LOGGER=y
CONFIG_SECURITY_KUMIHO=y
CONFIG_SECURITY_DSMS=y
CONFIG_SEC_INPUT_BOOSTER=m
CONFIG_SEC_INPUT_BOOSTER_MODE=y
CONFIG_SEC_INPUT_BOOSTER_SLSI=y
CONFIG_SEC_INPUT_BOOSTER_HANDLER=y
CONFIG_SDP=m
CONFIG_VBUS_NOTIFIER=m
CONFIG_SUPPORT_DROPDUMP=m
CONFIG_SEC_REBOOT=m
CONFIG_VIBRATOR_VIB_INFO=m
CONFIG_SEC_STI=y
CONFIG_SENSORS_FLICKER_SELF_TEST=m
CONFIG_NANOHUB=m
CONFIG_SENSOR_DRV=n
CONFIG_SHUB_PANEL_NOTIFY=y
CONFIG_SHUB_MODULE=y
CONFIG_SB_CORE=m
CONFIG_SB_PQUEUE=y
CONFIG_SB_NOTIFY=y
CONFIG_SB_SYSFS=y
CONFIG_SB_VOTE=y
CONFIG_SEC_KQ_MESH=m
CONFIG_KPERFMON=y
CONFIG_KPERFMON_BUILD=m
CONFIG_SEC_VIBRATOR_INPUTFF=m
# CONFIG_SEC_VIB_FOLD_MODEL is not set
CONFIG_USB_NOTIFY_LAYER=m
CONFIG_USB_AUDIO_ENHANCED_DETECT_TIME=y
CONFIG_USB_DEBUG_DETAILED_LOG=y
CONFIG_USB_EXTERNAL_NOTIFY=y
CONFIG_USB_HMT_SAMSUNG_INPUT=y
CONFIG_USB_HOST_CERTI=y
CONFIG_USB_HOST_NOTIFY=y
CONFIG_USB_HOST_SAMSUNG_FEATURE=y
CONFIG_USB_HW_PARAM=y
CONFIG_USB_INTERFACE_LPM_LIST=y
CONFIG_USB_NOTIFY_PROC_LOG=y
CONFIG_USB_USING_ADVANCED_USBLOG=y
CONFIG_DRV_SAMSUNG_PMIC=m
CONFIG_USB_VENDOR_NOTIFY=y
CONFIG_USB_VENDOR_RECEIVER=m
CONFIG_SENSORS_FINGERPRINT=m
CONFIG_CHARGER_MAX77775=m
CONFIG_SHIPMODE_BY_VBAT=y
CONFIG_USB_REPEATER=m
CONFIG_SEC_ABC_SPEC_TYPE1=m
CONFIG_PDIC_NOTIFIER=m
CONFIG_PDIC_USE_MODULE_PARAM=y
CONFIG_DRM_PANEL_MCD_COMMON=m
# CONFIG_DRM_PANEL_SAMSUNG_COMMON is not set
CONFIG_USDM_PANEL_JSON=y
CONFIG_USB_NOTIFIER=m
CONFIG_SEC_ABC=m
CONFIG_SEC_ABC_HUB=m
CONFIG_SEC_ABC_COMMON=m
CONFIG_SEC_ABC_HUB_CORE=m
CONFIG_SEC_ABC_HUB_BOOTC=m
CONFIG_SEC_ABC_MOTTO=m
CONFIG_USB_REPEATER_PTN3222=m
CONFIG_REGULATOR_DIO8018=m
CONFIG_INPUT_HALL_IC=m
CONFIG_HALL_NOTIFIER=m
CONFIG_HALL_LOGICAL=m
# CONFIG_HALL_DUMP_KEY_MODE is not set
CONFIG_INPUT_AW8624X_HAPTIC=m
CONFIG_AW8624X_SAMSUNG_FEATURE=y
CONFIG_USB_REPEATER_TUSB2E11=m
CONFIG_CHARGER_NU2111A=m
CONFIG_MFD_MAX77775=m
CONFIG_SENSORS_STK6D2X=m
CONFIG_BATTERY_AUTH_DS28E30=m
CONFIG_DIRECT_CHARGING=m
CONFIG_FUELGAUGE_MAX77775=m
CONFIG_UI_SOC_PROLONGING=y
CONFIG_IIO=y
CONFIG_IIO_BUFFER=y
CONFIG_SHUB=m
CONFIG_BATTERY_AUTH_SLE956681=m
CONFIG_CCIC_MAX77775=m
CONFIG_MAX77775_CCIC_ALTERNATE_MODE=y
CONFIG_MAX77775_GET_UNMASK_VBUS_HWPARAM=y
CONFIG_TOUCHSCREEN_GOODIX_BRL=m
CONFIG_SENSORS_GW9558X=m
CONFIG_SENSORS_FINGERPRINT_MODULE=y
CONFIG_FINGERPRINT_SECURE=y
CONFIG_SENSORS_FINGERPRINT_LSI=y
CONFIG_SENSORS_FINGERPRINT_NORMALSPI=y
CONFIG_SAMSUNG_NFC=m
CONFIG_SEC_MX_NFC=y
# CONFIG_MTK_CLKBUF_NFC is not set
CONFIG_SEC_NFC_WAKELOCK_METHOD=2
# CONFIG_SEC_NFC_DUPLICATED_IRQ_WQ is not set
# CONFIG_SEC_NFC_TEST_ON_PROBE is not set
CONFIG_ESE_P3_LSI=y
CONFIG_ESE_COLDRESET=y
# CONFIG_ESE_USE_REGULATOR is not set
# CONFIG_MAKE_NODE_USING_PLATFORM_DEVICE is not set
CONFIG_TOUCHSCREEN_SYNAPTICS_S3908T_I2C=m
CONFIG_BATTERY_SAMSUNG=m
CONFIG_SEC_PD=m
CONFIG_BATTERY_GKI=y
CONFIG_BATTERY_AGE_FORECAST=y
CONFIG_BATTERY_CISD=y
CONFIG_AFC_CHARGER_MODE=y
CONFIG_BATTERY_LOGGING=y
CONFIG_ENABLE_FULL_BY_SOC=y
CONFIG_STEP_CHARGING=y
CONFIG_SUPPORT_HV_CTRL=y
CONFIG_SUPPORT_SHIP_MODE=y
CONFIG_WIRELESS_CHARGER_CPS4038=m
CONFIG_HV_MUIC_MAX77775_AFC=y
CONFIG_MUIC_MAX77775=y
####[LEGO-END] DO NOT SUBMIT
CONFIG_SND_SOC_CIRRUS_AMP=m
CONFIG_SND_SOC_SAMSUNG_AUDIO=m
CONFIG_SND_SOC_SAMSUNG_ABOX_CHANGE_RMEM_SIZE=y
# CONFIG_SND_SOC_SAMSUNG_EXYNOS_CS35L43_I2C is not set
# CONFIG_SND_SOC_CS35L43_I2C is not set
# CONFIG_SND_SOC_SAMSUNG_EXYNOS_CS40L26_I2C is not set
# CONFIG_SND_SOC_CIRRUS_AMP is not set
CONFIG_SND_SOC_TFA98XX=m
CONFIG_SND_SOC_TFA9878=m
CONFIG_FW_LOADER_USER_HELPER=m
CONFIG_SEC_SND_SYNCHRONIZED_IPC=m
CONFIG_TFA_STEREO_NODE=y
CONFIG_DRM_MCD_COMMON=y
CONFIG_USDM_PANEL=m
CONFIG_USDM_SDP_ADAPTIVE_MIPI=y
# CONFIG_USDM_ADAPTIVE_MIPI is not set
CONFIG_USDM_MDNIE=y
CONFIG_USDM_PANEL_DISPLAY_MODE=y
CONFIG_USDM_PANEL_ID_READ_BY_HSDT=y
CONFIG_USDM_PANEL_ID_READ_REG_04=y
CONFIG_USDM_PANEL_LPM=y
CONFIG_USDM_PANEL_AOD_BL=y
CONFIG_USDM_PANEL_DPUI=y
CONFIG_USDM_PANEL_UEVENT_RECOVERY=y
CONFIG_USDM_FACTORY_DSC_CRC_TEST=y
CONFIG_USDM_FACTORY_CCD_TEST=y
CONFIG_USDM_FACTORY_ECC_TEST=y
CONFIG_USDM_PANEL_BACKLIGHT_PAC_3_0=y
CONFIG_USDM_PANEL_TESTMODE=y
CONFIG_CAMERA_RSX_V12=y
CONFIG_CAMERA_CIS_GN3_OBJ=m
CONFIG_CAMERA_VENDOR_MCD=y
CONFIG_CAMERA_CIS_3L6_OBJ=m
CONFIG_CAMERA_CIS_3J1_OBJ=m
CONFIG_CAMERA_CIS_OV08A10_OBJ=m
CONFIG_CAMERA_CIS_IMX374_OBJ=m
CONFIG_CAMERA_ACT_AK737X_OBJ=m
CONFIG_LEDS_AW36518_FLASH=m
CONFIG_CAMERA_FLASH_AW36518_OBJ=m
CONFIG_AF_HOST_CONTROL=y
CONFIG_OIS_USE=y
CONFIG_CAMERA_USE_INTERNAL_MCU=y
CONFIG_CAMERA_HW_BIG_DATA=y
# CONFIG_TRUSTONIC_TEE is not set
# CONFIG_TRUSTONIC_TRUSTED_UI is not set
# CONFIG_SECURE_OS_CONTROL is not set
# CONFIG_SECURE_OS_BOOSTER_API is not set
# CONFIG_TZ_NWFS is not set
# CONFIG_TZDEV_BOOST is not set
# CONFIG_ION_FD2PHYS is not set
# CONFIG_TZDEV_DEPLOY_TZAR is not set
# CONFIG_TZDEV_TEST is not set
# CONFIG_TZDEV_CPUFREQ_TRANSITION is not set
CONFIG_TZDEV_USE_ARM_CALLING_CONVENTION=y
CONFIG_TZDEV=m
CONFIG_TZDEV_IWI_EVENT=260
CONFIG_TZDEV_IWI_PANIC=261
CONFIG_TZIRS=y
CONFIG_TZLOG=y
CONFIG_TZLOG_PG_CNT=8
CONFIG_TZ_BOOT_LOG=y
CONFIG_TZ_BOOT_LOG_PG_CNT=1
CONFIG_TZ_TRANSPORT=y
CONFIG_TZ_TRANSPORT_PG_CNT=2
CONFIG_TZDEV_SWD_PANIC_IS_CRITICAL=y
CONFIG_TEEGRIS_VERSION=5
CONFIG_SAMSUNG_GKI_KERNEL=y
CONFIG_TZDEV_SK_MULTICORE=y
CONFIG_SAMSUNG_TUI=m
CONFIG_SAMSUNG_TUI_LOWLEVEL=y
CONFIG_SOC_S5E9945=y
CONFIG_QCOM_QMI_HELPERS=m
CONFIG_CNSS_UTILS=m
CONFIG_WCNSS_MEM_PRE_ALLOC=m
CONFIG_CNSS_GENL=m
CONFIG_CNSS2=m
# CONFIG_CNSS2_DEBUG is not set
CONFIG_CNSS2_QMI=y
CONFIG_CNSS_QMI_SVC=m
CONFIG_CNSS_PLAT_IPC_QMI_SVC=m
CONFIG_MHI_BUS=m
CONFIG_MHI_BUS_DEBUG=y
CONFIG_QRTR_MHI=m
CONFIG_QRTR=m
CONFIG_MHI_BUS_MISC=y
CONFIG_SEC_SS_CNSS_FEATURE_SYSFS=y
CONFIG_CNSS_KIWI_V2=y
CONFIG_QCA_CLD_WLAN=m
CONFIG_BUS_AUTO_SUSPEND=y
CONFIG_IPC_LOGGING=m
CONFIG_NL80211_TESTMODE=y
CONFIG_WLAN_DEBUG=y

CONFIG_F2FS_FS=y

CONFIG_F2FS_FS_SECURITY=y

CONFIG_F2FS_FS_ENCRYPTION=y

CONFIG_F2FS_FS_COMPRESSION=y

CONFIG_EXT4_FS_POSIX_ACL=y

CONFIG_NTFS_FS=y

CONFIG_NTFS_DEBUG=y

CONFIG_NLS=y

CONFIG_EROFS_FS=y

CONFIG_FIVE=y

CONFIG_PROCA=y

CONFIG_PROCA_S_OS=y

CONFIG_PROCA_CERTIFICATES_DB=y

CONFIG_FIVE_GKI_10=y

# CONFIG_FIVE_TEE_DRIVER is not set

# CONFIG_FIVE_PA_FEATURE is not set

CONFIG_GAF_V6=y

CONFIG_SAMSUNG_PRODUCT_SHIP=y


CONFIG_SECURITY_DEFEX_USER=y
```

## kernel/arch/arm64/configs/s5e9945-eng_defconfig
```kconfig
#
# please don't remove new line on this file
#

# SensorHub
CONFIG_SHUB_DEBUG=y
# Power Management
CONFIG_PINCTRL_SEC_GPIO_DVS=m

# Displayport test
CONFIG_SEC_DISPLAYPORT_SELFTEST=y
CONFIG_SEC_DISPLAYPORT_DBG=y

# DDAR KeyManagement Test for MDFPP evaluation
CONFIG_DDAR_KEY_DUMP=y

# Battery driver
CONFIG_ENG_BATTERY_CONCEPT=y

# Debugging
CONFIG_DEBUG_PREEMPT=y
CONFIG_DEBUG_RWSEMS=y
CONFIG_DEBUG_ATOMIC_SLEEP=y

# Memory Debugging
CONFIG_DEBUG_OBJECTS=y
CONFIG_DEBUG_OBJECTS_FREE=y
CONFIG_DEBUG_OBJECTS_TIMERS=y
CONFIG_DEBUG_OBJECTS_WORK=y
CONFIG_DEBUG_OBJECTS_RCU_HEAD=y
CONFIG_DEBUG_OBJECTS_PERCPU_COUNTER=y

# Watchdog Device Drivers
CONFIG_S3C2410_BUILTIN_WATCHDOG=y

# Camera
CONFIG_PABLO_UNIT_TEST=m

#
# please don't remove new line on this file
#
```
