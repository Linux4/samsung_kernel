## kernel/arch/arm64/configs/s5e8845-sec_defconfig
```kconfig
#
# please don't remove new line on this file
#

# SEC COMMON
CONFIG_DRV_SAMSUNG=m
CONFIG_SEC_BOOTSTAT=m
CONFIG_SEC_KEY_NOTIFIER=m

# DEBUG_SNAPSHOT
CONFIG_DEBUG_SNAPSHOT_API=y

# CONFIG_CPIF_VENDOR_HOOK is not set
CONFIG_TOUCHSCREEN_SEC_TS=m

# PMIC
CONFIG_MFD_S2MPU15_8845=m
CONFIG_MFD_S2MPU16_8845=m
CONFIG_REGULATOR_S2MPU15_8845=m
CONFIG_REGULATOR_S2MPU16_8845=m
CONFIG_RTC_DRV_S2MPU15_8845=m
CONFIG_KEYBOARD_S2MPU15_8845=m
CONFIG_S2MPU15_ADC_8845=m
CONFIG_PINCTRL_SAMSUNG_S2MPU15_8845=m
CONFIG_PINCTRL_SAMSUNG_S2MPU16_8845=m

# USB modularization
CONFIG_USB_CONFIGFS_F_SS_MON_GADGET=m
CONFIG_USB_CONFIGFS_F_CONN_GADGET=m

# Samsung Mobile Power Management
CONFIG_PM_DEBUG=y
CONFIG_SEC_PM=y
CONFIG_SEC_PM_DEBUG=m
CONFIG_SEC_WAKEUP_CPU_ALLOCATOR=m

# CPIF/GNSSIF
CONFIG_EXYNOS_MODEM_IF=m
CONFIG_SEC_MODEM_S5000AP=m
CONFIG_EXYNOS_CPIF_IOMMU_V9=m
CONFIG_CP_PKTPROC=m
CONFIG_CP_PKTPROC_UL=m
CONFIG_MODEM_IF_QOS=m
CONFIG_CP_BTL=m
# CONFIG_CP_LLC is not set
CONFIG_HW_REV_DETECT=m
CONFIG_CPIF_TP_MONITOR=m
CONFIG_REINIT_VSS=m
CONFIG_VERIFY_VSS=m
CONFIG_CPIF_DIRECT_DM=m
# CONFIG_CPIF_VENDOR_HOOK is not set
CONFIG_CH_EXTENSION=m
# CONFIG_CP_UART_NOTI is not set
CONFIG_CP_RESET_NOTI=y

# Modem Interface
CONFIG_LINK_DEVICE_WITH_SBD_ARCH=m
CONFIG_CP_PKTPROC_LRO=m

#GNSSIF
CONFIG_GNSS_PMUCAL=m
CONFIG_EXYNOS_GNSS_IF=m

#USB
CONFIG_USB_NOTIFY_LAYER_LSI=y
CONFIG_USB_NOTIFY_LAYER_MODULE=m
CONFIG_USB_NOTIFIER=m

#Audio
# CONFIG_SND_SOC_SAMSUNG_EXYNOS_CS35L43_I2C is not set
CONFIG_SND_SOC_SAMSUNG_EXYNOS8845_AUDIO=m
CONFIG_SND_SOC_SAMSUNG_EXYNOS8845_S5M3700X_I2C=m
CONFIG_SND_SOC_SAMSUNG_EXYNOS_TFA9878=m
CONFIG_SND_SOC_SAMSUNG_EXYNOS_TAS25XX=m
# CONFIG_SND_SOC_CIRRUS_AMP is not set

# CAMERA
CONFIG_CAMERA_VENDOR_MCD=y
#CONFIG_CAMERA_CIS_2LD_OBJ is not set
#CONFIG_CAMERA_CIS_GW2_OBJ is not set
#CONFIG_CAMERA_CIS_2LA_OBJ is not set
#CONFIG_CAMERA_CIS_3L6_OBJ is not set
#CONFIG_CAMERA_FLASH_S2MF301_OBJ is not set
#CONFIG_CAMERA_ACT_AK737X_OBJ is not set

# UFS
CONFIG_SEC_UFS_FEATURE=y

# SD
CONFIG_SEC_MMC_FEATURE=y

#CHUB
CONFIG_NANOHUB=m
CONFIG_SENSOR_DRV=y

# DISPLAY
# CONFIG_EXYNOS_CMD_SVSYNC is not set
# CONFIG_EXYNOS_CMD_SVSYNC_ONOFF is not set

#
# please don't remove new line on this file
#

# I/O
CONFIG_MQ_IOSCHED_SSG=m
CONFIG_MQ_IOSCHED_SSG_CGROUP=m
CONFIG_MQ_IOSCHED_SSG_WB=m
CONFIG_BLK_SEC_STATS=m
CONFIG_BLK_SEC_COMMON=m
CONFIG_BLK_SEC_WB=m

# Network Feature
CONFIG_TCP_CONG_ADVANCED=y
# CONFIG_TCP_CONG_WESTWOOD is not set
# CONFIG_TCP_CONG_HTCP is not set
CONFIG_TCP_CONG_BIC=y
CONFIG_DEFAULT_BIC=y
CONFIG_DEFAULT_TCP_CONG="bic" 

#VOLD ASEC
CONFIG_CRYPTO_TWOFISH=y

# uH
CONFIG_UH=y
CONFIG_RKP=y
CONFIG_KDP=y
CONFIG_KDP_CRED=y
CONFIG_RKP_TEST=y
CONFIG_KDP_TEST=y

# SEC_PRODUCT_FEATURE_KNOX_SUPPORT_NPA {
CONFIG_KNOX_NCM=y
# SEC_PRODUCT_FEATURE_KNOX_SUPPORT_NPA }
#freecess
CONFIG_SAMSUNG_FREECESS=y

##end
####[LEGO-START] DO NOT SUBMIT

CONFIG_SEC_PANEL_NOTIFIER_V2=m
CONFIG_USB_TYPEC_MANAGER_NOTIFIER=m
CONFIG_IF_CB_MANAGER=m
CONFIG_FUELGAUGE_SM5714=m
CONFIG_UI_SOC_PROLONGING=y
CONFIG_USDM_PANEL_OLED_COMMON=m
CONFIG_USDM_PANEL_S6E3FC5=m
CONFIG_DEV_RIL_BRIDGE=m
# CONFIG_SECURITY_DEFEX is not set
CONFIG_USDM_PANEL_ANA6710=m
CONFIG_MUIC_NOTIFIER=m
CONFIG_HICCUP_CC_DISABLE=y
CONFIG_HICCUP_CHARGER=y
CONFIG_MUIC_COMMON_SYSFS=y
CONFIG_MUIC_AFC_RETRY=y
CONFIG_MUIC_HV=y
CONFIG_MUIC_SUPPORT_PDIC=y
CONFIG_MUIC_USE_MODULE_PARAM=y
CONFIG_USE_MUIC=y
CONFIG_ANDROID_SWITCH=m
# CONFIG_ANDROID_SWITCH_GPIO is not set
CONFIG_SEC_DEBUG=m
CONFIG_IIO=y
CONFIG_IIO_BUFFER=y
CONFIG_SHUB=m
CONFIG_SEC_NFC_LOGGER=y
# CONFIG_SECURITY_DSMS is not set
CONFIG_SDP=m
CONFIG_VBUS_NOTIFIER=m
CONFIG_INPUT_SEC_INPUT=m
CONFIG_INPUT_SEC_NOTIFIER=m
CONFIG_SEC_DEBUG_TSP_LOG=m
CONFIG_TOUCHSCREEN_DUMP_MODE=m
# CONFIG_INPUT_SEC_SECURE_TOUCH is not set
# CONFIG_INPUT_SEC_TRUSTED_TOUCH is not set
CONFIG_INPUT_TOUCHSCREEN_TCLMV2=m
# CONFIG_SEC_INPUT_MULTI_DEVICE is not set
CONFIG_SEC_INPUT_RAWDATA=m
CONFIG_MFD_SM5714=m
CONFIG_TOUCHSCREEN_SYNAPTICS_I2C=m
CONFIG_SEC_REBOOT=m
CONFIG_VIBRATOR_VIB_INFO=m
CONFIG_SEC_STI=y
CONFIG_MUIC_PLATFORM=m
CONFIG_HV_MUIC_VOLTAGE_CTRL=y
CONFIG_MUIC_SUPPORT_POWERMETER=y
CONFIG_MUIC_SUPPORT_PRSWAP=y
CONFIG_PDIC_S2MF301=m
CONFIG_S2MF301_PDIC_TRY_SNK=y
CONFIG_S2MF301_TYPEC_WATER=y
CONFIG_SEC_INPUT_BOOSTER=m
CONFIG_SEC_INPUT_BOOSTER_MODE=y
CONFIG_SEC_INPUT_BOOSTER_SLSI=y
CONFIG_SEC_INPUT_BOOSTER_HANDLER=y
CONFIG_SB_CORE=m
CONFIG_SB_PQUEUE=y
CONFIG_SB_NOTIFY=y
CONFIG_SB_SYSFS=y
CONFIG_SB_VOTE=y
CONFIG_SEC_VIBRATOR_INPUTFF=m
# CONFIG_SEC_VIB_FOLD_MODEL is not set
CONFIG_USB_NOTIFY_LAYER=m
CONFIG_USB_DEBUG_DETAILED_LOG=y
CONFIG_USB_EXTERNAL_NOTIFY=y
CONFIG_USB_HMT_SAMSUNG_INPUT=y
CONFIG_USB_HOST_NOTIFY=y
CONFIG_USB_HOST_SAMSUNG_FEATURE=y
CONFIG_USB_HW_PARAM=y
CONFIG_USB_INTERFACE_LPM_LIST=y
CONFIG_USB_NOTIFY_PROC_LOG=y
CONFIG_USB_USING_ADVANCED_USBLOG=y
CONFIG_DRV_SAMSUNG_PMIC=m
CONFIG_NANOHUB=m
CONFIG_SENSOR_DRV=n
CONFIG_SHUB_PANEL_NOTIFY=yCONFIG_SHUB_MODULE=y
CONFIG_SENSORS_FINGERPRINT=m
CONFIG_PDIC_SLSI_NON_MCU=m
CONFIG_PDIC_PD30=y
CONFIG_SUPPORT_USB_TYPEC_OPS=y
CONFIG_S2M_PDIC_MANUAL_RETRY=y
CONFIG_CHARGER_SM5714=m
CONFIG_USB_REPEATER=m
CONFIG_SEC_ABC_SPEC_TYPE1=m
CONFIG_REGULATOR_FIXED_VOLTAGE=y
CONFIG_PDIC_NOTIFIER=m
CONFIG_PDIC_USE_MODULE_PARAM=y
CONFIG_MUIC_SM5714=m
CONFIG_MUIC_BCD_RESCAN=y
CONFIG_DRM_PANEL_MCD_COMMON=m
# CONFIG_DRM_PANEL_SAMSUNG_COMMON is not set
CONFIG_USDM_PANEL_JSON=y
CONFIG_USB_NOTIFIER=m
CONFIG_SEC_ABC=m
CONFIG_SEC_ABC_HUB=m
CONFIG_SEC_ABC_COMMON=m
CONFIG_SEC_ABC_HUB_CORE=m
CONFIG_SEC_ABC_HUB_BOOTC=m
CONFIG_SEC_ABC_MOTTO=m
CONFIG_MFD_S2MF301=m
CONFIG_REGULATOR_DIO8018=m
CONFIG_INPUT_ZM918_HAPTIC=m
CONFIG_CHARGER_SM5461=m
CONFIG_INPUT_HALL_IC=m
CONFIG_HALL_NOTIFIER=m
CONFIG_HALL_LOGICAL=m
# CONFIG_HALL_DUMP_KEY_MODE is not set
CONFIG_SENSORS_EL7XX=m
CONFIG_SENSORS_FINGERPRINT_MODULE=y
CONFIG_FINGERPRINT_SECURE=y
CONFIG_SENSORS_FINGERPRINT_LSI=y
CONFIG_PDIC_SM5714=m
CONFIG_SM5714_FACTORY_MODE=y
CONFIG_USB_REPEATER_PTN3222=m
CONFIG_TOUCHSCREEN_GOODIX_BRL=m
CONFIG_FUELGAUGE_S2MF301=m
CONFIG_FUELGAUGE_S2MF301_USE_5MILLIOHM=y
CONFIG_SEC_PM_THERMISTOR=m
CONFIG_STAR_K250A_LEGO=m
CONFIG_SEC_SNVM_PLATFORM_DRV=y
# CONFIG_SEC_SNVM_I2C_CLOCK_CONTROL is not set
CONFIG_SEC_SNVM_WAKELOCK_METHOD=2
# CONFIG_STAR_MEMORY_LEAK is not set
CONFIG_MUIC_S2MF301=m
CONFIG_HV_MUIC_S2MF301_AFC=y
CONFIG_MUIC_S2MF301_RID=y
CONFIG_TOP_S2MF301=y
CONFIG_SAMSUNG_NFC=m
CONFIG_SEC_MX_NFC=y
# CONFIG_MTK_CLKBUF_NFC is not set
CONFIG_SEC_NFC_WAKELOCK_METHOD=2
# CONFIG_SEC_NFC_DUPLICATED_IRQ_WQ is not set
# CONFIG_SEC_NFC_TEST_ON_PROBE is not set
CONFIG_ESE_P3_LSI=y
CONFIG_ESE_COLDRESET=y
# CONFIG_ESE_USE_REGULATOR is not set
# CONFIG_MAKE_NODE_USING_PLATFORM_DEVICE is not set
CONFIG_LSI_IFPMIC=y
CONFIG_CHARGER_S2MF301=m
CONFIG_PM_S2MF301=m
CONFIG_DIRECT_CHARGING=m
CONFIG_BATTERY_SAMSUNG=m
CONFIG_SEC_PD=m
CONFIG_BATTERY_GKI=y
CONFIG_BATTERY_AGE_FORECAST=y
CONFIG_BATTERY_CISD=y
CONFIG_AFC_CHARGER_MODE=y
CONFIG_BATTERY_LOGGING=y
CONFIG_BATTERY_SAMSUNG_REBOOT=y
CONFIG_ENABLE_FULL_BY_SOC=y
CONFIG_STEP_CHARGING=y
CONFIG_SUPPORT_HV_CTRL=y
####[LEGO-END] DO NOT SUBMIT
```

## kernel/arch/arm64/configs/s5e8845-user_defconfig
```kconfig
# printk and dmesg options
CONFIG_PRINTK_PROCESS=y

# Watchdog Device Drivers
CONFIG_S3C2410_BUILTIN_WATCHDOG=y

#
# please don't remove new line on this file
#
```

## kernel/arch/arm64/configs/s5e8845-userdebug_defconfig
```kconfig
# Power Management
CONFIG_PINCTRL_SEC_GPIO_DVS=m
CONFIG_SEC_PM_REGULATOR=m

# printk and dmesg options
CONFIG_PRINTK_PROCESS=y

# Watchdog Device Drivers
CONFIG_S3C2410_BUILTIN_WATCHDOG=y

# SensorHub
CONFIG_SHUB_DEBUG=y

#
# please don't remove new line on this file
#
```

## kernel/arch/arm64/configs/s5e9935-base_defconfig
```kconfig
# CONFIG_MODULE_SIG_ALL is not set
CONFIG_ARCH_EXYNOS=y
CONFIG_SERIAL_EXYNOS=m
CONFIG_I2C_CHARDEV=m
CONFIG_I2C_EXYNOS5=m
CONFIG_SPI_S3C64XX=m
CONFIG_SPI_SPIDEV=m
CONFIG_PCI_EXYNOS=m
CONFIG_PCI_EXYNOS_PHYCAL=m
CONFIG_PCI_EXYNOS_PHYCAL_DEBUG=m
CONFIG_EXYNOS_PCIE_IOMMU=m
CONFIG_EXYNOS_PHYCAL_IF=m
# CONFIG_PCIE_IOMMU_HISTORY_LOG=m
CONFIG_USI_V2=m
CONFIG_SOC_S5E9935=y
CONFIG_DEBUG_LOCK_ALLOC=y
CONFIG_PINCTRL_SAMSUNG=m
CONFIG_EXYNOS_CHIPID=n
CONFIG_EXYNOS_CHIPID_V2=m
CONFIG_POWER_RESET_EXYNOS=m
CONFIG_CLKSRC_EXYNOS_MCT_V3=m
CONFIG_ARM_GIC_V3_VENDORHOOK=m
CONFIG_S3C2410_WATCHDOG=m
CONFIG_S3C2410_BUILTIN_WATCHDOG=y
CONFIG_S3C2410_SHUTDOWN_REBOOT=y
CONFIG_SND_SOC_SAMSUNG=m
CONFIG_SND_SOC_SAMSUNG_ABOX_DEBUG=y
CONFIG_DEBUG_FS=y
CONFIG_COMPOSITE_CLK_SAMSUNG=m
CONFIG_EXYNOS_PMU_IF=m
CONFIG_EXYNOS_DEBUG=y
CONFIG_DEBUG_SNAPSHOT=m
CONFIG_DEBUG_SNAPSHOT_NR_CPUS=9
CONFIG_DEBUG_SNAPSHOT_DEBUG_KINFO=m
CONFIG_EXYNOS_DEBUG_TEST=m
CONFIG_EXYNOS_CORESIGHT=m
CONFIG_EXYNOS_ECC_HANDLER=m
CONFIG_EXYNOS_HARDLOCKUP_WATCHDOG=m
CONFIG_EXYNOS_ITMON_V2=m
CONFIG_EXYNOS_ADV_TRACER=m
CONFIG_EXYNOS_ADV_TRACER_S2D=m
CONFIG_EXYNOS_EHLD=m
CONFIG_EXYNOS_SSLD=m
CONFIG_EXYNOS_GETCPUSTATE=m
CONFIG_EXYNOS_MEMORY_LOGGER=m
CONFIG_EXYNOS_IMGLOADER=m
CONFIG_EXYNOS_SYSTEM_EVENT=m
CONFIG_CAL_IF=m
CONFIG_CMUCAL_DEBUG=y
CONFIG_EXYNOS_PD=m
CONFIG_EXYNOS_PD_DBG=m
CONFIG_PMUCAL_CMU_INIT=y
CONFIG_EXYNOS_ACPM=m
CONFIG_EXYNOS_ACPM_PLGDBG=m
CONFIG_EXYNOS_ACPM_MFD_BUS=m
CONFIG_EXYNOS_MFD_SPMI=y
CONFIG_EXYNOS_ESCA=m
CONFIG_EXYNOS_PM=m
CONFIG_EXYNOS_S2I=m
CONFIG_EXYNOS_FLEXPMU_DBG=m
CONFIG_SCSI_UFS_EXYNOS=m
CONFIG_SCSI_UFS_EXYNOS_FMP=y
CONFIG_ECT=m
CONFIG_EXYNOS_PM_QOS=m
CONFIG_CORESIGHT=y
CONFIG_CORESIGHT_LINK_AND_SINK_TMC=y
CONFIG_CORESIGHT_CATU=y
CONFIG_CORESIGHT_SINK_TPIU=y
CONFIG_CORESIGHT_SINK_ETBV10=y
CONFIG_CORESIGHT_STM=y
CONFIG_STM_PROTO_BASIC=y
CONFIG_ZSMALLOC=m
CONFIG_ZRAM=m
CONFIG_PRINTK_PROCESS=y
CONFIG_DEBUG_NOTIFIERS=y
CONFIG_SLUB_DEBUG_ON=y
CONFIG_CFI_CLANG=y
CONFIG_HPA=y
CONFIG_DMABUF_SAMSUNG_HEAPS=m
CONFIG_DMABUF_HEAPS_SAMSUNG_CMA=y
CONFIG_DMABUF_HEAPS_SAMSUNG_CARVEOUT=y
CONFIG_DMABUF_HEAPS_SAMSUNG_SYSTEM=y
CONFIG_DMABUF_HEAPS_SAMSUNG_HPA=y

#ICM
CONFIG_EXYNOS_ICM=m
CONFIG_EXYNOS_PROFILER_LEGACY=y
CONFIG_EXYNOS_MAIN_PROFILER=n
CONFIG_EXYNOS_CPU_PROFILER=n
CONFIG_EXYNOS_GPU_PROFILER=n
CONFIG_EXYNOS_MIF_PROFILER=n
CONFIG_EXYNOS_PROFILER_GFLOW=n
# CONFIG_EXYNOS_CRYPTOMANAGER is not set
# CONFIG_LTO_CLANG_FULL is not set
# CONFIG_EXYNOS_SSP is not set
CONFIG_EXYNOS_SECURE_LOG=m
# CONFIG_EXYNOS_TZASC_FAIL_DETECTOR is not set
# CONFIG_EXYNOS_PPMPU_FAIL_DETECTOR is not set
CONFIG_EXYNOS_SEH=m
CONFIG_HW_RANDOM_EXYNOS_SWD=m
CONFIG_EXYNOS_HDCP2=m
CONFIG_TRUSTONIC_TEE=m
CONFIG_EXYNOS_EL2=m
CONFIG_EXYNOS_S2MPU=m
CONFIG_PABLO_V11_0_0=n

# PMIC
CONFIG_MFD_SAMSUNG_PMIC=m
CONFIG_DRV_SAMSUNG_PMIC=m
CONFIG_RTC_SAMSUNG_PMIC=m
CONFIG_KEYBOARD_SAMSUNG_PMIC=m
CONFIG_ADC_SAMSUNG_PMIC=m
CONFIG_PINCTRL_SAMSUNG_PMIC=m

CONFIG_SAMSUNG_IOMMU_V9=m

CONFIG_DRM_SAMSUNG_DPU=m
CONFIG_PHY_EXYNOS_MIPI=m
CONFIG_PHY_EXYNOS_MIPI_DSIM=m
CONFIG_DRM_PANEL_SAMSUNG_COMMON=m
CONFIG_DRM_PANEL_SAMSUNG_EMUL=m
CONFIG_EXYNOS_DMA_DSIMFC=y
CONFIG_DRM_SAMSUNG_HIBERNATION_EARLY_WAKEUP=y
CONFIG_EXYNOS_PLL_SLEEP=y
CONFIG_DRM_SAMSUNG_DQE=y
CONFIG_DRM_SAMSUNG_HDR=y
CONFIG_DRM=y

# SGPU
CONFIG_DRM_SGPU=m
CONFIG_DRM_SGPU_DVFS=y
CONFIG_DRM_SGPU_EXYNOS=y
CONFIG_DRM_SGPU_VENDOR_HOOKS=n

# CPIF/GNSSIF
CONFIG_EXYNOS_MODEM_IF=m
CONFIG_SEC_MODEM_S5000AP=m
CONFIG_EXYNOS_CPIF_IOMMU_V9=m
CONFIG_CP_PKTPROC=m
CONFIG_CP_PKTPROC_UL=m
CONFIG_MODEM_IF_QOS=m
CONFIG_CP_BTL=m
# CONFIG_CP_LLC is not set
CONFIG_HW_REV_DETECT=m
CONFIG_CPIF_TP_MONITOR=m
# CONFIG_REINIT_VSS is not set
CONFIG_VERIFY_VSS=m
CONFIG_CPIF_DIRECT_DM=m
# CONFIG_CPIF_VENDOR_HOOK is not set
# CONFIG_CH_EXTENSION is not set
CONFIG_GNSS_PMUCAL=m
CONFIG_EXYNOS_GNSS_IF=m
# CONFIG_CP_UART_NOTI is not set
CONFIG_CP_RESET_NOTI=y

# TCP congestion control
CONFIG_TCP_CONG_ADVANCED=y
CONFIG_TCP_CONG_BIC=y
CONFIG_TCP_CONG_CUBIC=y
CONFIG_TCP_CONG_BBR=y
CONFIG_DEFAULT_BIC=y

# USB
CONFIG_USB_DWC3_EXYNOS_MODULE=m
CONFIG_EXYNOS_USBDRD_PHY30=y
CONFIG_USB_XHCI_EXYNOS=m
CONFIG_USB_CONFIGFS_F_DM=m
CONFIG_USB_CONFIGFS_RNDIS=y
CONFIG_USB_USE_IOCOHERENCY=m
CONFIG_USB_XHCI_EXYNOS_AUDIO=y
CONFIG_SND_EXYNOS_USB_AUDIO_GIC=y
CONFIG_SND_EXYNOS_USB_AUDIO=y
CONFIG_PHY_EXYNOS_USBDRD_EUSB=m
CONFIG_PHY_EXYNOS_EUSB_REPEATER=m
CONFIG_PHY_SAMSUNG_USB_CAL=y

#CPU
CONFIG_EXYNOS_CPUHP=m
CONFIG_EXYNOS_CPUPM=m
CONFIG_EXYNOS_IDLE_LAT=m
CONFIG_ARM_EXYNOS_CPU_FREQ=m
CONFIG_ARM_FREQ_QOS_TRACER=m
CONFIG_SCHED_CLUSTER=y
CONFIG_SCHED_EMS=m
CONFIG_SCHED_EMS_IDLE_SELECT=y
CONFIG_SCHED_EMS_FREQ_SELECT=y
CONFIG_SCHED_EMS_CORE_SELECT=y
CONFIG_SCHED_EMS_DEBUG=y
CONFIG_MHDVFS=y
CONFIG_CPU_FREQ_GOV_ENERGYAWARE=y
CONFIG_VENDOR_NR_CPUS=9
CONFIG_EXYNOS_UFCC=m
CONFIG_ARM_EXYNOS_DSU_FREQ=m
CONFIG_EXYNOS_AFM=m
CONFIG_EXYNOS_PERF=m
CONFIG_CPU_IDLE_GOV_HALO=y

# DEVFREQ/DM/DTM
CONFIG_ACPM_DVFS=m
CONFIG_EXYNOS_ESCA_DVFS_MANAGER=m
CONFIG_ARM_EXYNOS_DEVFREQ=m
CONFIG_ARM_EXYNOS_DEVFREQ_DEBUG=m
CONFIG_EXYNOS_ALT_DVFS=m
CONFIG_EXYNOS_THERMAL_V2=m
CONFIG_EXYNOS_CPU_THERMAL=m
CONFIG_ISP_THERMAL=m
CONFIG_DEV_THERMAL=m
CONFIG_GPU_THERMAL=m
CONFIG_EXYNOS_ACPM_THERMAL=m
CONFIG_EXYNOS_ESCA_THERMAL=m
CONFIG_EXYNOS_AMB_CONTROL=m
CONFIG_EXYNOS_MCINFO=m
CONFIG_EXYNOS_BTS=m

# LLC/SCI
CONFIG_EXYNOS_SCI=m
CONFIG_EXYNOS_LLCGOV=m
CONFIG_EXYNOS_SCI_DBG=m

# MULTIMEDIA
CONFIG_VIDEO_EXYNOS_MFC=m
CONFIG_VIDEO_EXYNOS_SCALER=m
CONFIG_VIDEO_EXYNOS_SMFC=m
CONFIG_VIDEO_EXYNOS_TSMUX=m
CONFIG_VIDEO_EXYNOS_REPEATER=m

#BCM
CONFIG_EXYNOS_BCM_DBG=m

# NPU
CONFIG_VISION_CORE=y
CONFIG_VISION_SUPPORT=y
CONFIG_EXYNOS_NPU=m
CONFIG_NPU_MAILBOX_VERSION=10
CONFIG_NPU_COMMAND_VERSION=11
CONFIG_NPU_NCP_VERSION=26
CONFIG_NPU_INTERFACE=y
CONFIG_NPU_HARDWARE=y
CONFIG_NPU_USE_MAILBOX_GROUP=n
CONFIG_NPU_USE_HW_DEVICE=y
CONFIG_NPU_USE_BOOT_IOCTL=y
CONFIG_NPU_USE_LLC=y
CONFIG_NPU_USE_LLC_PRESET=y
CONFIG_NPU_USE_PI_DTM=y
CONFIG_NPU_SET_DNC_FREQ=y
CONFIG_DSP_USE_VS4L=y
#CONFIG_NPU_USE_VOTF=y
CONFIG_NPU_STM=y
CONFIG_NPU_USE_UTIL_STATS=y
CONFIG_NPU_USE_IMB_ALLOCATOR=y
CONFIG_NPU_NUM_CORES=2
CONFIG_NPU_IMB_THRESHOLD=y
CONFIG_NPU_USE_FENCE_SYNC=y
CONFIG_NPU_USE_ASYNC=y
CONFIG_NPU_USE_IFD=y
CONFIG_NPU_AFM=y

# NFC
CONFIG_NFC=m
CONFIG_SEC_NFC=m
CONFIG_SEC_NFC_PRODUCT_N5=y
CONFIG_SEC_NFC_IF_I2C=y
CONFIG_SEC_NFC_DEDICATED_CLK=y
CONFIG_SEC_NFC_PMIC_LDO=y

# PDMA
CONFIG_SAMSUNG_PDMA=m

# WLBT
CONFIG_CFG80211=m
CONFIG_SCSC_CORE_CM=m
CONFIG_SCSC_CORE=m
CONFIG_SCSC_INDEPENDENT_SUBSYSTEM=m
CONFIG_SCSC_WLBT_CONFIG_PLATFORM=""
CONFIG_SCSC_PLATFORM=m
CONFIG_SCSC_CM_MX_CLIENT_TEST=y
CONFIG_SCSC_MMAP=m
CONFIG_SCSC_QOS=n
CONFIG_SCSC_MXLOGGER=y
CONFIG_SCSC_SMAPPER=n
CONFIG_SCSC_DEBUG=n
CONFIG_SCSC_DBG_SAMPLER=n
CONFIG_SCSC_WLAN=m
CONFIG_SCSC_WLAN_MAX_INTERFACES=12
CONFIG_SCSC_WLAN_SUPPORT_6G=y
CONFIG_SCSC_MX450_GDB_SUPPORT=y
CONFIG_SCSC_PRINTK=y
CONFIG_SCSC_CORE_FW_LOCATION="/vendor/etc/wifi"
CONFIG_SCSC_DEBUG_COMPATIBILITY=y
CONFIG_SCSC_LOGRING=m
CONFIG_SCSC_LOG_COLLECTION=m
CONFIG_SCSC_WLBTD=y
#CONFIG_SCSC_FM=n
#CONFIG_SCSC_FM_TEST=n
CONFIG_SCSC_STATIC_RING=y
CONFIG_SCSC_STATIC_RING_SIZE=4194304
CONFIG_SCSC_WIFILOGGER=y
CONFIG_SCSC_WLAN_WIFI_SHARING=y
CONFIG_SCSC_WLAN_SAE_CONFIG=y
#CONFIG_SCSC_WLAN_ENABLE_MAC_RANDOMISATION=y
CONFIG_SCSC_WLAN_SINGLE_ANTENNA is not set
CONFIG_SCSC_WIFI_NAN_ENABLE=y
CONFIG_SCSC_WLAN_RTT=y
CONFIG_SCSC_COMMON_HCF=y
# CONFIG_SCSC_FLASH_SERVICE_ON_BOOT is not set
CONFIG_WLBT_WARN_ON=y
# CONFIG_SCSC_BT is not set
CONFIG_SCSC_WLAN_MHS_STATIC_INTERFACE=y
CONFIG_SCSC_WLAN_ANDROID=y
# CONFIG_SCSC_LOGRING_DEBUGFS is not set
# CONFIG_SCSC_WIFILOGGER_DEBUGFS is not set
CONFIG_SCSC_MEMLOG=n
CONFIG_SCSC_PCIE=n
# CONFIG_SCSC_BT_BLUEZ is not set
# CONFIG_SCSC_BT_ADDRESS_IN_FILE is not set
CONFIG_SCSC_BT_ADDRESS_FILENAME="/mnt/vendor/efs/bluetooth/bt_addr"

CONFIG_SLSI_BT=m
CONFIG_SLSI_BT_USE_UART_INTERFACE=y
#CONFIG_SLSI_BT_USE_MIF_INTERFACE is not set
CONFIG_SLSI_BT_TTY_DEVICE_NAME="ttySAC1"
CONFIG_SLSI_BT_TTY_BAUD_RATE=4800000
CONFIG_SLSI_BT_H4=y
CONFIG_SLSI_BT_BCSP=y
#CONFIG_SLSI_BT_3WUTL is not set
#CONFIG_SLSI_BT_ADDRESS_IN_FILE is not set
```
