## Documentation/devicetree/bindings/power/supply/charger-manager.txt
```
charger-manager bindings
~~~~~~~~~~~~~~~~~~~~~~~~

Required properties :
 - compatible : "charger-manager"
 - <>-supply : for regulator consumer
 - cm-num-chargers : number of chargers
 - cm-num-fast-chargers : number of fast chargers
 - cm-chargers : name of chargers
 - cm-fast-chargers : name of fast chargers
 - cm-fuel-gauge : name of battery fuel gauge
 - subnode <regulator> :
	- cm-regulator-name : name of charger regulator
	- subnode <cable> :
		- cm-cable-name : name of charger cable
		- extcon : phandles to external connector devices
(optional)	- cm-cable-min : minimum current of cable
(optional)	- cm-cable-max : maximum current of cable

Optional properties :
 - cm-name : charger manager's name (default : "battery")
 - cm-poll-mode : polling mode (enum polling_modes)
 - cm-poll-interval : polling interval
 - cm-battery-stat : battery status (enum data_source)
 - cm-fullbatt-* : data for full battery checking
 - cm-thermal-zone : name of external thermometer's thermal zone
 - cm-battery-* : threshold battery temperature for charging
	-cold : critical cold temperature of battery for charging
	-cold-in-minus : flag that cold temperature is in minus degrees
	-hot : critical hot temperature of battery for charging
	-temp-diff : temperature difference to allow recharging
 - cm-dis/charging-max = limits of charging duration
 - cm-charge-voltage-max: maximum charge voltage in microVolts
 - cm-charge-voltage-drop: drop voltage in microVolts to allow recharging
 - cm-fast-charge-voltage-max: maximum fast charge voltage in microVolts
 - cm-fast-charge-voltage-drop: drop voltage in microVolts to allow restart fast charging
 - cm-flash-charge-voltage-max: maximum fast charge voltage in microVolts
 - cm-flash-charge-voltage-drop: drop voltage in microVolts to allow restart fast charging
 - cm-wireless-charge-voltage-max: maximum bpp standard wireless charge voltage in microVolts
 - cm-wireless-charge-voltage-drop: drop voltage in microVolts to allow restart bpp
   standard wireless charging
 - cm-wireless-fast-charge-voltage-max: maximum epp wireless charge voltage in microVolts
 - cm-wireless-fast-charge-voltage-drop: drop voltage in microVolts to allow restart epp
   wireless charging
 - cm-shutdown-voltage: drop voltage in microVolts to allow shutdown
 - cm-tickle-time-out: when 99% of the time is exceeded, it will be forced to 100%
 - cm-one-cap-time: how much time to allow capacity change
 - cm-wdt-interval: the interval to feed charger watchdog
 - monitored-battery: Phandle of battery characteristics devicetree node.
 - cm-capacity-track: the capacity track configuration option, if configured, Will
   automatically adjust the battery capacity.
 - cm-jeita-dcp-table: An array of dcp charger type table providing the temperature in
   degree Celsius, the recovery temperature in degree Celsius, the corresponding current
   and the corresponding terminate voltage, which is used to adjust the charging
   current according to different battery temperature to improve charging efficiency.
   The current unit is microamp and terminate voltage unit is microvolt.
 - cm-jeita-cdp-table: Similar to the above, An array of cdp charger type table.
 - cm-jeita-sdp-table: Similar to the above, An array of sdp charger type table.
 - cm-jeita-unknown-table: Similar to the above, An array of unknown table type table.
 - cm-jeita-fchg-table: Similar to the above, An array of fast charger type table.
 - cm-num-charge-pumps: number of charge pums chargers.
 - cm-num-wireless-chargers: number of wireless chargers.
 - cm-num-wireless-charge-pump-converters: number of wireless charge pump converters;
 - cm-charge-pumps: name of chager pumps.
 - cm-wireless-chargers: name of wireless chargers.
 - cm-wireless-charge-pump-converters: name of wireless charge pump converters;
 - cm-cp-taper-current: Charge pump target charge current
 - cm-cap-remap-table: capacity remap table.
 - cm-ir-cv-offset-microvolt: current and resistor compensation offeset value.
 - cm-ir-rc:  current and resistor compensation resistor value.
 - cm-ir-us-upper-limit-microvolt: current and resistor compensation upper limit.
Example :
	charger-manager@0 {
		compatible = "charger-manager";
		chg-reg-supply = <&charger_regulator>;

		cm-name = "battery";
		monitored-battery = <&bat>;
		cm-capacity-track;
		/* Always polling ON : 30s */
		cm-poll-mode = <1>;
		cm-poll-interval = <30000>;

		cm-fullbatt-vchkdrop-ms = <30000>;
		cm-fullbatt-vchkdrop-volt = <150000>;
		cm-fullbatt-soc = <100>;

		cm-cp-taper-current = <1000000>;

		cm-battery-stat = <3>;

		cm-num-chargers = <3>;
		cm-num-fast-chargers = <2>;
		cm-num-charge-pumps = <2>;
		cm-num-wireless-chargers = <2>;
		cm-num-wireless-charge-pump-converters = <2>;
		cm-chargers = "charger0", "charger1", "charger2";
		cm-fast-chargers = "fast_charger0", "fast_charger1";
		cm-charge-pumps = "cp-charger0", "cp-charger1";
		cm-wireless-chargers = "wl-charger0", "wl-charger1";
		cm-wireless-charge-pump-converters = "converter0", "converter1";

		cm-fuel-gauge = "fuelgauge0";

		cm-thermal-zone = "thermal_zone.1"
		/* in deci centigrade */
		cm-battery-cold = <50>;
		cm-battery-cold-in-minus;
		cm-battery-hot = <800>;
		cm-battery-temp-diff = <100>;

		/* Allow charging for 5hr */
		cm-charging-max = <18000000>;
		/* Allow discharging for 2hr */
		cm-discharging-max = <7200000>;
		cm-charge-voltage-max = <6500000>;
		cm-charge-voltage-drop = <700000>;
		cm-fast-charge-voltage-max = <11000000>;
		cm-fast-charge-voltage-drop  = <1000000>;
		cm-flash-charge-voltage-max = <11000000>;
		cm-flash-charge-voltage-drop  = <1000000>;
		cm-wireless-charge-voltage-max = <6500000>;
		cm-wireless-charge-voltage-drop = <700000>;
		cm-wireless-fast-charge-voltage-max = <12000000>;
		cm-wireless-fast-charge-voltage-drop = <1000000>;
		cm-shutdown-voltage = <3100000>;
		cm-tickle-time-out = <1500>;
		cm-one-cap-time = <30>;
		cm-wdt-interval = <60>;
		cm-ir-cv-offset-microvolt = <100000>;
		cm-ir-rc = <20>;
		cm-ir-us-upper-limit-microvolt = <4500000>;

		cm-jeita-temp-table = <900 930 0 4200000>, <1000 1030 100000 4200000>,
			<1100 1130 500000 4350000>, <1450 1420 0x7fff000 4350000>,
			<1500 1470 700000 4350000>;

		regulator@0 {
			cm-regulator-name = "chg-reg";
			cable@0 {
				cm-cable-name = "USB";
				extcon = <&extcon_usb>;
				cm-cable-min = <475000>;
				cm-cable-max = <500000>;
			};
			cable@1 {
				cm-cable-name = "TA";
				extcon = <&extcon_usb>;
				cm-cable-min = <650000>;
				cm-cable-max = <675000>;
			};
		};

	};
```

## Documentation/devicetree/bindings/power/supply/eta6937_charger.txt
```
ETA Solution ETA6937 battery charger ic binding

Required properties:
 - compatible: Should be:
 "eta,eta6937_chg",
 - reg: Address offset of charger register.
 - phys: Contains a phandle to the USB phy.

Optional Properties:
- monitored-battery: phandle of battery characteristics devicetree node.
  The charger uses the following battery properties:
- charge-term-current-microamp: current for charge termination phase.
- constant-charge-voltage-max-microvolt: maximum constant input voltage.
  See Documentation/devicetree/bindings/power/supply/battery.txt
- extcon: used to detect if vbus is high level.
Example:

	bat: battery {
		compatible = "simple-battery";
		charge-term-current-microamp = <120000>;
		constant-charge-voltage-max-microvolt = <4350000>;
		......
	};

	&i2c4 {
		status = "okay";
		clock-frequency = <400000>;

		eta6937_chg: charger@6a {
			compatible = "eat,eta6937_chg";
			reg = <0x6a>;
			phys = <&hsphy>;
			monitored-battery = <&bat>;
			chg-enable-gpios = <&ap_gpio 32 0>;
			extcon = <&extcon_gpio>;
		};
	};
```

## Documentation/devicetree/bindings/power/supply/hl1506_cp_converter.txt
```
Halo Microelectronics charge pump converter binding

Required properties:
 - compatible: Should be "halo,hl1506_cp_converter".
 - reg: Address offset of charger register.
 - chg_pump_en_gpio: chip en pin.
Optional Properties:
Example:

	bat: battery {
		compatible = "simple-battery";
		charge-term-current-microamp = <120000>;
		constant-charge-voltage-max-microvolt = <4350000>;
		......
	};

	&i2c4 {
		status = "okay";
		clock-frequency = <400000>;

		hl1506_cp_converter: charger@1b {
					     compatible = "halo,hl1506_cp_converter";
					     reg = <0x1b>;
					     chg_pump_en_gpio = <&ap_gpio 171 GPIO_ACTIVE_HIGH>;
				     };
	};
```

## Documentation/devicetree/bindings/power/supply/nu1619_wl_charger.txt
```
nuvolta PMIC battery wireless charger binding

Required properties:
 - compatible: Should be "nuvolta,wl_charger_nu1619".
 - reg: Address offset of charger register.
 - rx,irq_gpio: intterupt pin to receive interrupt for nu1619
Optional Properties:
- switch_chg_en_gpio: switch chip enable pin
- switch_flag_en_gpio: otg flag enable pin
Example:

	bat: battery {
		compatible = "simple-battery";
		charge-term-current-microamp = <120000>;
		constant-charge-voltage-max-microvolt = <4350000>;
		......
	};

	&i2c4 {
		status = "okay";
		clock-frequency = <400000>;

		nu1619_rx: charger@61 {
				   compatible = "nuvolta,wl_charger_nu1619";
				   reg = <0x61>;
				   rx,irq_gpio = <&ap_gpio 146 GPIO_ACTIVE_LOW>;
				   switch_chg_en_gpio = <&ap_gpio 171 GPIO_ACTIVE_LOW>;
			   };
	};
```

## Documentation/devicetree/bindings/power/supply/sys65153_wl_charger.txt
```
Silergy PMIC battery wireless charger binding

Required properties:
 - compatible: Should be "Silergy,wl_charger_sy65153".
 - reg: Address offset of charger register.
 - intb,irq_gpio: intterupt pin to receive interrupt for sy65153
 - pg,irq_gpio: intterupt pin to indicate power good status
Optional Properties:
- switch_chg_en_gpio: switch chip enable pin
- switch_flag_en_gpio: otg flag enable pin
Example:

	bat: battery {
		compatible = "simple-battery";
		charge-term-current-microamp = <120000>;
		constant-charge-voltage-max-microvolt = <4350000>;
		......
	};

	&i2c4 {
		status = "okay";
		clock-frequency = <400000>;

		sy65153_wl_charger: charger@61 {
				   compatible = "silergy,wl_charger_sy65153";
				   reg = <0x61>;
				   intb,irq_gpio = <&ap_gpio 146 GPIO_ACTIVE_LOW>;
				   pg,irq_gpio = <&ap_gpio 131 GPIO_ACTIVE_HIGH>;
				   switch_chg_en_gpio = <&ap_gpio 171 GPIO_ACTIVE_LOW>;
			   };
	};
```

## Documentation/devicetree/bindings/pstore/ramoops.txt
```
ramoops device tree

Optional properties:
- compatible: should be "pstore,ramoops"

Required properties:
- mem-size: total size reserved for ramoops usage
- mem-address: reserved area start physical address
- record-size: max size for record usage;
- console-size: max size for console usage;
- dump-oops: whether we use ramoops to dump oops info;

Example:

ramoops {
	mem-size = <0x40000>;
	mem-address = <0x8100000>;
	record-size = <0x8000>;
	console-size = <0x30000>;
	dump-oops = <0>;
	status = "okay";
};
```

## Documentation/devicetree/bindings/regulator/max77838-regulator.txt
```
MAX77838 regulators

Required properties:
- compatible: "maxim,max77838"
- reg: I2C slave address
- regulators: A node that houses a sub-node for each regulator within the
  device. Each sub-node is identified using the node's name, with valid
  values listed below. The content of each sub-node is defined by the
  standard binding for regulators; see regulator.txt.
  LDO[1-4] and BUCK respectively.

Optional properties:
- buck-ramp-up : buck ramp-up slew rate control.
					0 : 6.25mV/us
					1 : 12.5mV/us
					2 : 25mV/us
					3 : 50mV/us
- buck-ramp-down : buck ramp-down slew rate control.
					0 : 3.125mV/us
					1 : 6.25mV/us
					2 : 12.5mV/us
					3 : 25mV/us
- buck-fpwm : buck forced PWM.
				0 : Disable
				1 : Enable
- buck-fsrad : buck falling slew rate active discharge
				0 : Disable
				1 : Enable
- uvlo-fall-threshold : Vsys UVLO falling threshold
						0 : 2.30V
						1 : 2.35V
						2 : 2.40V
						3 : 2.45V

- active-discharge-enable : All regulators have active discharge enable setting
							0 : Disable
							1 : Enable

Each regulator is defined using the standard binding for regulators.

Example:

	max77838@60 {
		compatible = "maxim,max77838";
		reg = <0x60>;

		regulators {
			LDO1 {
				regulator-min-microvolt = <600000>;
				regulator-max-microvolt = <3775000>;
				active-discharge-enable = <1>;
			};
			
			LDO2 {
				active-discharge-enable = <1>;
			};

			...

			LDO4 {
				active-discharge-enable = <1>;
			};

			BUCK {
				regulator-boot-on;
				regulator-always-on;
			};
		};
		buck-ramp-up = <0>; 	/* 6.25mV/us */
		buck-fpwm = <0>;		/* Disable */
		
		uvlo-fall-threshold = <1>;	/* 2.35V */
	};
```

## Documentation/devicetree/bindings/regulator/rt5746-regulator.txt
```
Richtek RT5746 5A Buck regulator

rt5746-regulator is a regulator driver with i2c bus control interface.

Required properties:
- compatible:      Must be "rt,rt5746".
- reg:             Must be 0x1c as the i2c address.
- regulator-name:  A string used as a descriptive name for regulator outputs
- regulator-min-microvolt:  min microvolt voltage output for RT5746.
- regulator-max-microvolt:  max microvolt voltage output for RT5746.

Optional properties:
- qcom,qpnp-regulator:	That's depends upon Qualcomm evalutaion board.
			Not necessary for RT5746 driver.
- rt,standby_uV:        Can be used to set standby voltage. If not specified,
			IC default voltage will be used.
- rt,rampup_sel:	DVS rampping up rate sel, the value can be referenced
			in the datasheet.
- rt,rampdn_sel:	DVS rampping down rate sel, the value can be referenced
			in the datasheet.
- rt,ipeak_sel:		Current peak value for RT5746 buck. the value can be
			referenced in the datasheet.
- rt,tpwth_sel:		Thermal prewarning degree for RT5746 buck. the value can be
			referenced in the datasheet.
- rt,rearm_en:		After thermal shutdown, recovery procedure enabled or disabled.
- rt,discharge_en:	discharge circuit enable or disabled, it will be used when
			RT5746 buck was disabled.
- rt,irq_gpio:		IRQ gpio can be used to nofity AP SOC. if not used, please
			just mark it.

Example:
	i2c@f9928000 {
		status = "ok";
		rt5746_regulator: rt5746@1c {
			//required properties
			compatible = "rt,rt5746";
			reg = <0x1c>;
			regulator-name = "rt5746-dcdc1";
			regulator-min-microvolt = < 600000>;
			regulator-max-microvolt = <1393750>;
			//optional properties
			qcom,consumer-supplies = "rt5746-dcdc1", "";
			rt,standby_uV = < 800000>;
			rt,rampup_sel = <0x06>;
			rt,rampdn_sel = <0x01>;
			rt,ipeak_sel = <0x01>;
			rt,tpwth_sel = <0x02>;
			rt,rearm_en;
			//rt,discharge_en;
			rt,irq_gpio = <&msmgpio 73 0x00>;
		};
	};
```

## Documentation/devicetree/bindings/regulator/sprd,ump9621-regulator.txt
```
Unisoc UMP9621 Voltage regulators

The UMP9621 integrates low-voltage and low quiescent current DCDC/LDO.

Required properties:
- compatible: should be "sprd,ump96xx-regulator" or "sprd,ump9621-regulator".

List of regulators provided by this controller. It is named according to
its regulator type, DCDC_<name> and LDO_<name>. The definition for each
of these nodes is defined using the standard binding for regulators at
Documentation/devicetree/bindings/regulator/regulator.txt.

Example:
	regulators {
		compatible = "sprd,ump96xx-regulator";

		vddarm0: DCDC_CPU0 {
			regulator-name = "vddarm0";
			regulator-min-microvolt = <400000>;
			regulator-max-microvolt = <1996875>;
			regulator-ramp-delay = <25000>;
			regulator-always-on;
		};

		vddcama0: LDO_CAMA0 {
			regulator-name = "vddcama0";
			regulator-min-microvolt = <1200000>;
			regulator-max-microvolt = <3750000>;
			regulator-enable-ramp-delay = <100>;
		};
		...
};
```
