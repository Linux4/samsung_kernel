## Documentation/devicetree/bindings/rt5033 regulator binding document.txt
```
RT5033 MFD driver

This device supports I2C only.

Required properties:

  - compatible : "richtek,rt5033-safeldo", compatible = "richtek,rt5033-ldo1", compatible = "richtek,rt5033-dcdc1"


Optional properties:

  - TBD


Example:

	i2c@78ba000 {
		rt5033-mfd@34{
		
			rt5033_safe_ldo {
				compatible = "richtek,rt5033-safeldo";
				regulator-name = "RT5033SafeLDO"; /* constraints->name, change name by yourself*/
				regulator-min-microvolt = <3300000>;
				regulator-max-microvolt = <4950000>; /* max == min then apply_uV = 1 */
				/* regulator-microvolt-offset = < >; optional*/
				/* regulator-boot-on = "yes"; optional, exist = enabled */
				regulator-always-on = "yes";
				/* regulator-ramp-delay = <100>; optional*/

			};

			rt5033_ldo1 {
				compatible = "richtek,rt5033-ldo1";
				regulator-name = "RT5033LDO1"; /* change name by yourself */
				regulator-min-microvolt = <1200000>;
				regulator-max-microvolt = <3000000>; /* max == min then apply_uV = 1 */
				/* regulator-microvolt-offset = < >; optional*/
				/* regulator-boot-on = "yes"; optional, exist = enabled */
				/* regulator-always-on = "yes"; optional, exist = enabled */
				/* regulator-ramp-delay = <100>; optional*/

			};

			rt5033_buck1 {
				compatible = "richtek,rt5033-dcdc1";
				regulator-name = "RT5033DCDC1"; /* change name by yourself */
				regulator-min-microvolt = <1200000>;
				regulator-max-microvolt = <3300000>; /* max == min then apply_uV = 1 */
				/* regulator-microvolt-offset = < >; optional*/
				/* regulator-boot-on = "yes"; optional, exist = enabled */
				/* regulator-always-on = "yes"; optional, exist = enabled */
				/* regulator-ramp-delay = <100>; optional*/

			};
		};
	}
```

## Documentation/devicetree/bindings/sipa/sipa_v3.txt
```
SIPA for Spreadtrum platforms

Required properties:
- compatible: should be the following:
	"sprd,qogirn6pro-sipa".
- reg: Specify the physical base address of the controller and length
  of memory mapped region.
- interrupts: Should contain ipa interrupt.
- power-domains: A phandle pointed to the corresponding power domain.
- sprd,sipa-bypass-mode: IPA work mode select. 0: bypass mode 1: normal_mode
- fifo-names: Fifo that need to be reconfigured.
- fifo-sizes: Corresponding to fifo-names
	First parameter indicates fifo tx common fifo is it in iram. 0: DDR 1: iram.
	Second parameter indicates fifo tx common fifo total depth.
	Third parameter indicates fifo rx common fifo is it in iram. 0: DDR 1: iram.
	Fourth parameter indicates fifo tx common fifo total depth.

Examples:
        sipa: sipa@25220000 {
                compatible = "sprd,qogirn6pro-sipa";
                reg = <0 0x25220000 0 0x00002000>;
                reg-names = "ipa-base";
                interrupts = <GIC_SPI 137 IRQ_TYPE_LEVEL_HIGH>,
                        <GIC_SPI 136 IRQ_TYPE_LEVEL_HIGH>,
                        <GIC_SPI 135 IRQ_TYPE_LEVEL_HIGH>,
                        <GIC_SPI 134 IRQ_TYPE_LEVEL_HIGH>,
                        <GIC_SPI 133 IRQ_TYPE_LEVEL_HIGH>,
                        <GIC_SPI 132 IRQ_TYPE_LEVEL_HIGH>,
                        <GIC_SPI 131 IRQ_TYPE_LEVEL_HIGH>,
                        <GIC_SPI 130 IRQ_TYPE_LEVEL_HIGH>,
                        <GIC_SPI 138 IRQ_TYPE_LEVEL_HIGH>;
                interrupt-names = "ipa_irq0", "ipa_irq1", "ipa_irq2",
                    "ipa_irq3", "ipa_irq4", "ipa_irq5",
                    "ipa_irq6", "ipa_irq7", "ipa_general";

                sprd,sipa-bypass-mode = <0>;

                power-domains = <&pd_ipa_sys>;

                fifo-names = "sprd,usb-ul", "sprd,usb-dl",
                        "sprd,wifi-ul", "sprd,wifi-dl";
                fifo-sizes = <0 2048 0 2048>, <0 2048 0 2048>,
                        <0 128 0 128>, <0 128 0 128>;
        };
```

## Documentation/devicetree/bindings/soc/sprd/sprd,cp_dump.txt
```
Spreadtrum cp_dump bindings

Required properties:
- compatible: "sprd,cp_dump".
- sprd,sys-bus-ctrl-sp: Should contain the base address, offset and bit for sp sysbusctrl.
- sprd,sys-bus-ctrl-ch: Should contain the base address, offset and bit for ch sysbusctrl.

Example:

	nr_cp_dump: cp_dump {
		compatible = "sprd,cp_dump";
		sprd,sys-bus-ctrl-sp = <&aon_apb_regs 0x0128 0x1>;
		sprd,sys-bus-ctrl-ch = <&aon_apb_regs 0x0124 0x1>;
	};
```

## Documentation/devicetree/bindings/soc/sprd/sprd,cpdvfs.txt
```
Unisoc cpdvfs bindings

Unisoc's some SoCs integrates hardware DVFS. This DVFS driver controls settings and tuning
for communication processor include pscp, phycp, pubcp and wtlcp.

Required Properties:
- compatible: should be one of the following.
  - "sprd,pscp-dvfs": for PSCP DVFS,
  - "sprd,phycp-dvfs": for PHYCP DVFS,
  - "sprd,pubcp-dvfs": for PUBCP DVFS,
  - "sprd,wtlcp-dvfs": for WTLCP DVFS,
- sprd,core_id: core identification of the dvfs system.
- sprd,devices-num: number of dvfs device in this system.
- sprd,devices-name: dvfs device's name sequence list in this system.
- sprd,devices-id: dvfs device's ID sequence list in this system.


Example:
	dvfs_pubcp {
		compatible = "sprd,pubcp-dvfs";
		sprd,core_id = <0>;
		sprd,devices-num = <1>;
		sprd,devices-name = "core_axi";
		sprd,devices-id = <0>;
	};

	dvfs_wtlcp {
		compatible = "sprd,wtlcp-dvfs";
		sprd,core_id = <1>;
		sprd,devices-num = <1>;
		sprd,devices-name = "core_axi";
		sprd,devices-id = <0>;
	};

	dvfs_pscp {
		compatible = "sprd,pscp-dvfs";
		sprd,core_id = <2>;
		sprd,devices-num = <3>;
		sprd,devices-name = "core", "axi", "apb";
		sprd,devices-id = <0>, <1>, <2>;
	};

	dvfs_phycp {
		compatible = "sprd,phycp-dvfs";
		sprd,core_id = <3>;
		sprd,devices-num = <3>;
		sprd,devices-name = "core", "axi", "apb";
		sprd,devices-id = <0>, <1>, <2>;
	};
```

## Documentation/devicetree/bindings/soc/sprd/sprd,debuglog.txt
```
Unisoc debuglog bindings

This node is used to define control information and address space node used the
power debug driver, which output the power and interrupt state will help us to
analyze the SoC system power exception.

Required properties:
- compatible:
	"sprd,debuglog-sharkl6pro",
	"sprd,debuglog-sharkl6",
	"sprd,debuglog-sharkl5pro",
	"sprd,debuglog-sharkl5",
	"sprd,debuglog-sharkl3",
	"sprd,debuglog-sharkle",

- sprd,sys-ap-ahb:
	Specify the ap-ahb address space node in the soc system

- sprd,sys-ap-apb:
	Specify the ap-apb address space node in the soc system

- sprd,sys-pmu-apb:
	Specify the pmu-apb address space node in the soc system

- sprd,sys-aon-apb:
	Specify the aon-apb address space node in the soc system

Example:
	debug_log: debuglog {
		compatible = "sprd,debuglog-sharkl5pro";

		sprd,sys-ap-ahb = <&ap_ahb_regs>;
		sprd,sys-ap-apb = <&ap_apb_regs>;
		sprd,sys-pmu-apb = <&pmu_apb_regs>;
		sprd,sys-aon-apb = <&aon_apb_regs>;
	};
```

## Documentation/devicetree/bindings/soc/sprd/sprd,debugstat.txt
```
Unisoc debugstat bindings

The node uses to count individual subsystems information, which output log will
help us to analyze the SoC system power exception.

Required properties:
- compatible:
	"sprd,debugstat-sharkl6pro",
	"sprd,debugstat-sharkl6",
	"sprd,debugstat-sharkl5pro",
	"sprd,debugstat-sharkl5",
	"sprd,debugstat-sharkl3",
	"sprd,debugstat-sharkle",
	"sprd,debugstat-pike2

Example:
	debug_stat: debugstat {
		compatible = "sprd,debugstat-sharkl5pro";
	};
```

## Documentation/devicetree/bindings/soc/sprd/sprd,sipa_eth.txt
```
Unisoc sipa-eth bindings

This is only for virtual network interface controller that dealing with ipa data transferring.

Required properties:
- compatible: Must be "sprd,sipa_eth".
- sprd,netid: index for SIPA NIC interface
- sprd,term-type: names for the various IPA srouce / destination ID
- sprd,mac-header: a bool to indicate a skb has to pull its mac header or not

Example:

aliases {
	eth0 = &sipa_eth0;
	...
	eth7 = &sipa_eth7;
};

On Roc1+Orca platform:
sipa_eth0: sipa-eth0 {
	compatible = "sprd,sipa_eth";
	sprd,netid = <1>;
	sprd,term-type = <0x6>;
};

On Orca CPE platform:
sipa_eth0: sipa-eth0 {
	compatible = "sprd,sipa_eth";
	sprd,netid = <1>;
	sprd,term-type = <0x6>;
	sprd,mac-header;
};

sipa_usb0: sipa-usb {
	compatible = "sprd,sipa_usb";
	sprd,netid = <0>;
	sprd,term-type = <0x2>;
};

sipa_dummy: sipa-dummy {
	compatible = "sprd,sipa_dummy";
}
```

## Documentation/devicetree/bindings/soc/sprd/sprd,syscon.txt
```
UNISOC PMIC syscon driver bindings

This driver is designed for that pmic sub-modules can read/write pmic global register easily.

Required properties:
- compatible:
  -"sprd,sc27xx-syscon" for SC27XX series pmic syscon
  -"sprd,ump962x-syscon" for UMP962x main pmic syscon
  -"sprd,ump9621-syscon" for UMP9621 sub-pmic syscon
  -"sprd,ump9622-syscon" for UMP9622 sub-pmic syscon

- reg: Specifies the physical offset address(relative to pmic base register address) for specific pmic register.

Example:
	syscon@2000 {
		compatible = "sprd,ump962x-syscon";
		reg = <0x2004>, <0x2008>;
	};
```

## Documentation/devicetree/bindings/soc/sprd/sprd,usbpinmux.txt
```
Spreadtrum USBPINMUX

Required properties:
- compatible: should be one of following:
	"sprd,qogirl6-usbpinmux".
- sprd,syscon-config: specify the handle for aon apb syscon.
- syscons: control function for check usbpinmux mode.
- syscon-names: names of used syscons function.
- vdd-supply: phandle for Vdd regulator.
- sprd,vdd-voltage: the voltage should be set 3.3V.
- pinctrl-names: The pin control state names.
- pintcrl-0: The "ap_uart1_9" pinctrl state, it will set uart_in9 as ap_uart1.
- pintcrl-1: The "auddsp_uart0_1" pinctrl state, it set uart_in1 as auddsp_uart0.

Example:
        usbpinmux: usbpinmux {
		compatible = "sprd,qogirl6-usbpinmux";
		sprd,syscon-config = <&aon_apb_regs>;
		syscons = <&aon_apb_regs REG_AON_APB_USB_UART_JTAG_MUX (MASK_AON_APB_USB_JTAG_HW_SEL_EN |
			MASK_AON_APB_DAP_USB_JTAG_SEL | MASK_AON_APB_USB_BYPASS_SEL | MASK_AON_APB_UART_JTAG_SEL)>;
		syscon-names = "usb_uart_jtag_mux";
		vdd-supply = <&vddusb33>;
		sprd,vdd-voltage = <3300000>;
		pinctrl-names = "ap_uart1_9", "auddsp_uart0_1";
		pintcrl-0 = <&ap_uart1_9>;
		pintcrl-1 = <&auddsp_uart0_1>;
	};
```

## Documentation/devicetree/bindings/sound/foursemi,fs1816.txt
```
FourSemi fs1816 Audio Amplifier

Required properties:

  - compatible : "foursemi,fs1816"

  - reg : The I2C address of the device

  - intz-gpios : INTZ pin of the device
  NOTE: INTZ pin must be hiZ/bias-disabled
  when the machine powers up

  - fs,rx_channel : Select input channel
  left: 1, right: 2, mono: 3(default)

  - fs,rx_volume : Playback digital volume
  gain=(1023-vol)*-0.09375dB, 1023 as default, range: 0~1023

Optional properties:

  - sound-name-prefix : string using as prefix for the sink/source names of
  the component, it's an optional property for multi-device application.
  For example:
  sound-name-prefix = "SPKx"; // x=spkr-id

Example:

fs1816@34 {
	compatible = "foursemi,fs1816";
	reg = <0x34>;
	intz-gpios = <&tlmm xxx 0>;
	fs,rx_channel = <3>;
	fs,rx_volume = <1023>;
	status = "ok";
};
```

## Documentation/devicetree/bindings/sound/marvell,adma-1.0.txt
```
MARVELL ADMA 1.0

Required properties:
- compatible: "marvell,adma-1.0"
- reg: register range
- interrupts: interrupt line
- #dma-cells: dma cells number
- asram: sram associated with adma

Example:

adma0: adma@d128d800 {
	compatible = "marvell,adma-1.0";
	reg = <0xD128D800 0x100>;
	interrupts = <0 82 0x4>;
	#dma-cells = <1>;
	asram = <&asram>;
	status = "disabled";
};
```

## Documentation/devicetree/bindings/sound/marvell,audio-map-clock.txt
```
* Marvell audio MAP clock

Required properties:
- compatible : "marvell,mmp-map-clock"
- reg: register range for APMU, APBSP, MAP, DSPAUX
- reg-names: register names for APMU, APBSP, MAP, DSPAUX
- #clock-cells: clock cells
- map: map node

Example:

audio_map_clocks: clock{
	compatible = "marvell,audio-map-clock";
	reg = <0xd4282800 0x400>,
	      <0xd4090000 0x1000>,
	      <0xd1200000 0x8000>,
	      <0xd1230000 0x100>;
	reg-names = "apmu", "apbs", "map", "dspaux";
	#clock-cells = <1>;
	map = <&map>;
};
```

## Documentation/devicetree/bindings/sound/marvell,map-card.txt
```
MARVELL audio MAP card

Required properties:
- compatible: "marvell,map-card"
- map,audio-routing: A list of the connections between audio components.
  Each entry is a pair of strings, the first being the connection's sink,
  the second being the connection's source. Valid names for sources and
  sinks are the dapm widgets defined in mmp-map-fe-dai driver.

marvell,map-card contains a group of dailinks:
fe_i2s1: AP low latency audio frontend dai
fe_i2s2: AP low power audio frontend dai
fe_i2s3: voice call frontend dai
fe_i2s4: bt/fm frontend dai
be_i2s1: aux audio backend dai
be_i2s2: codec headset backend dai
be_i2s3: codec speaker backend dai
be_i2s4: codec mic1 backend dai
be_i2s5: codec mic2 backend dai

Required properties for dailinks:
- compatible: "marvell,map-dailink-x", identify dailink number
- dai-name: dai name
- stream-name: stream name
- marvell,cpu-dai: cpu-dai name & index
- marvell,codec-dai: codec-dai name & index
- marvell,dai-dynamic: dynamic or not
- marvell,dai-no-host-mode: no-host or not
- marvell,dai-no-pcm: no-pcm or not
- marvell,dai-fixup: fixup index

Example:

	sound {
		compatible = "marvell,map-card";
		map,dapm-route =
			"ADC input1", "TDM_MIC1_CAP",
			"ADC input2", "TDM_MIC2_CAP",
			"ADC input3", "BT_VC_UL",
			"TDM_OUT1_PLAYBACK", "DAC1 output out1",
			"TDM_OUT2_PLAYBACK", "DAC2 output out2",
			"BT_VC_DL", "ADC output ain3";
		fe_i2s1: fe_i2s1 {
			compatible = "marvell,map-dailink-1";
			dai-name = "MAP I2S1 audio";
			stream-name = "map i2s1";
			marvell,cpu-dai = <&sspa0 0>;
			marvell,codec-dai = <&mmp_map_codec 1>;
			marvell,dai-dynamic;
		};
		fe_i2s2: fe_i2s2 {
			compatible = "marvell,map-dailink-1";
			dai-name = "MAP I2S4 audio";
			stream-name = "map i2s4";
			marvell,cpu-dai = <&sspa1 1>;
			marvell,codec-dai = <&mmp_map_codec 4>;
			marvell,dai-dynamic;
		};
		fe_i2s3: fe_i2s3 {
			compatible = "marvell,map-dailink-2";
			dai-name = "MAP I2S2 audio";
			stream-name = "map i2s2";
			marvell,cpu-dai = <&mmp_pcm_hostless 0>;
			marvell,codec-dai = <&mmp_map_codec 2>;
			marvell,dai-dynamic;
			marvell,dai-no-host-mode;
		};
		fe_i2s4: fe_i2s4 {
			compatible = "marvell,map-dailink-1";
			dai-name = "MAP I2S3 audio";
			stream-name = "map i2s3";
			marvell,cpu-dai = <&mmp_pcm_hostless 0>;
			marvell,codec-dai = <&mmp_map_codec 3>;
			marvell,dai-dynamic;
			marvell,dai-no-host-mode;
		};
		be_i2s1: be_i2s1 {
			compatible = "marvell,map-dailink-3";
			dai-name = "MAP AUXI2S audio";
			stream-name = "BT audio";
			marvell,cpu-dai = <&mmp_map_be 1>;
			marvell,codec-dai = <&snd_soc_dummy 0>;
			marvell,codec-name = "snd-soc-dummy";
			marvell,codec-dai-name = "snd-soc-dummy-dai";
			marvell,dai-no-pcm;
			marvell,dai-fixup = <0>;
		};
		be_i2s2: be_i2s2 {
			compatible = "marvell,map-dailink-6";
			dai-name = "MAP TDM hs audio";
			stream-name = "codec hs audio";
			marvell,cpu-dai = <&mmp_map_be_tdm 2>;
			marvell,codec-dai = <&pm860_codec 3>;
			marvell,dai-no-pcm;
			marvell,dai-fixup = <1>;
		};
		be_i2s3: be_i2s3 {
			compatible = "marvell,map-dailink-4";
			dai-name = "MAP TDM speaker audio";
			stream-name = "codec speaker audio";
			marvell,cpu-dai = <&mmp_map_be_tdm 1>;
			marvell,codec-dai = <&pm860_codec 4>;
			marvell,dai-no-pcm;
			marvell,dai-fixup = <1>;
		};
		be_i2s4: be_i2s4 {
			compatible = "marvell,map-dailink-5";
			dai-name = "MAP TDM mic1 audio";
			stream-name = "codec mic1 audio";
			marvell,cpu-dai = <&mmp_map_be_tdm 3>;
			marvell,codec-dai = <&pm860_codec 1>;
			marvell,dai-no-pcm;
		};
		be_i2s5: be_i2s5 {
			compatible = "marvell,map-dailink-5";
			dai-name = "MAP TDM mic2 audio";
			stream-name = "codec mic2 audio";
			marvell,cpu-dai = <&mmp_map_be_tdm 4>;
			marvell,codec-dai = <&pm860_codec 2>;
			marvell,dai-no-pcm;
		};
	};
```
