## Documentation/devicetree/bindings/sound/marvell,mmp-pcm-hostless.txt
```
* Marvell pcm hostless
Required properties:
- bus_number: bus number
- compatible : "marvell,mmp-pcm-hostless"
- #dailink-cells: sub device number

Example:

mmp_pcm_hostless: mmp_pcm_hostless {
	bus_number = <0>;
	compatible = "marvell,mmp-pcm-hostless";
	#dailink-cells = <1>;
	status = "okay";
};
```

## Documentation/devicetree/bindings/sound/marvell,pxa-88pm805.txt
```
MARVELL audio machine driver

Required properties:
- compatible: must be "marvell,pxa-88pm805-snd-card"

Example:

	sound {
		compatible = "marvell,pxa-88pm805-snd-card";
		ssp-controllers = <&ssp_dai1 &ssp_dai4>;
	};
```

## Documentation/devicetree/bindings/sound/mrvl,mmp-sspa-dai.txt
```
MARVELL SSPA dai

Required properties:
- compatible: "marvell,mmp-sspa-dai"
- reg: register range
- dmas: associated dma engine
- dma-names: dma directions
- asram: associated sram
- platform_driver_name: associated platform driver
- clocks: clock id
- pinctrl-names: pinctrl name
- pinctrl-0: sspa(0/1) pin mux
- playback_period_bytes: peroid size for playback, in byte.
- playback_buffer_bytes: buffer size for playback, in byte.
- capture_period_bytes: peroid size for capture, in byte.
- capture_buffer_bytes: buffer size for capture, in byte.
- burst_size: dma burst size
- sleep_vol: low power mode voltage settings.
- #dailink-cells: dai number

Example:

/* SSPA port 0 */
sspa0: sspa@d128dc00 {
	compatible = "mrvl,mmp-sspa-dai";
	reg = <0xd128dc00 0x100>;
	dmas = <&adma0 1
		&adma0 0>;
	dma-names = "rx", "tx";
	asram = <&asram>;
	platform_driver_name = "tdma_platform";
	clocks = <&audio_map_clocks AUDIO_CLK_SSPA1>;
	pinctrl-names = "default";
	pinctrl-0 = <&sspa0_func>;
	playback_period_bytes = <2048>;
	playback_buffer_bytes = <4096>;
	capture_period_bytes = <2048>;
	capture_buffer_bytes = <4096>;
	burst_size = <4>;
	sleep_vol = <0x14>;
	#dailink-cells = <1>;
	status = "okay";
};
```
