## Documentation/devicetree/bindings/leds/leds-sc27xx-kpled.txt
```
UNISOC PMIC Keypad_led

The PMIC Keypad_led can work at LDO mode or current mode.

Required properties:
- compatible: Should be one of follow:
  "sprd,sc2731-keypad-led",
  "sprd,sc2723-keypad-led",
  "sprd,sc2721-keypad-led",
  "sprd,sc2730-keypad-led",
  "sprd,ump9620-keypad-led".

- reg: address of keypad led control register.

Examples:

led-controller@1b88 {
	compatible = "sprd,sc27xx-keypad-led", "sprd,sc2730-keypad-led";
	reg = <0x1b88>, <0x1b8c>;
};
```

## Documentation/devicetree/bindings/leds/marvell,88pm828x.txt
```
LEDs connected to 88pm828x

Required properties:
- compatible : should be : "marvell,88pm828x".
- reg: the slave address of 88pm828x as one twsi device, it should be 0x10.
- ramp_mode: IDAC current ramp up/down mode, typically 0x2 (Non-Linear Mode).
- idac_current: IDAC current setting, typically 0xa00 (20mA by default).
- ramp_clk: ramping clock for Linear or Non-Linear mode, typically 0x0 (8KHz).
- str_config: WLED String Configuration, 1 for 88PM828; 0 for 88PM828A.

Optional properties:
- avdd-supply: power domain for twsi bus. it's platform dependent.

Examples:

backlight: pm828x@10 {
	compatible = "marvell,88pm828x";
	reg = <0x10>;
	ramp_mode = <0x2>;
	idac_current = <0xa00>;
	ramp_clk = <0>;
	str_config = <0x1>;
	avdd-supply = <&ldo12>;
};
```

## Documentation/devicetree/bindings/leds/marvell,lm3532.txt
```
LEDs connected to lm3532

Required properties:
- compatible : should be : "marvell,lm3532".
- reg: the slave address of lm3532 as one twsi device, it should be 0x38.
- flags: to select
	LM3532_CONFIG_BUTTON_BL/LM3532_CONFIG_ALS/LM3532_DISP_BTN_TIED/LM3532_HAS_WEBTOP.
- ramp_time: startup/shutdon ramp rate, typically 0x0 (8µs/step).
- ctrl_a_fs_current: full-scale current setting of control A, typically 0x13
(20.2mA by default).
- ctrl_a_mapping_mode: LED Current mapping mode of control A, typically 0x2 (linear mapping).
- ctrl_a_pwm: to select which PWM input (PWM1 or PWM2) is mapped to Control
Bank A and which zones the selected PWM input is active in, typically 0x86.
- rst_gpio: reset control for lm3532, it's platform dependent.

Optional properties:
- avdd-supply: power domain for twsi bus. it's platform dependent.

Examples:

backlight: lm3532@38 {
	compatible = "marvell,lm3532";
	reg = <0x38>;
	flags = <0>;
	ramp_time = <0>;
	ctrl_a_fs_current = <0x1b>;
	ctrl_a_mapping_mode = <0x2>;
	ctrl_a_pwm = <0x86>;
	rst_gpio = <&gpio GPIO(6) 0>;
	avdd-supply = <&ldo12>;
};
```

## Documentation/devicetree/bindings/media/marvell-vpu.txt
```
* Marvell codec

Required properties:
- compatible : should be "mrvl, mmp-xxx" for SoCs:
- reg: should be register base and length as documented in the
  SoC reference manual
- interrupts : Should contain the VPU interrupt. For CODA960,
  a second interrupt is needed for the MJPEG unit.
- clocks : Should contain the ahb and per clocks, in the order
  determined by the clock-names property.
- clock-names : Should be "ahb", "per"
- iram : phandle pointing to the SRAM device node

Example:
coda7542: coda7542@d420d000 {
	compatible = "mrvl,mmp-coda7542";
	reg = <0xd420d000 0x1000>,
	      <0xd1004000 0x11600>;
	interrupts = <0 25 0x4>;
	marvell,power-domain = <&pd_vpu>;
	status = "disabled";
};

axi@f0400000 {
	compatible = "mrvl,axi-bus", "simple-bus";
	#address-cells = <1>;
	#size-cells = <1>;
	reg = <0xf0400000 0x07c00000>;
	ranges;

	dec@0xf0400000 {
		compatible = "mrvl,mmp-hantro";
		reg = <0xf0400000 0x00000800>;
		interrupts = <0 26 0x4>;
		marvell,power-domain = <&pd_vpu>;
		status = "disabled";
	};

	pp@0xf0400000 {
		compatible = "mrvl,mmp-hantro";
		reg = <0xf0400000 0x00000800>;
		interrupts = <0 26 0x4>;
		status = "disabled";
	};

	enc@0xf0400800 {
		compatible = "mrvl,mmp-hantro";
		reg = <0xf0400800 0x003ff800>;
		interrupts = <0 26 0x4>;
		marvell,power-domain = <&pd_vpu>;
		status = "disabled";
	};
};
```

## Documentation/devicetree/bindings/media/mv_b52_sensor.txt
```
B52 sensor

backsensor node
------------
Required properties:
- compatible	: "marvell,backsensor" "marvell,frontsensor";

sensor node
------------
- compatible	: "sony,imx219", "ovt,ov5642", "ovt,ov13850r2a", "ovt,ov13850", "ovt,ov8858r2a", "samsung,sr544",
			"ovt,ov5648", "ovt,ov2680", "hynix,hi551", "samsung,s5k3l2", "samsung,s5k5e3";
- reg			: I2C slave address of the sensor;
- adapter		: I2C adapter number;
- sensor-pos	: 1 means sccb1, 2 means sccb2
- mclk			: the rate of mclk;
- dphy3			: HS Settle and HS Term;
- dphy5			: Lane Enable control;
- dphy6			: CLK Settle and CLK Term;
- af_2v8-supply	  	: analog power supply 2.8V for vcm;
- avdd_2v8-supply 	: analog power supply 2.8V;
- dovdd_1v8-supply	: I/O power supply 1.8V;
- dvdd_1v2-supply	: core power supply 1.2V;
- pwdn-gpios		: GPIO connected to PWDN pin and FLAG_ACTIVE_LOW;
- reset-gpios		: GPIO connected to RSTN pin and FLAG_ACTIVE_LOW;

Example:
IMX219: sensor@0 {
	compatible = "sony,imx219";
	status = "okay";
	reg = <0x1A>;
	adapter = <0x1>;
	sensor-pos = <1>;
	mclk = <26000000>;
	dphy3 = <0x2700>;
	dphy5 = <0xff>;
	dphy6 = <0x1001>;
	af_2v8-supply = <&ldo7>;
	avdd_2v8-supply = <&ldo3>;
	dovdd_1v8-supply = <&ldo6>;
	dvdd_1v2-supply = <&CAMERA_DVDD_SUPPLY>;
	pwdn-gpios = <&gpio CAM_MAIN_PWDN_N 1>;
	reset-gpios = <&gpio CAM1_RST_N 1>;
};
```

## Documentation/devicetree/bindings/media/mv_b52isp.txt
```
ISP: Converts raw Bayer pixels from external CMOS sensors to either
RGB or YUV pixel format. The ISP has 2 image pipelines to support
2 independent raw sensors.

b52isp node
------------
Required properties:
- compatible	: should be "ovt,double-pipeline ISP";
- reg		: physical base address and length of the registers set;
- interrupts	: must contain CCIC interrupts;
- clocks	: list of clock specifiers, corresponding to entries in
		  clock-names property;
- clock-names	: must contain "SC2AXICLK", "ISPCORECLK", "ISPPIPECLK"
				entries, matching entries in the clocks property.
- marvell, power-domain: the power domain

Example:
b52isp: b52isp@0xF0B00000 {
	compatible = "ovt,double-pipeline ISP";
	reg = <0xF0B00000 0xFFFFF>;
	interrupts = <0 92 0x4>;
	clocks = <&soc_clocks PXA1928_CLK_SC2_AXI_MIX_CLK>,
		   <&soc_clocks PXA1928_CLK_ISP_CORE_MIX_CLK>,
		   <&soc_clocks PXA1928_CLK_ISP_PIPE_MIX_CLK>;
	clock-names = "SC2AXICLK", "ISPCORECLK", "ISPPIPECLK";
	marvell,power-domain = <&pd_sc2>;
};

plat_cam node
------------
Required properties:
- compatible	: should be "marvell,platform-cam";

b52isp_sc2_csi and b52isp_sc2_dma node
------------
Required properties:
- compatible	: should be "marvell,ccicv2"; used for sc2 csi and dma.
- cciv2_type	: 0 means csi, 1 means dma;
- interrupts	: must contain CCIC interrupts;
```

## Documentation/devicetree/bindings/media/mv_sc2_camera.txt
```
SoC camera driver for SC2.

mcam node
------------
Required properties:
- compatible	: should be "marvell,mv_sc2_camera";
- reg		: mcam1 or mcam2;
- clocks	: list of clock specifiers, corresponding to entries in
		  clock-names property;
- clock-names	: must contain "SC2AXICLK" entries,
		matching entries in the clocks property.
- marvell,power-domain	: power domain;

Example:
mcam0: mcam@0 {
	compatible = "marvell,mv_sc2_camera";
	marvell,power-domain = <&pd_sc2>;
	reg = <0x0 0x0>;
};
```

## Documentation/devicetree/bindings/media/mv_sc2_ccic.txt
```
CMOS Camera Interface Controller (CCIC) 1 and 2 -- Used to capture pixel
data from external CMOS sensor(s). Each CCIC module includes a MIPI CSI-2
controller. CCIC1 supports up to 4-lane MIPI CSI-2, and CCIC2 supports up
to 2-lane MIPI CSI-2. When the external CMOS sensor is a smart sensor with
built-in ISP, CCIC DMA is used to transfer the pixel data to DDR

ccic node
------------
Required properties:
- compatible	: should be "marvell,mmp-sc2ccic" for CCIC 1 and 2;
- reg		: physical base address and length of the registers set;
- dma-burst	: the length of dma burst;
- interrupts	: must contain CCIC interrupts;
- clocks	: list of clock specifiers, corresponding to entries in
		  clock-names property;
- clock-names	: must contain "SC2MCLK", "SC2DPHYCLK", "SC2CSICLK" entries,
		  matching entries in the clocks property.

Example:
ccic1: ccic@d420a000 {
		compatible = "marvell,mmp-sc2ccic", "marvell,mmp-ccic";
		reg = <0xd420a000 0x31c>;
		reg-names = "ccic-regs";
		dma-burst = <64>;
		interrupts = <0 120 0x4>;
		clocks = <&soc_clocks PXA1928_CLK_SC2_MCLK1_CLK>,
			   <&soc_clocks PXA1928_CLK_SC2_DPHY4LN_CLK>,
			   <&soc_clocks PXA1928_CLK_SC2_CSI_MIX_CLK>,
			   <&soc_clocks PXA1928_CLK_SC2_4X_MIX_CLK>,
			   <&soc_clocks PXA1928_CLK_SC2_AXI_MIX_CLK>;
		clock-names = "SC2MCLK", "SC2DPHYCLK", "SC2CSICLK",
				"SC24XCLK", "SC2AXICLK";
};
```

## Documentation/devicetree/bindings/media/mv_sc2_mmu.txt
```
sensor control2 descriptor: converts virtual addresses from CCICs
and ISP to physical addresses in DDR using 16 independent channels.

sc2mmu node
------------
Required properties:
- compatible	: should be "marvell,mmp-sc2mmu"
- reg		: physical base address and length of the registers set;
- interrupts	: must contain CCIC interrupts;

Example:
sc2mmu1: sc2mmu@d4209000 {
		compatible = "marvell,mmp-sc2mmu";
		reg = <0xd4209000 0x84c>;
		reg-names = "mmu-regs";
		interrupts = <0 91 0x4>;
		status = "disable";
};
```

## Documentation/devicetree/bindings/media/soc_camera.txt
```
SoC camera driver.

soc camera node
------------
Required properties:
- compatible	: should be "soc-camera-pdrv";
- reg		: should be <0x0, 0x0>, <0x1, 0x0>;

Example:
soc-camera@0 {
	compatible = "soc-camera-pdrv";
	status = "disabled";
	reg = <0x0 0x0>;
};
```

## Documentation/devicetree/bindings/memory-controllers/mck-memorybus.txt
```
Device tree bindings for Marvell MCK memory controllers

It only supports MCK4 and MCK5 version memory controllers now.

Required properties:

 - compatible:          Should be "marvell,devfreq-ddr" for MCK memocry controller.
 - reg:                 A resource specifier for the register space.
 - interrupts:          The irq number of this device that is used to interrupt the CPU
 - clocks:              the id of ddr clock in device tree

Optional properties:
 - "marvell,qos"	Indicate the device supports min/max qos feature.

Example:

	devfreq-ddr {
		compatible = "marvell,devfreq-ddr";
		reg = <0xc0100000 0x880>;
		interrupts = <0 43 0x4>;
		clocks = <&soc_clocks PXA1U88_CLK_DDR>;
		marvell,qos;
	};
```

## Documentation/devicetree/bindings/mfd/88pm805.txt
```
* Marvell 88pm805 driver

Required properties:
- compatible: must be "marvell,88pm805"

Example:

pmic2: 88pm805@38 {
	compatible = "marvell,88pm805";
	reg = <0x38>;
	interrupt-parent = <&gpio>;
	interrupts = <124 0x1>;
	marvell,88pm805-irq-write-clear;
};
```

## Documentation/devicetree/bindings/mfd/88pm830.txt
```
* Marvell 88PM830 Power Management IC

Required parent device properties:
- compatible : "marvell,88pm830"
- reg : the I2C slave address for the 88pm830 chip
- interrupts : IRQ line for the 88pm830 chip
- interrupt-controller: describes the 88pm830 as an interrupt controller
- #interrupt-cells : should be 1.

parent device properties:
- marvell,88pm830-irq-flags: the irq flags used, varies accoring to the
			     interrupt controller and the HW design


88pm830 consists of a group of sub-devices:

Device			 Description
------			 -----------
88pm830-chg		: charger
88pm830-bat		: battery fuel-gauge
88pm830-usb		: usb vbus
88pm830-leds		: camera flash/torch

Example:

pmic: 88pm830@68 {
	      compatible = "marvell,88pm830";
	      reg = <0x68>;
	      interrupts = <2>;
	      interrupt-parent = <&gpio>;
	      interrupt-controller;
	      #interrupt-cells = <1>;

	      marvell,88pm830-irq-flags = IRQF_ONESHOT;

	      charger {
			compatible = "marvell,88pm830-chg";

	      };

	      battery {
			compatible = "marvell,88pm830-bat";

	      };

	      vbus {
			compatible = "marvell,88pm830-led";

	      };
	      led {
			compatible = "marvell,88pm830-vbus";

	      };
	      debug {
			compatible = "marvell,88pm830-debug";

	      };
      };
```

## Documentation/devicetree/bindings/mfd/88pm886.txt
```
* Marvell 88PM886 Power Management IC

Required parent device properties:
- compatible : "marvell,88pm886"
- reg : the I2C slave address for the 88pm886 chip
- interrupts : IRQ line for the 88pm886 chip
- interrupt-controller: describes the 88pm886 as an interrupt controller (has its own domain)
- #interrupt-cells : should be 1.
		- The cell is the 88pm886 local IRQ number

Optional parent device properties:
- marvell,88pm860x-irq-write-clear: inicates whether interrupt status is
  cleared by write

88pm886 consists of a large and varied group of sub-devices:

Device			 Supply Names	 Description
------			 ------------	 -----------
88pm886-onkey		:		: On key
88pm886-rtc		:		: RTC
88pm886-vbus		:		: Vbus
88pm886-regulator	:		: Regulators
88pm886-backlight	:		: Backlight
88pm886-leds		:		: Camera flash/torch
88pm886-charger		:		: Switch Charger
88pm886-battery 	:		: Hardware fuelgauge

Example:

	pmic: 88pm886@30 {
		compatible = "marvell,88pm886";
		reg = <0x34>;
		interrupts = <0 4 IRQ_TYPE_LEVEL_HIGH>;
		interrupt-parent = <&gic>;
		interrupt-controller;
		#interrupt-cells = <1>;

		marvell,88pm886-irq-write-clear;

		regulators {
			BUCK1 {
				regulator-min-microvolt = <1000000>;
				regulator-max-microvolt = <1500000>;
				regulator-boot-on;
				regulator-always-on;
			};
		};

		vbus {
			compatible = "marvell,88pm886-vbus";
		};
		charger {
			compatible = "marvell,88pm886-charger";
		};
		battery {
			compatible = "marvell,88pm886-battery";
		};
	};
```

## Documentation/devicetree/bindings/mfd/88pm8xx.txt
```
* Marvell 88PM8xx Power Management IC

Required parent device properties:
- compatible : "marvell,88pm800"
- compatible : "marvell,88pm80x-onkey"
- reg : the I2C slave address for the 88pm8xx chip
- interrupts : IRQ line for the 88pm8xx chip
- interrupt-controller: describes the 88pm8xx as an interrupt controller
- #interrupt-cells : should be 1.

parent device properties:
- marvell,88pm800-irq-write-clear: the irq clear method used


88pm800 consists of a group of sub-devices:

Device			 Description
------			 -----------
88pm80x-regulator	: regulator
88pm80x-headset		: headset
88pm80x-dvc		: dvc
88pm80x-onkey		: onkey

Example:

pmic: 88pm800@30 {
	compatible = "marvell,88pm800";
	interrupt-controller;
	#interrupt-cells = <1>;

	marvell,88pm800-irq-write-clear;

	regulators {
		compatible = "marvell,88pm80x-regulator";
	};

	vibrator {
		  compatible = "marvell,88pm80x-vibrator";
	};

	headset {
		  compatible = "marvell,88pm80x-headset";
	};

	dvc {
		  compatible = "marvell,88pm8xx-dvc";
	};

	onkey {
		  compatible = "marvell,88pm80x-88pm80x-onkey";
	};

      };
```

## Documentation/devicetree/bindings/mfd/marvell,88pm860.txt
```
* Marvell 88PM860 Power Management IC
Required properties:
- compatible : "marvell,88pm860"
- reg : the I2C slave address for the 88pm860 chip

88pm860 consists of one sub-device:
pm860_codec: codec driver

Required properties for pm860_codec:
- compatible : "marvell,88pm860-codec"
- #dailink-cells: sub device number

Example:

pmic2: 88pm860@38 {
	compatible = "marvell,88pm860";
	reg = <0x38>;
	pm860_codec: pm860_codec {
		compatible = "marvell,88pm860-codec";
		#dailink-cells = <1>;
	};
};
```
