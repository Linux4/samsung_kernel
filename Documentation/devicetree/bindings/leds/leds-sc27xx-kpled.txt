## Documentation/devicetree/bindings/mfd/marvell,mmp-map.txt
```
* Marvell audio MAP

Required properties:
- compatible : "marvell,mmp-map"
- reg: register range
- audio_reg: pmu audio power control register
- bit_sram: sram ctrl bit in pmu register
- bit_apb: apb ctrl bit in pmu register
- pll_sel: map pll select bit, which is different between Eden & Helan2
- power_ctrl: power on/off API. 0: helanx_power_on; 1: edenx_power_on.
- clocks: MAP clock index
- marvell,apll: audio pll select bit. 0: 32k-apll; 1: 26m-apll

marvell,mmp-map consists of a group of sub-devices:
mmp_map_codec: map-codec driver
mmp_map_be: map-be driver
mmp_map_be_tdm: map-tdm driver

Required properies for sub-devices
- compatible : sub-device name
- #dailink-cells: sub device number

Example:

map: map@d1200000 {
	reg = <0xd1230000 0x80
		0xd1200000 0x8000>;
	audio_reg = <128>;
	bit_sram = <3>;
	bit_apb = <2>;
	pll_sel = <0>;
	power_ctrl = <0>;
	clocks = <&audio_map_clocks AUDIO_CLK_MAP>;
	marvell,apll = <0>;
	status = "okay";
	mmp_map_codec: mmp_map_codec {
		compatible = "marvell,mmp-map-codec";
		#dailink-cells = <1>;
	};
	mmp_map_be: mmp_map_be {
		compatible = "marvell,mmp-map-be";
		#dailink-cells = <1>;
	};
	mmp_map_be_tdm: mmp_map_be_tdm {
		compatible = "marvell,mmp-map-be-tdm";
		#dailink-cells = <1>;
	};
};
```

## Documentation/devicetree/bindings/mfd/rt8973.txt
```
Richtek RT8973 MUIC

Required properties:

 - compatible	: should be "richtek,rt8973"
 - reg			: i2c slave address of the device
 - interrupt-parent	: parent of interrupt
 - interrupts		: interrupt to indicate accessories attach or detach
 - rt8973,irq-gpio	: irq gpio



Example:
		&soc {

			i2c_0: i2c@f9967000 {
					rt8973@14 {
						compatible = "richtek,rt8973";
						reg = <0x14>;
						interrupt-parent = <&msmgpio>;
						rt8973,irq-gpio = <&msmgpio 73 0>;
				};
			};
		};
```

## Documentation/devicetree/bindings/mfd/sprd,ump96xx-pmic.txt
```
UNISOC SoCs UMP96XX PMIC MFD driver

Required properties:
- compatible: should be one of following:
	"sprd,ump9620"
	"sprd,ump9621"
	"sprd,ump9622"
- reg: Specifies PMICs chip select signal for spi framework.

Optional properties:
- size-cells: size of cells required to define a sys module address size on.
- address-cells: number of address cells for the PMIC's subnodes.
- #interrupt-cells: be identical to the that of the parent interrupt.
- interrupt-controller :be identical to describe the PMIC that have interrupt signal.
- spi-max-frequency: max frequency of spi/adi bus for pmic.

Example:
	ump9620_pmic: pmic@0 {
		compatible = "sprd,ump9620";
		reg = <0>;
		spi-max-frequency = <26000000>;
		interrupt-controller;
		#interrupt-cells = <2>;
		#address-cells = <1>;
		#size-cells = <0>;
	};
```

## Documentation/devicetree/bindings/misc/acipc.txt
```
* ACIPC driver.

Required properties:
- compatible: "marvell,mmp-acipc"
- reg: Should contain registers location and length
- interrupts: Should be three. The first interrupt number is a composite interrupt.
- interrupt-names: Assign name of irq resource.
- clocks: soc_clocks PXA1L88_CLK_IPC_RST.

Examples:
acipc: acipc@d401d000 {
	compatible = "marvell,mmp-acipc";
	reg = <0xd401d000 0x100>;
	interrupts = <0 16 0x4>,<0 17 0x4>,<0 18 0x4>;
	interrupt-names = "IPC_AP_DATAACK", "IPC_AP_SET_CMD", "IPC_AP_SET_MSG";
	clocks = <&soc_clocks PXA1L88_CLK_IPC_RST>;
	status = "disabled";
};
```

## Documentation/devicetree/bindings/misc/apbs.txt
```
* apb apare

Required properties:
- compatible: "marvell,mmp-apb-spare".
- reg: Should contain registers location and length

Example:
apbs: apbs@d4090000 {
	compatible = "marvell,mmp-apb-spare";
	reg = <0xd4090000 0x154>;
};
```

## Documentation/devicetree/bindings/misc/cp-load.txt
```
* Cp Load

Required properties:
- compatible: "marvell, cp_load"
- cp-type: 0 for pxa988, 1 for pxa1L88, 2 means pxa1928.
- lpm-qos: should be PM_QOS_CPUIDLE_BLOCK_AXI;
- remap-smc-funcid: the smc function id for seagull remap register

Examples:
	cp-load {
		compatible = "marvell,cp_load";
		cp-type = <3>;
		lpm-qos = <PM_QOS_CPUIDLE_BLOCK_AXI>;
		remap-smc-funcid = <0xd0002001>;
		status = "okay";
	};
```

## Documentation/devicetree/bindings/misc/iml.txt
```
* IML driver.

The DMA addr provided by CP is not physical address so we may need to manually revert it to phy addr again or DMA operation will fail.
The phy addr -> CP side address remapping rule is based on CP address remapping register, which defines how many bits in CP address are replaced
with content in the remapping register.
Note that DMA engine hardware on some platforms can support non phy addr provided by CP, in which case remap register is not needed.

Required properties:
- compatible: "marvell,mmp-iml"
- reg: the share memory address, RIPC lock address, RIPC clock address, CP address remapping register (optional)
- interrupts: the RIPC interrupt
- interrupt-names: name of the interrupt
- (optional) remap: <remap bit starting pos in CP addr remap register, remap bit starting pos in CP address, number of bits to remap>
- dmas: dma channel for rx
- dma-names: dma name

Examples:

iml: iml@7ffffe0{
	compatible = "marvell,mmp-iml";
	reg = <0x07ffffe0 0x10>, <0xd403d200 0x10>, <0xd403b038 0x10>, <0xd4282d24 0x4>;
	interrupts = <0 56 0x4>;
	interrupt-names = "IPC_MSA_DATA";
	remap = <0 26 6>;
	dmas = <&pdma0 0xFF 0>;
	dma-names =  "iml-dma";
	status = "disabled";
};
```

## Documentation/devicetree/bindings/misc/led-rgb.txt
```
Marvell RGB led driver
-----------------------------------------------------
This binding defines which gpios are used to control rgb leds over
Marvell platform.

Required properties:
- compatible : "marvell,led-rgb"
- pinctrl-names: which pinctrl set name is used
- pinctrl-0: the default pinctrl group
- led_r: which gpio is used to control red led
- led_g: which gpio is used to control green led
- led_b: which gpio is used to control blue led

Example:
	smc@0x3404c000 {
		compatible = "brcm,bcm11351-smc", "brcm,kona-smc";
		reg = <0x3404c000 0x400>; //1 KiB in SRAM
	};

+       led-rgb {
+               compatible = "marvell,led-rgb";
+               pinctrl-names = "default";
+               pinctrl-0 = <&led_pmx_func>;
+               led_r = <&gpio 102 0>;
+               led_g = <&gpio 103 0>;
+               led_b = <&gpio 104 0>;
+               status = "okay";
+       };
```

## Documentation/devicetree/bindings/misc/marvell,profile.txt
```
Marvell SoC PROFILE DEVICETREE BINDINGS

Required properties:

	- "compatible"			Must be set to "marvell,profile"
	- "marvell,profile-number"	The profile number used by dvc driver
					to determine the voltage.
					Init it as 0 by default.

Example:
       profile {
               compatible = "marvell,profile";
               marvell,profile-number = <0>;
       };
```
