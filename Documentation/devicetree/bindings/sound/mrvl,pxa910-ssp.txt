## Documentation/devicetree/bindings/sound/mrvl,pxa910-ssp.txt
```
MARVELL PXA910-SSP

Required properties:
- compatible: "mrvl,pxa910-ssp"
- reg: register range
- ssp-id: ssp index
- interrupts: interrupt line

Example:

ssp4: ssp@d4039000 {
	compatible = "mrvl,pxa910-ssp";
	reg = <0xd4039000 0x90>;
	ssp-id = <5>;
	interrupts = <0 34 0x4>;
	status = "disabled";
};
```

## Documentation/devicetree/bindings/sound/rt5508.txt
```
* RT5508 SPK AMP controller

Required Specific Properties:

- compatible : "richtek,rt5508"

Optional Specific Properties:

- rt,chan_sel : default channel selection.
                0 -> left channel
		1 -> (L+R)/2
		2 -> right channel

- proprietary_param : proprietary param for Richtek RT5508,
		      something liks as the speaker protection/MBDRC/ALC, etc...

Example:

	i2c@12C70000 {
		status = "ok";
		rt5508: rt5508@34 {
			status = "ok";
			compatible = "richtek,rt5508";
			reg = <0x34>;
		};
	};
```

## Documentation/devicetree/bindings/sound/samsung,s2803x.txt
```
Samsung S2803X Audio Mixer

Required properties:
- compatible: "samsung,s2803x"
- reg: Should contain Audio Mixer register location and length
- clocks: Should provide the clock handles
- clock-names: The nume of the clocks used in the driver. It must have
  following clock-names:
  "audmixer_sysclk", "audmixer_bclk0", "audmixer_bclk1", "audmixer_bclk2",
  "audmixer_dout", and "audmixer_aclk"
- samsung,lpass-subip: This binds the device with Samsung audio sub-system
- pinctrl-names: Should be "default" and "idle".
- pinctrl-0: Should be the phandle of active pinctrl node
- pinctrl-1: Should be the phandle of idle pinctrl node

Optional:
- bck-mcko-mode: If defined, MCLK is provided in case of BCLK. Required if the
  BCLK like is directly provided to the Codec COD3025X as MCLK.

Example:

s2803x: s2803x@148C0000 {
	compatible = "samsung,s2803x";
	reg = <0x148C0000 0x200>;
	clocks = <&clock 80>,	/* sclk_audmixer */
		 <&clock 81>,	/* sclk_audmixer_bclk0*/
		 <&clock 83>,	/* sclk_audmixer_bclk1 */
		 <&clock 82>,	/* sclk_audmixer_bclk2 */
		 <&clock 68>,	/* dout_audmixer*/
		 <&clock 70>;	/* aclk_aud */

	clock-names = "audmixer_sysclk", "audmixer_bclk0",
			"audmixer_bclk1", "audmixer_bclk2",
			"audmixer_dout", "audmixer_aclk";

	samsung,lpass-subip;

	/* Board specific - may vary for different boards */
	pinctrl-names = "default", "idle";
	pinctrl-0 = <&i2s_pmic_bus>;
	pinctrl-1 = <&i2s_pmic_bus_idle>;
	bck-mcko-mode;
};
```

## Documentation/devicetree/bindings/sound/samsung,universal7580-cod3022x.txt
```
Samsung Universal7580 sound-card node

Required properties:
- compatible : "samsung,universal7580-cod3022x"
- samsung,audio-cpu: The phandle of the Samsung I2S0 controller
- samsung,audio-codec: The phandle of the Codec node
- samsung,auxdev: The phandle of auxdev node

Optional properties:
- clocks/clock_names: The phandle of Codec BCLK, if available.
- pinctrl-0/pinctrl-names: The pin-controls nodes that need to be configured.
- mic-bias-mode: Tuplet of 3 number specifying mic-bias mode for microphones
  connected to MIC1, MIC2 and LINE-IN. The mic-bias mode may be one of the
  following: MIC1, MIC2 and
	0 - No configuration required
	1 - Internal MICBIAS1 is used for mic bias
	2 - Internal MICBIAS2 is used for mic bias
	3 - Some LDO is used as mic bias with a gpio control
- mic-bias-gpios: If the mic-bias is controlled by gpio, we need to provide the
  gpio array here. GPIO entry provided only if present and the order followed is
  MIC1, MIC2 and LINE-IN.

Example:

sound {
	compatible = "samsung,universal7580-cod3022x";
	samsung,audio-cpu = <&i2s0	/* primary */
				&i2s0	/* secondary */
				&audio_cp_dummy
				&audio_bt_dummy
				&audio_fm_dummy>;
	samsung,audio-codec = <&audio_codec_cod3022x
				&audio_codec_cod3022x
				&audio_codec_cod3022x
				&audio_codec_dummy
				&audio_codec_cod3022x>;
	samsung,auxdev = <&s2801x>;
	gpios = <&gpf1 5 0x1>;
	clocks = <&clock 151>;		 /* sclk_i2s */
	clock-names = "codec_bclk";
	mic-bias-mode = <3 1 2>;
	mic-bias-gpios = <&gpd2 7 0x1>;
	pinctrl-names = "default";
	pinctrl-0 = <&main_mic_bias_en>;
	status = "okay";
};
```

## Documentation/devicetree/bindings/sound/snd-soc-dummy.txt
```
* sound soc dummy
Required properties:
- compatible : "snd-soc-dummy"
- #dailink-cells: sub device number

Example:

snd_soc_dummy: snd_soc_dummy {
	compatible = "snd-soc-dummy";
	#dailink-cells = <1>;
	status = "okay";
};
```

## Documentation/devicetree/bindings/sound/sprd-pdm.txt
```
Spreadtrum Communications PDM bindings

PDM (pulse density modulation) is audio interface. This
module is the digital part for processing the input of
dmic. The audio data out can be transmit by iis interface
or can be accessed by dma request or interrupt. All external
dmic devices must be the smae. The pdm data are send to vbc
and vad. The data in vad is used for voice trigger. The data
in vbc is used for acoustic echo cancel.

======

Required properties:
- compatible : Should be one of following "sprd,pdm", "sprd,pdm-ums9620"
- reg: must be the PHY controller base address.
- #sound-dai-cells : it used to specify how many cells used when using dai phandle.
	if equal 0 means using default dai 0, if equal 1,
	the dai number is determined by the second parameter of sound-dai property.
- aon-apb-set-offset: offset value for registers setting.
- aon-apb-clr-offset: offset value for registers clear.
- sprd,syscon-agcp-ahb: specify the handle for audcp_ahb_regs
- sprd,syscon-agcp-apb: specify the handle for audcp_aon_apb_regs
======

Example:

	pdm_dmic: pdm-dmic@56370000 {
		compatible = "sprd,pdm-ums9620";
		status = "disabled";
		reg = <0 0x56370000 0 0x2000>;
		#sound-dai-cells = <1>;
		aon-apb-set-offset = <0>;
		aon-apb-clr-offset = <0>;
		sprd,syscon-agcp-ahb = <&audcp_ahb_regs>;
		sprd,syscon-agcp-apb = <&audcp_aon_apb_regs>;
	};
```

## Documentation/devicetree/bindings/sound/sprd-sound.txt
```
* Spreadtrum Audio Devices

* MUST define a /sprd-audio-devices node
  and, all sprd audio devices child node should be contain in it.

Required /sprd-audio-devices Specific Properties:

- compatible : "sprd,sound"

* SPRD-CODEC

Required SoC Specific Properties:
- compatible : "sprd,sprd-codec-v1"
or,
- compatible : "sprd,sprd-codec-v3"

Required Board Specific Properties:
- sprd,audio_power_ver : Which audio power version supported.
	* <1> : Tiger serial project;
	* <3> : Shark serial project;
- sprd,hp_pa_ver : Which internal headphone pa supported. (only sprd-codec-v3 option)
	* <0> or null: default version of headphone pa;
	* <1> : version 2 of headphone pa. (Dolphin serial project);
- sprd,ap_irq : Which IRQ number of codec ap part.
- sprd,dp_irq : Which IRQ number of codec dp part.

Optional Board Specific Properties:
- reg: physical base address of the controller and length of memory mapped
  region.(not check now)
- sprd,def_da_fs : set default playback sample rate.

* VBC

Required SoC Specific Properties:
- compatible : "sprd,vbc-r1p0"
or,
- compatible : "sprd,vbc-r2p0"

Required Board Specific Properties:

Optional Board Specific Properties:
- reg: physical base address of the controller and length of memory mapped
  region.(not check now)

* I2S

Required SoC Specific Properties:
- compatible : "sprd,i2s"

Required Board Specific Properties:
- sprd,hw_port : Which i2s hardware port.
- sprd,base : <physical base address, virtual base address>.
- sprd,dma_rx_no : Which i2s RX DMA number.
- sprd,dma_tx_no : Which i2s TX DMA number.

Optional Board Specific Properties:
- reg: physical base address of the controller and length of memory mapped
  region.(not check now)
- sprd,config : phandle of i2s configure.
	(* if this option is null, will use i2s configure default)
	+ child node
	*- sprd,def_pcm_config : empty property; define use default pcm configure;
		(* if this option is null, will use i2s configure default)
	*- sprd,slave_timeout : set the slave timeout value;
	*- sprd,byte_per_chan : set the bytes per channel;
	*- sprd,slave_mode : set is slave mode;
	*- sprd,lsb : set is LSB mode;
	*- sprd,lrck : set is LRCK mode;
	*- sprd,low_for_left : set is Low for Left mode;
	*- sprd,clk_inv : set is CLK invert;
	*- sprd,i2s_compatible : set is compatible standard I2S mode;
	*- sprd,pcm_short_frame : set is PCM short frame mode;
	*- sprd,pcm_slot : set support PCM slot;
	*- sprd,tx_watermark : set the TX watermark;
	*- sprd,rx_watermark : set the RX watermark;
(** i2s default configure **)
/* default i2s config */
const static struct i2s_config def_i2s_config = {
	.hw_port = 0,
	.fs = 32000,
	.slave_timeout = 0xF11,
	.bus_type = I2S_BUS,
	.byte_per_chan = I2S_BPCH_16,
	.mode = I2S_SLAVE,
	.lsb = I2S_MSB,
	.rtx_mode = I2S_RX_MODE,
	.sync_mode = I2S_LRCK,
	.lrck_inv = I2S_L_LEFT,
	.clk_inv = I2S_CLK_N,
	.i2s_bus_mode = I2S_MSBJUSTFIED,
	.tx_watermark = 12,
	.rx_watermark = 20,
};
(** pcm default configure **)
/* default pcm config */
const static struct i2s_config def_pcm_config = {
	.hw_port = 0,
	.fs = 8000,
	.slave_timeout = 0xF11,
	.bus_type = PCM_BUS,
	.byte_per_chan = I2S_BPCH_16,
	.mode = I2S_MASTER,
	.lsb = I2S_LSB,
	.rtx_mode = I2S_RTX_MODE,
	.sync_mode = I2S_LRCK,
	.lrck_inv = I2S_L_LEFT,
	.clk_inv = I2S_CLK_N,
	.pcm_bus_mode = I2S_SHORT_FRAME,
	.pcm_slot = 0x1,
	.pcm_cycle = 1,
	.tx_watermark = 12,
	.rx_watermark = 20,
};

* VBC Sound Card

Required SoC Specific Properties:
- compatible : "sprd,vbc-r1p0-sprd-codec-v1"
or,
- compatible : "sprd,vbc-r2p0-sprd-codec-v3"
- sprd,model : what's name of this sound card;
- sprd,pcm : phandle of the platform;
- sprd,codec : phandle of the codec;

Required Board Specific Properties:

Optional Board Specific Properties:

* I2S Sound Card

Required SoC Specific Properties:
- compatible : "sprd,i2s-null-codec"
- sprd,model : what's name of this sound card;
- sprd,i2s : phandle list of the cpu dai(i2s);
- sprd,pcm : phandle of the platform;
- sprd,codec : phandle of the codec;

Required Board Specific Properties:

Optional Board Specific Properties:


Example:

- SoC Specific Portion:

/ {
        sprd-audio-devices {
                compatible = "sprd,sound";
                #address-cells = <1>;
                #size-cells = <1>;

                /* 1. codecs */
                sprd_codec_v3: sprd-codec-v3 {
                        compatible = "sprd,sprd-codec-v3";
                        status = "disable";
                        sprd,def_da_fs = <44100>;
                        sprd,ap_irq = <164>;
                        sprd,dp_irq = <52>;
                };

                sprd_codec_v1: sprd-codec-v1 {
                        compatible = "sprd,sprd-codec-v1";
                        status = "disable";
                        sprd,def_da_fs = <44100>;
                        sprd,ap_irq = <103>;
                        sprd,dp_irq = <63>;
                };

                null_codec: null-codec {
                        compatible = "sprd,null-codec";
                };

                /* 2. cpu-dais */
                vbc_r2p0: vbc-r2p0 {
                        compatible = "sprd,vbc-r2p0";
                        status = "disable";
                };

                vbc_r1p0: vbc-r1p0 {
                        compatible = "sprd,vbc-r1p0";
                        status = "disable";
                };

                vaudio: vaudio {
                        compatible = "sprd,vaudio";
                };

                pcm_def_config: bt-i2s-config {
                        sprd,def_pcm_config;
                };

                i2s_def_config: fm-i2s-config {
                };

                i2s0: i2s@0 {
                        compatible = "sprd,i2s";
                        status = "disable";
                        sprd,hw_port = <0>;
                        sprd,base = <0x70D00000 0xF537C000>;
                        sprd,dma_rx_no = <3>;
                        sprd,dma_tx_no = <4>;
                };

                i2s1: i2s@1 {
                        compatible = "sprd,i2s";
                        status = "disable";
                        sprd,hw_port = <1>;
                        sprd,base = <0x70E00000 0xF5380000>;
                        sprd,dma_rx_no = <5>;
                        sprd,dma_tx_no = <6>;
                };

                i2s2: i2s@2 {
                        compatible = "sprd,i2s";
                        status = "disable";
                        sprd,hw_port = <2>;
                        sprd,base = <0x70F00000 0xF5382000>;
                        sprd,dma_rx_no = <7>;
                        sprd,dma_tx_no = <8>;
                };

                i2s3: i2s@3 {
                        compatible = "sprd,i2s";
                        status = "disable";
                        sprd,hw_port = <3>;
                        sprd,base = <0x71000000 0xF5384000>;
                        sprd,dma_rx_no = <9>;
                        sprd,dma_tx_no = <10>;
                };

                /* 3. platform */
                sprd_pcm: sprd-pcm-audio {
                        compatible = "sprd,sprd-pcm";
                };

                /* 4. machine */
                vbc_sound: sound@0 {
                        compatible = "sprd,vbc-r2p0-sprd-codec-v3";
                        sprd,model = "sprdphone";
                        sprd,vaudio = <&vaudio>;
                        sprd,vbc = <&vbc_r2p0>;
                        sprd,codec = <&sprd_codec_v3>;
                        sprd,pcm = <&sprd_pcm>;
                };

                i2s_sound: sound@1 {
                        compatible = "sprd,i2s-null-codec";
                        sprd,model = "all-i2s";
                        sprd,i2s = <&i2s0>, <&i2s1>, <&i2s2>, <&i2s3>;
                        sprd,codec = <&null_codec>;
                        sprd,pcm = <&sprd_pcm>;
                };

        };

};

Board Specific:

&vbc_r2p0 {
        status = "okay";
};

&sprd_codec_v3 {
        status = "okay";
        sprd,audio_power_ver = <3>;
        sprd,hp_pa_ver = <1>;
        sprd,ap_irq = <166>;
};

&i2s0 {
        status = "okay";
};

&i2s1 {
        status = "okay";
};

&i2s_sound {
        sprd,i2s = <&i2s0>, <&i2s1>;
};
```

## Documentation/devicetree/bindings/spi/spi-pxa2xx.txt
```
SPI

MARVELL SPI 1

Required properties:
- Compatibility : "marvell,pxa910-spi"
- reg		: Address of SPI1 Register
- ssp-id	: Bus Id
- interrupts	: One ssp interrupt should be required here

Optional properties:
-  dmas		: Used to choose dmas channel
-  dma-names	: Names of dma

Example:
	spi1: spi@d4035000 {
		compatible = "marvell,pxa910-spi";
		reg = <0xd4035000 0x90>;
		ssp-id = <1>;
		interrupts = <0 0 0x4>;
		dmas = <&pdma1 6 0
			&pdma1 7 0>;
		dma-names = "rx", "tx";
		lpm-qos = <PM_QOS_CPUIDLE_BLOCK_AXI>;
		status = "disabled";
		pinctrl-names = "default";
		pinctrl-0 = <&spi1_pins>;
		#address-cells = <1>;
		#size-cells = <0>;
		status = "disabled";
	};
```

## Documentation/devicetree/bindings/spi/spi-sprd.txt
```
Spreadtrum SPI Controller

Required properties:
- compatible: should be one of following:
	"sprd,sc9860-spi",
	"sprd,sc9863-spi",
	"sprd,ums9620-spi".
- reg: Offset and length of SPI controller register space.
- interrupts: Should contain SPI interrupt.
- clock-names: Should contain following entries:
	"spi" for SPI clock,
	"source" for SPI source (parent) clock,
	"enable" for SPI module enable clock.
- clocks: List of clock input name strings sorted in the same order
	as the clock-names property.
- #address-cells: The number of cells required to define a chip select
	address on the SPI bus. Should be set to 1.
- #size-cells: Should be set to 0.

Example:
spi0: spi@70a00000{
	compatible = "sprd,sc9863-spi";
	reg = <0 0x70a00000 0 0x1000>;
	interrupts = <GIC_SPI 7 IRQ_TYPE_LEVEL_HIGH>;
	clock-names = "enable", "spi", "source";
	clocks = <&apapb_gate CLK_SPI0_EB>,
		 <&ap_clk CLK_AP_SPI0>, <&pll CLK_TWPLL_192M>;
	#address-cells = <1>;
	#size-cells = <0>;
	status = "disabled";
};
```
