## Documentation/devicetree/bindings/staging/iio/sensor_motion.txt
```
* Invensense motion sensors module
- compatible = "invensense,mpu9250"
- reg : register offset
- interrupts : interrupt
Example:
sensor: mpu9250@69 {
	        compatible = "invensense,mpu9250";
	        reg = <0x69>;
	        interrupts = <65 IRQ_TYPE_EDGE_FALLING>;
	        status = "okay";
	};

* Invensense motion sensors module
- compatible = "invensense,icm20628"
- reg : register offset
- interrupts : interrupt
Example:
sensor4: icm20628@69 {
                compatible = "invensense,icm20628";
                reg = <0x69>;
                interrupt-parent = <&gpio>;
                interrupts = <91 0x1>;
                inven,irq-gpios = <&gpio 91 0x00>;
                avdd-supply = <&ldo4>;
                axis_map_x = <1>;
                negate_x = <0>;
                axis_map_y = <0>;
                negate_y = <0>;
                axis_map_z = <2>;
                negate_z = <1>;
                inven,secondary_axis_map_x = <1>;
                inven,secondary_negate_x = <0>;
                inven,secondary_axis_map_y = <0>;
                inven,secondary_negate_y = <0>;
                inven,secondary_axis_map_z = <2>;
                inven,secondary_negate_z = <1>;
                inven,secondary_type = "compass";
                inven,secondary_name = "ak09912";
                inven,secondary_reg = <0x0D>;
          };
```

## Documentation/devicetree/bindings/thermal/helan2_thermal.txt
```
* pxa1U88 thermal module
- compatible = "marvell,pxa28nm-thermal"
- reg : register offset
- interrupts : interrupt
Example:
thermal: thermal@d4013300 {
        compatible = "marvell,pxa28nm-thermal";
        reg = <0xd4013300 0x1C>;
        interrupts = <0 60 0x4>;
        status = "okay";
};
```

## Documentation/devicetree/bindings/thermal/pxa1928_thermal.txt
```
* PXA1928 Thermal
- compatible = "mrvl,thermal"
- reg : address range of the thermal sensor registers;
- interrupts : interrupts generated from ICU;
- marvell,version-flag: sensor ip version;
- status: enable/disable
Example:
thermal: thermal@d403b000 {
        compatible = "mrvl,thermal";
        reg = <0xd403b000 0x7c>;
        marvell,version-flag = <3>;
        interrupts = <0 132 0x4>;
        status = "disabled";
};
```

## Documentation/devicetree/bindings/thermal/pxa1936_thermal.txt
```
* pxa1936 thermal module
- compatible = "marvell,pxa1936-thermal"
- reg : register offset
- interrupts : interrupt
Example:
thermal: thermal@d4013300 {
        compatible = "marvell,pxa1936-thermal";
        reg = <0xd4013300 0x1C>;
        interrupts = <0 60 0x4>;
        status = "okay";
};
```

## Documentation/devicetree/bindings/thermal/pxa_thermal.txt
```
* PXA1L88 Thermal
- compatible = "marvell,pxa-thermal"
- reg : address range of the thermal sensor registers;
- interrupts : interrupts generated from ICU;
- trigger_levels_count: trip points number;
- type: sensor type
- status: enable/disable
Example:
thermal: thermal@d4013200 {
        compatible = "marvell,pxa-thermal";
        reg = <0xd4013200 0x50>;
        interrupts = <0 60 0x4>;
        trigger_levels_count = <4>;
        type = <2>;
        status = "ok";
};
```

## Documentation/devicetree/bindings/thermal/sprd-virtual-thermal.txt
```
Spreadtrum thermal device tree bindings

Required properties:
- compatible : Should be "sprd,virtual-thermal"
- sensor-names : Should be thmzone name, such as "soc-thmzone", "cluster0-thmzone".
- type : temperature type should be "max-temp" and "avg-temp".

Example:

	virtual_cp_max_sensor: virtual-cp-max-sensor@18 {
		compatible = "sprd,virtual-thermal";
		#thermal-sensor-cells = <1>;
		sensor-names ="cluster0-thmzone","cluster1-thmzone","soc-thmzone";
		type = max-temp;
	};
```

## Documentation/devicetree/bindings/timer/sprd,time-sync.txt
```
Unisoc time-sync bindings

The sprd time sync feature used for APCP / APCH and so on.
It will create a device and send an event to HAL when the
time requires synchronization.

Required Properties:
- compatible: must be "sprd,time-sync".
- compatible: ch must be "sprd,time-sync-ch".

Example:
	time_sync {
		compatible = "sprd,time-sync";
	};

Used for CH send message:
The reg is SENSOR_TS_CTRL address.
	time_sync_ch {
		compatible = "sprd,time-sync-ch";
		reg = <0x0 0x62110080 0x0 0x10>;
	};
```

## Documentation/devicetree/bindings/usb/ehci-marvell.txt
```
MARVELL HS USB EHCI controller

Required properties:

- compatible: should be "marvell,pxa-u2oehci"
- reg: should contain one register range i.e. start and length
- interrupts: description of the interrupt line

Example:
ehci: ehci@d4208100 {
	compatible = "marvell,pxa-u2oehci";
	reg = <0xd4208100 0x200>;
	interrupts = <0 67 0x4>;
	marvell,ehci-name = "pxa-u2oehci";
	marvell,udc-mode = <1>;
	marvell,extern-attr = <1>;
	marvell,otg-force-a-bus-req;
	clocks = <&soc_clocks PXA1928_CLK_USB>;
	status = "disabled";
};
```

## Documentation/devicetree/bindings/usb/marvell-usb-phy.txt
```
USB PHY

MARVELL USB2 PHY

Required properties:
- compatible: Should be "marvell,usb2-phy-28lp"
- reg : Address and length of the register set for the device.

Example:
usbphy: usbphy@d4207000 {
	compatible = "marvell,usb2-phy-28lp";
	reg = <0xd4207000 0xe0>;
	marvell,udc-name = "mv-udc";
	marvell,ehci-name = "pxa-u2oehci";
	marvell,otg-name = "mv-otg";
	marvell,phy-name = "mv-usb-phy";
	marvell,pll-lock-bypass;
	clocks = <&soc_clocks PXA1928_CLK_USB>;
	status = "disabled";
};
```

## Documentation/devicetree/bindings/usb/marvell-usb.txt
```
* MARVELL USB CONTROLLER
Required properties:
- compatible : should be "marvell,mv-otg";
- reg : register base address and size;

otg: otg@d4208100 {
	compatible = "marvell,mv-otg";
	reg = <0xd4208100 0x200>;
	interrupts = <0 67 0x4>;
	marvell,udc-name = "mv-udc";
	marvell,ehci-name = "pxa-u2oehci";
	marvell,otg-name = "mv-otg";
	marvell,udc-mode = <1>;
	marvell,extern-attr = <3>;
	marvell,otg-force-a-bus-req;
	lpm-qos = <PM_QOS_CPUIDLE_BLOCK_AXI>;
	clocks = <&soc_clocks PXA1928_CLK_USB>;
	status = "disabled";
};


MARVELL USB device controller

Required properties:
- compatible: Should be "marvell,mv-udc"
- reg: Address and length of the register set for the device
- interrupts: Should contain macb interrupt

udc: udc@d4208100 {
	compatible = "marvell,mv-udc";
	reg = <0xd4208100 0x200>;
	interrupts = <0 67 0x4>;
	marvell,udc-name = "mv-udc";
	marvell,udc-mode = <1>;
	marvell,extern-attr = <3>;
	marvell,otg-force-a-bus-req;
	lpm-qos = <PM_QOS_CPUIDLE_BLOCK_AXI>;
	clocks = <&soc_clocks PXA1928_CLK_USB>;
	status = "disabled";
};
```

## Documentation/devicetree/bindings/usb/sprd,sc27xx-pd.txt
```
Spreadtrum Power Delivery controllers

Required properties :
- compatible		: should be one of the following
                          "sprd,sc27xx-pd"
                          "sprd,sc2730-pd"
                          "sprd,ump9620-pd"
- reg			: power delivery and typec base address
- interrupt-parent	: phandle for the Interrupt Controller
- interrupts		: Interrupt specifier
- extcon		: phandle for extcon to get typec plug event

- nvmem-cells: A phandle to the calibration data provided by a nvmem device.
- nvmem-cell-names: Should be "pdrc_calib", "pddelta_calib", "pdref_calib", "cc_calib".

Required sub-node:
- connector : The "usb-c-connector" attached to the SPRDTRUM SC2730 IC. The bindings
  of the connector node are specified in:

	Documentation/devicetree/bindings/connector/usb-connector.txt

Example:

pmic_pd: pd@e00 {
        compatible = "sprd,sc27xx-pd", "sprd,sc2730-pd";
        reg = <0xe00>, <0x380>;
        interrupt-parent = <&sc2730_pmic>;
        interrupts = <9 IRQ_TYPE_LEVEL_HIGH>;
        extcon = <&pmic_typec>;
        nvmem-cells = <&pdrc_calib>, <&pddelta_calib>, <&pdref_calib>, <&cc_cal>;
        nvmem-cell-names = "pdrc_calib", "pddelta_calib", "pdref_calib", "cc_calib";

	usb_con: connector {
		compatible = "usb-c-connector";
		label = "USB-C";
		power-role = "dual";
		try-power-role = "sink";
		source-pdos = <PDO_FIXED(5000, 400, PDO_FIXED_USB_COMM)>;
		sink-pdos = <PDO_FIXED(5000, 500, PDO_FIXED_USB_COMM)
			     PDO_FIXED(9000, 2000, PDO_FIXED_USB_COMM)>;
		op-sink-microwatt = <18000000>;
};
```

## Documentation/devicetree/bindings/vibrator/drv2604_vibrator.txt
```
Device tree bindings for Texas-Instruments drv2604 vibrator driver

Required properties:

 - compatible:          Should be "ti,drv2604-vibrator".
 - reg:                 I2C client number (0x5a as defined in drv2604 datasheet).
 - vibrator-supply:     Regulator that supplies the vibrator driver.

Example:

	vibrator: vibrator@5a {
		compatible = "ti,drv2604-vibrator";
		reg = <0x5a>;
		vibrator-supply = <&ldo10>;
	};
```

## Documentation/devicetree/bindings/video/backlight/lm3532_bl.txt
```
lm3532_bl bindings

Required properties:
  - compatible: "ti,lm3532"
  - reg: I2C slave address (u8)
  - avdd-supply: regulator that supplies the device.

Optional properties:
  - flags: various flags for the device:
	# LM3532_CONFIG_MAP_ALL_CTRL_A- all ILEDS will be controlled by Control
	  A PWM and Control A registers.
	# LM3532_CONFIG_ALS- enables device working with IRQ, registering
	  as input device.
  - ramp_time: desired ramp time in microseconds. the larger the ramp time the
    smoother is the transition to a new brightness level.
  - ctrl_a_fs_current: configures the full-scale current setting for the
    current sink assigned to Control Bank A.
  - ctrl_a_mapping_mode: chooses the mapping type as either exponential or
    linear.
  - ctrl_a_pwm: configures control A PWM register.
  - rst_gpio: gpio that resets the device.
  - feedback_en_val: configures which current sinks are part of the boost
    control loop.
  - output_cfg_val: configures how the three control banks are routed to the
    current sinks (ILED1, ILED2, ILED3).

Example:
	backlight1: lm3532@38 {
		compatible = "ti,lm3532";
		reg = <0x38>;
		flags = <0>;
		ramp_time = <0>;
		ctrl_a_fs_current = <0x13>; /* 20.2mA */
		ctrl_a_current_ctrl = <0x1> /* use I2C control */
		ctrl_a_mapping_mode = <0x2>; /* use linear mapping */
		ctrl_a_pwm = <0x86>;	/*
					 * CTRL_A zone 0 PWM enable,
					 * polarity active high
					 */
		rst_gpio = <&gpio 32 0>; /* reset GPIO is 32 */
		avdd-supply = <&ldo9>; /* regulator is ldo9 */
		feedback_en_val = <0x1> /* ILED1 feedback enable */
		output_cfg_val = <0x0>	/*
					 * ILEDX (X = 1, 2, 3) controlled by
					 * Control A PWM and Control A
					 * Brightness.
					 */
	};
```

## Documentation/devicetree/bindings/watchdog/mmp-wdt.txt
```
* Marvell MMP Watchdog Time

Required Properties:

- Compatibility : "marvell,mmp-wdt"
- reg		: Address of the timer and main pmu registers

Optional properties:

-  marvell,mmp-wdt-disabled	: Used to decide whether watchdog timer needed.

Example:

	watchdog: wdt@d4080000 {
		compatible = "marvell,mmp-wdt";
		reg = <0xd4080000 0xc8>,
			  <0xd4050000 0x1024>;
		marvell,mmp-wdt-disabled;
	};

Required Properties:

- Compatibility : "marvell,mmp-wdt-rtc"
- reg		: Address of the wdtrtc registers

Example:
	wdtrtc: wdtrtc@d4010000 {
		compatible = "marvell,mmp-wdt-rtc";
		reg = <0xd4010000 0x10000>;
	};


Required Properties:

- Compatibility : "marvell,mmp-watchdog"
- reg		: Address of the watchdog registers

Example:

	wdt: wdt@d4080000 {
		compatible = "marvell,mmp-watchdog";
		reg = <0xd4080000 0xff>;
	};
```

## Kconfig
```kconfig
# SPDX-License-Identifier: GPL-2.0
#
# For a description of the syntax of this configuration file,
# see Documentation/kbuild/kconfig-language.txt.
#
mainmenu "Linux/$(ARCH) $(KERNELVERSION) Kernel Configuration"

comment "Compiler: $(CC_VERSION_TEXT)"

source "scripts/Kconfig.include"

source "init/Kconfig"

source "kernel/Kconfig.freezer"

source "fs/Kconfig.binfmt"

source "mm/Kconfig"

source "net/Kconfig"

source "drivers/Kconfig"

source "fs/Kconfig"

source "security/Kconfig"

source "crypto/Kconfig"

source "lib/Kconfig"

source "lib/Kconfig.debug"

source "techpack/camera/drivers/Kconfig"
source "techpack/display/msm/samsung/NT36672C_PM6585JB3/Kconfig" # ADDED BY LEGO AUTOMATICALLY: DO NOT SUBMIT
source "techpack/display/msm/samsung/A23_ILI7807S_BS066FBM/Kconfig" # ADDED BY LEGO AUTOMATICALLY: DO NOT SUBMIT
source "techpack/display/msm/samsung/A23_NT36672C_TCFJ6606/Kconfig" # ADDED BY LEGO AUTOMATICALLY: DO NOT SUBMIT
source "techpack/display/msm/samsung/A23_FT8720_LPS066A767A/Kconfig" # ADDED BY LEGO AUTOMATICALLY: DO NOT SUBMIT
source "techpack/display/msm/samsung/Kconfig" # ADDED BY LEGO AUTOMATICALLY: DO NOT SUBMIT
```

## arch/arm/Kconfig.sec
```kconfig
config SEC_A6PLTE_PROJECT
	depends on ARCH_SDM450
	default n
	bool "Samsung A6-Plus LTE Project"
	help
	  Support for Samsung A6-Plus LTE Project

config MACH_A6PLTE_EUR_OPEN
	depends on SEC_A6PLTE_PROJECT
	default n
	bool "Samsung A6-Plus LTE EUR OPEN"
	help
	  Support for Samsung A6-Plus LTE EUR OPEN device.
	  
config MACH_A6PLTE_MEA_OPEN
	depends on SEC_A6PLTE_PROJECT
	default n
	bool "Samsung A6-Plus LTE MEA OPEN"
	help
	  Support for Samsung A6-Plus LTE MEA OPEN device.

config MACH_A6PLTE_SEA_OPEN
	depends on SEC_A6PLTE_PROJECT
	default n
	bool "Samsung A6-Plus LTE SEA OPEN"
	help
	  Support for Samsung A6-Plus LTE SEA OPEN device.

config MACH_A6PLTE_LTN_OPEN
        depends on SEC_A6PLTE_PROJECT
        default n
        bool "Samsung A6-Plus LTE LTN OPEN"
        help
          Support for Samsung A6-Plus LTE LTN OPEN device.

config MACH_A6PLTE_CIS_SER
	depends on SEC_A6PLTE_PROJECT
	default n
	bool "Samsung A6-Plus LTE CIS SER"
	help
	  Support for Samsung A6-Plus LTE CIS SER device.

config MACH_A6PLTE_CHN_OPEN
	depends on SEC_A6PLTE_PROJECT
	default n
	bool "Samsung A6-Plus LTE CHN OPEN"
	help
	  Support for Samsung A6-Plus LTE CHN OPEN device.

config MACH_A6PLTE_CHN_HK
	depends on SEC_A6PLTE_PROJECT
	default n
	bool "Samsung A6-Plus LTE CHN HK"
	help
	  Support for Samsung A6-Plus LTE CHN HK device.

config MACH_A6PLTE_KOR_KTT
	depends on SEC_A6PLTE_PROJECT
	default n
	bool "Samsung A6-Plus LTE KOR KTT"
	help
	  Support for Samsung A6-Plus LTE KOR KTT device.

config SEC_GTA2XLLTE_PROJECT
	depends on ARCH_SDM450
	default n
	bool "Samsung Tab A2 XL LTE Project"
	help
	  Support for Samsung Tab A2 XL LTE Project

config MACH_GTA2XLLTE_EUR_OPEN
	depends on SEC_GTA2XLLTE_PROJECT
	default n
	bool "Samsung Tab A2 XL LTE EUR OPEN"
	help
	  Support for Samsung Tab A2 XL LTE EUR OPEN device.

config SEC_GTA2XLWIFI_PROJECT
        depends on ARCH_SDM450
        default n
        bool "Samsung Tab A2 XL WIFI Project"
        help
          Support for Samsung Tab A2 XL WIFI Project

config MACH_GTA2XLWIFI_EUR_OPEN
        depends on SEC_GTA2XLWIFI_PROJECT
        default n
        bool "Samsung Tab A2 XL WIFI EUR OPEN"
        help
          Support for Samsung Tab A2 XL WIFI EUR OPEN device.

config SEC_J6PLTE_PROJECT
	depends on ARCH_SDM450
	default n
	bool "Samsung A6-Plus LTE Project"
	help
	  Support for Samsung A6-Plus LTE Project

config MACH_J6PLTE_CIS_SER
	depends on SEC_J6PLTE_PROJECT
	default n
	bool "Samsung J6-Plus LTE CIS SER"
	help
	  Support for Samsung J6-Plus LTE CIS SER device.

config SEC_J2ESSLTE_PROJECT
		depends on ARCH_MSM8937
		default n
		bool "Samsung J2ESSLTE Project"
		help
		Support for Samsung J2ESSLTE Project.

config MACH_J2ESSLTE_SWA_INS
		depends on SEC_J2ESSLTE_PROJECT
		default n
		bool "Samsung J2ESSLTE SWA INS"
		help
		Support for Samsung J2ESSLTE SWA INS device.
```
