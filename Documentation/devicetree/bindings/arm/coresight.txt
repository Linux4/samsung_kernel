## Documentation/devicetree/bindings/arm/coresight.txt
```
* ARM Coresight

Required Properties:

- Compatibility : "marvell,coresight"
- clocks	: clocks for debug and etb modules.
- clock-names	: clock name for debug and etb modules
- reg		: Address of the coresight registers

Example for arm:

	coresight: coresight@d4100000 {
        compatible = "marvell,coresight";
        clocks = <&soc_clocks PXA1U88_CLK_DBGCLK>,
                 <&soc_clocks PXA1U88_CLK_TRACECLK>;
        clock-names = "DBGCLK","TRACECLK";
        #address-cells = <1>;
        #size-cells = <1>;
        reg = <0xd4100000 0x100000>;
        ranges;

        dbg: dbg@0xd4110000 {
                compatible = "marvell,coresight-dbg";
                reg = <0xd4110000 0x8000>;
        };

        cti: cti@0xd4118000 {
                compatible = "marvell,coresight-cti";
                reg = <0xd4118000 0x4000>;
        };

        etm: etm@0xd411c000 {
                compatible = "marvell,coresight-etm";
                reg = <0xd411c000 0x4000>;
        };

        cstf: cstf@0xd4109000 {
                compatible = "marvell,coresight-cstf";
                reg = <0xd4109000 0x4000>;
        };

        cetb: cetb@0xd4105000 {
                compatible = "marvell,coresight-cetb";
                reg = <0xd4105000 0x4000>;
        };

        letb: letb@0xd410a000 {
                compatible = "marvell,coresight-letb";
                reg = <0xd410a000 0x4000>;
        };
	};


Example for arm64:

	coresight: coresight@d4100000 {
        compatible = "marvell,coresight";
        clocks = <&soc_clocks PXA1U88_CLK_DBGCLK>,
                 <&soc_clocks PXA1U88_CLK_TRACECLK>;
        clock-names = "DBGCLK","TRACECLK";
        #address-cells = <1>;
        #size-cells = <1>;
        reg = <0xd4100000 0x100000>;
        ranges;

        dbg: dbg@0xd4110000 {
                compatible = "marvell,coresight-dbg";
                reg = <0xd4110000 0x8000>;
        };

        cti: cti@0xd4118000 {
                compatible = "marvell,coresight-cti";
                reg = <0xd4118000 0x4000>;
        };

        etm: etm@0xd411c000 {
                compatible = "marvell,coresight-etm";
                reg = <0xd411c000 0x4000>;
        };

        letb: letb@0xd410a000 {
                compatible = "marvell,coresight-letb";
                reg = <0xd410a000 0x4000>;
        };
	};
```

## Documentation/devicetree/bindings/arm/mrvl/coredbg.txt
```
* Marvell MMP core debug related components

Marvell MMP chips have a CoreSight System Components into their design
and produce real-time instruction and data trace information from a SoC.
We have software jtag as well.

Required properties:
For CoreSight components:
- compatible : Should be "marvell,coresight"
- clocks : From common clock binding. First clock is debug clock (ATCLK and
  PCLKDBG). Another clock is for internal trace clock.
- clock-names : From common clock binding. Shall be "DBGCLK" and "TRACECLK".
- mapping of the CoreSight addresses into main address space:
	#address-cells = <1>;
	#size-cells = <1>;
	reg = <base_addr size >;
	ranges;
- each component of CoreSight:
  dbg: Debug Access Port.
  cti: Cross Trigger Interface.
  etm: Embedded Trace Macrocell.
  cstf: CoreSight Trace Funnel.
  etb: Embedded Trace Buffer.

For software jtag:
- compatible : Should be "marvell,sw-jtag".
- reg : The software jtag address.
- status : "disabled" indicates the software jtag is not available for use.

Example:
	coresight: coresight@d4100000 {
		compatible = "marvell,coresight";
		clocks = <&soc_clocks PXA1L88_CLK_DBGCLK>,
			 <&soc_clocks PXA1L88_CLK_TRACECLK>;
		clock-names = "DBGCLK","TRACECLK";
		#address-cells = <1>;
		#size-cells = <1>;
		reg = <0xd4100000 0x100000>;
		ranges;

		dbg: dbg@0xd4110000 {
			compatible = "marvell,coresight-dbg";
			reg = <0xd4110000 0x8000>;
		};

		cti: cti@0xd4118000 {
			compatible = "marvell,coresight-cti";
			reg = <0xd4118000 0x4000>;
		};

		etm: etm@0xd411c000 {
			compatible = "marvell,coresight-etm";
			reg = <0xd411c000 0x4000>;
		};

		cstf: cstf@0xd4109000 {
			compatible = "marvell,coresight-cstf";
			reg = <0xd4109000 0x4000>;
		};

		cetb: cetb@0xd4105000 {
			compatible = "marvell,coresight-cetb";
			reg = <0xd4105000 0x4000>;
		};

		letb: letb@0xd410a000 {
			compatible = "marvell,coresight-letb";
			reg = <0xd410a000 0x4000>;
		};
	};

	swjtag: swjtag@d4013100 {
		compatible = "marvell,sw-jtag";
		reg = <0xd4013100 0x10>;
		status = "disabled";
	};
```

## Documentation/devicetree/bindings/arm/mrvl/mrvl.txt
```
Marvell Platforms Device Tree Bindings
----------------------------------------------------

PXA168 Aspenite Board
Required root node properties:
	- compatible = "mrvl,pxa168-aspenite", "mrvl,pxa168";

PXA910 DKB Board
Required root node properties:
	- compatible = "mrvl,pxa910-dkb";

MMP2 Brownstone Board
Required root node properties:
	- compatible = "mrvl,mmp2-brownstone";

PXA1L88 DKB Board
Required root node properties:
	- compatible = "marvell,PXA1L88";

PXA1L88 tablet V10 DKB Board
Required root node properties:
	- compatible = "marvell,pxa1L88-tablet-v10";

PXA1936 SOC
Required root node properties:
	- compatible = "marvell,pxa1936";

PXA1936 QT Emulation
Required root node properties:
	- compatible = "marvell,pxa1936-qt";

PXA1936 FPGA Emulation
Required root node properties:
	- compatible = "marvell,pxa1936-fpga";

PXA1936 DKB Board
Required root node properties:
	- compatible = "marvell,pxa1936-dkb";

PXA1936 FF Board
Required root node properties:
	- compatible = "marvell,pxa1936-ff";

Generic QT Emulation
Required root node properties:
	- compatible = "marvell,qt";
```

## Documentation/devicetree/bindings/arm/mrvl/timer.txt
```
* Marvell MMP Timer controller

Each timer have multiple counters, so the timer DT need include counter's
description.

1. Timer

Required properties:
- compatible : Should be "marvell,mmp-timer".
- reg : Address and length of the register set of timer controller.
- marvell,timer-fastclk-frequency : The fast clock frequency of the timer.
  Timer will have several clock inputs: fast clock, 32KHZ, 1KHZ. For all
  SOCes use this timer controller, fast clock may not be same.
- marvell,timer-apb-frequency : The fequency of the apb bus that the timer
  attached to. This frequency and "marvell,timer-fastclk-frequency" are used
  to calculated delay loops for clock operations.

Optional properties:
- marvell,timer-has-crsr : This timer has CRSR register.
- marvell,timer-has-shadow : This timer has shadow register.

2. Counter

Required properties:
- compatible : It can be
      "marvell,timer-counter-clkevt" : The counter is used for clock event
                                       device.
      "marvell,timer-counter-clksrc" : The counter is used for clock source.
      "marvell,timer-counter-delay" : The counter is used for delay timer.
- marvell,timer-counter-id : The counter index in this timer.

Optional properties:
- interrupts : The interrupt for clock event device.
  Only valid for "marvell,timer-counter-clkevt".
- marvell,timer-counter-cpu : which CPU the counter is bound. Only valid for
  "marvell,timer-counter-clkevt".
- marvell,timer-counter-broadcast : When this counter acts as clock event
  device. It is broadcast clock event device.
  Only valid for "marvell,timer-counter-clkevt".
- marvell,timer-counter-nodynirq : When this counter acts as broadcast clock
  event device, it cannot switch the IRQ of broadcast clock event to any CPU.
  Only valid for "marvell,timer-counter-clkevt".

3. Examples

timer0: timer@d4014000 {
	compatible = "marvell,mmp-timer";
	reg = <0xd4014000 0xc8>;
	marvell,timer-fastclk-frequency = <3250000>;
	marvell,timer-apb-frequency = <26000000>;
	status = "okay";

	counter0 {
		compatible = "marvell,timer-counter-clkevt";
		interrupts = <13>;
		marvell,timer-counter-id = <0>;
		marvell,timer-counter-cpu = <0>;
		marvell,timer-counter-frequency = <32768>;
	};

	counter1 {
		compatible = "marvell,timer-counter-clksrc";
		marvell,timer-counter-id = <1>;
		marvell,timer-counter-frequency = <32768>;
	};
};
```

## Documentation/devicetree/bindings/fb/marvell_apical.txt
```
* MARVELL APICAL CONTROLLER

Required properties:
- compatible : should be "marvell,mmp-apical";
- reg : register base address and size;

Example:
apical: apical@d420b400 {
	compatible = "marvell,mmp-apical";
	reg = <0xd420b400 0x400>, <0xd420b000 0x3d0>;
	status = "disabled";
};
```

## Documentation/devicetree/bindings/fb/marvell_disp.txt
```
* MARVELL DISP CONTROLLER

Required properties:
- compatible : should be "marvell,mmp-disp";
- reg : register base address and size;
- interrupts : DISP interrupt number;

Example:
disp: disp@d420b000 {
	compatible = "marvell,mmp-disp";
	reg = <0xd420b000 0x3d0>;
	lpm-qos = <PM_QOS_CPUIDLE_BLOCK_DDR>;
	interrupts = <0 41 0x4>;
	status = "disabled";
};
```

## Documentation/devicetree/bindings/fb/marvell_dsi.txt
```
* MARVELL DSI CONTROLLER

Required properties:
- compatible : should be "marvell,mmp-dsi";
- reg : register base address and size;
- interrupts : DSI interrupt number;

Example:
dsi: dsi@d420b800 {
	compatible = "marvell,mmp-dsi";
	reg = <0xd420b800 0x1ec>;
	interrupts = <0 53 0x4>;
	status = "disabled";
};
```

## Documentation/devicetree/bindings/fb/marvell_fb.txt
```
* MARVELL frame buffer baselay

Required properties:
- compatible : should be "marvell,mmp-fb";

Example:
fb0: fbbase {
	compatible = "marvell,mmp-fb";
	status = "disabled";
};
```

## Documentation/devicetree/bindings/fb/marvell_fb_overlay.txt
```
* MARVELL frame buffer overlay

Required properties:
- compatible : should be "marvell,mmp-fb-overlay";

Example:
fb1: fboverlay {
	compatible = "marvell,mmp-fb-overlay";
	status = "disabled";
};
```

## Documentation/devicetree/bindings/fb/marvell_vdma.txt
```
* MARVELL VDMA

Required properties:
- compatible : should be "marvell,mmp-vdma";
- reg : register base address and size;

Example:
vdma: vdma@d4209000 {
	compatible = "marvell,mmp-vdma";
	reg = <0xd4209000 0x850>, <0xd420b000 0x3d0>;
	status = "disabled";
};
```

## Documentation/devicetree/bindings/gpu/marvell-gd.txt
```
* Marvell 2D Graphics Accelerator

Required properties:
- compatible : should be "mrvl, xxx" for SoCs:
- reg: should be register base and length as documented in the
  SoC reference manual
- interrupts : Should contain the VPU interrupt. For CODA960,
  a second interrupt is needed for the MJPEG unit.
- clocks : Should contain the ahb and per clocks, in the order
  determined by the clock-names property.
- clock-names : Should be "ahb", "per"
- iram : phandle pointing to the SRAM device node
- marvell,[core]-clk-freq-combine : core in [] can be 3d, sh, 2d;
  present diffent cores' frequency table node.

Example:
gpu: gpu@C0400000 {
	compatible = "marvell,gpu";
	reg = <0xC0400000 0x1000>;
	interrupts = <0 8 0x4>;
    marvell,3d-clk-freq-combine =
          <156000 156000>,
          <312000 208000>,
          <416000 312000>,
          <624000 416000>,
          <705000 416000>;
	status = "disabled";
};

gpu2d {
	compatible = "marvell,gpu2d";
	status = "disabled";
};
```

## Documentation/devicetree/bindings/hwmon/sensor_apds.txt
```
* Avago ambient light + proximity sensors module
- compatible = "avago,apds9930"
- reg : register offset
- interrupts : interrupt
Example:
sensor: apds9930@39 {
	        compatible = "avago,apds9930";
	        reg = <0x39>;
	        interrupts = <14 0x1>;
	        status = "okay";
	};
```

## Documentation/devicetree/bindings/hwmon/sensor_apds990x.txt
```
* Avago ambient light + proximity sensors module
- compatible = "avago,apds990x"
- reg : register offset
- interrupts : interrupt
Example:
sensor: apds990x@39 {
	        compatible = "avago,apds990x";
	        reg = <0x39>;
	        interrupts = <ALS_INT 0x1>;
	        status = "okay";
	};
```

## Documentation/devicetree/bindings/hwmon/sensor_bmp18x.txt
```
* Bosch pressure sensor module
- compatible = "bosch,bmp18x"
- reg : register offset
- interrupts : interrupt
Example:
sensor: bmp18x@77 {
	        compatible = "bosch,bmp18x";
	        reg = <0x77>;
	        status = "okay";
	};
```

## Documentation/devicetree/bindings/hwmon/sensor_isl.txt
```
* Intersil ambient light + proximity sensors module
- compatible = "intersil,isl29043"
- reg : register offset
- interrupts : interrupt
Example:
sensor: isl29043@44 {
	        compatible = "intersil,isl29043";
	        reg = <0x44>;
	        interrupts = <14 0x1>;
	        status = "okay";
	};
```

## Documentation/devicetree/bindings/hwmon/sensor_lps.txt
```
* ST pressure sensor module
- compatible = "st,lps331ap"
- reg : register offset
- interrupts : interrupt
Example:
sensor: lps331ap@5d {
	        compatible = "st,lps331ap";
	        reg = <0x5d>;
	        status = "okay";
	};
```

## Documentation/devicetree/bindings/hwmon/sensor_memsic.txt
```
* Memsic accelerometer sensor module
- compatible = "memsic,mxc400x"
- reg : register offset
- interrupts : interrupt
Example:
sensor5: mxc400x@15 {
                compatible = "memsic,mxc400x";
                reg = <0x15>;
        };

* Memsic magnetic sensor module
- compatible = "memsic,mmc3524x"
- reg : register offset
- interrupts : interrupt
Example:
sensor6: mmc3524x@30 {
                 compatible = "memsic,mmc3524x";
                 reg = <0x30>;
        };
```

## Documentation/devicetree/bindings/iio/sprd_hub/sprd-sensorhub.txt
```
Unisoc sensor hub bindings

Unisoc's some SoCs integrates sensor hub. This sensor hub driver collect and
analyze data uploaded from sensors.

Required Properties:
- compatible: consisted of platform name and common name.
  - "sprd,sharkl3-sensorhub", "sprd,sensor-hub": for Sharkl3-compatible sensor hub,
  - "sprd,sharkl5-sensorhub", "sprd,sensor-hub": for Sharkl5-compatible sensor hub,
  - "sprd,sharkl5Pro-sensorhub", "sprd,sensor-hub": for Sharkl5pro-compatible sensor hub,
  - "sprd,roc1-sensorhub", "sprd,sensor-hub": for Roc1-compatible sensor hub
  - "sprd,qogirl6-sensorhub", "sprd,sensor-hub": for qogirl6-compatible sensor hub
  - "sprd,qogirn6pro-sensorhub", "sprd,sensor-hub": for qogirn6pro-compatible sensor hub

- sipc_sensorhub_id: define sensorhub id value in sipc communication
 - <6>: SIPC_ID_PM_SYS, sensorhub running on sp sys,
 - <9>: SIPC_ID_CH, sensorhub running on ch sys,
 if sipc_sensorhub_id not defined, sensorhub driver code will use 6 as default

Example:
	sprd-sensorhub {
		compatible = "sprd,sharkl5-sensorhub", "sprd,sensor-hub";
		sipc_sensorhub_id = <6>;
	};
```

## Documentation/devicetree/bindings/input/keyreset.txt
```
Device tree bindings for key reset device

description:
This device allows to perform reset (or panic) by means of key-bindings.

Required properties:

 - compatible:          Should be "marvell,keyreset".
 - keys-down :          list of keys which when pressed cause desired behavior.

Optional properties:

 - keyreset-need-panic: cause panic when key combination pressed, else cause reset.
 - keyreset-press-msec: debounce time (msec) for reset/panic

Example:
	/* cause reset with no delay when pressing specified buttons */
	keyreset {
		compatible = "marvell,keyreset";
		keys-down = <0x73 0x72>;
		keyreset-need-panic;
	};

	/* cause panic after 2 seconds of pressing specified buttons */
	keyreset {
		compatible = "marvell,keyreset";
		keys-down = <0x73 0x72>;
		keyreset-need-panic;
		keyreset-press-msec = <2000>;
	};
```

## Documentation/devicetree/bindings/input/touchscreen/88ms100.txt
```
* 88MS100 touchscreen driver

Required properties:
- compatible: must be "marvell,88ms100-touch"

Example:

	twsi1: i2c@d4010800 {
		touch3: 88ms100@720p {
			compatible = "marvell,88ms100-touch";
			pinctrl-names = "default"; pinctrl-0 = <&touch_pins>;
			reg = <0x18>;
			interrupt-parent = <&gpio>;
			interrupts = <72 0x1>;
			irq-gpios = <&gpio 72 0>;
			reset-gpios = <&gpio 75 0>;
			marvell,max-height = <1280>;
			marvell,max-width = <720>;
			avdd-supply = <&ldo11>;
		};

	};
```
