## Documentation/devicetree/bindings/input/touchscreen/gt9xx_touch.txt
```
* Goodix Technology touchscreen driver

Required properties:
- compatible: must be "goodix,gt913-touch"

Example:

	twsi0: i2c@d4011000 {
		touch3: gt913@720p {
			compatible = "goodix,gt913-touch";
			pinctrl-names = "default"; pinctrl-0 = <&touch_pins>;
			reg = <0x5d>;
			interrupt-parent = <&gpio>;
			interrupts = <17 0x1>;
			irq-gpios = <&gpio 17 0>;
			reset-gpios = <&gpio 16 0>;
			goodix,cfg-group = <0>;
			goodix,max-height = <1280>;
			goodix,max-width = <720>;
			avdd-supply = <&ldo10>;
		};
	};
```

## Documentation/devicetree/bindings/input/touchscreen/msg2133.txt
```
* MSG2133 touchscreen driver

Required properties:
- compatible: must be "focaltech,msg2133"

Example:

	twsi1: i2c@d4010800 {
		touch2: msg2133@26 {
			compatible = "focaltech,msg2133";
			pinctrl-names = "default"; pinctrl-0 = <&touch_pins>;
			reg = <0x26>;
			interrupt-parent = <&gpio>;
			interrupts = <72 0x1>;
			focaltech,abs-x-max = <480>;
			focaltech,abs-y-max = <854>;
			focaltech,irq-gpios = <&gpio 72 0>;
			focaltech,reset-gpios = <&gpio 75 0>;
			focaltech,v_tsp-supply = <&ldo11>;
		};

	};
```

## Documentation/devicetree/bindings/input/touchscreen/solomon-ssd20xx.txt
```
Synaptics TD4310 I2C touchscreen controller

Required properties:
 - compatible:     "solomon,ssd20xx"
 - gpios: 	   The reset and interrupt GPIO number
 - reg: 	   I2C slave address of the chip

Example nodes:

&i2c3 {
	/* ... */
	touchscreen@53 {
		compatible = "solomon,ssd20xx";
		reg = <0x53>;
		gpios = <&ap_gpio 145 GPIO_ACTIVE_HIGH
			&ap_gpio 144 GPIO_ACTIVE_HIGH>;
	};
	/* ... */
};
```

## Documentation/devicetree/bindings/input/touchscreen/synaptics_dsx_i2c.txt
```
* Synaptics DSX touchscreen driver

Required properties:
- compatible: must be "synaptics,s3202-touch"

Example:

	twsi1: i2c@d4010800 {

		touch1: s3202@720p {
			compatible = "synaptics,s3202-touch";
			pinctrl-names = "default"; pinctrl-0 = <&touch_pins>;
			reg = <0x22>;
			interrupt-parent = <&gpio>;
			interrupts = <72 0x1>;
			/* IRQF_ONESHOT | IRQF_TRIGGER_FALLING */
			synaptics,irq-flags =  <0x2002>;
			synaptics,irq-gpios = <&gpio 72 0>;
			synaptics,reset-gpios = <&gpio 75 0>;
			synaptics,sensor_res_x = <720>;
			synaptics,sensor_res_y = <1280>;
			synaptics,sensor_max_x = <798>;
			synaptics,sensor_max_y = <1392>;
			synaptics,sensor_margin_x = <39>;
			synaptics,sensor_margin_y = <0>;
			avdd-supply = <&ldo10>;
	};
```

## Documentation/devicetree/bindings/ion/marvell,pxa-ion.txt
```
* MARVELL PXA-ION Implementation

** Required properties:

- compatible: should be "marvell,pxa-ion"

- marvell,ion-nr: indicates number of ion heaps we are going to create,
		   should equal to the number of child heap nodes.

** Optional properties

- marvell,ion-iommu: indicates if we are going to attach ion devices
		     to iommu mapping domains.
- heap1: 	     the child node of heap we are going to create,
		     include below properties:

** heap required properties:

- marvell,ion-name: name of the heap;

- marvell,ion-type: indicates the type of heap_data to be created,
		    like ION_HEAP_TYPE_SYSTEM etc.

- marvell,ion-id:   the id for this heap, user can use this id to
		    specify allocate buffer from which heap

** heap optional properties:

- marvell,ion-base:  indicates the start address of the heap

- marvell,ion-size:  indicates the size of this heap


Example:

ion {
	compatible = "marvell,pxa-ion";
	marvell,ion-nr = <2>;
	status = "okay";
	marvell,ion-iommu = <1>;
	heap1 {
		marvell,ion-name = "carveout_heap";
		marvell,ion-type = <2>;
		marvell,ion-id = <2>;
		marvell,ion-base = <0>;
		marvell,ion-size = <0>;
	};
	heap2 {
		marvell,ion-name = "system_heap";
		marvell,ion-type = <0>;
		marvell,ion-id = <0>;
	};
};
```
