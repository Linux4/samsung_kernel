## Documentation/devicetree/bindings/misc/maxscend-cmmb.txt
```
* Maxscend CMMB module

Required properties:
- Compatibility : "maxscend,cmmb"

Example:
	spi1: spi@d4035000 {
		cmmb_if {
			compatible = "maxscend,cmmb";
			bits_per_word = /bits/ 8 <8>;
			reg = <0x0 0x0>;
			bus_num = <1>;
			mode = <0x0>;
			spi-max-frequency = <8000000>;
		};
	};
```

## Documentation/devicetree/bindings/misc/mediatek-md32.txt
```
* Mediatek MD32

MD32 is a tiny processor sub-system. MD32 integrated with peripherals is
designed to handle specific tasks for base-band SoC, such as Sensor HUB.

Required properties:
  - compatible: "mediatek,mt8173-md32"
  - reg: physical base address of the md32 sram, md32 register and md32 clock control,
    length of memory mapped region, 0x38000 and 0x100 respectively.
  - interrupts: interrupt number to the cpu.
  - clocks : clock name from clock manager
  - clock-names: the clock of MD32 system

Example:
	md32@10020000 {
		compatible = "mediatek,mt8173-md32";
		reg = <0 0x10020000 0 0x38000>,
		      <0 0x10050000 0 0x100>,
		interrupts = <GIC_SPI 166 IRQ_TYPE_LEVEL_HIGH>;
		clocks = <&topckgen CLK_TOP_SCP_SEL>;
		clock-names = "sys";
	};
```

## Documentation/devicetree/bindings/misc/mmp-debug.txt
```
* Marvell AXI timeout debug method

Required Properties:

- Compatibility 	: "marvell,mmp-debug"
- reg			: Address of the debug registers in squ domain
- interrupts:		: Interrupt number of axi timeout
- detection_modes	: Which mode to detect axi timeout.
				0x0: No mode enabled
				0x1: Interrupt mode
				0x2: Data abort mode
				0x3: Both interupt and data abort modes

Example:

	debug: debug@d42a0000 {
		compatible = "marvell,mmp-debug";
		reg = <0xd42a0000 0x800>;
		interrupts = <0 62 0x4>;
		detection_modes = <0x3>;
	};
```

## Documentation/devicetree/bindings/misc/mmp_gps.txt
```
* GPS module
- compatible = "marvell,mmp-gps"
- vgps-supply: power supply
Example:
mmp-gps {
        compatible = "marvell,mmp-gps";
        vgps-supply = <&ldo13>;
};
```

## Documentation/devicetree/bindings/misc/seh.txt
```
* Structured Error Handler

** seh

Required properties:
- compatible: "marvell,seh".
- reg: Should contain registers location and length
- interrupts: Should be one. If CP DWON, this interrupt will be triggered.
- interrupt-names: Assign name of irq resource.
- clocks: RIPC CLK.
- watchdog-type: should be 1, which means use soc timer as watchdog.
- timer-num: should be 2.
- match-num: should be 0.

Example:
seh: seh@d4080000 {
	compatible = "marvell,seh";
	reg = <0xd4080000 0x100>;
	interrupts = <0 32 0x4>;
	interrupt-names = "CP_TIMER2_3";
	clocks = <&soc_clocks PXA1L88_CLK_AICER>;
	watchdog-type = <1>; /* soc timer */
	timer-num = <2>; /* timer num */
	match-num = <0>; /* match num */
};
```

## Documentation/devicetree/bindings/misc/sprd-apipe.txt
```
* Spreadtrum audio pipe driver

This binding defines a audio pipe which for data transmission for applications

Required properties:

- compatible	: "sprd,apipe"

Example:
audio-apipe-pcm {
	compatible = "sprd,apipe";
};
```

## Documentation/devicetree/bindings/misc/sprd_apdu_r3p0.txt
```
Spreadtrum APDU r3p0 driver
================================================================

Required properties:
 - compatible: should be one of the following:
   "sprd,qogirn6pro-apdu"
 - reg: physical address of the musb and length of APDU memory mapped region.
	if soc ranges has been configured,
	APDU physical base addrress need deduct base address.
 - sprd,sys-pub-reg: physical base address of pub apb reg,
	referenced the corresponding syscon.
 - sprd,pub-ise-reg-offset: physical address offset of
	ise med high addrress config reg at pub apb.
 - sprd,pub-ise-bit-offset: ise med high addrress config bit offset
 - sprd,sys-ise-pd-reg: physical base address of pmu reg for ise.
 - sprd,sys-ise-aon-reg: ise clock calibrating reg.
 - sprd,sys-ise-aon-clk-reg: ise clock reg.
 - interrupts: interrupt number for the musb controller

Example:
-------

Board specific DT entry:

	apdu_if: apdu@500000 {
		compatible = "sprd,qogirn6pro-apdu";
		reg = <0x500000 0x10000>;
		sprd,sys-pub-reg = <&pub_apb_regs>;
		sprd,pub-ise-reg-offset = <0x3368>;
		sprd,pub-ise-bit-offset = <15>;
		sprd,sys-ise-pd-reg = <&pmu_apb_regs>;
		sprd,sys-ise-aon-reg = <&aon_apb_regs>;
		sprd,sys-ise-aon-clk-reg = <&aon_pre_div_clk_gen_regs>;
		interrupts = <GIC_SPI 49 IRQ_TYPE_LEVEL_HIGH>;
	};
```

## Documentation/devicetree/bindings/misc/sw-jtag.txt
```
* Software Jtag

Required Properties:

- Compatibility : "marvell,sw-jtag"
- reg		: Address of the timer and main pmu registers

Example:

	swjtag: swjtag@d4013100  {
		compatible = "marvell,sw-jtag";
		reg = <0xd4013100 0x10>;
	};
```

## Documentation/devicetree/bindings/mmc/sdhci-pxa.txt
```
* Marvell sdhci-pxa v2/v3 controller

This file documents differences between the core properties in mmc.txt
and the properties used by the sdhci-pxav2 and sdhci-pxav3 drivers.

Required properties:
- compatible: should be one of the following
  - "mrvl,pxav2-mmc"
  - "marvell,pxav3-mmc-v1": for pxa988/pxa1088/pxa1L88
  - "marvell,pxav3-mmc-v2": for pxa1U88
  - "marvell,pxav3-mmc-v3": for pxa1928

Optional properties:
- marvell,sdh-quirks: set to sdhci_host quirks
- marvell,sdh-quirks2: set to sdhci_host quirks2
- marvell,sdh-host-caps: set to sdhci_host caps
- marvell,sdh-host-caps2: set to sdhci_host caps2
- marvell,sdh-flags: PXA specific flags (see PXA_FLAG_* at include/dt-bindings/mmc/pxa_sdhci.h)
- marvell,sdh-dtr-data: An array of <timing preset_rate src_rate tx_delay rx_delay>

Example:

sdhci@d4280800 {
	compatible = "mrvl,pxav3-mmc";
	reg = <0xd4280800 0x800>;
	bus-width = <8>;
	interrupts = <27>;
	non-removable;
};
```

## Documentation/devicetree/bindings/net/smsc-lan91c111.txt
```
SMSC LAN91c111 Ethernet mac

Required properties:
- compatible = "smsc,lan91c111";
- reg : physical address and size of registers
- interrupts : interrupt connection

Optional properties:
- phy-device : phandle to Ethernet phy
- local-mac-address : Ethernet mac address to use
- reg-io-width : Mask of sizes (in bytes) of the IO accesses that
  are supported on the device.  Valid value for SMSC LAN91c111 are
  1, 2 or 4.  If it's omitted or invalid, the size would be 2 meaning
  16-bit access only.

Examples:

smc91x: smc91x@80000300 {
	compatible = "smsc,lan91c111";
	reg = <0x80000300 0xffcff>;
	interrupts = <0 63 0x1>;
	rst_gpio = <&gpio 3 0>;
	clksrc = "smc91x";
	status = "okay";
};
```

## Documentation/devicetree/bindings/panel/marvell,mmp-lg4591.txt
```
Marvell HD720 TFT LCD panel

Required properties:
- compatible: should be "marvell,mmp-lg4591"


Optional properties:
- avdd-supply: regulator to provide the supply voltage
- marvell,path-name: clk name;
- panel_esd: esd feature for panel;
- rst_gpio: GPIO pin to reset panel;

Example:

panel: lg4591 {
	compatible = "marvell,mmp-lg4591";
	marvell,path-name = "mmp_pnpath";
	panel_esd = <0>;
	rst_gpio = <&gpio 4 0>;
	avdd-supply = <&ldo10>;
	status = "okay";
};
```

## Documentation/devicetree/bindings/panel/marvell,mmp-otm1281.txt
```
Marvell HD720 TFT LCD panel

Required properties:
- compatible: should be "marvell,mmp-otm1281"


Optional properties:
- iovdd-supply: regulator to provide the supply voltage
- marvell,path-name: clk name;
- rst_gpio: GPIO pin to reset panel;

Example:

panel: otm1281 {
	compatible = "marvell,mmp-otm1281";
	marvell,path-name = "mmp_pnpath";
	rst_gpio = <&gpio GPIO(121) 0>;
	iovdd-supply = <&buck2>;
	status = "okay";
};
```

## Documentation/devicetree/bindings/panel/marvell,mmp-otm1283a.txt
```
Marvell FWVGA LCD panel

Required properties:
- compatible: should be "marvell,mmp-otm1283a"

Optional properties:
- avdd-supply: regulator to provide the supply voltage
- marvell,path-name: clk name;
- panel_esd: esd feature for panel;
- rst_gpio: GPIO pin to reset panel;

Example:

panel3: otm1283a {
	compatible = "marvell,mmp-otm1283a";
	marvell,path-name = "mmp_pnpath";
	panel_esd = <0>;
	rst_gpio = <&gpio 4 0>;
	avdd-supply = <&ldo11>;
	status = "okay";
};
```

## Documentation/devicetree/bindings/panel/marvell,mmp-otm8018b.txt
```
Marvell FWVGA LCD panel

Required properties:
- compatible: should be "marvell,mmp-otm8018b"

Optional properties:
- avdd-supply: regulator to provide the supply voltage
- marvell,path-name: clk name;
- panel_esd: esd feature for panel;
- rst_gpio: GPIO pin to reset panel;

Example:

panel: otm8018b {
	compatible = "marvell,mmp-otm8018b";
	marvell,path-name = "mmp_pnpath";
	panel_esd = <0>;
	rst_gpio = <&gpio 4 0>;
	avdd-supply = <&ldo10>;
	status = "okay";
};
```

## Documentation/devicetree/bindings/panel/marvell,mmp-r63311.txt
```
Marvell 1080p TFT LCD panel

Required properties:
- compatible: should be "marvell,mmp-r63311"


Optional properties:
- avdd-supply: regulator to provide the supply voltage
- marvell,path-name: clk name;
- rst_gpio: GPIO pin to reset panel;
- power_gpio: GPIO pin to control power on/off for panel;
- bl_gpio: GPIO pin to control backlight;

Example:

panel2: r63311 {
	compatible = "marvell,mmp-r63311";
	marvell,path-name = "mmp_pnpath";
	rst_gpio = <&gpio 4 0>;
	power_gpio = <&gpio 6 0>;
	bl_gpio = <&gpio 32 0>;
	status = "okay";
};
```

## Documentation/devicetree/bindings/panel/marvell,mmp-td043mgea1.txt
```
Marvell TD043MGEA1 LCD panel

Required properties:
- compatible: should be "marvell,mmp-td043mgea1"


Optional properties:
- iovdd-supply: regulator to provide the supply voltage
- marvell,path-name: clk name;
- rst_gpio: GPIO pin to reset panel;

Example:

panel: td043mgea1 {
	compatible = "marvell,mmp-td043mgea1";
	marvell,path-name = "mmp_pnpath";
	status = "okay";
};
```

## Documentation/devicetree/bindings/pinctrl/marvell,edge_wakeup.txt
```
Mrvell MMP EDGE WAKEUP

Required properties:
- compatible : Should be "mrvl,mmp-edge-wakeup"
- reg : Address and length of the register set which checks edge wakeup
  status.
- interrupts : Should be the edge wakeup interrupt

edgewakeup: edgewakeup@d4019800 {
		compatible = "mrvl,mmp-edge-wakeup";
		reg = <0xd4019800 0x10>;
		interrupts = <0 50 0x4>;
		};
```

## Documentation/devicetree/bindings/pinctrl/marvell,mmp-mfp-leftover.txt
```
* Marvell default mfp configuration

Required properties:
- compatible: "marvell,mmp-mfp-leftover"
- pinctrl-names: which pinctrl group is used as initialization setting.
- reg: mfp configuration register setting.
- pinctrl-0: default pinctrl group.

Example:
mfpr: mfpr@d401e000 {
	pinctrl-names = "default";
	reg = <0xd401e000 0x280>;
	pinctrl-0 = <&mfp_pins_group_0>;
	status = "ok";
}
```

## Documentation/devicetree/bindings/power/devfreq-vpu.txt
```
Device tree bindings for Marvell VPU devfreq device

Required properties:

 - compatible:          Should be "marvell,devfreq-vpu" for VPU devfreq.
 - "marvell,vpu-id"	The id of VPU devfreq device. It supports 2 devices at
			max now, one for decoder and another for decoder.
 - clocks:              The id of VPU function clock and bus clock in device tree
 - clock-names:		The name of VPU function clock and bus clock, which
			should be "vpu-fclk","vpu-bclk".

Optional properties:
 - "marvell,mmp-clk-freq-combine"	The relationship of function clock and
					bus clock. If there is no table, the
					bus clock is fixed when function clock
					changes.
 - "marvell,qos"			Indicate the device supports min/max
					qos feature.

Example:

	devfreq-vpu {
		compatible = "marvell,devfreq-vpu";
		marvell,vpu-id = <0>;
		clocks = <&soc_clocks PXA1U88_CLK_VPU
			  &soc_clocks PXA1U88_CLK_VPUBUS>;
		clock-names = "vpu-fclk", "vpu-bclk";
		marvell,mmp-clk-freq-combine =
				<156000 156000>,
				<208000 208000>,
				<312000 312000>,
				<416000 416000>,
				<528750 528500>;
		marvell,qos;
	};
```

## Documentation/devicetree/bindings/power/mcpm.txt
```
Device tree bindings for MCPM framework

Required properties:

 - compatible:		Should be "arm, mcpm" for VPU devfreq.
 - method:		"smc" or "hvc"
 - cpu_off:		The id of cpu_off defined in arm trust firmware
 - cpu_on:		The id of cpu_on defined in arm trust firmware

Example:

	mcpm {
		compatible      = "arm,mcpm";
		method          = "smc";
		cpu_off         = <0x85000001>;
		cpu_on          = <0x85000002>;
	};
```

## Documentation/devicetree/bindings/power/pd.txt
```
*Marvell power domain

Required properties:
- compatible:
  - "marvell,power-domain-display"
- clocks: related clocks with dispaly power domain

Examples:
pd_display: pd_display@0xd4282800 {
	compatible = "marvell,power-domain-display-pxa1928";
	reg = <0xd4282800 0x1000>;
	clocks = <&soc_clocks PXA1928_CLK_DISP_AXI_CLK>,
		<&soc_clocks PXA1928_CLK_DISP_ESC_CLK>,
		<&soc_clocks PXA1928_CLK_DISP_DISP1_EN>,
		<&soc_clocks PXA1928_CLK_DISP_VDMA_EN>;
	clock-names = "axi_clk", "esc_clk", "disp1_clk_gate", "vdma_clk_gate";
};

pd_display: pd_display@0xd4282800 {
	compatible = "marvell,power-domain-display-pxa1u88";
	reg = <0xd4282800 0x1000>;
	clocks = <&soc_clocks PXA1U88_CLK_DISP_HCLK>,
		<&soc_clocks PXA1U88_CLK_DSI_ESC>,
		<&soc_clocks PXA1U88_CLK_DISP1_EN>;
	clock-names = "LCDCIHCLK", "esc_clk", "disp1_clk_gate";

pd_vpu: pd_vpu@d4282800 {
	compatible = "marvell,power-domain-common-vpu";
	reg = <0xd4282800 0x1000>;
};

pd_gc: pd_gc@d4282800 {
	compatible = "marvell,power-domain-common-gc";
	reg = <0xd4282800 0x1000>;
};

pd_gc2d: pd_gc2d@d4282800 {
	compatible = "marvell,power-domain-common-gc2d";
	reg = <0xd4282800 0x1000>;
	clocks = <&soc_clocks PXA1U88_CLK_GC2D>;

pd_vpu: pd_vpu@d4282800 {
	compatible = "marvell,power-domain-hantro";
	reg = <0xd4282800 0x1000>;
};

pd_gc: pd_gc@d4282800 {
	compatible = "marvell,power-domain-gc3d";
	reg = <0xd4282800 0x1000>;
	clocks = <&soc_clocks PXA1928_CLK_GC3D1X>;
};

pd_gc2d: pd_gc2d@d4282800 {
	compatible = "marvell,power-domain-gc2d";
	reg = <0xd4282800 0x1000>;
	clocks = <&soc_clocks PXA1928_CLK_GC2D>;
};

pd_smmu: pd_smmu@c0010000 {
	compatible = "marvell,power-domain-smmu-pxa1u88";
	reg = <0xc0010000 0x10000>;
	marvell,power-domain-parent = <&pd_vpu>;
	clocks = <&soc_clocks PXA1U88_CLK_VPU>;
};

pd_smmu: pd_smmu@f0500000 {
	compatible = "marvell,power-domain-smmu-pxa1928";
	reg = <0xf0500000 0x10000>;
	marvell,power-domain-parent = <&pd_vpu>;
	clocks = <&soc_clocks PXA1928_CLK_VPUBUS>;
	clock-names = "VPUACLK";
};
```

## Documentation/devicetree/bindings/power/pd_sc2_isp.txt
```
Power domain for sc2 isp

Required properties:
- compatible:
  - "marvell,power-domain-sc2"
- reg: apmu register and length

Examples:
pd_sc2: pd_sc2@d4282800 {
	compatible = "marvell,power-domain-sc2";
	reg = <0xd4282800 0x1000>;
};
```

## Documentation/devicetree/bindings/power/supply/aw32257-charger.txt
```
Binding for aw32257 Charger

Required properties:
- compatible: Should contain one of the following:
 * "aw32257"
 * "ti,bq24157"

- reg:			   integer, i2c address of the device.
- ti,current-limit:	   integer, initial maximum current charger can pull
			   from power supply in mA.
- ti,weak-battery-voltage: integer, weak battery voltage threshold in mV.
			   The chip will use slow precharge if battery voltage
			   is below this value.
- ti,battery-regulation-voltage: integer, maximum charging voltage in mV.
- ti,charge-current:	   integer, maximum charging current in mA.
- ti,termination-current:  integer, charge will be terminated when current in
			   constant-voltage phase drops below this value (in mA).
- ti,resistor-sense:	   integer, value of sensing resistor in milliohm.
- charge,chg-pd-gpio:	   Control charging enable.
- extcon:	   used to detect if vbus is high level.
Example:

aw32257-charger: charger@6a {
	compatible = "aw32257";
	reg = <0x6a>;
	phys = <&hsphy>;
	monitored-battery = <&bat>;
	max_cv = <0x48>;
	cv_val = <0x2b>;
	ti,current-limit = <100000>;
	ti,weak-battery-voltage = <3400>;
	ti,battery-regulation-voltage = <4400>;
	ti,charge-current = <650000>;
	ti,termination-current = <180000>;
	ti,resistor-sense = <56>;
	charge,chg-pd-gpio = <&ap_gpio 121 0>;
	extcon = <&extcon_gpio>;
	vddvbus:otg-vbus {
		regulator-name = "vddvbus";
	};
};
```
