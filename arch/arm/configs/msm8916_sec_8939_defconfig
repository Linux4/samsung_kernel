## arch/arm/configs/msm8916_sec_j1_vzw_defconfig
```kconfig
CONFIG_SEC_J1_PROJECT=y
CONFIG_MACH_J1_VZW=y

# HARD RESET
CONFIG_RESTART_REASON_SEC_PARAM=y

# SS Pinctrl Driver
CONFIG_SEC_GPIO_SETTINGS=y

#SENSOR
CONFIG_SENSORS_CORE=y
CONFIG_SENSORS_K2HH=y
CONFIG_SENSORS_K2HH_VDD=y
CONFIG_SENSORS_CM36672P=y
CONFIG_SENSORS_LEDA_EN_GPIO=y

#Wifi
#
# Enable Qualcomm Wifi features
#
#CONFIG_MSM_PIL_PRONTO=y
#CONFIG_WCNSS_CORE=y
#CONFIG_WCNSS_CORE_PRONTO=y
#CONFIG_WCNSS_MEM_PRE_ALLOC=y
#
# Wifi features (Qualcomm)
#
#CONFIG_NET_CORE=y
#CONFIG_WIRELESS=y
#CONFIG_WIRELESS_EXT_SYSFS=y
#CONFIG_WEXT_CORE=y
#CONFIG_WEXT_PROC=y
#CONFIG_CFG80211=y
#CONFIG_CFG80211_DEFAULT_PS=y
#CONFIG_WLAN_REGION_CODE=300
#CONFIG_TARGET_LOCALE_CHN=y
#CONFIG_CFG80211_ALLOW_RECONNECT is not set
#CONFIG_WLAN=y
#CONFIG_WIRELESS_EXT=y
#CONFIG_WEXT_PRIV=y
#CONFIG_MODULES=y
#CONFIG_MODULE_UNLOAD=y
#CONFIG_MODULE_FORCE_UNLOAD=y
#CONFIG_WCNSS_REGISTER_DUMP_ON_BITE =y

# MUIC
CONFIG_SM5502_MUIC=y
CONFIG_SM5504_MUIC=y
#CONFIG_MUIC_SUPPORT_RUSTPROOF=y
# CONFIG_MUIC_SM5502_SUPPORT_LANHUB_TA is not set
CONFIG_USBID_STANDARD_VER_01=y
CONFIG_MUIC_SUPPORT_VZW_INCOMPATIBLE=y

# VIBRATOR
CONFIG_MSM_VIBRATOR=y

#Touch Screen
# CONFIG_TOUCHSCREEN_IST30XX_CORE3 is not set
CONFIG_TOUCHSCREEN_ZINITIX_BT432=y
CONFIG_COMMON_INPUT_BOOSTER=y

#AUDIO
#CONFIG_RADIO_IRIS=y
#CONFIG_RADIO_IRIS_TRANSPORT=m

#LCD
CONFIG_PANEL_S6D77A1A01_WVGA_VIDEO_PANEL=y
CONFIG_PANEL_S6D77A1A01_WVGA_VIDEO_PANEL_REVB=y
#CONFIG_MFD_RT5033=y
CONFIG_BATTERY_SAMSUNG=y
CONFIG_BATTERY_SAMSUNG_DATA_FILE="j1vzw_battery_data.h"
CONFIG_SAMSUNG_LPM_MODE=y
#CONFIG_CHARGER_RT5033=y
#CONFIG_FUELGAUGE_RT5033=y
#CONFIG_REGULATOR_RT5033=y
CONFIG_FUELGAUGE_STC3117=y
CONFIG_MFD_SM5701=y
CONFIG_CHARGER_SM5701=y
CONFIG_FLED_SM5701=y

# Pre-power on alarm
#CONFIG_RTC_AUTO_PWRON=y
#CONFIG_RTC_AUTO_PWRON_PARAM=y
#CAMERA
#CONFIG_MSM_EEPROM=n
#CONFIG_MSM_OTP=y

#optimize mmc block delay on resume
CONFIG_MMC_BLOCK_DEFERRED_RESUME=y

#front cam
CONFIG_SR200PC20=y
CONFIG_SR544=y
CONFIG_SENSOR_8_BPP=y

CONFIG_MSM_EEPROM=n
CONFIG_MSM_OTP=y
#FLASH
#CONFIG_FLASHLIGHT=y
#CONFIG_RT_FLASH_LED=y
#CONFIG_FLED_RT5033=y
#CONFIG_FLED_RT5033_EXT_GPIO=y

#disable KSM for power consumption problem
#CONFIG_KSM=y
#CONFIG_ADAPTIVE_KSM=y
#CONFIG_KSM_MEMCMP=y

#LEDS
CONFIG_LEDS_KTD2026=y
CONFIG_LEDS_GPIO=y

# MODEM SECURE CHECK
#CONFIG_SEC_PERIPHERAL_SECURE_CHK=y

CONFIG_VPNCLIENT_SECURITY=y

# RTCC v3
CONFIG_SWAP=y
CONFIG_ZSMALLOC=y
CONFIG_ZRAM=y
CONFIG_RUNTIME_COMPCACHE=y
CONFIG_KSWAPD_NOSWAP=y
```

## arch/arm/configs/msm8916_sec_j1xqlte_spr_defconfig
```kconfig
CONFIG_SEC_J1X_PROJECT=y
CONFIG_MACH_J1XLTE_USA_SPR=y

# HARD RESET
CONFIG_RESTART_REASON_SEC_PARAM=y

# MUIC
CONFIG_SM5703_MUIC=y
CONFIG_USBID_STANDARD_VER_01=y
# CONFIG_MUIC_SUPPORT_CHARGING_CABLE is not set
CONFIG_MUIC_SUPPORT_RUSTPROOF=y
CONFIG_MUIC_SUPPORT_DESKDOCK=y
#AUDIO


#Touch Screen
CONFIG_KEYBOARD_TC350K=y
CONFIG_TOUCHSCREEN_BT432_TS=y

#LCD
CONFIG_PANEL_EA8061S_AMS450JV01_WVGA=y
CONFIG_SAMSUNG_DEBUG_DISPLAY=n

#Vibrator
CONFIG_SM5703_VIBRATOR=y


# Charging/Battery
CONFIG_MFD_SM5703=y
CONFIG_REGULATOR_SM5703=y
CONFIG_CHARGER_SM5703=y
CONFIG_BATTERY_SAMSUNG=y
CONFIG_BATTERY_SAMSUNG_DATA_FILE="j1xspr_battery_data.h"
CONFIG_SAMSUNG_LPM_MODE=y
CONFIG_FUELGAUGE_SM5703=y
CONFIG_BATTERY_SWELLING=y
CONFIG_SIOP_CHARGING_LIMIT_CURRENT=700
CONFIG_PREVENT_SOC_JUMP=y
CONFIG_CHARGER_SM5703_SOFT_START_CHARGING=y
CONFIG_CHARGER_SM5703_DUALPATH=y

#SENSOR
CONFIG_SENSORS=y
CONFIG_SENSORS_CORE=y
CONFIG_SENSORS_BMA2X2=y
CONFIG_SENSORS_BMA2X2_ENABLE_INT1=y
CONFIG_SENSORS_CM36672P=y
CONFIG_SENSORS_CM36672P_SMART_PERS=y

#FLASH
CONFIG_FLASHLIGHT=y
CONFIG_SM_FLASH_LED=y
CONFIG_FLED_SM5703=y
CONFIG_FLED_SM5703_EXT_GPIO=y

#CAMERA
CONFIG_S5K4ECGX=y
CONFIG_SR200PC20=y
CONFIG_SENSOR_8_BPP=y

#CONFIG_MSM_EEPROM=n
#CONFIG_MSM_OTP=y


# DUAL SIM / SINGLE SIM Detection
CONFIG_CHECK_SIMSLOT_COUNT=y
# CONFIG_CHECK_SIMSLOT_COUNT_GPIO is not set
CONFIG_CHECK_SIMSLOT_COUNT_DT=y

# MODEM SECURE CHECK
CONFIG_SEC_PERIPHERAL_SECURE_CHK=y

#EPDG
CONFIG_NET_CORE=y
CONFIG_NET_SCH_PRIO=y
CONFIG_NET_SCHED=y   #depends on CONFIG_NET  which is enabled by default.. coz not seeing in the config file
CONFIG_NET_CLS_BASIC=y # required if basic is being used as a filter. depends on CONFIG_NET_CLS so enabling it by default
CONFIG_NET_CLS=y
CONFIG_NET_CLS_ACT=y # for enabling the action target.
CONFIG_NET_ACT_MIRRED=y  # for enabling the mirred target for redirecting the packet between the devices.
CONFIG_NET_EMATCH=y   #basic uses extended matches so this has to be present
CONFIG_NET_SCH_INGRESS=y # classifier for ingress packet


#APC CPR QUOTIENT
CONFIG_APC_CPR_QUOT_BOOST=y

# SDP and DLP
CONFIG_SDP=y
CONFIG_SDP_VAULT=y
CONFIG_DLP=y

# SSWAP
CONFIG_SWAP=y
CONFIG_FRONTSWAP=y
CONFIG_ZSMALLOC=y
CONFIG_PGTABLE_MAPPING=y
CONFIG_ZSWAP=y
CONFIG_ZPOOL=y
CONFIG_DIRECT_RECLAIM_FILE_PAGES_ONLY=y
CONFIG_INCREASE_MAXIMUM_SWAPPINESS=y
CONFIG_FIX_INACTIVE_RATIO=y
CONFIG_TIGHT_PGDAT_BALANCE=y
CONFIG_VNSWAP=y
CONFIG_SWAP_ENABLE_READAHEAD=n

# MODEM SECURE CHECK
CONFIG_SEC_PERIPHERAL_SECURE_CHK=y

# USB
CONFIG_USB_RNDIS_VZW_REQ=y
```

## arch/arm/configs/msm8916_sec_j3lte_kor_defconfig
```kconfig
CONFIG_SEC_J3_PROJECT=y
CONFIG_MACH_J3LTE_KOR_OPEN=y

CONFIG_RESTART_REASON_SEC_PARAM=y


# MUIC
CONFIG_SM5703_MUIC=y
CONFIG_USBID_STANDARD_VER_01=y
CONFIG_MUIC_SUPPORT_CHARGING_CABLE=y
CONFIG_MUIC_SUPPORT_RUSTPROOF=y
CONFIG_MUIC_SUPPORT_DESKDOCK=y

#USB Host
CONFIG_USB_HOST_NOTIFY=y

#Touch Screen
CONFIG_TOUCHSCREEN_IST30XXC=y
CONFIG_KEYBOARD_TC360_TKEY_J3=y


#LCD
CONFIG_PANEL_S6E8AA5X01_AMS497HY01_HD=y
CONFIG_SAMSUNG_DEBUG_DISPLAY=n

# Vibrator
CONFIG_SM5703_VIBRATOR=y



# Charging/Battery
CONFIG_MFD_SM5703=y
CONFIG_REGULATOR_SM5703=y
CONFIG_CHARGER_SM5703=y
CONFIG_BATTERY_SAMSUNG=y
CONFIG_BATTERY_SAMSUNG_DATA_FILE="j3_battery_data.h"
CONFIG_SAMSUNG_LPM_MODE=y
CONFIG_FUELGAUGE_SM5703=y
CONFIG_BATTERY_SWELLING=y
CONFIG_SIOP_CHARGING_LIMIT_CURRENT=700
CONFIG_PREVENT_SOC_JUMP=y
CONFIG_CHARGER_SM5703_SOFT_START_CHARGING=y
CONFIG_CHARGER_SM5703_DUALPATH=y
#SENSOR
CONFIG_SENSORS=y
CONFIG_SENSORS_CORE=y
CONFIG_SENSORS_K2HH=y
CONFIG_SENSORS_CM36672P=y
CONFIG_SENSORS_CM36672P_SMART_PERS=y

#NFC
CONFIG_NFC=y
CONFIG_NFC_PN547=y
CONFIG_NFC_PN547_8916_USE_BBCLK2=y
CONFIG_NFC_PN547_8916_CLK_CTL=y
CONFIG_NFC_PN547_PVDD_EN_CONTROL=y

#FLASH
CONFIG_FLASHLIGHT=y
CONFIG_SM_FLASH_LED=y
CONFIG_FLED_SM5703=y
CONFIG_FLED_SM5703_EXT_GPIO=y

#CAMERA
CONFIG_S5K4H5YC=y
CONFIG_S5K5E3YX=y
CONFIG_CAMERA_SYSFS_V2=y
CONFIG_SW_LANDING_FOR_MULTI_TASKING=y

#Wifi
#
# Enable Qualcomm Wifi features
#
CONFIG_MSM_PIL_PRONTO=y
CONFIG_WCNSS_CORE=y
CONFIG_WCNSS_CORE_PRONTO=y
CONFIG_WCNSS_MEM_PRE_ALLOC=y

#
# Wifi features (Qualcomm)
#
CONFIG_NET_CORE=y
CONFIG_WIRELESS=y
CONFIG_WIRELESS_EXT_SYSFS=y
CONFIG_WEXT_CORE=y
CONFIG_WEXT_PROC=y
CONFIG_CFG80211=y
CONFIG_CFG80211_DEFAULT_PS=y
#CONFIG_CFG80211_ALLOW_RECONNECT is not set
CONFIG_WLAN=y
CONFIG_WIRELESS_EXT=y
CONFIG_WEXT_PRIV=y
CONFIG_MODULES=y
CONFIG_MODULE_UNLOAD=y
CONFIG_MODULE_FORCE_UNLOAD=y
CONFIG_WCNSS_REGISTER_DUMP_ON_BITE =y

#AUDIO
CONFIG_SEC_DEVIDE_RINGTONE_GAIN=y
CONFIG_RADIO_IRIS=y
CONFIG_RADIO_IRIS_TRANSPORT=m
# DUAL SIM / SINGLE SIM Detection
# CONFIG_CHECK_SIMSLOT_COUNT is not set
# CONFIG_CHECK_SIMSLOT_COUNT_GPIO is not set
# CONFIG_CHECK_SIMSLOT_COUNT_DT is not set

# MMC

# MODEM SECURE CHECK
CONFIG_SEC_PERIPHERAL_SECURE_CHK=y

#EPDG
CONFIG_NET_CORE=y
CONFIG_NET_SCH_PRIO=y
CONFIG_NET_SCHED=y   #depends on CONFIG_NET  which is enabled by default.. coz not seeing in the config file
CONFIG_NET_CLS_BASIC=y # required if basic is being used as a filter. depends on CONFIG_NET_CLS so enabling it by default
CONFIG_NET_CLS=y
CONFIG_NET_CLS_ACT=y # for enabling the action target.
CONFIG_NET_ACT_MIRRED=y  # for enabling the mirred target for redirecting the packet between the devices.
CONFIG_NET_EMATCH=y   #basic uses extended matches so this has to be present
CONFIG_NET_SCH_INGRESS=y # classifier for ingress packet


#APC CPR QUOTIENT
CONFIG_APC_CPR_QUOT_BOOST=y

# KNOX SDP and DLP
CONFIG_SDP=y
CONFIG_DLP=y

# SSWAP
CONFIG_SWAP=y
CONFIG_FRONTSWAP=y
CONFIG_ZSMALLOC=y
CONFIG_ZSMALLOC_STAT=y
CONFIG_ZSMALLOC_OBJ_SEQ=n
CONFIG_PGTABLE_MAPPING=y
CONFIG_ZSWAP=y
CONFIG_ZSWAP_COMPACTION=y
CONFIG_ZSWAP_ENABLE_WRITEBACK=n
CONFIG_ZPOOL=y
CONFIG_DIRECT_RECLAIM_FILE_PAGES_ONLY=y
CONFIG_INCREASE_MAXIMUM_SWAPPINESS=y
CONFIG_FIX_INACTIVE_RATIO=y
CONFIG_TIGHT_PGDAT_BALANCE=y
CONFIG_VNSWAP=y
CONFIG_SWAP_ENABLE_READAHEAD=n
```

## arch/arm/configs/msm8916_sec_j3lte_spr_defconfig
```kconfig
CONFIG_SEC_J3_PROJECT=y
CONFIG_MACH_J3LTE_USA_SPR=y

# HARD RESET
CONFIG_RESTART_REASON_SEC_PARAM=y

# MUIC
CONFIG_SM5703_MUIC=y
CONFIG_USBID_STANDARD_VER_01=y
CONFIG_MUIC_SUPPORT_CHARGING_CABLE=y
CONFIG_MUIC_SUPPORT_RUSTPROOF=y
CONFIG_MUIC_SUPPORT_DESKDOCK=y
#AUDIO


#Touch Screen
CONFIG_TOUCHSCREEN_IST30XXC=y
CONFIG_KEYBOARD_TC360_TKEY_J3=y

#LCD
CONFIG_PANEL_S6E8AA5X01_AMS497HY01_HD=y

#Vibrator
CONFIG_SM5703_VIBRATOR=y


# Charging/Battery
CONFIG_MFD_SM5703=y
CONFIG_REGULATOR_SM5703=y
CONFIG_CHARGER_SM5703=y
CONFIG_BATTERY_SAMSUNG=y
CONFIG_BATTERY_SAMSUNG_DATA_FILE="j3_battery_data.h"
CONFIG_SAMSUNG_LPM_MODE=y
CONFIG_FUELGAUGE_SM5703=y
CONFIG_BATTERY_SWELLING=y
CONFIG_SIOP_CHARGING_LIMIT_CURRENT=700
CONFIG_PREVENT_SOC_JUMP=y
CONFIG_CHARGER_SM5703_SOFT_START_CHARGING=y
CONFIG_CHARGER_SM5703_DUALPATH=y

#SENSOR
CONFIG_SENSORS=y
CONFIG_SENSORS_CORE=y
CONFIG_SENSORS_K2HH=y
CONFIG_SENSORS_CM36672P=y

#FLASH
CONFIG_FLASHLIGHT=y
CONFIG_SM_FLASH_LED=y
CONFIG_FLED_SM5703=y
CONFIG_FLED_SM5703_EXT_GPIO=y

#CAMERA
CONFIG_DB8221A=y
CONFIG_SR544=y
CONFIG_SENSOR_8_BPP=y

CONFIG_MSM_EEPROM=n
CONFIG_MSM_OTP=y


# DUAL SIM / SINGLE SIM Detection
CONFIG_CHECK_SIMSLOT_COUNT=y
# CONFIG_CHECK_SIMSLOT_COUNT_GPIO is not set
CONFIG_CHECK_SIMSLOT_COUNT_DT=y

# MODEM SECURE CHECK
CONFIG_SEC_PERIPHERAL_SECURE_CHK=y

#EPDG
CONFIG_NET_CORE=y
CONFIG_NET_SCH_PRIO=y
CONFIG_NET_SCHED=y   #depends on CONFIG_NET  which is enabled by default.. coz not seeing in the config file
CONFIG_NET_CLS_BASIC=y # required if basic is being used as a filter. depends on CONFIG_NET_CLS so enabling it by default
CONFIG_NET_CLS=y
CONFIG_NET_CLS_ACT=y # for enabling the action target.
CONFIG_NET_ACT_MIRRED=y  # for enabling the mirred target for redirecting the packet between the devices.
CONFIG_NET_EMATCH=y   #basic uses extended matches so this has to be present
CONFIG_NET_SCH_INGRESS=y # classifier for ingress packet


#APC CPR QUOTIENT
CONFIG_APC_CPR_QUOT_BOOST=y

# SDP
CONFIG_SDP=y
CONFIG_SDP_VAULT=y

# SSWAP
CONFIG_SWAP=y
CONFIG_FRONTSWAP=y
CONFIG_ZSMALLOC=y
CONFIG_PGTABLE_MAPPING=y
CONFIG_ZSWAP=y
CONFIG_ZPOOL=y
CONFIG_DIRECT_RECLAIM_FILE_PAGES_ONLY=y
CONFIG_INCREASE_MAXIMUM_SWAPPINESS=y
CONFIG_FIX_INACTIVE_RATIO=y
CONFIG_TIGHT_PGDAT_BALANCE=y
CONFIG_VNSWAP=y
CONFIG_SWAP_ENABLE_READAHEAD=n
```
