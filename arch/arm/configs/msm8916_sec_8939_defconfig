## arch/arm/configs/msm8916_sec_eng_defconfig
```kconfig
# GPIO DVS feature
CONFIG_SEC_GPIO_DVS=y

CONFIG_CORESIGHT=y
CONFIG_CORESIGHT_FUSE=y
CONFIG_CORESIGHT_EVENT=y
CONFIG_CORESIGHT_TMC=y
CONFIG_CORESIGHT_TPIU=y
CONFIG_CORESIGHT_FUNNEL=y
CONFIG_CORESIGHT_REPLICATOR=y
CONFIG_CORESIGHT_STM=y
CONFIG_CORESIGHT_HWEVENT=y
CONFIG_CORESIGHT_MODEM_ETM=y
CONFIG_CORESIGHT_WCN_ETM=y
CONFIG_CORESIGHT_RPM_ETM=y
CONFIG_CORESIGHT_QPDI=y
CONFIG_CORESIGHT_ETMV4=y

CONFIG_SLUB_DEBUG=y
CONFIG_DEBUG_KMEMLEAK=y
CONFIG_DEBUG_KMEMLEAK_EARLY_LOG_SIZE=4000
CONFIG_DEBUG_KMEMLEAK_DEFAULT_OFF=y
CONFIG_DEBUG_SPINLOCK=y
CONFIG_DEBUG_MUTEXES=y
CONFIG_DEBUG_ATOMIC_SLEEP=y
CONFIG_DEBUG_STACK_USAGE=y
CONFIG_DEBUG_LIST=y
CONFIG_FAULT_INJECTION=y
CONFIG_FAIL_PAGE_ALLOC=y
CONFIG_FAULT_INJECTION_DEBUG_FS=y
CONFIG_FAULT_INJECTION_STACKTRACE_FILTER=y
CONFIG_DEBUG_PAGEALLOC=y
CONFIG_PANIC_ON_DATA_CORRUPTION=y
CONFIG_DEBUG_LL=y
CONFIG_EARLY_PRINTK=y

# CONFIG_PANIC_ON_RT_THROTTLING is not set

CONFIG_SEC_FILE_LEAK_DEBUG=y


# CONFIG_SEC_RESTRICT_ROOTING is not set
# CONFIG_SEC_RESTRICT_SETUID is not set
# CONFIG_SEC_RESTRICT_FORK is not set
# CONFIG_SEC_RESTRICT_ROOTING_LOG is not set
```

## arch/arm/configs/msm8916_sec_fortuna_aio_defconfig
```kconfig
CONFIG_SEC_FORTUNA_PROJECT=y
CONFIG_MACH_FORTUNA_AIO=y

# SS Pinctrl Driver
CONFIG_SEC_GPIO_SETTINGS=y

# MUIC
CONFIG_SM5502_MUIC=y
# CONFIG_MUIC_SM5502_SUPPORT_LANHUB_TA is not set
CONFIG_MUIC_SUPPORT_RUSTPROOF=y
CONFIG_USBID_STANDARD_VER_01=y

#Touch Screen
CONFIG_TOUCHSCREEN_IST30XX=y
CONFIG_TOUCHSCREEN_ZINITIX_BT541=y

#Vibrator
CONFIG_MSM_VIBRATOR=y

#LCD
CONFIG_FB_MSM_MIPI_HX8389C_QHD_VIDEO_PANEL=y

#SENSOR
# CONFIG_SENSORS_ADSP is not set
# CONFIG_SENSORS_K303C is not set
CONFIG_SENSORS_BMA2X2=y
CONFIG_SENSORS_BMM050=y
# CONFIG_SENSORS_TMD3782S is not set
CONFIG_SENSORS_GP2A002=y

#NFC
CONFIG_SEC_NFC=y
CONFIG_SEC_NFC_I2C=y
CONFIG_SEC_NFC_USE_8916_BBCLK2=y
CONFIG_SEC_NFC_IF_I2C=y
CONFIG_SEC_NFC_PRODUCT_N5=y

#FLASH
CONFIG_FLASHLIGHT=y
CONFIG_RT_FLASH_LED=y
CONFIG_FLED_RT5033=y
CONFIG_FLED_RT5033_EXT_GPIO=y

#Wifi
#
# Enable Qualcomm Wifi features
#
CONFIG_MSM_PIL_PRONTO=y
CONFIG_WCNSS_CORE=y
CONFIG_WCNSS_CORE_PRONTO=y
CONFIG_WCNSS_MEM_PRE_ALLOC=y

#
# Wifi features (Qualcomm)
#
CONFIG_NET_CORE=y
CONFIG_WIRELESS=y
CONFIG_WIRELESS_EXT_SYSFS=y
CONFIG_WEXT_CORE=y
CONFIG_WEXT_PROC=y
CONFIG_CFG80211=y
CONFIG_CFG80211_DEFAULT_PS=y
#CONFIG_CFG80211_ALLOW_RECONNECT is not set
CONFIG_WLAN=y
CONFIG_WIRELESS_EXT=y
CONFIG_WEXT_PRIV=y
CONFIG_MODULES=y
CONFIG_MODULE_UNLOAD=y
CONFIG_MODULE_FORCE_UNLOAD=y
CONFIG_WCNSS_REGISTER_DUMP_ON_BITE =y

#AUDIO
CONFIG_RADIO_IRIS=y
CONFIG_RADIO_IRIS_TRANSPORT=m

#optimize mmc block delay on resume
CONFIG_MMC_BLOCK_DEFERRED_RESUME=y

# RTCC v3
CONFIG_SWAP=y
CONFIG_ZSMALLOC=y
CONFIG_ZRAM=y
CONFIG_RUNTIME_COMPCACHE=y
CONFIG_KSWAPD_NOSWAP=y

# IPSec
CONFIG_CRYPTO_NULL=y

#CONFIGURE Knox UID PID
CONFIG_KNOX_VPN_UID_PID=y

# Charging/Battery
CONFIG_MFD_RT5033=y
CONFIG_REGULATOR_RT5033=y
CONFIG_CHARGER_RT5033=y
CONFIG_BATTERY_SAMSUNG=y
CONFIG_BATTERY_SAMSUNG_DATA_FILE="fortuna_battery_data.h"
CONFIG_SAMSUNG_LPM_MODE=y
CONFIG_FUELGAUGE_RT5033=y

# DUAL SIM / SINGLE SIM Detection
CONFIG_CHECK_SIMSLOT_COUNT=y
# CONFIG_CHECK_SIMSLOT_COUNT_GPIO is not set
CONFIG_CHECK_SIMSLOT_COUNT_DT=y
```

## arch/arm/configs/msm8916_sec_fortuna_cmcc_defconfig
```kconfig
CONFIG_SEC_FORTUNA_PROJECT=y
CONFIG_MACH_FORTUNA_CMCC=y

# SS Pinctrl Driver
CONFIG_SEC_GPIO_SETTINGS=y

# MUIC
CONFIG_SM5502_MUIC=y
CONFIG_SM5504_MUIC=y
# CONFIG_MUIC_SM5502_SUPPORT_LANHUB_TA is not set
CONFIG_MUIC_SUPPORT_RUSTPROOF=y
CONFIG_USBID_STANDARD_VER_01=y

#Touch Screen
CONFIG_TOUCHSCREEN_IST30XX=y
CONFIG_TOUCHSCREEN_ZINITIX_BT541=y

#LCD
CONFIG_FB_MSM_MIPI_HX8389C_QHD_VIDEO_PANEL=y
CONFIG_CABC_TUNING=y

CONFIG_MFD_RT5033=y
CONFIG_BATTERY_SAMSUNG=y
CONFIG_BATTERY_SAMSUNG_DATA_FILE="fortuna_battery_data.h"
CONFIG_SAMSUNG_LPM_MODE=y
CONFIG_CHARGER_RT5033=y
CONFIG_FUELGAUGE_RT5033=y
CONFIG_REGULATOR_RT5033=y

#SENSOR
CONFIG_SENSORS_K2HH=y
CONFIG_SENSORS_GP2A002=y
# CONFIG_SENSORS_HSCDTD008A is not set
#NFC
CONFIG_NFC_PN547=y
CONFIG_NFC_PN547_8916_USE_BBCLK2=y

#FLASH
CONFIG_FLASHLIGHT=y
CONFIG_RT_FLASH_LED=y
CONFIG_FLED_RT5033=y
CONFIG_FLED_RT5033_EXT_GPIO=y

#Wifi
#
# Enable Qualcomm Wifi features
#
CONFIG_MSM_PIL_PRONTO=y
CONFIG_WCNSS_CORE=y
CONFIG_WCNSS_CORE_PRONTO=y
CONFIG_WCNSS_MEM_PRE_ALLOC=y

#
# Wifi features (Qualcomm)
#
CONFIG_NET_CORE=y
CONFIG_WIRELESS=y
CONFIG_WIRELESS_EXT_SYSFS=y
CONFIG_WEXT_CORE=y
CONFIG_WEXT_PROC=y
CONFIG_CFG80211=y
CONFIG_CFG80211_DEFAULT_PS=y
#CONFIG_CFG80211_ALLOW_RECONNECT is not set
CONFIG_WLAN=y
CONFIG_WIRELESS_EXT=y
CONFIG_WEXT_PRIV=y
CONFIG_MODULES=y
CONFIG_MODULE_UNLOAD=y
CONFIG_MODULE_FORCE_UNLOAD=y
CONFIG_WCNSS_REGISTER_DUMP_ON_BITE =y

#Power off Alarm
CONFIG_RTC_AUTO_PWRON=y
CONFIG_RTC_AUTO_PWRON_PARAM=y

#optimize mmc block delay on resume
CONFIG_MMC_BLOCK_DEFERRED_RESUME=y

# RTCC v3
CONFIG_SWAP=y
CONFIG_ZSMALLOC=y
CONFIG_ZRAM=y
CONFIG_RUNTIME_COMPCACHE=y
CONFIG_KSWAPD_NOSWAP=y

CONFIG_TRACE_MODEM_MEM_FAIL=y
```

## arch/arm/configs/msm8916_sec_fortuna_spr_defconfig
```kconfig
CONFIG_SEC_FORTUNA_PROJECT=y
CONFIG_MACH_FORTUNA_SPR=y

# HARD RESET
CONFIG_RESTART_REASON_SEC_PARAM=y

# MUIC
CONFIG_SM5502_MUIC=y
CONFIG_USBID_STANDARD_VER_01=y
CONFIG_MUIC_SUPPORT_RUSTPROOF=y

#AUDIO


#Touch Screen
CONFIG_TOUCHSCREEN_ZINITIX_BT541=y

#LCD
CONFIG_PANEL_HX8389C_GH9607501A_QHD=y
CONFIG_PANEL_S6D78A0_GH9607501A_QHD=y

#Vibrator
CONFIG_SS_VIBRATOR=y

# BATTERY
CONFIG_MFD_RT5033=y
CONFIG_BATTERY_SAMSUNG=y
CONFIG_BATTERY_SAMSUNG_DATA_FILE="fortuna_battery_data.h"
CONFIG_SAMSUNG_LPM_MODE=y
CONFIG_CHARGER_RT5033=y
CONFIG_FUELGAUGE_RT5033=y
CONFIG_REGULATOR_RT5033=y
CONFIG_MFD_RT5033_RESET_WA=y
CONFIG_MFD_RT5033_SLDO_VBUSDET=y
CONFIG_BATTERY_SWELLING=n

#SENSOR
CONFIG_SENSORS=y
CONFIG_SENSORS_CORE=y
CONFIG_SENSORS_GP2A002=y
CONFIG_SENSORS_GP2A_MODE_B1=y
CONFIG_SENSORS_GP2A_VDD=y
#BMC150
CONFIG_SENSORS_BMA2X2=y
CONFIG_SENSORS_BMM050=y
CONFIG_SENSORS_BMA2X2_ENABLE_INT1=y
CONFIG_INPUT_BMA2x2_ACC_ALERT_INT=y

#NFC
CONFIG_NFC=y
CONFIG_SEC_NFC=y
CONFIG_SEC_NFC_IF_I2C=y
CONFIG_SEC_NFC_PRODUCT_N5=y
CONFIG_SEC_NFC_USE_8916_BBCLK2=y

#FLASH
CONFIG_FLASHLIGHT=y
CONFIG_RT_FLASH_LED=y
CONFIG_FLED_RT5033=y
CONFIG_FLED_RT5033_EXT_GPIO=y

#CAMERA
CONFIG_S5K4H5YB=y
CONFIG_S5K5E3YX=y

# DUAL SIM / SINGLE SIM Detection
CONFIG_CHECK_SIMSLOT_COUNT=y
# CONFIG_CHECK_SIMSLOT_COUNT_GPIO is not set
CONFIG_CHECK_SIMSLOT_COUNT_DT=y

# MODEM SECURE CHECK
CONFIG_SEC_PERIPHERAL_SECURE_CHK=y

#EPDG
CONFIG_NET_CORE=y
CONFIG_NET_SCH_PRIO=y
CONFIG_NET_SCHED=y   #depends on CONFIG_NET  which is enabled by default.. coz not seeing in the config file
CONFIG_NET_CLS_BASIC=y # required if basic is being used as a filter. depends on CONFIG_NET_CLS so enabling it by default
CONFIG_NET_CLS=y
CONFIG_NET_CLS_ACT=y # for enabling the action target.
CONFIG_NET_ACT_MIRRED=y  # for enabling the mirred target for redirecting the packet between the devices.
CONFIG_NET_EMATCH=y   #basic uses extended matches so this has to be present
CONFIG_NET_SCH_INGRESS=y # classifier for ingress packet


#APC CPR QUOTIENT
CONFIG_APC_CPR_QUOT_BOOST=y

# SDP
CONFIG_SDP=y
CONFIG_SDP_VAULT=y

# SSWAP
CONFIG_SWAP=y
CONFIG_FRONTSWAP=y
CONFIG_ZSMALLOC=y
CONFIG_PGTABLE_MAPPING=y
CONFIG_ZSWAP=y
CONFIG_ZPOOL=y
CONFIG_DIRECT_RECLAIM_FILE_PAGES_ONLY=y
CONFIG_INCREASE_MAXIMUM_SWAPPINESS=y
CONFIG_FIX_INACTIVE_RATIO=y
CONFIG_TIGHT_PGDAT_BALANCE=y
CONFIG_VNSWAP=y
CONFIG_SWAP_ENABLE_READAHEAD=n
```

## arch/arm/configs/msm8916_sec_goyairis3g_swa_defconfig
```kconfig
CONFIG_SEC_GOYAIRIS_PROJECT=y
CONFIG_MACH_GOYAIRIS3G_SWA_OPEN=y

# HARD RESET
CONFIG_RESTART_REASON_SEC_PARAM=y

# MUIC
CONFIG_SM5703_MUIC=y
CONFIG_USBID_STANDARD_VER_01=y
CONFIG_MUIC_NOTI=y
CONFIG_MUIC_SM5703_SUPPORT_LANHUB_TA=y
CONFIG_MUIC_SUPPORT_RUSTPROOF=y


#USB HOST
CONFIG_USB_HOST_NOTIFY=y

#AUDIO
CONFIG_AUDIO_SPEAKER_OUT_MAXIM_AMP_ENABLE=y
# CONFIG_AUDIO_SPEAKER_OUT_NXP_AMP_ENABLE is not set
CONFIG_AUDIO_QUAT_I2S_ENABLE=y
CONFIG_JACK_AUDIO=y

# INPUT (TSP, TKEY)
CONFIG_TOUCHSCREEN_ZT7548_TS=y

CONFIG_NO_ERROR_ON_MISMATCH=y
CONFIG_DEBUG_SECTION_MISMATCH=y

#
# Specific keyboard combination reject in kernel level.
# Only processing Framework level.
#
CONFIG_USE_VM_KEYBOARD_REJECT=y

#Vibrator
CONFIG_MSM_VIBRATOR=y

# FGPA for IRIS
CONFIG_SEC_ICE40XX_IRIS=y

#LCD
CONFIG_PANEL_VX5B3D_BA070WS1_WSVGA=y

#BATTERY
CONFIG_MFD_SM5703=y
CONFIG_REGULATOR_SM5703=y
CONFIG_CHARGER_SM5703=y
CONFIG_BATTERY_SAMSUNG=y
CONFIG_BATTERY_SAMSUNG_DATA_FILE="goyairis_battery_data.h"
CONFIG_SAMSUNG_LPM_MODE=y
CONFIG_FUELGAUGE_SM5703=y
CONFIG_BATTERY_SWELLING=y
CONFIG_SIOP_CHARGING_LIMIT_CURRENT=700
CONFIG_PREVENT_SOC_JUMP=y
CONFIG_CHARGER_SM5703_SOFT_START_CHARGING=y
CONFIG_CHARGER_SM5703_DUALPATH=y
CONFIG_SW_SELF_DISCHARGING=y

#SENSOR
CONFIG_SENSORS=y
CONFIG_SENSORS_CORE=y
CONFIG_SENSORS_SX9500_ALWAYS=y
CONFIG_SENSORS_SX9500_NORMAL_TOUCH_THRESHOLD=11
CONFIG_SENSORS_SX9500_INIT_TOUCH_THRESHOLD=8000
CONFIG_SENSORS_SX9500_REGULATOR_ONOFF=y
CONFIG_SENSORS_BMA2X2=y
CONFIG_SENSORS_BMC150_VDD=y
CONFIG_SENSORS_BMA2X2_ENABLE_INT1=y
CONFIG_SENSORS_CM36672P=y
CONFIG_SENSORS_LEDA_EN_GPIO=y

#CAMERA
CONFIG_SR544=y
CONFIG_S5K5E3YX=y
CONFIG_MSM_EEPROM=y
CONFIG_MSM_OTP=y
CONFIG_SENSOR_8_BPP=y
CONFIG_CAMERA_IRIS=y

#FLASH
CONFIG_FLASHLIGHT=y
CONFIG_SM_FLASH_LED=y
CONFIG_FLED_SM5703=y
CONFIG_FLED_SM5703_EXT_GPIO=y

# TIMA LOG
CONFIG_ARCH_MSM8939_TIMA=y

#APC CPR QUOTIENT
CONFIG_APC_CPR_QUOT_BOOST=y

# SSWAP
CONFIG_SWAP=y
CONFIG_FRONTSWAP=y
CONFIG_ZSMALLOC=y
CONFIG_PGTABLE_MAPPING=y
CONFIG_ZSWAP=y
CONFIG_ZPOOL=y
CONFIG_DIRECT_RECLAIM_FILE_PAGES_ONLY=y
CONFIG_INCREASE_MAXIMUM_SWAPPINESS=y
CONFIG_FIX_INACTIVE_RATIO=y
CONFIG_TIGHT_PGDAT_BALANCE=y
CONFIG_VNSWAP=y
CONFIG_SWAP_ENABLE_READAHEAD=n
```

## arch/arm/configs/msm8916_sec_grandmax_koropen_defconfig
```kconfig
CONFIG_SEC_GRANDMAX_PROJECT=y
CONFIG_MACH_GRANDMAX_KOR_OPEN=y

# SS Pinctrl Driver
CONFIG_SEC_GPIO_SETTINGS=y

# MUIC
CONFIG_SM5504_MUIC=y
CONFIG_MUIC_SUPPORT_RUSTPROOF=y
CONFIG_USBID_STANDARD_VER_01=y
CONFIG_MUIC_SUPPORT_CHARGING_CABLE=y

# VIBRATOR
CONFIG_MSM_VIBRATOR=y

#Touch Screen
CONFIG_TOUCHSCREEN_IST30XX_O1=y
CONFIG_INPUT_BOOSTER=y

#LCD
CONFIG_FB_MSM_MIPI_S6D2AA0X_HD_VIDEO_PANEL=y
CONFIG_BL_ISL98611=y
CONFIG_CABC_TUNING=y
CONFIG_MDNIE_TFT_MSM8X16=y

CONFIG_MFD_RT5033=y
CONFIG_MFD_RT5033_RESET_WA=y
CONFIG_BATTERY_SAMSUNG=y
CONFIG_BATTERY_SAMSUNG_DATA_FILE="grandmax_battery_data.h"
CONFIG_SAMSUNG_LPM_MODE=y
CONFIG_CHARGER_RT5033=y
CONFIG_FUELGAUGE_RT5033=y
CONFIG_REGULATOR_RT5033=y

#SENSOR
CONFIG_SENSORS_K2HH=y
CONFIG_SENSORS_AK09911C=y
CONFIG_SENSORS_CM36686=y
CONFIG_SENSORS_CM36686_LEDA_EN_GPIO=y

#FLASH
CONFIG_FLASHLIGHT=y
CONFIG_RT_FLASH_LED=y
CONFIG_FLED_RT5033=y
CONFIG_FLED_RT5033_EXT_GPIO=y

CONFIG_FRONT_EEPROM=y

#Wifi
#
# Enable Qualcomm Wifi features
#
CONFIG_MSM_PIL_PRONTO=y
CONFIG_WCNSS_CORE=y
CONFIG_WCNSS_CORE_PRONTO=y
CONFIG_WCNSS_MEM_PRE_ALLOC=y

#
# Wifi features (Qualcomm)
#
CONFIG_NET_CORE=y
CONFIG_WIRELESS=y
CONFIG_WIRELESS_EXT_SYSFS=y
CONFIG_WEXT_CORE=y
CONFIG_WEXT_PROC=y
CONFIG_CFG80211=y
CONFIG_CFG80211_DEFAULT_PS=y
#CONFIG_CFG80211_ALLOW_RECONNECT is not set
CONFIG_WLAN=y
CONFIG_WIRELESS_EXT=y
CONFIG_WEXT_PRIV=y
CONFIG_MODULES=y
CONFIG_MODULE_UNLOAD=y
CONFIG_MODULE_FORCE_UNLOAD=y
CONFIG_WCNSS_REGISTER_DUMP_ON_BITE =y

#Power off Alarm
CONFIG_RTC_AUTO_PWRON=y
CONFIG_RTC_AUTO_PWRON_PARAM=y

#optimize mmc block delay on resume
CONFIG_MMC_BLOCK_DEFERRED_RESUME=y

# TIMA LOG
CONFIG_ARCH_MSM8916_TIMA=y

#AUDIO
CONFIG_AUDIO_SPEAKER_OUT_NXP_AMP_ENABLE=y
CONFIG_AUDIO_QUAT_I2S_ENABLE=y

CONFIG_RADIO_IRIS=y
CONFIG_RADIO_IRIS_TRANSPORT=m

# RTCC v3
CONFIG_SWAP=y
CONFIG_ZSMALLOC=y
CONFIG_ZRAM=y
CONFIG_RUNTIME_COMPCACHE=y
CONFIG_KSWAPD_NOSWAP=y

CONFIG_TRACE_MODEM_MEM_FAIL=y

# MUIC
CONFIG_USB_HOST_NOTIFY=y

# DMB
CONFIG_TDMB=y
CONFIG_TDMB_VENDOR_FCI=y
CONFIG_TDMB_FC8080=y
CONFIG_TDMB_SPI=y
CONFIG_TDMB_QUALCOMM=y
```

## arch/arm/configs/msm8916_sec_heat_eur_defconfig
```kconfig
CONFIG_SEC_HEAT_PROJECT=y
CONFIG_MACH_HEAT_EUR=y

CONFIG_SEC_GPIO_SETTINGS=y

# MUIC
CONFIG_SM5504_MUIC=y
# CONFIG_MUIC_SM5502_SUPPORT_LANHUB_TA is not set
CONFIG_MUIC_SUPPORT_RUSTPROOF=y


#HALL IC
# CONFIG_SENSORS_HALL is not set
# CONFIG_W1 is not set
# CONFIG_W1_MASTER_GPIO_MSM is not set
# CONFIG_W1_SLAVE_DS28EL35 is not set
# CONFIG_W1_WORKQUEUE is not set
# CONFIG_W1_FAST_CHECK is not set
# CONFIG_W1_SN is not set

#LCD
CONFIG_FB_MSM_MIPI_SAMSUNG_WVGA_VIDEO_PT_PANEL=y
CONFIG_MDNIE_LITE_TUNING=y

CONFIG_REGULATOR_FIXED_VOLTAGE=y

#Touch Screen
CONFIG_TOUCHSCREEN_CYTTSP4=y

#Touch Key
CONFIG_KEYBOARD_CYPRESS_TOUCHKEY=y

CONFIG_MFD_RT5033=y
CONFIG_BATTERY_SAMSUNG=y
CONFIG_BATTERY_SAMSUNG_DATA_FILE="heat_battery_data.h"
CONFIG_SAMSUNG_LPM_MODE=y
CONFIG_CHARGER_RT5033=y
CONFIG_FUELGAUGE_RT5033=y
CONFIG_REGULATOR_RT5033=y

#Wifi
#
# Enable Qualcomm Wifi features
#
CONFIG_MSM_PIL_PRONTO=y
CONFIG_WCNSS_CORE=y
CONFIG_WCNSS_CORE_PRONTO=y
CONFIG_WCNSS_MEM_PRE_ALLOC=y

#
# Wifi features (Qualcomm)
#
CONFIG_NET_CORE=y
CONFIG_WIRELESS=y
CONFIG_WIRELESS_EXT_SYSFS=y
CONFIG_WEXT_CORE=y
CONFIG_WEXT_PROC=y
CONFIG_CFG80211=y
CONFIG_CFG80211_DEFAULT_PS=y
#CONFIG_CFG80211_ALLOW_RECONNECT is not set
CONFIG_WLAN=y
CONFIG_WIRELESS_EXT=y
CONFIG_WEXT_PRIV=y

CONFIG_MODULES=y
CONFIG_MODULE_UNLOAD=y
CONFIG_MODULE_FORCE_UNLOAD=y
CONFIG_WCNSS_REGISTER_DUMP_ON_BITE =y

#AUDIO
CONFIG_RADIO_IRIS=y
CONFIG_RADIO_IRIS_TRANSPORT=m

#SENSOR
CONFIG_SENSORS_K2HH=y
CONFIG_SENSORS_K2HH_SW_I2C=y

#NFC
CONFIG_SEC_NFC=y
CONFIG_SEC_NFC_I2C=y
CONFIG_SEC_NFC_USE_8916_BBCLK2=y
CONFIG_SEC_NFC_IF_I2C=y
CONFIG_SEC_NFC_PRODUCT_N5=y

#FLASH
CONFIG_FLASHLIGHT=y
CONFIG_RT_FLASH_LED=y
CONFIG_FLED_RT5033=y
CONFIG_FLED_RT5033_EXT_GPIO=y

#CAMERA
CONFIG_S5K4ECGX=y
CONFIG_SR130PC20=y
CONFIG_CAM_DUAL_POWER_SEQ=y

# RTCC v3
CONFIG_SWAP=y
CONFIG_ZSMALLOC=y
CONFIG_ZRAM=y
CONFIG_RUNTIME_COMPCACHE=y
CONFIG_KSWAPD_NOSWAP=y

# TIMA LOG
CONFIG_ARCH_MSM8916_TIMA=y

#optimize mmc block delay on resume
CONFIG_MMC_BLOCK_DEFERRED_RESUME=y

CONFIG_TRACE_MODEM_MEM_FAIL=y
```

## arch/arm/configs/msm8916_sec_hestia2lte_eur_defconfig
```kconfig
CONFIG_SEC_HESTIA2_PROJECT=y
CONFIG_MACH_HESTIA2_EUR_OPEN=y

# MUIC
CONFIG_SM5502_MUIC=y
CONFIG_USBID_STANDARD_VER_01=y
CONFIG_MUIC_SUPPORT_CHARGING_CABLE=y
CONFIG_MUIC_SUPPORT_RUSTPROOF_INBATT=y

#AUDIO
CONFIG_AUDIO_SPEAKER_OUT_NXP_AMP_ENABLE=y
CONFIG_AUDIO_QUAT_I2S_ENABLE=y

#GPIO Expander IC
CONFIG_GPIO_PCAL6416A=y

#Touch Key
CONFIG_KEYBOARD_ABOV_TOUCH_HESTIA2=y

#Touch Screen
CONFIG_TOUCHSCREEN_MMS300=y
#CONFIG_KEYBOARD_TC360_TKEY=y
#CONFIG_TOUCHSCREEN_SYNAPTICS_S7301=y
#CONFIG_TOUCHSCREEN_SYNAPTICS_S7301_KEYS=y
#CONFIG_TOUCHSCREEN_SYNAPTICS_S7301_WORKAROUND=y
#CONFIG_TOUCHSCREEN_SYNAPTICS_S7301_KEYLED=y
#CONFIG_SEC_TOUCHSCREEN_SURFACE_TOUCH=y
CONFIG_NO_ERROR_ON_MISMATCH=y
CONFIG_DEBUG_SECTION_MISMATCH=y

#VIBTONZ
CONFIG_VIBETONZ=y
CONFIG_TACTILE_ASSIST=y

#LCD
CONFIG_PANEL_EA8061V_AMS497EE01_HD=y

#BATTERY
CONFIG_MFD_RT5033=y
CONFIG_BATTERY_SAMSUNG=y
CONFIG_BATTERY_SAMSUNG_DATA_FILE="hestia2_battery_data.h"
CONFIG_SAMSUNG_LPM_MODE=y
CONFIG_CHARGER_RT5033=y
CONFIG_FUELGAUGE_RT5033=y
CONFIG_REGULATOR_RT5033=y
CONFIG_BATTERY_SWELLING=y

#SENSOR
CONFIG_SENSORS=y
CONFIG_SENSORS_CORE=y
CONFIG_SENSORS_K2HH=y
CONFIG_SENSORS_CM36672=y
CONFIG_SENSORS_CM36672_LEDA_EN_GPIO=y
```
