## arch/arm/configs/msm8916_sec_a3_eur_defconfig
```kconfig
CONFIG_SEC_A3_EUR_PROJECT=y
CONFIG_MACH_A3_EUR_OPEN=y

CONFIG_DEBUG_SPINLOCK=y

CONFIG_SEC_GPIO_SETTINGS=y

# MUIC
CONFIG_SM5502_MUIC=y
CONFIG_MUIC_SUPPORT_RUSTPROOF_INBATT=y
CONFIG_USBID_STANDARD_VER_01=y
CONFIG_MUIC_SUPPORT_CHARGING_CABLE=y

#Haptic Vibrator
CONFIG_VIBETONZ=y

#LCD
CONFIG_FB_MSM_MIPI_SAMSUNG_QHD_VIDEO_PT_PANEL=y
CONFIG_MDNIE_LITE_TUNING=y
CONFIG_ESD_RECOVERY=y

CONFIG_REGULATOR_FIXED_VOLTAGE=y

#INPUT (TSP, Touchkey)
CONFIG_TOUCHSCREEN_MMS300=y
CONFIG_TOUCHSCREEN_ZINITIX_BT541=y
CONFIG_KEYBOARD_ABOV_TOUCH=y
CONFIG_SEC_DVFS=y

#HALL IC
CONFIG_SENSORS_HALL=y

CONFIG_MFD_RT5033=y
CONFIG_BATTERY_SAMSUNG=y
CONFIG_BATTERY_SAMSUNG_DATA_FILE="a3_battery_data.h"
CONFIG_SAMSUNG_LPM_MODE=y
CONFIG_CHARGER_RT5033=y
CONFIG_FUELGAUGE_RT5033=y
CONFIG_REGULATOR_RT5033=y
CONFIG_SIOP_CHARGING_LIMIT_CURRENT=700

#Wifi
#
# Enable Qualcomm Wifi features
#
CONFIG_MSM_PIL_PRONTO=y
CONFIG_WCNSS_CORE=y
CONFIG_WCNSS_CORE_PRONTO=y
CONFIG_WCNSS_MEM_PRE_ALLOC=y

#
# Wifi features (Qualcomm)
#
CONFIG_NET_CORE=y
CONFIG_WIRELESS=y
CONFIG_WIRELESS_EXT_SYSFS=y
CONFIG_WEXT_CORE=y
CONFIG_WEXT_PROC=y
CONFIG_CFG80211=y
CONFIG_CFG80211_DEFAULT_PS=y
#CONFIG_CFG80211_ALLOW_RECONNECT is not set
CONFIG_WLAN=y
CONFIG_WIRELESS_EXT=y
CONFIG_WEXT_PRIV=y

CONFIG_MODULES=y
CONFIG_MODULE_UNLOAD=y
CONFIG_MODULE_FORCE_UNLOAD=y
CONFIG_WCNSS_REGISTER_DUMP_ON_BITE =y

#AUDIO
CONFIG_RADIO_IRIS=y
CONFIG_RADIO_IRIS_TRANSPORT=m
CONFIG_AUDIO_SPEAKER_OUT_NXP_AMP_ENABLE=y

#SENSOR
CONFIG_SENSORS_K303C=y
CONFIG_SENSORS_CM36652=y
CONFIG_SENSORS_CM36652_LEDA_EN_GPIO=y
# BMC150
CONFIG_SENSORS_BMA2X2=y
CONFIG_SENSORS_BMM050=y
CONFIG_INPUT_BMA2x2_ACC_ALERT_INT=y

#NFC
CONFIG_SEC_NFC=y
CONFIG_SEC_NFC_I2C=y
CONFIG_SEC_NFC_USE_8916_BBCLK2=y
CONFIG_SEC_NFC_IF_I2C=y
CONFIG_SEC_NFC_PRODUCT_N5=y

#FLASH
CONFIG_FLASHLIGHT=y
CONFIG_RT_FLASH_LED=y
CONFIG_FLED_RT5033=y
CONFIG_FLED_RT5033_EXT_GPIO=y

#CONFIG_FRONT_EEPROM=y

# RTCC v3
CONFIG_SWAP=y
CONFIG_ZSMALLOC=y
CONFIG_ZRAM=y
CONFIG_RUNTIME_COMPCACHE=y
CONFIG_KSWAPD_NOSWAP=y

# TIMA LOG
CONFIG_ARCH_MSM8916_TIMA=y

#optimize mmc block delay on resume
CONFIG_MMC_BLOCK_DEFERRED_RESUME=y

# DUAL SIM / SINGLE SIM Detection
CONFIG_CHECK_SIMSLOT_COUNT=y
CONFIG_CHECK_SIMSLOT_COUNT_GPIO=971
```

## arch/arm/configs/msm8916_sec_a3u_eur_defconfig
```kconfig
CONFIG_SEC_A3_PROJECT=y
CONFIG_MACH_A3U_EUR_OPEN=y

# MUIC
CONFIG_SM5502_MUIC=y
CONFIG_MUIC_SUPPORT_RUSTPROOF_INBATT=y
CONFIG_USBID_STANDARD_VER_01=y
CONFIG_MUIC_SUPPORT_CHARGING_CABLE=y

#HALL IC
CONFIG_SENSORS_HALL=y

#VIBTONZ
CONFIG_VIBETONZ=y
CONFIG_TACTILE_ASSIST=y

#AUDIO
CONFIG_AUDIO_SPEAKER_OUT_NXP_AMP_ENABLE=y
CONFIG_AUDIO_QUAT_I2S_ENABLE=y

#SENSORS
CONFIG_INPUT=y
CONFIG_INPUT_MISC=y
CONFIG_INPUT_GPIO=y
CONFIG_INPUT_POLLDEV=y

#SENSORS
CONFIG_SENSORS=y
CONFIG_SENSORS_CORE=y
CONFIG_SENSORS_USE_SYMLINK=y
CONFIG_SYSFS=y
CONFIG_INPUT=y
CONFIG_INPUT_MISC=y
CONFIG_INPUT_GPIO=y
CONFIG_INPUT_POLLDEV=y
CONFIG_SENSORS_CM36652=y
CONFIG_SENSORS_CM36652_LEDA_EN_GPIO=y

# BMC150
CONFIG_SENSORS_BMA2X2=y
CONFIG_SENSORS_BMM050=y
CONFIG_INPUT_BMA2x2_ACC_ALERT_INT=y
# CONFIG_SENSORS_BMA2X2_ENABLE_INT1 is not set
# CONFIG_BOSCH_BMA2X2_ENABLE_INT2 is not set
#DISPLAY
CONFIG_PANEL_S6E88A0_AMS452EF01_QHD=y

#INPUT (TSP, Touchkey)
CONFIG_TOUCHSCREEN_ZINITIX_BT541=y
CONFIG_KEYBOARD_ABOV_TOUCH_A3=y

#BATTERY
CONFIG_MFD_RT5033=y
CONFIG_MFD_RT5033_RESET_WA=y
CONFIG_BATTERY_SAMSUNG=y
CONFIG_BATTERY_SAMSUNG_DATA_FILE="a3_battery_data.h"
CONFIG_SAMSUNG_LPM_MODE=y
CONFIG_CHARGER_RT5033=y
CONFIG_FUELGAUGE_RT5033=y
CONFIG_REGULATOR_RT5033=y
CONFIG_BATTERY_SWELLING=y
CONFIG_SIOP_CHARGING_LIMIT_CURRENT=700
#NFC
CONFIG_SEC_NFC=y
CONFIG_SEC_NFC_I2C=y
CONFIG_SEC_NFC_USE_8916_BBCLK2=y
CONFIG_SEC_NFC_IF_I2C=y
CONFIG_SEC_NFC_PRODUCT_N5=y

#CAMERA
CONFIG_MSM_OTP=y


CONFIG_CRYPTO_GCM=y
CONFIG_XFRM_USER=y
CONFIG_NET_KEY=y
CONFIG_INET=y 
CONFIG_IP_ADVANCED_ROUTER=y 
CONFIG_IP_MULTIPLE_TABLES=y 
CONFIG_INET_AH=y 
CONFIG_INET_ESP=y 
CONFIG_INET_IPCOMP=y 
CONFIG_INET_XFRM_MODE_TRANSPORT=y 
CONFIG_INET_XFRM_MODE_TUNNEL=y 
CONFIG_INET_XFRM_MODE_BEET=y 
CONFIG_IPV6=y 
CONFIG_INET6_AH=y 
CONFIG_INET6_ESP=y 
CONFIG_INET6_IPCOMP=y 
CONFIG_INET6_XFRM_MODE_TRANSPORT=y 
CONFIG_INET6_XFRM_MODE_TUNNEL=y 
CONFIG_INET6_XFRM_MODE_BEET=y 
CONFIG_IPV6_MULTIPLE_TABLES=y 
CONFIG_NETFILTER=y 
CONFIG_NETFILTER_XTABLES=y 
CONFIG_NETFILTER_XT_MATCH_POLICY=y


#
# Bluetooth deconfig
#
CONFIG_BT=y
# CONFIG_BT_RFCOMM=y is not set
# CONFIG_BT_RFCOMM_TTY=y is not set
# CONFIG_BT_BNEP=y is not set
# CONFIG_BT_BNEP_MC_FILTER=y is not set
# CONFIG_BT_BNEP_PROTO_FILTER=y is not set
CONFIG_BT_HIDP=y
CONFIG_HID_SUPPORT=y
CONFIG_HID=y
CONFIG_HIDRAW=y
# CONFIG_BT_HCISMD=y is not set
# CONFIG_BT_HCIUART=y is not set
# CONFIG_BT_HCIUART_H4=y is not set

# Special HID drivers
CONFIG_HID_A4TECH=y
CONFIG_HID_ACRUX=y
# CONFIG_HID_ACRUX_FF is not set
CONFIG_HID_APPLE=y
CONFIG_HID_BELKIN=y
CONFIG_HID_CHERRY=y
CONFIG_HID_CHICONY=y
CONFIG_HID_PRODIKEYS=y
CONFIG_HID_CYPRESS=y
CONFIG_HID_DRAGONRISE=y
CONFIG_HID_EMS_FF=y
CONFIG_HID_ELECOM=y
CONFIG_HID_EZKEY=y
CONFIG_HID_KEYTOUCH=y
CONFIG_HID_KYE=y
CONFIG_HID_UCLOGIC=y
CONFIG_HID_WALTOP=y
CONFIG_HID_GYRATION=y
CONFIG_HID_TWINHAN=y
CONFIG_HID_KENSINGTON=y
CONFIG_HID_LCPOWER=y
CONFIG_HID_LOGITECH=y
CONFIG_HID_MAGICMOUSE=y
CONFIG_HID_MICROSOFT=y
CONFIG_HID_MONTEREY=y
CONFIG_HID_MULTITOUCH=y
CONFIG_HID_NTRIG=y
CONFIG_HID_ORTEK=y
CONFIG_HID_PANTHERLORD=y
CONFIG_HID_PETALYNX=y
CONFIG_HID_PICOLCD=y
# CONFIG_HID_PICOLCD_FB is not set
# CONFIG_HID_PICOLCD_BACKLIGHT is not set
# CONFIG_HID_PICOLCD_LCD is not set
# CONFIG_HID_PICOLCD_LEDS is not set
CONFIG_HID_QUANTA=y
CONFIG_HID_ROCCAT=y
CONFIG_HID_ROCCAT_COMMON=y
CONFIG_HID_ROCCAT_ARVO=y
CONFIG_HID_ROCCAT_KONE=y
CONFIG_HID_ROCCAT_KONEPLUS=y
CONFIG_HID_ROCCAT_KOVAPLUS=y
CONFIG_HID_ROCCAT_PYRA=y
CONFIG_HID_SAMSUNG=y
CONFIG_HID_SYNAPTICS_BT=y
CONFIG_HID_SONY=y
CONFIG_HID_SUNPLUS=y
CONFIG_HID_GREENASIA=y
CONFIG_HID_SMARTJOYPLUS=y
CONFIG_HID_TOPSEED=y
CONFIG_HID_THRUSTMASTER=y
CONFIG_HID_WACOM=y
CONFIG_HID_WACOM_POWER_SUPPLY=y
CONFIG_HID_ZAGG=y
CONFIG_HID_ZEROPLUS=y
CONFIG_HID_ZYDACRON=y
CONFIG_SEC_NET_FILTER=y

#MMC
CONFIG_SEC_HYBRID_TRAY=y
```

## arch/arm/configs/msm8916_sec_a53g_eur_defconfig
```kconfig
CONFIG_SEC_A53G_EUR_PROJECT=y
CONFIG_MACH_A53G_EUR_OPEN=y

CONFIG_SEC_GPIO_SETTINGS=y
# MUIC
CONFIG_SM5502_MUIC=y
CONFIG_MUIC_SUPPORT_RUSTPROOF_INBATT=y
CONFIG_USBID_STANDARD_VER_01=y
CONFIG_MUIC_SUPPORT_CHARGING_CABLE=y
# CONFIG_MUIC_SM5502_SUPPORT_LANHUB_TA is not set

#HALL IC
CONFIG_SENSORS_HALL=y

#LCD
#CONFIG_FB_MSM_MIPI_EA8061V_PANEL=y
#CONFIG_MDNIE_LITE_TUNING=y
#CONFIG_EXTERNAL_POWER_GPIO=y

#DISPLAY
CONFIG_PANEL_EA8061V_AMS497EE01_HD=y
CONFIG_FB_MSM_MDSS_SAMSUNG=y

#Touch Key
#CONFIG_KEYBOARD_ABOV_TOUCH=y
CONFIG_INPUT_ENABLED=y
CONFIG_KEYBOARD_ABOV_TOUCH_A5=y
#Touch Screen
CONFIG_TOUCHSCREEN_MMS300_A=y
#CONFIG_TOUCHSCREEN_MMS300=y
#CONFIG_TOUCHSCREEN_CYTTSP5=y
#CONFIG_TOUCHSCREEN_CYTTSP5_DEVICETREE_SUPPORT=y

CONFIG_LEDS_GPIO=y

# VIBRATOR
CONFIG_SS_VIBRATOR=y

CONFIG_MFD_RT5033=y
CONFIG_MFD_RT5033_RESET_GPIO=y
CONFIG_MFD_RT5033_SLDO_VBUSDET=n
CONFIG_BATTERY_SAMSUNG=y
CONFIG_BATTERY_SAMSUNG_DATA_FILE="a5_battery_data.h"
CONFIG_SAMSUNG_LPM_MODE=y
CONFIG_CHARGER_RT5033=y
CONFIG_FUELGAUGE_RT5033=y
CONFIG_REGULATOR_RT5033=y
CONFIG_BATTERY_SWELLING=y

#SENSORS
CONFIG_SENSORS=y
CONFIG_SENSORS_CORE=y
CONFIG_SENSOR_USE_SYMLINK=y
CONFIG_SYSFS=y
CONFIG_INPUT=y
CONFIG_INPUT_GPIO=y
CONFIG_INPUT_POLLDEV=y
# CONFIG_INPUT_MPU6515 is not set
# CONFIG_INPUT_MPU6500_SELFTEST is not set
# CONFIG_INPUT_MPU6500_POLLING is not set
# CONFIG_SENSORS_HSCDTD008A is not set
CONFIG_SENSORS_TMD3782S_VDD_LEDA=y
CONFIG_SENSORS_TMD3782S=y
CONFIG_SENSORS_BMC150_VDD=y
# BMC150
CONFIG_SENSORS_BMA2X2=y
CONFIG_SENSORS_BMM050=y
CONFIG_SENSORS_BMA2X2_ENABLE_INT1=y
CONFIG_SENSORS_ACCELEROMETER_2G=y

CONFIG_NFC_PN547=y
CONFIG_NFC_PN547_8916_USE_BBCLK2=y

#Wifi
#
# Enable Qualcomm Wifi features
###########################################
CONFIG_MSM_PIL_PRONTO=y
CONFIG_WCNSS_CORE=y
CONFIG_WCNSS_CORE_PRONTO=y
CONFIG_WCNSS_MEM_PRE_ALLOC=y
#############################################
#
# Wifi features (Qualcomm)
#
CONFIG_NET_CORE=y
CONFIG_WIRELESS=y
CONFIG_WIRELESS_EXT_SYSFS=y
CONFIG_WEXT_CORE=y
CONFIG_WEXT_PROC=y
CONFIG_CFG80211=y
CONFIG_CFG80211_DEFAULT_PS=y
#CONFIG_CFG80211_ALLOW_RECONNECT is not set
CONFIG_WLAN=y
CONFIG_WIRELESS_EXT=y
CONFIG_WEXT_PRIV=y

CONFIG_MODULES=y
CONFIG_MODULE_UNLOAD=y
CONFIG_MODULE_FORCE_UNLOAD=y
CONFIG_WCNSS_REGISTER_DUMP_ON_BITE =y

#AUDIO
CONFIG_RADIO_IRIS=y
CONFIG_RADIO_IRIS_TRANSPORT=m
CONFIG_AUDIO_SPEAKER_OUT_NXP_AMP_ENABLE=y
CONFIG_AUDIO_QUAT_I2S_ENABLE=y

#FLASH
CONFIG_FLASHLIGHT=y
CONFIG_RT_FLASH_LED=y
CONFIG_FLED_RT5033=y
CONFIG_FLED_RT5033_EXT_GPIO=y

#CAMERA
CONFIG_SEC_A5_COMMON_CAMERA=y
#CONFIG_MSM_OTP is not set
CONFIG_IMX135=y
CONFIG_S5K5E3YX=y

#MMC
CONFIG_SEC_HYBRID_TRAY=y
#

#Power off Alarm
#CONFIG_RTC_AUTO_PWRON is not set
#CONFIG_RTC_AUTO_PWRON_PARAM is not set

#optimize mmc block delay on resume
CONFIG_MMC_BLOCK_DEFERRED_RESUME=y

#DUAL SIM / SINGLE SIM Detection
CONFIG_CHECK_SIMSLOT_COUNT=y
CONFIG_CHECK_SIMSLOT_COUNT_DT=y

# SSWAP
CONFIG_SWAP=y
CONFIG_FRONTSWAP=y
CONFIG_ZSMALLOC=y
CONFIG_PGTABLE_MAPPING=y
CONFIG_ZSWAP=y
CONFIG_ZPOOL=y
CONFIG_DIRECT_RECLAIM_FILE_PAGES_ONLY=y
CONFIG_INCREASE_MAXIMUM_SWAPPINESS=y
CONFIG_FIX_INACTIVE_RATIO=y
CONFIG_TIGHT_PGDAT_BALANCE=y
CONFIG_VNSWAP=y
CONFIG_SWAP_ENABLE_READAHEAD=n
```

## arch/arm/configs/msm8916_sec_a5_eur_defconfig
```kconfig
CONFIG_SEC_A5_EUR_PROJECT=y
CONFIG_MACH_A5_EUR_OPEN=y

CONFIG_SEC_GPIO_SETTINGS=y
# MUIC
CONFIG_SM5502_MUIC=y
CONFIG_MUIC_SUPPORT_RUSTPROOF_INBATT=y
CONFIG_USBID_STANDARD_VER_01=y
CONFIG_MUIC_SUPPORT_CHARGING_CABLE=y
# CONFIG_MUIC_SM5502_SUPPORT_LANHUB_TA is not set

#HALL IC
CONFIG_SENSORS_HALL=y

#LCD
#CONFIG_FB_MSM_MIPI_EA8061V_PANEL=y
#CONFIG_MDNIE_LITE_TUNING=y
#CONFIG_EXTERNAL_POWER_GPIO=y

#DISPLAY
CONFIG_PANEL_EA8061V_AMS497EE01_HD=y
CONFIG_FB_MSM_MDSS_SAMSUNG=y

#Touch Key
#CONFIG_KEYBOARD_ABOV_TOUCH=y
CONFIG_INPUT_ENABLED=y
CONFIG_KEYBOARD_ABOV_TOUCH_A5=y
#Touch Screen
CONFIG_TOUCHSCREEN_MMS300_A=y
#CONFIG_TOUCHSCREEN_MMS300=y
#CONFIG_TOUCHSCREEN_CYTTSP5=y
#CONFIG_TOUCHSCREEN_CYTTSP5_DEVICETREE_SUPPORT=y

CONFIG_LEDS_GPIO=y

# VIBRATOR
CONFIG_SS_VIBRATOR=y

CONFIG_MFD_RT5033=y
CONFIG_MFD_RT5033_RESET_GPIO=y
CONFIG_MFD_RT5033_SLDO_VBUSDET=n
CONFIG_BATTERY_SAMSUNG=y
CONFIG_BATTERY_SAMSUNG_DATA_FILE="a5_battery_data.h"
CONFIG_SAMSUNG_LPM_MODE=y
CONFIG_CHARGER_RT5033=y
CONFIG_FUELGAUGE_RT5033=y
CONFIG_REGULATOR_RT5033=y
CONFIG_BATTERY_SWELLING=y

#SENSORS
CONFIG_SENSORS=y
CONFIG_SENSORS_CORE=y
CONFIG_SENSOR_USE_SYMLINK=y
CONFIG_SYSFS=y
CONFIG_INPUT=y
CONFIG_INPUT_GPIO=y
CONFIG_INPUT_POLLDEV=y
# CONFIG_INPUT_MPU6515 is not set
# CONFIG_INPUT_MPU6500_SELFTEST is not set
# CONFIG_INPUT_MPU6500_POLLING is not set
# CONFIG_SENSORS_HSCDTD008A is not set
CONFIG_SENSORS_TMD3782S=y
CONFIG_SENSORS_TMD3782S_VDD_LEDA=y
# BMC150
CONFIG_SENSORS_BMA2X2=y
CONFIG_SENSORS_BMM050=y
CONFIG_SENSORS_BMC150_VDD=y
CONFIG_SENSORS_BMA2X2_ENABLE_INT1=y
CONFIG_SENSORS_ACCELEROMETER_2G=y
#
#NFC
#
CONFIG_NFC=y
CONFIG_SEC_NFC=y
CONFIG_SEC_NFC_IF_I2C=y
CONFIG_SEC_NFC_PRODUCT_N5=y
CONFIG_SEC_NFC_USE_8916_BBCLK2=y

#Wifi
#
# Enable Qualcomm Wifi features
#
CONFIG_MSM_PIL_PRONTO=y
CONFIG_WCNSS_CORE=y
CONFIG_WCNSS_CORE_PRONTO=y
CONFIG_WCNSS_MEM_PRE_ALLOC=y

#
# Wifi features (Qualcomm)
#
CONFIG_NET_CORE=y
CONFIG_WIRELESS=y
CONFIG_WIRELESS_EXT_SYSFS=y
CONFIG_WEXT_CORE=y
CONFIG_WEXT_PROC=y
CONFIG_CFG80211=y
CONFIG_CFG80211_DEFAULT_PS=y
#CONFIG_CFG80211_ALLOW_RECONNECT is not set
CONFIG_WLAN=y
CONFIG_WIRELESS_EXT=y
CONFIG_WEXT_PRIV=y

CONFIG_MODULES=y
CONFIG_MODULE_UNLOAD=y
CONFIG_MODULE_FORCE_UNLOAD=y
CONFIG_WCNSS_REGISTER_DUMP_ON_BITE =y

#AUDIO
CONFIG_RADIO_IRIS=y
CONFIG_RADIO_IRIS_TRANSPORT=m
CONFIG_AUDIO_SPEAKER_OUT_NXP_AMP_ENABLE=y
CONFIG_AUDIO_QUAT_I2S_ENABLE=y

#FLASH
CONFIG_FLASHLIGHT=y
CONFIG_RT_FLASH_LED=y
CONFIG_FLED_RT5033=y
CONFIG_FLED_RT5033_EXT_GPIO=y

#CAMERA
CONFIG_SEC_A5_COMMON_CAMERA=y
#CONFIG_MSM_OTP is not set
CONFIG_IMX135=y
CONFIG_S5K5E3YX=y

#Power off Alarm
#CONFIG_RTC_AUTO_PWRON is not set
#CONFIG_RTC_AUTO_PWRON_PARAM is not set

#optimize mmc block delay on resume
CONFIG_MMC_BLOCK_DEFERRED_RESUME=y

CONFIG_CHECK_SIMSLOT_COUNT=y
CONFIG_CHECK_SIMSLOT_COUNT_DT=y

#IPSec
CONFIG_CRYPTO_NULL=y

#EPDG
CONFIG_NET_CORE=y
CONFIG_NET_SCH_PRIO=y
CONFIG_NET_SCHED=y   #depends on CONFIG_NET  which is enabled by default.. coz not seeing in the config file
CONFIG_NET_CLS_BASIC=y # required if basic is being used as a filter. depends on CONFIG_NET_CLS so enabling it by default
CONFIG_NET_CLS=y
CONFIG_NET_CLS_ACT=y # for enabling the action target.
CONFIG_NET_ACT_MIRRED=y  # for enabling the mirred target for redirecting the packet between the devices.
CONFIG_NET_EMATCH=y   #basic uses extended matches so this has to be present
CONFIG_NET_SCH_INGRESS=y # classifier for ingress packet
```
