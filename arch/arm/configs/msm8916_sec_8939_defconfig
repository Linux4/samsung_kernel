## arch/arm/configs/msm8916_sec_a5u_canbmc_defconfig
```kconfig
CONFIG_SEC_A5_PROJECT=y
CONFIG_MACH_A5U_CAN_BMC=y

# HARD RESET
CONFIG_RESTART_REASON_SEC_PARAM=y

# GPIO SETTING
CONFIG_SEC_GPIO_SETTINGS=y

# MUIC
CONFIG_SM5502_MUIC=y
CONFIG_MUIC_SUPPORT_RUSTPROOF_INBATT=y
CONFIG_USBID_STANDARD_VER_01=y
CONFIG_MUIC_SUPPORT_CHARGING_CABLE=y

#HALL IC
CONFIG_SENSORS_HALL=y
#Touch Key
CONFIG_KEYBOARD_ABOV_TOUCH_A5=y

#Touch Screen
CONFIG_TOUCHSCREEN_MMS300_A=y

# VIBRATOR
CONFIG_SS_VIBRATOR=y

#AUDIO
CONFIG_AUDIO_SPEAKER_OUT_NXP_AMP_ENABLE=y
CONFIG_AUDIO_QUAT_I2S_ENABLE=y

#SENSORS
CONFIG_SENSORS=y
CONFIG_SENSORS_CORE=y
CONFIG_SENSORS_USE_SYMLINK=y
CONFIG_INPUT=y
CONFIG_INPUT_MISC=y
CONFIG_INPUT_GPIO=y
CONFIG_INPUT_POLLDEV=y
CONFIG_SENSORS_TMD3782S=y
CONFIG_SENSORS_TMD3782S_VDD_LEDA=y
# BMC150
CONFIG_SENSORS_BMA2X2=y
CONFIG_SENSORS_BMM050=y
CONFIG_SENSORS_BMA2X2_ENABLE_INT1=y
CONFIG_SENSORS_BMC150_VDD=y
CONFIG_SENSORS_ACCELEROMETER_2G=y

#AUDIO
CONFIG_RADIO_IRIS=y
CONFIG_RADIO_IRIS_TRANSPORT=m
CONFIG_AUDIO_SPEAKER_OUT_NXP_AMP_ENABLE=y
CONFIG_AUDIO_QUAT_I2S_ENABLE=y

#DISPLAY
CONFIG_PANEL_EA8061V_AMS497EE01_HD=y

#optimize mmc block delay on resume
CONFIG_MMC_BLOCK_DEFERRED_RESUME=y

#BATTERY
CONFIG_MFD_RT5033=y
CONFIG_MFD_RT5033_RESET_GPIO=y
CONFIG_MFD_RT5033_SLDO_VBUSDET=n
CONFIG_BATTERY_SAMSUNG=y
CONFIG_BATTERY_SAMSUNG_DATA_FILE="a5_battery_data.h"
CONFIG_SAMSUNG_LPM_MODE=y
CONFIG_CHARGER_RT5033=y
CONFIG_FUELGAUGE_RT5033=y
CONFIG_REGULATOR_RT5033=y
CONFIG_BATTERY_SWELLING=y
CONFIG_SIOP_CHARGING_LIMIT_CURRENT=700
CONFIG_FEATURE_SOFT_START_CHARGING=y

#NFC
CONFIG_NFC=y
CONFIG_SEC_NFC=y
CONFIG_SEC_NFC_IF_I2C=y
CONFIG_SEC_NFC_PRODUCT_N5=y
CONFIG_SEC_NFC_USE_8916_BBCLK2=y

#FLASH
CONFIG_FLASHLIGHT=y
CONFIG_RT_FLASH_LED=y
CONFIG_FLED_RT5033=y
CONFIG_FLED_RT5033_EXT_GPIO=y

#CAMERA
#CONFIG_MSM_OTP is not set
CONFIG_IMX135=y
CONFIG_S5K5E3YX=y

#IPSec
CONFIG_CRYPTO_NULL=y
#MMC
CONFIG_SEC_HYBRID_TRAY=y
#
# Bluetooth deconfig
#
CONFIG_BT=y
# CONFIG_BT_RFCOMM=y is not set
# CONFIG_BT_RFCOMM_TTY=y is not set
# CONFIG_BT_BNEP=y is not set
# CONFIG_BT_BNEP_MC_FILTER=y is not set
# CONFIG_BT_BNEP_PROTO_FILTER=y is not set
CONFIG_BT_HIDP=y
CONFIG_HID_SUPPORT=y
CONFIG_HID=y
CONFIG_HIDRAW=y
# CONFIG_BT_HCISMD=y is not set
# CONFIG_BT_HCIUART=y is not set
# CONFIG_BT_HCIUART_H4=y is not set

# Special HID drivers
CONFIG_HID_A4TECH=y
CONFIG_HID_ACRUX=y
# CONFIG_HID_ACRUX_FF is not set
CONFIG_HID_APPLE=y
CONFIG_HID_BELKIN=y
CONFIG_HID_CHERRY=y
CONFIG_HID_CHICONY=y
CONFIG_HID_PRODIKEYS=y
CONFIG_HID_CYPRESS=y
CONFIG_HID_DRAGONRISE=y
CONFIG_HID_EMS_FF=y
CONFIG_HID_ELECOM=y
CONFIG_HID_EZKEY=y
CONFIG_HID_KEYTOUCH=y
CONFIG_HID_KYE=y
CONFIG_HID_UCLOGIC=y
CONFIG_HID_WALTOP=y
CONFIG_HID_GYRATION=y
CONFIG_HID_TWINHAN=y
CONFIG_HID_KENSINGTON=y
CONFIG_HID_LCPOWER=y
CONFIG_HID_LOGITECH=y
CONFIG_HID_MAGICMOUSE=y
CONFIG_HID_MICROSOFT=y
CONFIG_HID_MONTEREY=y
CONFIG_HID_MULTITOUCH=y
CONFIG_HID_NTRIG=y
CONFIG_HID_ORTEK=y
CONFIG_HID_PANTHERLORD=y
CONFIG_HID_PETALYNX=y
CONFIG_HID_PICOLCD=y
# CONFIG_HID_PICOLCD_FB is not set
# CONFIG_HID_PICOLCD_BACKLIGHT is not set
# CONFIG_HID_PICOLCD_LCD is not set
# CONFIG_HID_PICOLCD_LEDS is not set
CONFIG_HID_QUANTA=y
CONFIG_HID_ROCCAT=y
CONFIG_HID_ROCCAT_COMMON=y
CONFIG_HID_ROCCAT_ARVO=y
CONFIG_HID_ROCCAT_KONE=y
CONFIG_HID_ROCCAT_KONEPLUS=y
CONFIG_HID_ROCCAT_KOVAPLUS=y
CONFIG_HID_ROCCAT_PYRA=y
CONFIG_HID_SAMSUNG=y
CONFIG_HID_SYNAPTICS_BT=y
CONFIG_HID_SONY=y
CONFIG_HID_SUNPLUS=y
CONFIG_HID_GREENASIA=y
CONFIG_HID_SMARTJOYPLUS=y
CONFIG_HID_TOPSEED=y
CONFIG_HID_THRUSTMASTER=y
CONFIG_HID_WACOM=y
CONFIG_HID_WACOM_POWER_SUPPLY=y
CONFIG_HID_ZAGG=y
CONFIG_HID_ZEROPLUS=y
CONFIG_HID_ZYDACRON=y

#IPSec
CONFIG_CRYPTO_NULL=y
```

## arch/arm/configs/msm8916_sec_a5u_lgt_defconfig
```kconfig
CONFIG_SEC_A5_PROJECT=y
CONFIG_MACH_A5U_KOR_OPEN=y

# GPIO SETTING
CONFIG_SEC_GPIO_SETTINGS=y

# MUIC
CONFIG_SM5502_MUIC=y
CONFIG_MUIC_SUPPORT_RUSTPROOF_INBATT=y
CONFIG_USBID_STANDARD_VER_01=y
CONFIG_MUIC_SUPPORT_CHARGING_CABLE=y

#HALL IC
CONFIG_SENSORS_HALL=y
#Touch Key
CONFIG_KEYBOARD_ABOV_TOUCH_A5=y

#Touch Screen
CONFIG_TOUCHSCREEN_MMS300=y

#Haptic Vibrator
CONFIG_VIBETONZ=y
CONFIG_TACTILE_ASSIST=y

#AUDIO
CONFIG_AUDIO_SPEAKER_OUT_NXP_AMP_ENABLE=y
CONFIG_AUDIO_QUAT_I2S_ENABLE=y

#SENSORS
CONFIG_SENSORS=y
CONFIG_SENSORS_CORE=y
CONFIG_INPUT=y
CONFIG_INPUT_MISC=y
CONFIG_INPUT_GPIO=y
CONFIG_INPUT_POLLDEV=y
CONFIG_SENSORS_TMD3782S=y
# BMC150
CONFIG_SENSORS_BMA2X2=y
CONFIG_SENSORS_BMM050=y
CONFIG_INPUT_BMA2x2_ACC_ALERT_INT=y
# CONFIG_SENSORS_BMA2X2_ENABLE_INT1 is not set
# CONFIG_BOSCH_BMA2X2_ENABLE_INT2 is not set

#SENSORS
CONFIG_SENSORS=y
CONFIG_SENSORS_CORE=y
CONFIG_SENSORS_USE_SYMLINK=y

#AUDIO
CONFIG_RADIO_IRIS=y
CONFIG_RADIO_IRIS_TRANSPORT=m
CONFIG_AUDIO_SPEAKER_OUT_NXP_AMP_ENABLE=y
CONFIG_AUDIO_QUAT_I2S_ENABLE=y

#DISPLAY
CONFIG_PANEL_EA8061V_AMS497EE01_HD=y

#optimize mmc block delay on resume
CONFIG_MMC_BLOCK_DEFERRED_RESUME=y

#BATTERY
CONFIG_MFD_RT5033=y
CONFIG_MFD_RT5033_RESET_WA=y
CONFIG_BATTERY_SAMSUNG=y
CONFIG_BATTERY_SAMSUNG_DATA_FILE="a5_battery_data.h"
CONFIG_SAMSUNG_LPM_MODE=y
CONFIG_CHARGER_RT5033=y
CONFIG_FUELGAUGE_RT5033=y
CONFIG_REGULATOR_RT5033=y
CONFIG_BATTERY_SWELLING=y
CONFIG_SIOP_CHARGING_LIMIT_CURRENT=700

#NFC
CONFIG_SEC_NFC=y
CONFIG_SEC_NFC_IF_I2C=y
CONFIG_SEC_NFC_PRODUCT_N5=y
CONFIG_SEC_NFC_USE_8916_BBCLK2=y
CONFIG_SEC_NFC_MARGINTIME=y

#CAMERA
CONFIG_MSM_OTP=y

#USB
CONFIG_USB_HOST_NOTIFY=y
CONFIG_USB_LOCK_SUPPORT_FOR_MDM=y

# DMB
CONFIG_TDMB=y
CONFIG_TDMB_VENDOR_FCI=y
CONFIG_TDMB_FC8080=y
CONFIG_TDMB_SPI=y
CONFIG_TDMB_QUALCOMM=y

#LGU I-WLAN
CONFIG_LGUIWLAN=y
CONFIG_MODULES=y
CONFIG_MODULE_UNLOAD=y
CONFIG_MODULE_FORCE_UNLOAD=y

#MMC
CONFIG_SEC_HYBRID_TRAY=y

#
# Bluetooth deconfig
#
CONFIG_BT=y
# CONFIG_BT_RFCOMM=y is not set
# CONFIG_BT_RFCOMM_TTY=y is not set
# CONFIG_BT_BNEP=y is not set
# CONFIG_BT_BNEP_MC_FILTER=y is not set
# CONFIG_BT_BNEP_PROTO_FILTER=y is not set
CONFIG_BT_HIDP=y
CONFIG_HID_SUPPORT=y
CONFIG_HID=y
CONFIG_HIDRAW=y
# CONFIG_BT_HCISMD=y is not set
# CONFIG_BT_HCIUART=y is not set
# CONFIG_BT_HCIUART_H4=y is not set

# Special HID drivers
CONFIG_HID_A4TECH=y
CONFIG_HID_ACRUX=y
# CONFIG_HID_ACRUX_FF is not set
CONFIG_HID_APPLE=y
CONFIG_HID_BELKIN=y
CONFIG_HID_CHERRY=y
CONFIG_HID_CHICONY=y
CONFIG_HID_PRODIKEYS=y
CONFIG_HID_CYPRESS=y
CONFIG_HID_DRAGONRISE=y
CONFIG_HID_EMS_FF=y
CONFIG_HID_ELECOM=y
CONFIG_HID_EZKEY=y
CONFIG_HID_KEYTOUCH=y
CONFIG_HID_KYE=y
CONFIG_HID_UCLOGIC=y
CONFIG_HID_WALTOP=y
CONFIG_HID_GYRATION=y
CONFIG_HID_TWINHAN=y
CONFIG_HID_KENSINGTON=y
CONFIG_HID_LCPOWER=y
CONFIG_HID_LOGITECH=y
CONFIG_HID_MAGICMOUSE=y
CONFIG_HID_MICROSOFT=y
CONFIG_HID_MONTEREY=y
CONFIG_HID_MULTITOUCH=y
CONFIG_HID_NTRIG=y
CONFIG_HID_ORTEK=y
CONFIG_HID_PANTHERLORD=y
CONFIG_HID_PETALYNX=y
CONFIG_HID_PICOLCD=y
# CONFIG_HID_PICOLCD_FB is not set
# CONFIG_HID_PICOLCD_BACKLIGHT is not set
# CONFIG_HID_PICOLCD_LCD is not set
# CONFIG_HID_PICOLCD_LEDS is not set
CONFIG_HID_QUANTA=y
CONFIG_HID_ROCCAT=y
CONFIG_HID_ROCCAT_COMMON=y
CONFIG_HID_ROCCAT_ARVO=y
CONFIG_HID_ROCCAT_KONE=y
CONFIG_HID_ROCCAT_KONEPLUS=y
CONFIG_HID_ROCCAT_KOVAPLUS=y
CONFIG_HID_ROCCAT_PYRA=y
CONFIG_HID_SAMSUNG=y
CONFIG_HID_SYNAPTICS_BT=y
CONFIG_HID_SONY=y
CONFIG_HID_SUNPLUS=y
CONFIG_HID_GREENASIA=y
CONFIG_HID_SMARTJOYPLUS=y
CONFIG_HID_TOPSEED=y
CONFIG_HID_THRUSTMASTER=y
CONFIG_HID_WACOM=y
CONFIG_HID_WACOM_POWER_SUPPLY=y
CONFIG_HID_ZAGG=y
CONFIG_HID_ZEROPLUS=y
CONFIG_HID_ZYDACRON=y
# Ringback tone gain devide
CONFIG_SEC_DEVIDE_RINGTONE_GAIN=y
```

## arch/arm/configs/msm8916_sec_a7_chnopen_defconfig
```kconfig
CONFIG_SEC_A7_PROJECT=y
CONFIG_MACH_A7_CHN_OPEN=y
CONFIG_TOUCHSCREEN_FTS=y
CONFIG_KEYBOARD_ABOV_TOUCH=y

#VIBTONZ
CONFIG_VIBETONZ=y

#MMC
CONFIG_SEC_HYBRID_TRAY=y

# Charging/Battery
CONFIG_MFD_RT5033=y
CONFIG_REGULATOR_RT5033=y
CONFIG_CHARGER_RT5033=y
CONFIG_BATTERY_SAMSUNG=y
CONFIG_BATTERY_SAMSUNG_DATA_FILE="a7_battery_data.h"
CONFIG_SAMSUNG_LPM_MODE=y
CONFIG_FUELGAUGE_RT5033=y
```

## arch/arm/configs/msm8916_sec_e5_eur_defconfig
```kconfig
CONFIG_SEC_E5_PROJECT=y
CONFIG_MACH_E5_EUR_OPEN=y

# HARD RESET
CONFIG_RESTART_REASON_SEC_PARAM=y

# MUIC
CONFIG_SM5502_MUIC=y
CONFIG_SM5504_MUIC=y
CONFIG_MUIC_SUPPORT_RUSTPROOF_INBATT=y
CONFIG_USBID_STANDARD_VER_01=y
CONFIG_MUIC_SUPPORT_CHARGING_CABLE=y
CONFIG_MUIC_SUPPORT_DESKDOCK=y

#AUDIO
CONFIG_AUDIO_SPEAKER_OUT_NXP_AMP_ENABLE=y
CONFIG_AUDIO_QUAT_I2S_ENABLE=y
CONFIG_RADIO_LNA_CONTROL=y

# TSP
CONFIG_TOUCHSCREEN_MMS300=y
CONFIG_KEYBOARD_TC360_TKEY=y

#HALL IC
CONFIG_SENSORS_HALL=y

#LCD
CONFIG_PANEL_EA8061V_AMS497EE10_HD=y

#Vibrator
CONFIG_MSM_VIBRATOR=y

# BATTERY
CONFIG_MFD_RT5033=y
CONFIG_BATTERY_SAMSUNG=y
CONFIG_BATTERY_SAMSUNG_DATA_FILE="e5_battery_data.h"
CONFIG_SAMSUNG_LPM_MODE=y
CONFIG_CHARGER_RT5033=y
CONFIG_FUELGAUGE_RT5033=y
CONFIG_REGULATOR_RT5033=y
CONFIG_MFD_RT5033_RESET_WA=y
CONFIG_MFD_RT5033_SLDO_VBUSDET=y
CONFIG_BATTERY_SWELLING=y

#SENSOR
CONFIG_SENSORS=y
CONFIG_SENSORS_CORE=y
CONFIG_SENSORS_K2HH=y
CONFIG_SENSORS_CM36672P=y
CONFIG_SENSORS_LEDA_EN_GPIO=y

#NFC
CONFIG_NFC=y
CONFIG_SEC_NFC=y
CONFIG_SEC_NFC_IF_I2C=y
CONFIG_SEC_NFC_PRODUCT_N5=y
CONFIG_SEC_NFC_USE_8916_BBCLK2=y

#optimize mmc block delay on resume
CONFIG_MMC_BLOCK_DEFERRED_RESUME=y
#MMC
CONFIG_SEC_HYBRID_TRAY=y

#FLASH
CONFIG_FLASHLIGHT=y
CONFIG_RT_FLASH_LED=y
CONFIG_FLED_RT5033=y
CONFIG_FLED_RT5033_EXT_GPIO=y

# DUAL SIM / SINGLE SIM Detection
CONFIG_CHECK_SIMSLOT_COUNT=y
# CONFIG_CHECK_SIMSLOT_COUNT_GPIO is not set
CONFIG_CHECK_SIMSLOT_COUNT_DT=y

#CAMERA
# CONFIG_MSM_OTP is not set
CONFIG_S5K4H5YB=y
CONFIG_S5K5E3YX=y

# SSWAP
CONFIG_SWAP=y
CONFIG_FRONTSWAP=y
CONFIG_ZSMALLOC=y
CONFIG_PGTABLE_MAPPING=y
CONFIG_ZSWAP=y
CONFIG_ZPOOL=y
CONFIG_DIRECT_RECLAIM_FILE_PAGES_ONLY=y
CONFIG_INCREASE_MAXIMUM_SWAPPINESS=y
CONFIG_FIX_INACTIVE_RATIO=y
CONFIG_TIGHT_PGDAT_BALANCE=y
CONFIG_VNSWAP=y
CONFIG_SWAP_ENABLE_READAHEAD=n
```

## arch/arm/configs/msm8916_sec_e5_tfn_defconfig
```kconfig
CONFIG_SEC_E5_PROJECT=y
CONFIG_MACH_E5_USA_TFN=y

# HARD RESET
CONFIG_RESTART_REASON_SEC_PARAM=y

# MUIC
CONFIG_SM5502_MUIC=y
CONFIG_SM5504_MUIC=y
CONFIG_USBID_STANDARD_VER_01=y

#AUDIO
CONFIG_AUDIO_SPEAKER_OUT_NXP_AMP_ENABLE=y
CONFIG_AUDIO_QUAT_I2S_ENABLE=y
#CONFIG_RADIO_LNA_CONTROL is not set

# TSP
CONFIG_TOUCHSCREEN_MMS300=y
CONFIG_KEYBOARD_TC360_TKEY=y
CONFIG_INPUT_BOOSTER=y

#LCD
CONFIG_PANEL_EA8061V_AMS497EE10_HD=y

#Vibrator
CONFIG_MSM_VIBRATOR=y

# BATTERY
CONFIG_MFD_RT5033=y
CONFIG_BATTERY_SAMSUNG=y
CONFIG_BATTERY_SAMSUNG_DATA_FILE="e5_battery_data.h"
CONFIG_SAMSUNG_LPM_MODE=y
CONFIG_CHARGER_RT5033=y
CONFIG_FUELGAUGE_RT5033=y
CONFIG_REGULATOR_RT5033=y
CONFIG_MFD_RT5033_RESET_WA=y
CONFIG_MFD_RT5033_SLDO_VBUSDET=y
CONFIG_BATTERY_SWELLING=n

#SENSOR
CONFIG_SENSORS=y
CONFIG_SENSORS_CORE=y
CONFIG_SENSORS_K2HH=y
CONFIG_SENSORS_CM36672P=y
CONFIG_SENSORS_LEDA_EN_GPIO=y

#HALL IC
CONFIG_SENSORS_HALL=y

#NFC
CONFIG_SEC_NFC=y
CONFIG_SEC_NFC_IF_I2C=y
CONFIG_SEC_NFC_PRODUCT_N5=y
CONFIG_SEC_NFC_USE_8916_BBCLK2=y

#MMC
CONFIG_SEC_HYBRID_TRAY=y

#FLASH
CONFIG_FLASHLIGHT=y
CONFIG_RT_FLASH_LED=y
CONFIG_FLED_RT5033=y
CONFIG_FLED_RT5033_EXT_GPIO=y

#CAMERA
# CONFIG_MSM_OTP is not set
CONFIG_S5K4H5YB=y
CONFIG_S5K5E3YX=y
```

## arch/arm/configs/msm8916_sec_e73g_sea_defconfig
```kconfig
CONFIG_SEC_E7_PROJECT=y
CONFIG_MACH_E73G_SEA_OPEN=y

# HARD RESET
CONFIG_RESTART_REASON_SEC_PARAM=y

# MUIC
CONFIG_SM5502_MUIC=y
CONFIG_USBID_STANDARD_VER_01=y

#LCD
CONFIG_PANEL_EA8061_HD=y

#Touch Key
CONFIG_KEYBOARD_TC360_TKEY=y

#Touch Screen
CONFIG_TOUCHSCREEN_FTS=y
#Vibrator
CONFIG_MSM_VIBRATOR=y

#AUDIO
CONFIG_RADIO_IRIS=y
CONFIG_RADIO_IRIS_TRANSPORT=m
CONFIG_AUDIO_SPEAKER_OUT_NXP_AMP_ENABLE=y
CONFIG_AUDIO_QUAT_I2S_ENABLE=y

#BATTERY
CONFIG_MFD_RT5033=y
CONFIG_BATTERY_SAMSUNG=y
CONFIG_BATTERY_SAMSUNG_DATA_FILE="e7_battery_data.h"
CONFIG_SAMSUNG_LPM_MODE=y
CONFIG_CHARGER_RT5033=y
CONFIG_FUELGAUGE_RT5033=y
CONFIG_REGULATOR_RT5033=y
CONFIG_MFD_RT5033_RESET_WA=y
CONFIG_MFD_RT5033_SLDO_VBUSDET=n
#CONFIG_BATTERY_SWELLING is not set

#FLASH
CONFIG_FLASHLIGHT=y
CONFIG_RT_FLASH_LED=y
CONFIG_FLED_RT5033=y
CONFIG_FLED_RT5033_EXT_GPIO=y

#CAMERA
CONFIG_MSM_OTP=y

#SENSOR
CONFIG_SENSORS=y
CONFIG_SENSORS_CORE=y
CONFIG_SENSORS_K2HH=y
CONFIG_SENSORS_CM36672P=y
CONFIG_SENSORS_LEDA_EN_GPIO=y

# DUAL SIM / SINGLE SIM Detection
CONFIG_CHECK_SIMSLOT_COUNT=y
# CONFIG_CHECK_SIMSLOT_COUNT_GPIO is not set
CONFIG_CHECK_SIMSLOT_COUNT_DT=y
```

## arch/arm/configs/msm8916_sec_e7_ctc_defconfig
```kconfig
CONFIG_SEC_E7_PROJECT=y
CONFIG_MACH_E7_CHN_CTC=y

# HARD RESET
CONFIG_RESTART_REASON_SEC_PARAM=y

# MUIC
CONFIG_SM5502_MUIC=y
CONFIG_USBID_STANDARD_VER_01=y

#AUDIO
CONFIG_AUDIO_SPEAKER_OUT_NXP_AMP_ENABLE=y
CONFIG_AUDIO_QUAT_I2S_ENABLE=y
CONFIG_RADIO_LNA_CONTROL=y

#LCD
CONFIG_PANEL_EA8061_HD=y

#Touch Key
CONFIG_KEYBOARD_TC360_TKEY=y

#Touch Screen
CONFIG_TOUCHSCREEN_FTS=y
#Vibrator
CONFIG_MSM_VIBRATOR=y

#HALL IC
CONFIG_SENSORS_HALL=y

#AUDIO
CONFIG_RADIO_IRIS=y
CONFIG_RADIO_IRIS_TRANSPORT=m
CONFIG_AUDIO_SPEAKER_OUT_NXP_AMP_ENABLE=y

#BATTERY
CONFIG_MFD_RT5033=y
CONFIG_BATTERY_SAMSUNG=y
CONFIG_BATTERY_SAMSUNG_DATA_FILE="e7_battery_data.h"
CONFIG_SAMSUNG_LPM_MODE=y
CONFIG_CHARGER_RT5033=y
CONFIG_FUELGAUGE_RT5033=y
CONFIG_REGULATOR_RT5033=y
CONFIG_MFD_RT5033_RESET_WA=y
CONFIG_MFD_RT5033_SLDO_VBUSDET=n
CONFIG_BATTERY_SWELLING=y

#CAMERA
#CONFIG_MSM_OTP is not set
CONFIG_S5K3L2XX=y
CONFIG_S5K5E3YX=y

#NFC
CONFIG_NFC_PN547=y
CONFIG_NFC_PN547_8916_USE_BBCLK2=y

#SENSOR
CONFIG_SENSORS=y
CONFIG_SENSORS_CORE=y
CONFIG_SENSORS_K2HH=y
CONFIG_SENSORS_CM36672P=y
CONFIG_SENSORS_LEDA_EN_GPIO=y

#MMC
CONFIG_SEC_HYBRID_TRAY=y
```

## arch/arm/configs/msm8916_sec_e7_eur_defconfig
```kconfig
CONFIG_SEC_E7_PROJECT=y
CONFIG_MACH_E7_EUR_OPEN=y

# MUIC
CONFIG_SM5502_MUIC=y
CONFIG_SM5504_MUIC=y
CONFIG_MUIC_SUPPORT_RUSTPROOF_INBATT=y
CONFIG_USBID_STANDARD_VER_01=y
CONFIG_MUIC_SUPPORT_CHARGING_CABLE=y

# IFPMIC
CONFIG_MFD_RT5033_RESET_WA=y

#LCD
CONFIG_PANEL_EA8061_HD=y

#Touch Key
CONFIG_KEYBOARD_TC360_TKEY_E=y
CONFIG_INPUT_BOOSTER=y

#Touch Screen
CONFIG_TOUCHSCREEN_FTS=y
#Vibrator
CONFIG_MSM_VIBRATOR=y

#HALL IC
CONFIG_SENSORS_HALL=y

#AUDIO
CONFIG_RADIO_IRIS=y
CONFIG_RADIO_IRIS_TRANSPORT=m
CONFIG_AUDIO_SPEAKER_OUT_NXP_AMP_ENABLE=y
CONFIG_AUDIO_QUAT_I2S_ENABLE=y
CONFIG_RADIO_LNA_CONTROL=y
CONFIG_RADIO_LNA_CONTROL_WITH_EX_POWER=y

#BATTERY
CONFIG_MFD_RT5033=y
CONFIG_BATTERY_SAMSUNG=y
CONFIG_BATTERY_SAMSUNG_DATA_FILE="e7_battery_data.h"
CONFIG_SAMSUNG_LPM_MODE=y
CONFIG_CHARGER_RT5033=y
CONFIG_FUELGAUGE_RT5033=y
CONFIG_REGULATOR_RT5033=y
CONFIG_BATTERY_SWELLING=y

#NFC
CONFIG_SEC_NFC=y
CONFIG_SEC_NFC_IF_I2C=y
CONFIG_SEC_NFC_PRODUCT_N5=y
CONFIG_SEC_NFC_USE_8916_BBCLK2=y

#FLASH
CONFIG_FLASHLIGHT=y
CONFIG_RT_FLASH_LED=y
CONFIG_FLED_RT5033=y
CONFIG_FLED_RT5033_EXT_GPIO=y

#CAMERA
#CONFIG_MSM_OTP is not set
#CONFIG_SPI_QUP is not set

#SENSOR
CONFIG_SENSORS=y
CONFIG_SENSORS_CORE=y
CONFIG_SENSORS_K2HH=y
CONFIG_SENSORS_CM36672P=y
CONFIG_SENSORS_LEDA_EN_GPIO=y

CONFIG_CRYPTO_GCM=y
CONFIG_XFRM_USER=y
CONFIG_NET_KEY=y
CONFIG_INET=y
CONFIG_IP_ADVANCED_ROUTER=y
CONFIG_IP_MULTIPLE_TABLES=y
CONFIG_INET_AH=y
CONFIG_INET_ESP=y
CONFIG_INET_IPCOMP=y
CONFIG_INET_XFRM_MODE_TRANSPORT=y
CONFIG_INET_XFRM_MODE_TUNNEL=y
CONFIG_INET_XFRM_MODE_BEET=y
CONFIG_IPV6=y
CONFIG_INET6_AH=y
CONFIG_INET6_ESP=y
CONFIG_INET6_IPCOMP=y
CONFIG_INET6_XFRM_MODE_TRANSPORT=y
CONFIG_INET6_XFRM_MODE_TUNNEL=y
CONFIG_INET6_XFRM_MODE_BEET=y 
CONFIG_IPV6_MULTIPLE_TABLES=y
CONFIG_NETFILTER=y
CONFIG_NETFILTER_XTABLES=y
CONFIG_NETFILTER_XT_MATCH_POLICY=y

#MMC
CONFIG_SEC_HYBRID_TRAY=y

# DUAL SIM / SINGLE SIM Detection
CONFIG_CHECK_SIMSLOT_COUNT=y
# CONFIG_CHECK_SIMSLOT_COUNT_GPIO is not set
CONFIG_CHECK_SIMSLOT_COUNT_DT=y
```
