## arch/arm/configs/msm8974pro_sec_pateklte_ctc_defconfig
```kconfig
# K PROJECT config
CONFIG_ARCH_MSM8974PRO=y
CONFIG_SEC_PATEK_PROJECT=y
CONFIG_SEC_LOCALE_CHN=y
CONFIG_MACH_PATEKLTE_CTC=y
CONFIG_MACH_PATEKLTE_CHN=y
CONFIG_MSM_ADSPRPC=y
#
# Wifi features
#
#
# Remove Qualcomm Wifi features
#
# CONFIG_WCNSS_CORE is not set
# CONFIG_WCNSS_CORE_PRONTO is not set
# CONFIG_WCNSS_MEM_PRE_ALLOC is not set

#
# Add Broadcomm Wifi features
#
CONFIG_NET_CORE=y
CONFIG_WIRELESS=y
CONFIG_WIRELESS_EXT_SYSFS=y
CONFIG_WEXT_CORE=y
CONFIG_WEXT_PROC=y
CONFIG_CFG80211=y
CONFIG_CFG80211_DEFAULT_PS=y
CONFIG_CFG80211_ALLOW_RECONNECT=y
CONFIG_WLAN=y
CONFIG_WIFI_CONTROL_FUNC=y
CONFIG_BCM4339=y
CONFIG_BCMDHD_FW_PATH="/system/etc/wifi/bcmdhd_sta.bin"
CONFIG_BCMDHD_NVRAM_PATH="/system/etc/wifi/nvram_net.txt"
CONFIG_BROADCOM_WIFI_RESERVED_MEM=y
#CONFIG_WLAN_REGION_CODE=100
CONFIG_MMC_MSM_SDC2_SUPPORT=y
CONFIG_CFG80211_REG_NOT_UPDATED=y
CONFIG_PPP_FILTER=y
CONFIG_PPP_ASYNC=y
CONFIG_PPP_SYNC_TTY=y

# CONFIG_MSM_PIL_PRONTO is not set
#
# LCD
#
CONFIG_LCD_CLASS_DEVICE=y
CONFIG_BACKLIGHT_LCD_SUPPORT=y
CONFIG_BACKLIGHT_CLASS_DEVICE=y
CONFIG_MDNIE_LITE_TUNING=y
CONFIG_FB_MSM_MIPI_MAGNA_OCTA_VIDEO_WXGA_PT_DUAL_PANEL=y
CONFIG_FB_MSM_MDSS_DBG_SEQ_TICK=y
CONFIG_FB_MSM_MDSS_DSI_DBG=y
CONFIG_DUAL_LCD=y
CONFIG_GET_LCD_ATTACHED=y
# pcd detection in patek project means sub pba was detached.
CONFIG_GET_LCD_PCD_DETECTED=y
CONFIG_ESD_ERR_FG_RECOVERY=y

#
# Camera
#
CONFIG_S5K2P2XX=y
CONFIG_COMPANION=y
CONFIG_S5K8B1YX=y
#
# Input
#
CONFIG_KEYBOARD_ABOV_TOUCH_PATEK=y
CONFIG_TOUCHSCREEN_SYNAPTICS_I2C_RMI_PATEK=y
CONFIG_KEYBOARD_MATRIX=y
#
# Earjack
#
#CONFIG_SAMSUNG_JACK=y
CONFIG_INPUT_GPIO=y
CONFIG_MUIC_DET_JACK=y
CONFIG_LDO_EARMIC_BIAS=y
# Audience
#CONFIG_SND_SOC_ES705=y
#CONFIG_SND_SOC_ES705_SLIM=y
#CONFIG_FW_LOADER=y
#CONFIG_FIRMWARE_IN_KERNEL=y
#CONFIG_EXTRA_FIRMWARE_DIR="firmware"
#
# DHA Solution
#
CONFIG_SEC_DHA_SOL_MAL=y
#
# DUAL CP Flag
CONFIG_AUDIO_DUAL_CP=y
#
# usb
#
CONFIG_USB_DUN_SUPPORT=y
# CONFIG_USB_EHCI_HCD is not set
# CONFIG_USB_EHCI_EHSET is not set
# CONFIG_USB_EHCI_MSM is not set
# CONFIG_USB_EHCI_MSM_HSIC is not set
CONFIG_USB_DWC3=y
CONFIG_MHL_VERSION=0x21

CONFIG_USB_STORAGE_DETECT=y
CONFIG_USB_HOST_NOTIFY=y
CONFIG_MHL_VERSION=0x21

#
# Enable SEC_PM Feature
#
CONFIG_SEC_PM=y
CONFIG_SEC_PM_DEBUG=y
CONFIG_REGULATOR_MAX77804K=y
#
# Finger print sensor
#
CONFIG_SENSORS_FINGERPRINT=y
CONFIG_SENSORS_FINGERPRINT_SYSFS=y
CONFIG_SENSORS_VFS61XX=y
CONFIG_SENSORS_VFS61XX_KO=y
# CONFIG_SENSORS_ADSP is not set
#
# Sensor hub
#
CONFIG_AVERAGE=y
CONFIG_SENSORS_SSP=y
CONFIG_SENSORS_SYSFS=y
CONFIG_SENSORS_SSP_FACTORY=y
CONFIG_SENSORS_SSP_MPU6500=y
CONFIG_SENSORS_SSP_AK09911=y
CONFIG_SENSORS_SSP_BMP182=y
CONFIG_SENSORS_SSP_ATUC128L5HAR=y
CONFIG_SENSORS_SSP_SENSORHUB=y
CONFIG_SENSORS_SSP_STM=y
# CONFIG_SENSORS_SSP_SHTC1 is not set
CONFIG_SENSORS_SSP_MOBEAM=y
# CONFIG_SENSORS_SSP_TMG399X is not set
CONFIG_SENSORS_SSP_MAX88921=y
#CONFIG_SENSORS_MAX86900 is not set
CONFIG_SENSORS_ADPD142=y
CONFIG_IIO_BUFFER=y
CONFIG_IIO=y
CONFIG_IIO_KFIFO_BUF=y
CONFIG_IIO_TRIGGER=y
CONFIG_IIO_ST_HWMON=y
#
# NFC
#
CONFIG_NFC_PN547=y
CONFIG_NFC_PN547_PMC8974_CLK_REQ=y
#
# Battery & Charger
#
CONFIG_BATTERY_SAMSUNG=y
CONFIG_BATTERY_SAMSUNG_DATA_FILE="patek_battery_data.h"
CONFIG_SAMSUNG_LPM_MODE=y
# CONFIG_SMB350_CHARGER is not set
# CONFIG_BATTERY_BQ28400 is not set
# CONFIG_BATTERY_MSM is not set
# CONFIG_FUELGAUGE_DUMMY is not set
#
# MAX77804K Charger
#
# CONFIG_QPNP_CHARGER is not set
# CONFIG_QPNP_BMS is not set
CONFIG_FUELGAUGE_MAX17048=y
CONFIG_CHARGER_MAX77804K=y
#
# Misc module
#
# CONFIG_KS8851 is not set
# CONFIG_SEC_FPGA_ICE40XX is not set
# CONFIG_IR_REMOCON_FPGA is not set
CONFIG_SENSORS_HALL=y
CONFIG_SENSORS_HALL_IRQ_CTRL=y
CONFIG_REGULATOR_MAX77826=y
CONFIG_MFD_MAX77804K=y
CONFIG_MAX77804K_MUIC=y
CONFIG_MUIC_MAX77804K_SUPPORT_MHL_CABLE_DETECTION=y
# CONFIG_LEDS_AN30259A is not set
# CONFIG_MOTOR_DRV_MAX77804K is not set
# CONFIG_VIBETONZ is not set
# CONFIG_TACTILE_ASSIST is not set
# CONFIG_GPIO_PCAL6416A is not set
CONFIG_LEDS_MAX77804K=y
CONFIG_MAX77826_VIBRATOR=y
#
# etc
#
# CONFIG_HID is not set
#
# BT
#
CONFIG_BT_BCM4339=y
#
# SAPA
#
CONFIG_RTC_AUTO_PWRON=y
CONFIG_RTC_AUTO_PWRON_PARAM=y

## CHINA
#configs for Wi-Fi
CONFIG_TARGET_LOCALE_CHN=y
#CONFIG_WLAN_REGION_CODE=300

#
# extcon
#
CONFIG_EXTCON=y
CONFIG_EXTCON_MAX77804K=y
CONFIG_MUIC_DET_JACK=y

# SSWAP
CONFIG_SWAP=y
CONFIG_FRONTSWAP=y
CONFIG_ZSMALLOC_NEW=y
CONFIG_PGTABLE_MAPPING=y
CONFIG_ZSWAP=y
CONFIG_DIRECT_RECLAIM_FILE_PAGES_ONLY=n
CONFIG_INCREASE_MAXIMUM_SWAPPINESS=y
CONFIG_FIX_INACTIVE_RATIO=y
CONFIG_TIGHT_PGDAT_BALANCE=y
CONFIG_VNSWAP=y
CONFIG_SWAP_ENABLE_READAHEAD=n


#
# RCU
#
CONFIG_RCU_FAST_NO_HZ=y
```

## arch/arm/configs/pxa986_lt023g_defconfig
```kconfig
# CONFIG_WIFIONLY_BOARD is not set
CONFIG_VIBRATOR_ANDROID=y
CONFIG_ANDROID_TIMED_GPIO=y
# CONFIG_SEC_IRLED is not set
CONFIG_SENSORS_ASP01=y
```

## arch/arm/configs/sdm450_sec_userdebug_defconfig
```kconfig
CONFIG_CGROUP_DEBUG=y
CONFIG_OPROFILE=m
CONFIG_KPROBES=y
CONFIG_BRIDGE_NETFILTER=y
CONFIG_NF_CONNTRACK_SIP=y
CONFIG_NL80211_TESTMODE=y
CONFIG_CMA_SIZE_MBYTES=40
CONFIG_KS8851=y
CONFIG_DEBUG_GPIO=y
CONFIG_MSMB_CAMERA_DEBUG=y
CONFIG_HID_MAGICMOUSE=y
CONFIG_MMC_EMBEDDED_SDIO=y
CONFIG_LEDS_TRIGGER_BACKLIGHT=y
CONFIG_LEDS_TRIGGER_DEFAULT_ON=y
CONFIG_MSM_GLADIATOR_ERP=y
CONFIG_PANIC_ON_GLADIATOR_ERROR=y
CONFIG_MSM_CORE_HANG_DETECT=y
CONFIG_MSM_DCC=y
CONFIG_MSM_IPC_ROUTER_GLINK_XPRT=y
CONFIG_MSM_GLINK_PKT=y
CONFIG_CORESIGHT_TPDA=y
CONFIG_CORESIGHT_TPDM=y
CONFIG_CORESIGHT_DBGUI=y
CONFIG_CORESIGHT_ETMV4=y
CONFIG_CORESIGHT_REMOTE_ETM=y
CONFIG_CORESIGHT_QPDI=y
CONFIG_LOG_BUF_MAGIC=y
CONFIG_DYNAMIC_DEBUG=y
CONFIG_PAGE_OWNER=y
CONFIG_DEBUG_PAGEALLOC=y
CONFIG_SLUB_DEBUG_PANIC_ON=y
CONFIG_DEBUG_KMEMLEAK=y
CONFIG_DEBUG_KMEMLEAK_EARLY_LOG_SIZE=4000
CONFIG_DEBUG_KMEMLEAK_DEFAULT_OFF=y
CONFIG_DEBUG_STACK_USAGE=y
CONFIG_DEBUG_VM=y
CONFIG_DEBUG_MEMORY_INIT=y
CONFIG_LOCKUP_DETECTOR=y
CONFIG_BOOTPARAM_SOFTLOCKUP_PANIC=y
CONFIG_PANIC_ON_SCHED_BUG=y
CONFIG_PANIC_ON_RT_THROTTLING=y
CONFIG_DEBUG_HIGHMEM=y
CONFIG_DEBUG_SPINLOCK=y
CONFIG_DEBUG_SPINLOCK_PANIC_ON_BUG=y
CONFIG_DEBUG_LOCK_ALLOC=y
CONFIG_DEBUG_MUTEXES=y
CONFIG_DEBUG_ATOMIC_SLEEP=y
CONFIG_DEBUG_LIST=y
CONFIG_FAULT_INJECTION=y
CONFIG_FAIL_PAGE_ALLOC=y
CONFIG_UFS_FAULT_INJECTION=y
CONFIG_FAULT_INJECTION_DEBUG_FS=y
CONFIG_FAULT_INJECTION_STACKTRACE_FILTER=y
CONFIG_BLK_DEV_IO_TRACE=y
CONFIG_LKDTM=y
CONFIG_PANIC_ON_DATA_CORRUPTION=y
CONFIG_FIPS_ENABLE=y



# DS5 Streamline v22

CONFIG_HW_PERF_EVENTS=y
CONFIG_PERF_EVENTS=y
CONFIG_FTRACE=y
CONFIG_HIGH_RES_TIMERS=y
CONFIG_LOCAL_TIMERS=y
CONFIG_GATOR=m

# Kernel Atrace
CONFIG_KERNEL_ATRACE=y

CONFIG_SEC_GPIO_DVS=y

CONFIG_USER_RESET_DEBUG_TEST=y
CONFIG_SEC_DEBUG_FORCE_ERROR=y

CONFIG_KNOX_TEST=y
```

## arch/arm/mach-exynos/Kconfig.local
```kconfig
choice
	prompt "Support Target Locale"
	default TARGET_LOCALE_EUR

config TARGET_LOCALE_EUR
	bool "Locale Europe Open support"
	help
	  Enable universal5260 LOCAL EUR.
	  is used to distinguish LOCALE-related difference.

config TARGET_LOCALE_USA
	bool "Locale USA support"
	help
	  Enable universal5260 LOCALE USA.
	  is used to distinguish LOCALE-related difference.

config TARGET_LOCALE_CHN
	bool "Locale China Support"
	help
	  Enable universal5260 LOCAL CHN.
	  is used to distinguish LOCALE-related difference.

config TARGET_LOCALE_KOR
	bool "Locale Korea Support"
	help
	  Enable universal5260 LOCAL KOR.
	  is used to distinguish LOCALE-related difference.
	  
endchoice


comment "Target Carrier"
#choice
#	prompt "Support Target Carrier"
#	depends on MACH_UNIVERSAL5260

config MACH_M2ALTE_USA_ATT
	bool "USA ATT Operator"
	help
	  Enable Carrier Operator USA_ATT.

	  
config MACH_MEGA2ELTE_USA_ATT
	bool "USA ATT Operator"
	help
	  Enable Carrier Operator MEGA2ELTE_USA_ATT.

	  
config MACH_M2ALTE_CHN_CMCC
	bool "CHN CMCC Operator"
	help
	  Enable Carrier Operator CHN_CMCC.

config MACH_M2ALTE_KOR_SKT
	bool "KOR_SKT Operator"
	help
	  Enable Carrier Operator KOR_SKT.

config MACH_M2ALTE_KOR_KTT
	bool "KOR_KTT Operator"
	help
	  Enable Carrier Operator KOR_KTT.

config MACH_M2ALTE_KOR_LGT
	bool "KOR_LGT Operator"
	help
	  Enable Carrier Operator KOR_LGT.

#endchoice
```
