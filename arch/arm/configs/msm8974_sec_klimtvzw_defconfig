## arch/arm/configs/msm8974_sec_mondrianwifi_eur_defconfig
```kconfig
# from msm8974_sec_defconfig
CONFIG_AUDIT=y

# MAXIM 77888
CONFIG_MFD_MAX77888=y
CONFIG_CHARGER_MAX77888=y
CONFIG_REGULATOR_MAX77888=y
CONFIG_MUIC_MAX77888_SUPPORT_SMART_DOCK=y

# HALL SENSOR
CONFIG_SENSORS_HALL=y

# CONFIG_MSM_PIL_PRONTO is not set
CONFIG_NET_KEY=y
CONFIG_IP_MULTICAST=y
CONFIG_INET_XFRM_MODE_TRANSPORT=y
CONFIG_INET_XFRM_MODE_TUNNEL=y
CONFIG_NF_CONNTRACK_SECMARK=y
# CONFIG_NF_CONNTRACK_SIP is not set
CONFIG_NETFILTER_XT_TARGET_CONNSECMARK=y
CONFIG_NETFILTER_XT_TARGET_NOTRACK=y
CONFIG_NETFILTER_XT_TARGET_SECMARK=y
CONFIG_NETFILTER_XT_TARGET_TCPMSS=y
CONFIG_IP_NF_SECURITY=y
CONFIG_UHID=y
CONFIG_HID=y
CONFIG_HIDRAW=y
#CONFIG_BT_HCISMD=y
# CONFIG_BT_HCISMD is not set
# CONFIG_MSM_BT_POWER is not set
CONFIG_PPP=y
CONFIG_PPP_BSDCOMP=y
CONFIG_PPP_DEFLATE=y
CONFIG_PPP_MPPE=y
CONFIG_PPPOLAC=y
CONFIG_PPPOPNS=y
# CONFIG_WCNSS_CORE is not set
# CONFIG_WCNSS_CORE_PRONTO is not set
# CONFIG_WCNSS_MEM_PRE_ALLOC is not set
CONFIG_SENSORS_QPNP_ADC_CURRENT=y
CONFIG_IMX132=y
CONFIG_MSM_WFD=y
# CONFIG_FB_MSM_MDSS_HDMI_MHL_SII8334 is not set
CONFIG_FB_MSM_MDSS_DBG_SEQ_TICK=y
CONFIG_FB_MSM_MDSS_DSI_DBG=y
CONFIG_SND_SOC_MSM_HDMI_CODEC_RX=y
# CONFIG_HID_PID is not set
# CONFIG_USB_HIDDEV is not set
CONFIG_HID_A4TECH=y
CONFIG_HID_ACRUX=y
# CONFIG_HID_ACRUX_FF is not set
CONFIG_HID_BELKIN=y
CONFIG_HID_CHERRY=y
CONFIG_HID_CHICONY=y
CONFIG_HID_PRODIKEYS=y
CONFIG_HID_CYPRESS=y
CONFIG_HID_DRAGONRISE=y
CONFIG_HID_EMS_FF=y
CONFIG_HID_ELECOM=y
CONFIG_HID_EZKEY=y
CONFIG_HID_KEYTOUCH=y
CONFIG_HID_KYE=y
CONFIG_HID_UCLOGIC=y
CONFIG_HID_WALTOP=y
CONFIG_HID_GYRATION=y
CONFIG_HID_TWINHAN=y
CONFIG_HID_KENSINGTON=y
CONFIG_HID_LCPOWER=y
CONFIG_HID_LOGITECH=y
CONFIG_HID_MONTEREY=y
CONFIG_HID_MULTITOUCH=y
CONFIG_HID_NTRIG=y
CONFIG_HID_ORTEK=y
CONFIG_HID_PANTHERLORD=y
CONFIG_HID_PETALYNX=y
CONFIG_HID_PICOLCD=y
# CONFIG_HID_PICOLCD_FB is not set
# CONFIG_HID_PICOLCD_BACKLIGHT is not set
# CONFIG_HID_PICOLCD_LCD is not set
# CONFIG_HID_PICOLCD_LEDS is not set
CONFIG_HID_QUANTA=y
CONFIG_HID_ROCCAT=y
CONFIG_HID_ROCCAT_COMMON=y
CONFIG_HID_ROCCAT_ARVO=y
CONFIG_HID_ROCCAT_KONE=y
CONFIG_HID_ROCCAT_KONEPLUS=y
CONFIG_HID_ROCCAT_KOVAPLUS=y
CONFIG_HID_ROCCAT_PYRA=y
CONFIG_HID_SAMSUNG=y
CONFIG_HID_SONY=y
CONFIG_HID_SUNPLUS=y
CONFIG_HID_GREENASIA=y
CONFIG_HID_SMARTJOYPLUS=y
CONFIG_HID_TOPSEED=y
CONFIG_HID_THRUSTMASTER=y
CONFIG_HID_WACOM=y
CONFIG_HID_WACOM_POWER_SUPPLY=y
CONFIG_HID_ZEROPLUS=y
CONFIG_HID_ZYDACRON=y

CONFIG_EXT4_FS_SECURITY=y
CONFIG_ENABLE_DEFAULT_TRACERS=y
CONFIG_SECURITY=y
CONFIG_SECURITY_NETWORK=y
CONFIG_LSM_MMAP_MIN_ADDR=4096
CONFIG_SECURITY_SELINUX=y
#############################################################
################     End of Common 8974 config    ####################
#############################################################

#mondrian wifi config
CONFIG_MACH_MONDRIAN=y
CONFIG_MACH_MONDRIAN_WIFI=y
CONFIG_MACH_MONDRIANWIFI_EUR=y

CONFIG_BATTERY_SAMSUNG=y
CONFIG_SAMSUNG_LPM_MODE=y
CONFIG_FUELGAUGE_MAX17050=y
CONFIG_FUELGAUGE_MAX17050_COULOMB_COUNTING=y

# Earjack
CONFIG_SAMSUNG_JACK=y
CONFIG_INPUT_GPIO=y

# DHA Solution
CONFIG_SEC_DHA_SOL_MAL=y

#
# Enable Qualcomm Wifi features
#
CONFIG_MSM_PIL_PRONTO=y
CONFIG_WCNSS_CORE=y
CONFIG_WCNSS_CORE_PRONTO=y
CONFIG_WCNSS_MEM_PRE_ALLOC=y

#VIBRATOR
CONFIG_MSM_VIBRATOR=y

#LED
CONFIG_LEDS_QPNP=y

# Display
CONFIG_CABC_TUNING=y
CONFIG_FB_MSM_MIPI_SAMSUNG_TFT_VIDEO_WQXGA_PT_PANEL=y

#
# Wifi features (Qualcomm)
#
CONFIG_NET_CORE=y
CONFIG_WIRELESS=y
CONFIG_WIRELESS_EXT_SYSFS=y
CONFIG_WEXT_CORE=y
CONFIG_WEXT_PROC=y
CONFIG_CFG80211=y
CONFIG_CFG80211_WEXT=y
CONFIG_CFG80211_DEFAULT_PS=y
# CONFIG_CFG80211_ALLOW_RECONNECT is not set
CONFIG_WLAN=y
CONFIG_WIRELESS_EXT=y
CONFIG_WEXT_PRIV=y

CONFIG_MODULES=y
CONFIG_MODULE_UNLOAD=y
CONFIG_MODULE_FORCE_UNLOAD=y
CONFIG_WCNSS_REGISTER_DUMP_ON_BITE =y

#
# Wifi features (Broadcomm)
# CONFIG_BCM4339 is not set
# CONFIG_BCMDHD_FW_PATH is not set
# CONFIG_BCMDHD_NVRAM_PATH is not set
# CONFIG_BROADCOM_WIFI_RESERVED_MEM is not set
# CONFIG_WLAN_REGION_CODE is not set
# CONFIG_MMC_MSM_SDC2_SUPPORT is not set
# CONFIG_H_EUR_WIFI is not set

# Input Devices
CONFIG_TOUCHSCREEN_SYNAPTICS_I2C_RMI=y

#SENSOR
CONFIG_STAGING=y
CONFIG_IIO=y
CONFIG_IIO_BUFFER=y
CONFIG_IIO_SW_RING=y
CONFIG_IIO_KFIFO_BUF=y
CONFIG_INV_MPU_IIO=y
# CONFIG_INV_TESTING is not set
CONFIG_SENSORS=y
CONFIG_SENSORS_GP2A030A=y

CONFIG_SEC_FPGA=y
CONFIG_IR_REMOCON_FPGA=y

CONFIG_MHL_VERSION=0x21

#USB
CONFIG_USB_STORAGE_DETECT=y
CONFIG_USB_HOST_NOTIFY=y
CONFIG_USB_DEBUG_DETEAILED_LOG=y

#ethernet driver
CONFIG_USB_NET_SMSC75XX=y
CONFIG_USB_NET_SMSC95XX=y

CONFIG_MSM_DMA_TEST=y
CONFIG_MEDIA_TUNER_SIMPLE=y
CONFIG_MEDIA_TUNER_TDA8290=y
CONFIG_MEDIA_TUNER_TDA827X=y
CONFIG_MEDIA_TUNER_TDA18271=y
CONFIG_MEDIA_TUNER_TDA9887=y
CONFIG_MEDIA_TUNER_TEA5761=y
CONFIG_MEDIA_TUNER_TEA5767=y
CONFIG_MEDIA_TUNER_MT20XX=y
CONFIG_MEDIA_TUNER_MT2060=y
CONFIG_MEDIA_TUNER_MT2063=y
CONFIG_MEDIA_TUNER_MT2266=y
CONFIG_MEDIA_TUNER_MT2131=y
CONFIG_MEDIA_TUNER_QT1010=y
CONFIG_MEDIA_TUNER_XC2028=y
CONFIG_MEDIA_TUNER_XC5000=y
CONFIG_MEDIA_TUNER_XC4000=y
CONFIG_MEDIA_TUNER_MXL5005S=y
CONFIG_MEDIA_TUNER_MXL5007T=y
CONFIG_MEDIA_TUNER_MC44S803=y
CONFIG_MEDIA_TUNER_MAX2165=y
CONFIG_MEDIA_TUNER_TDA18218=y
CONFIG_MEDIA_TUNER_TDA18212=y
CONFIG_USB_GSPCA=y

# SSWAP
CONFIG_SWAP=y
CONFIG_FRONTSWAP=y
CONFIG_ZSMALLOC_NEW=y
CONFIG_PGTABLE_MAPPING=y
CONFIG_ZSWAP=y
CONFIG_DIRECT_RECLAIM_FILE_PAGES_ONLY=n
CONFIG_INCREASE_MAXIMUM_SWAPPINESS=y
CONFIG_FIX_INACTIVE_RATIO=y
CONFIG_TIGHT_PGDAT_BALANCE=y
CONFIG_VNSWAP=y
CONFIG_SWAP_ENABLE_READAHEAD=n

CONFIG_EXTEND_SERIAL_NUM_16=y
```

## arch/arm/configs/msm8974_sec_viennalteeur_defconfig
```kconfig
# from msm8974_sec_defconfig
CONFIG_AUDIT=y
# CONFIG_MSM_PIL_PRONTO is not set
CONFIG_NET_KEY=y
CONFIG_IP_MULTICAST=y
CONFIG_INET_XFRM_MODE_TRANSPORT=y
CONFIG_INET_XFRM_MODE_TUNNEL=y
CONFIG_NF_CONNTRACK_SECMARK=y
# CONFIG_NF_CONNTRACK_SIP is not set
CONFIG_NETFILTER_XT_TARGET_CONNSECMARK=y
CONFIG_NETFILTER_XT_TARGET_NOTRACK=y
CONFIG_NETFILTER_XT_TARGET_SECMARK=y
CONFIG_NETFILTER_XT_TARGET_TCPMSS=y
CONFIG_IP_NF_SECURITY=y
CONFIG_UHID=y
CONFIG_HID=y
CONFIG_HIDRAW=y
#CONFIG_BT_HCISMD=y
# CONFIG_BT_HCISMD is not set
# CONFIG_MSM_BT_POWER is not set
CONFIG_PPP=y
CONFIG_PPP_BSDCOMP=y
CONFIG_PPP_DEFLATE=y
CONFIG_PPP_MPPE=y
CONFIG_PPPOLAC=y
CONFIG_PPPOPNS=y
# CONFIG_WCNSS_CORE is not set
# CONFIG_WCNSS_CORE_PRONTO is not set
# CONFIG_WCNSS_MEM_PRE_ALLOC is not set
CONFIG_SENSORS_QPNP_ADC_CURRENT=y
CONFIG_IMX132=y
CONFIG_MSM_WFD=y
# CONFIG_FB_MSM_MDSS_HDMI_MHL_SII8334 is not set
CONFIG_FB_MSM_MDSS_DBG_SEQ_TICK=y
CONFIG_FB_MSM_MDSS_DSI_DBG=y
CONFIG_SND_SOC_MSM_HDMI_CODEC_RX=y
# CONFIG_LCD_CLASS_DEVICE is not set
# CONFIG_HID_PID is not set
# CONFIG_USB_HIDDEV is not set
CONFIG_HID_A4TECH=y
CONFIG_HID_ACRUX=y
# CONFIG_HID_ACRUX_FF is not set
CONFIG_HID_BELKIN=y
CONFIG_HID_CHERRY=y
CONFIG_HID_CHICONY=y
CONFIG_HID_PRODIKEYS=y
CONFIG_HID_CYPRESS=y
CONFIG_HID_DRAGONRISE=y
CONFIG_HID_EMS_FF=y
CONFIG_HID_ELECOM=y
CONFIG_HID_EZKEY=y
CONFIG_HID_KEYTOUCH=y
CONFIG_HID_KYE=y
CONFIG_HID_UCLOGIC=y
CONFIG_HID_WALTOP=y
CONFIG_HID_GYRATION=y
CONFIG_HID_TWINHAN=y
CONFIG_HID_KENSINGTON=y
CONFIG_HID_LCPOWER=y
CONFIG_HID_LOGITECH=y
CONFIG_HID_MONTEREY=y
CONFIG_HID_MULTITOUCH=y
CONFIG_HID_NTRIG=y
CONFIG_HID_ORTEK=y
CONFIG_HID_PANTHERLORD=y
CONFIG_HID_PETALYNX=y
CONFIG_HID_PICOLCD=y
# CONFIG_HID_PICOLCD_FB is not set
# CONFIG_HID_PICOLCD_BACKLIGHT is not set
# CONFIG_HID_PICOLCD_LCD is not set
# CONFIG_HID_PICOLCD_LEDS is not set
CONFIG_HID_QUANTA=y
CONFIG_HID_ROCCAT=y
CONFIG_HID_ROCCAT_COMMON=y
CONFIG_HID_ROCCAT_ARVO=y
CONFIG_HID_ROCCAT_KONE=y
CONFIG_HID_ROCCAT_KONEPLUS=y
CONFIG_HID_ROCCAT_KOVAPLUS=y
CONFIG_HID_ROCCAT_PYRA=y
CONFIG_HID_SAMSUNG=y
CONFIG_HID_SONY=y
CONFIG_HID_SUNPLUS=y
CONFIG_HID_GREENASIA=y
CONFIG_HID_SMARTJOYPLUS=y
CONFIG_HID_TOPSEED=y
CONFIG_HID_THRUSTMASTER=y
CONFIG_HID_WACOM=y
CONFIG_HID_WACOM_POWER_SUPPLY=y
CONFIG_HID_ZEROPLUS=y
CONFIG_HID_ZYDACRON=y
# CONFIG_IIO is not set
# CONFIG_IIO_BUFFER is not set
# CONFIG_IIO_SW_RING is not set
# CONFIG_IIO_KFIFO_BUF is not set
# CONFIG_INV_MPU_IIO is not set
# CONFIG_SENSORS_GP2A_IIO is not set
# CONFIG_SENSORS_CORE is not set
# CONFIG_INV_TESTING is not set
CONFIG_EXT4_FS_SECURITY=y
CONFIG_ENABLE_DEFAULT_TRACERS=y
CONFIG_SECURITY=y
CONFIG_SECURITY_NETWORK=y
CONFIG_LSM_MMAP_MIN_ADDR=4096
CONFIG_SECURITY_SELINUX=y

# vienna lte config
CONFIG_MACH_VIENNA=y
CONFIG_MACH_VIENNA_LTE=y
CONFIG_MACH_VIENNAEUR=y
CONFIG_LCD_CLASS_DEVICE=y
CONFIG_BACKLIGHT_LCD_SUPPORT=y
CONFIG_BACKLIGHT_CLASS_DEVICE=y
CONFIG_FB_MSM_EDP_SAMSUNG=y
CONFIG_FB_MSM_MDSS_EDP=y

CONFIG_USB_SWITCH_FSA9485=y
CONFIG_MUIC_FSA9485_SUPPORT_LANHUB=y
CONFIG_USB_STORAGE_DETECT=y
CONFIG_USB_HOST_NOTIFY=y
#ethernet driver
CONFIG_USB_NET_SMSC75XX=y
CONFIG_USB_NET_SMSC95XX=y
# MHL
CONFIG_MHL_VERSION=0x21
# BT
CONFIG_BT_BCM4339=y

CONFIG_BATTERY_SAMSUNG=y
CONFIG_SAMSUNG_LPM_MODE=y
CONFIG_FUELGAUGE_MAX17050=y
CONFIG_FUELGAUGE_MAX17050_COULOMB_COUNTING=y
CONFIG_CHARGER_BQ24260=y
CONFIG_CHARGER_SMB358=y

CONFIG_MOTOR_DRV_ISA1400=y
CONFIG_VIBRATOR_UPDATE=y

#LED FLAG
CONFIG_LEDS_QPNP=y


# Earjack
CONFIG_SAMSUNG_JACK=y
CONFIG_INPUT_GPIO=y

# DHA Solution
CONFIG_SEC_DHA_SOL_MAL=y

#
# Remove Qualcomm Wifi features
#
CONFIG_MSM_PIL_PRONTO=n
CONFIG_WCNSS_CORE=n
CONFIG_WCNSS_CORE_PRONTO=n
#
# Wifi features (Broadcomm)
#
CONFIG_NET_CORE=y
CONFIG_WIRELESS=y
CONFIG_WIRELESS_EXT_SYSFS=y
CONFIG_WEXT_CORE=y
CONFIG_WEXT_PROC=y
CONFIG_CFG80211=y
CONFIG_CFG80211_DEFAULT_PS=y
CONFIG_CFG80211_ALLOW_RECONNECT=y
CONFIG_WLAN=y
CONFIG_WIFI_CONTROL_FUNC=y
CONFIG_BCM4354=y
CONFIG_BCMDHD_FW_PATH="/system/etc/wifi/bcmdhd_sta.bin"
CONFIG_BCMDHD_NVRAM_PATH="/system/etc/wifi/nvram_net.txt"
CONFIG_BROADCOM_WIFI_RESERVED_MEM=y
CONFIG_WLAN_REGION_CODE=100
CONFIG_MMC_MSM_SDC2_SUPPORT=y
CONFIG_WIFI_BROADCOM_COB=y
# Input Devices
CONFIG_TOUCHSCREEN_ATMEL_MXT1664S=y
CONFIG_INPUT_WACOM=y
CONFIG_SENSORS_HALL=y

# eDP ESD FUNCTION
#
CONFIG_EDP_ESD_FUNCTION=y
CONFIG_EDP_TCON_MDNIE=y
CONFIG_EDP_EXTERNAL_POWER=y

# Sensors
CONFIG_SENSORS=y
CONFIG_SENSORS_BMI055=y
CONFIG_SENSORS_CM3323=y
CONFIG_SENSORS_AK8963C=y
CONFIG_SENSORS_SX9500=y
CONFIG_SENSORS_SX9500_INIT_TOUCH_THRESHOLD=3000
CONFIG_SENSORS_SX9500_NORMAL_TOUCH_THRESHOLD=17

CONFIG_SEC_FPGA=y
CONFIG_IR_REMOCON_FPGA=y

# SSWAP
CONFIG_SWAP=y
CONFIG_FRONTSWAP=y
CONFIG_ZSMALLOC_NEW=y
CONFIG_PGTABLE_MAPPING=y
CONFIG_ZSWAP=y
CONFIG_DIRECT_RECLAIM_FILE_PAGES_ONLY=y
CONFIG_INCREASE_MAXIMUM_SWAPPINESS=y
CONFIG_FIX_INACTIVE_RATIO=y
CONFIG_TIGHT_PGDAT_BALANCE=y
CONFIG_VNSWAP=y
CONFIG_SWAP_ENABLE_READAHEAD=n
```

## arch/arm/configs/msm8974pro_sec_chagallkdi_defconfig
```kconfig
# Chagall PROJECT config
CONFIG_ARCH_MSM8974PRO=y
CONFIG_MACH_CHAGALL=y
CONFIG_MACH_CHAGALL_LTE=y
CONFIG_SEC_LOCALE_JPN=y
CONFIG_MACH_CHAGALL_KDI=y
CONFIG_MSM_ADSPRPC=y

CONFIG_DEFERRED_INITCALLS=y

#
# ODE and DIR Encryption
#
CONFIG_CRYPTO=y
CONFIG_CRYPTO_SHA1=y
CONFIG_CRYPTO_SHA256=y
CONFIG_CRYPTO_AES=y
CONFIG_CRYPTO_CBC=y
CONFIG_ECRYPT_FS=y
CONFIG_WTL_ENCRYPTION_FILTER=y
CONFIG_KEYS_DEBUG_PROC_KEYS=y
CONFIG_CRYPTO_SHA512=y

#
# Wifi features
#
#
# Remove Qualcomm Wifi features
#
# CONFIG_WCNSS_CORE is not set
# CONFIG_WCNSS_CORE_PRONTO is not set
# CONFIG_WCNSS_MEM_PRE_ALLOC is not set

#
# Add Broadcomm Wifi features
#
CONFIG_NET_CORE=y
CONFIG_WIRELESS=y
CONFIG_WIRELESS_EXT_SYSFS=y
CONFIG_WEXT_CORE=y
CONFIG_WEXT_PROC=y
CONFIG_CFG80211=y
CONFIG_CFG80211_DEFAULT_PS=y
CONFIG_CFG80211_ALLOW_RECONNECT=y
CONFIG_WLAN=y
CONFIG_WIFI_CONTROL_FUNC=y
CONFIG_BCM4354=y
CONFIG_BCMDHD_FW_PATH="/system/etc/wifi/bcmdhd_sta.bin"
CONFIG_BCMDHD_NVRAM_PATH="/system/etc/wifi/nvram_net.txt"
CONFIG_BROADCOM_WIFI_RESERVED_MEM=y
CONFIG_WLAN_REGION_CODE=100
CONFIG_MMC_MSM_SDC2_SUPPORT=y
CONFIG_CFG80211_REG_NOT_UPDATED=y

# CONFIG_MSM_PIL_PRONTO is not set
#
# LCD
#
CONFIG_LCD_CLASS_DEVICE=y
CONFIG_BACKLIGHT_LCD_SUPPORT=y
CONFIG_BACKLIGHT_CLASS_DEVICE=y
CONFIG_FB_MSM_MIPI_SAMSUNG_OCTA_CMD_WQXGA_S6TNMR7_PT_PANEL=y

#
# Camera
#
CONFIG_IMX134=y
CONFIG_I2C_ACTUATOR=y
#
# Input
#
CONFIG_TOUCHSCREEN_SYNAPTICS_I2C_RMI=y
CONFIG_KEYBOARD_TC360_TOUCHKEY=y
#
# Earjack
#
#CONFIG_SAMSUNG_JACK is not set
CONFIG_INPUT_GPIO=y
# Audience
#CONFIG_SND_SOC_ES705=y
#CONFIG_SND_SOC_ES705_SLIM=y
#CONFIG_FW_LOADER=y
#CONFIG_FIRMWARE_IN_KERNEL=y
#CONFIG_EXTRA_FIRMWARE_DIR="firmware"

#
# DHA Solution
#

#
# usb
#
CONFIG_USB_DUN_SUPPORT=y
CONFIG_USB_DWC3=y
CONFIG_USB_STORAGE_DETECT=y
CONFIG_USB_HOST_NOTIFY=y

CONFIG_MHL_VERSION=0x21

#
# Enable SEC_PM Feature
#
CONFIG_SEC_PM=y
CONFIG_SEC_PM_DEBUG=y
CONFIG_REGULATOR_MAX77804K=y
#
# Finger print sensor
#
CONFIG_SENSORS_FINGERPRINT=y
CONFIG_SENSORS_FINGERPRINT_SYSFS=y
CONFIG_SENSORS_VFS61XX=y
CONFIG_SENSORS_VFS61XX_KO=y
# CONFIG_SENSORS_ADSP is not set
#
# Sensors
#
CONFIG_SENSORS=y
CONFIG_SENSORS_BMI055=y
CONFIG_SENSORS_CM3323=y
CONFIG_SENSORS_AK09911C=y
CONFIG_SENSORS_SX9500=y
CONFIG_SENSORS_SX9500_INIT_TOUCH_THRESHOLD=8000
CONFIG_SENSORS_SX9500_NORMAL_TOUCH_THRESHOLD=10
CONFIG_GLOVE_TOUCH=y
#
# Battery & Charger
#
CONFIG_BATTERY_SAMSUNG=y
CONFIG_BATTERY_SAMSUNG_DATA_FILE="chagallkdi_battery_data.h"
CONFIG_SAMSUNG_LPM_MODE=y
CONFIG_CHARGER_SMB1357=y
# CONFIG_SMB350_CHARGER is not set
# CONFIG_BATTERY_BQ28400 is not set
# CONFIG_BATTERY_MSM is not set
# CONFIG_FUELGAUGE_DUMMY is not set
#
# MAX77804K Charger
#
# CONFIG_QPNP_CHARGER is not set
# CONFIG_QPNP_BMS is not set
CONFIG_FUELGAUGE_MAX17048=y
# CONFIG_CHARGER_MAX77804K is not set
#
# Misc module
#
# CONFIG_KS8851 is not set
CONFIG_SEC_FPGA_ICE40XX=y
CONFIG_DTCP_ION_PHYS=y
CONFIG_IR_REMOCON_FPGA=y
CONFIG_SENSORS_HALL=y
CONFIG_SENSORS_HALL_IRQ_CTRL=y
CONFIG_REGULATOR_MAX77826=y
CONFIG_MFD_MAX77804K=y
CONFIG_MAX77804K_MUIC=y
CONFIG_MUIC_MAX77804K_SUPPORT_MHL_CABLE_DETECTION=y
CONFIG_MOTOR_DRV_MAX77804K=y
CONFIG_VIBETONZ=y
CONFIG_TACTILE_ASSIST=y
CONFIG_LEDS_MAX77804K=y
#
# etc
#
# CONFIG_HID is not set
#
# BT
#
CONFIG_BT_BCM4354=y

#
# extcon
#
CONFIG_EXTCON=y
CONFIG_EXTCON_MAX77804K=y

# SSWAP
CONFIG_SWAP=y
CONFIG_FRONTSWAP=y
CONFIG_ZSMALLOC_NEW=y
CONFIG_PGTABLE_MAPPING=y
CONFIG_ZSWAP=y
CONFIG_DIRECT_RECLAIM_FILE_PAGES_ONLY=y
CONFIG_INCREASE_MAXIMUM_SWAPPINESS=y
CONFIG_FIX_INACTIVE_RATIO=y
CONFIG_TIGHT_PGDAT_BALANCE=y
CONFIG_VNSWAP=y
CONFIG_SWAP_ENABLE_READAHEAD=n

#
# RCU
#
CONFIG_RCU_FAST_NO_HZ=y

#
# NFC features (NXP)
CONFIG_NFC_PN547=y
#
#ISDBT FCI8300 tuner
#
CONFIG_ISDBT=y
CONFIG_ISDBT_FC8300=y
#Fullseg TSIF
CONFIG_TSPP=y
CONFIG_DVB_CORE=y
CONFIG_DVB_MPQ=y
CONFIG_DVB_MPQ_DEMUX=y
#CONFIG_SECURE_DEMUX_ENABLE
CONFIG_DTCP_ION_PHYS=y
```
