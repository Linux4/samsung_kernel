## arch/arm64/configs/a22_00_defconfig
```kconfig
CONFIG_CROSS_COMPILE="aarch64-linux-android-"
# CONFIG_FHANDLE is not set
CONFIG_IKHEADERS=y
CONFIG_LOG_BUF_SHIFT=19
CONFIG_UCLAMP_TASK=y
CONFIG_UCLAMP_GROUPS_COUNT=32
CONFIG_UCLAMP_MAP_OPP=y
CONFIG_UCLAMP_TASK_GROUP=y
CONFIG_CPUSETS=y
CONFIG_CGROUP_DEBUG=y
CONFIG_SCHED_TUNE=y
CONFIG_DEFAULT_USE_ENERGY_AWARE=y
CONFIG_PELT_UTIL_HALFLIFE_16=y
# CONFIG_RD_BZIP2 is not set
# CONFIG_RD_LZMA is not set
# CONFIG_RD_XZ is not set
# CONFIG_RD_LZO is not set
# CONFIG_RD_LZ4 is not set
CONFIG_SYSCTL_SYSCALL=y
# CONFIG_KALLSYMS_BASE_RELATIVE is not set
# CONFIG_SLUB_DEBUG is not set
CONFIG_CC_STACKPROTECTOR_STRONG=y
CONFIG_MODULE_SRCVERSION_ALL=y
# CONFIG_BLK_DEV_BSG is not set
CONFIG_BLK_INLINE_ENCRYPTION=y
CONFIG_BLK_INLINE_ENCRYPTION_FALLBACK=y
CONFIG_MACH_MT6768=y
CONFIG_SCHED_MC=y
CONFIG_NR_CPUS=8
CONFIG_PREEMPT=y
# CONFIG_BOUNCE is not set
CONFIG_ZSMALLOC=y
# CONFIG_RANDOMIZE_BASE is not set
CONFIG_CMDLINE="console=tty0 console=ttyMT3,921600n1 root=/dev/ram vmalloc=496M slub_max_order=0 slub_debug=O "
# CONFIG_EFI is not set
# CONFIG_BUILD_ARM64_APPENDED_DTB_IMAGE is not set
# CONFIG_BUILD_ARM64_APPENDED_DTB_IMAGE_NAMES is not set
# CONFIG_CORE_DUMP_DEFAULT_ELF_HEADERS is not set
CONFIG_COMPAT=y
CONFIG_WQ_POWER_EFFICIENT_DEFAULT=y
CONFIG_CPU_FREQ=y
CONFIG_CPU_FREQ_STAT=y
CONFIG_CPU_FREQ_DEFAULT_GOV_SCHEDUTIL=y
CONFIG_CPU_FREQ_GOV_POWERSAVE=y
CONFIG_CPU_FREQ_GOV_USERSPACE=y
CONFIG_CPU_FREQ_GOV_ONDEMAND=y
CONFIG_CPU_FREQ_LIMIT=y
CONFIG_XFRM_MIGRATE=y
CONFIG_SYN_COOKIES=y
CONFIG_BRIDGE=y
CONFIG_VLAN_8021Q=y
CONFIG_CLS_U32_PERF=y
CONFIG_CLS_U32_MARK=y
CONFIG_CFG80211=y
CONFIG_NL80211_TESTMODE=y
CONFIG_CFG80211_DEVELOPER_WARNINGS=y
#FreeCess
CONFIG_SAMSUNG_FREECESS=y
# CONFIG_CFG80211_DEFAULT_PS is not set
CONFIG_CFG80211_INTERNAL_REGDB=y
# CONFIG_UEVENT_HELPER is not set
CONFIG_EXTRA_FIRMWARE="melfas/melfas_mip4_ts.fw"
CONFIG_EXTRA_FIRMWARE_DIR="firmware"
CONFIG_ZRAM=y
CONFIG_BLK_DEV_LOOP_MIN_COUNT=16
CONFIG_MEDIATEK_SOLUTION=y
CONFIG_MTK_PLATFORM="mt6768"
CONFIG_ARCH_MTK_PROJECT="k69v1_64_titan_buffalo"
# CONFIG_MTK_AB_OTA_UPDATER is not set
CONFIG_MTK_GPT_SCHEME_SUPPORT=y
CONFIG_MTK_PMIC_NEW_ARCH=y
CONFIG_MTK_PMIC_COMMON=y
CONFIG_MTK_PMIC_CHIP_MT6358=y
CONFIG_MTK_EXTERNAL_CHARGER_TYPE_DETECT=y
CONFIG_MTK_PMIC_WRAP_HAL=y
CONFIG_MTK_CPU_FREQ=y
CONFIG_MTK_PTPOD=y
CONFIG_MTK_STATIC_POWER=y
CONFIG_MTK_UNIFY_POWER=y
CONFIG_MTK_CM_MGR=y
CONFIG_MTK_THERMAL_PA_VIA_ATCMD=y
CONFIG_CUSTOM_KERNEL_IMGSENSOR="imx582_mipi_raw imx258f_mipi_raw imx355_mipi_raw gc02m1b_mipi_raw gc02m1_mipi_raw s5kgm2_mipi_raw"
CONFIG_CUSTOM_KERNEL_CAM_CAL_DRV="BRCB032GWZ_3 GT24c32a cat24c16"
CONFIG_MTK_SEC_VIDEO_PATH_SUPPORT=y
CONFIG_MTK_CAMERA_ISP_RSC_SUPPORT=y
CONFIG_MTK_CAMERA_ISP_DPE_SUPPORT=y
CONFIG_MTK_CAMERA_ISP_TSF_SUPPORT=y
CONFIG_MTK_CAMERA_ISP_FD_SUPPORT=y
CONFIG_MTK_CAMERA_ISP_WPE_SUPPORT=y
CONFIG_MTK_CAMERA_ISP_OWE_SUPPORT=y
CONFIG_MTK_CAMERA_ISP_MFB_SUPPORT=y
CONFIG_MTK_CAM_CAL=y
CONFIG_MTK_CMDQ_V3=y
CONFIG_MTK_CMDQ=y
CONFIG_MTK_IMGSENSOR=y
CONFIG_IMGSENSOR_SYSFS=y
CONFIG_MTK_SM5714_FLASHLIGHT=y
CONFIG_LEDS_SM5714=y
CONFIG_MTK_JPEG=y
CONFIG_MTK_SMI_EXT=y
CONFIG_MTK_LCM=y
CONFIG_MTK_FB=y
CONFIG_MTK_LCM_PHYSICAL_ROTATION="0"
CONFIG_LCM_HEIGHT="1600"
CONFIG_LCM_WIDTH="720"
CONFIG_MTK_AAL_SUPPORT=y
CONFIG_MTK_DX_HDCP_DDP_SUPPORT=y
CONFIG_MTK_CAM_SECURITY_SUPPORT=y
CONFIG_MTK_CAM_GENIEZONE_SUPPORT=y
CONFIG_MTK_CCU=y
CONFIG_MTK_COMBO=y
CONFIG_MTK_COMBO_CHIP_CONSYS_6768=y
CONFIG_MTK_COMBO_GPS=y
CONFIG_MTK_COMBO_BT=y
CONFIG_MTK_COMBO_WIFI=y
CONFIG_MTK_DHCPV6C_WIFI=y
CONFIG_MTK_GPS_SUPPORT=y
CONFIG_MTK_FMRADIO=y
CONFIG_MTK_FM_CHIP="MT6631_FM"
CONFIG_MTK_CONNSYS_DEDICATED_LOG_PATH=y
CONFIG_MTK_MD1_SUPPORT=9
CONFIG_MTK_ECCCI_DRIVER=y
CONFIG_MTK_ECCCI_C2K=y
CONFIG_MTK_SRIL_SUPPORT=y
CONFIG_DEV_RIL_BRIDGE=y
CONFIG_INET6_AH=y
CONFIG_IP_NF_MATCH_AH=y
# CONFIG_IP6_NF_NAT is not set
CONFIG_NET_ACT_POLICE=y
CONFIG_IP_NF_MATCH_RPFILTER=y
CONFIG_MTK_BTIF=y
CONFIG_TEEGRIS_TEE_SUPPORT=y
CONFIG_MTK_TEE_GP_SUPPORT=y
CONFIG_MTK_ENABLE_GENIEZONE=y
CONFIG_MTK_ACCDET=y
CONFIG_ACCDET_EINT_IRQ=y
CONFIG_ACCDET_SUPPORT_EINT0=y
CONFIG_MTK_LENS=y
CONFIG_MTK_FLASHLIGHT=y
CONFIG_MTK_FLASHLIGHT_PT=y
CONFIG_MTK_FLASHLIGHT_PT_STRICT=y
CONFIG_MTK_FLASHLIGHT_DLPT=y
CONFIG_RT_FLASHLIGHT=y
CONFIG_MTK_TINYSYS_SCP_SUPPORT=y
CONFIG_MTK_LEDS=y
CONFIG_MTK_PWM=y
CONFIG_MTK_CHIP=y
CONFIG_MTK_IDLE_BALANCE_ENHANCEMENT=y
CONFIG_MTK_SCHED_EAS_POWER_SUPPORT=y
CONFIG_SCHED_HMP=y
CONFIG_SCHED_HMP_PRIO_FILTER_VAL=1
CONFIG_PRIO_LIMIT_HMP_BOOST=y
CONFIG_MTK_SCHED_BOOST=y
CONFIG_MTK_SCHED_RQAVG_KS=y
CONFIG_MTK_SCHED_RQAVG_US=y
CONFIG_MTK_SCHED_CPULOAD=y
CONFIG_USB_MTK_HDRC=y
CONFIG_MTK_MUSB_QMU_SUPPORT=y
CONFIG_MTK_MUSB_QMU_PURE_ZLP_SUPPORT=y
CONFIG_MTK_MUSB_DRV_36BIT=y
CONFIG_USB_MTK_OTG=y
CONFIG_MTK_RAM_CONSOLE=y
CONFIG_MTK_AEE_FEATURE=y
CONFIG_MTK_RTC=y
CONFIG_MTK_USB_TYPEC=y
# CONFIG_MTK_LOAD_TRACKER is not set
# CONFIG_MTK_CPU_CTRL_CFP is not set
CONFIG_MTK_PERF_OBSERVER=y
CONFIG_MTK_RESYM=y
# CONFIG_MTK_FPSGO_V3 is not set
CONFIG_MTK_EARA_THERMAL=y
CONFIG_MTK_PERF_TRACKER=y
CONFIG_MTK_LOWMEM_HINT=y
CONFIG_MTPROF=y
CONFIG_ANDROID_DEFAULT_SETTING=y
CONFIG_MTK_ANDROID_DEFAULT_SETTING=y
CONFIG_MTK_TIMER_TIMESYNC=y
CONFIG_MTK_HIGH_FRAME_RATE=y
CONFIG_MTK_TC10_FEATURE=y
CONFIG_MTK_FREQ_HOPPING=y
CONFIG_MTK_TINYSYS_SSPM_SUPPORT=y
CONFIG_MTK_TINYSYS_SSPM_VERSION="v1"
CONFIG_MTK_GPU_SUPPORT=y
CONFIG_MTK_GPU_VERSION="mali bifrost r25p0"
CONFIG_MTK_GPU_COMMON_DVFS_SUPPORT=y
CONFIG_MTK_VIBRATOR=y
CONFIG_MTK_SELINUX_AEE_WARNING=y
CONFIG_MTK_SYNC=y
CONFIG_MTK_DRAM_LOG_STORE=y
CONFIG_MTK_DRAM_LOG_STORE_ADDR=0x10E700
CONFIG_MTK_DRAM_LOG_STORE_SIZE=0x100
CONFIG_BATTERY_SAMSUNG=y
CONFIG_BATTERY_SAMSUNG_LEGO_STYLE=y
CONFIG_CHARGER_SM5714=y
CONFIG_BATTERY_CISD=y
CONFIG_BATTERY_NOTIFIER=y
CONFIG_FUELGAUGE_SM5714=y
CONFIG_USE_MUIC=y
CONFIG_MUIC_NOTIFIER=y
CONFIG_MUIC_MANAGER=y
CONFIG_MUIC_CORE=y
CONFIG_MUIC_SM5714=y
CONFIG_MUIC_SYSFS=y
CONFIG_MFD_SM5714=y
CONFIG_USB_TYPEC_MANAGER_NOTIFIER=y
CONFIG_PDIC_NOTIFIER=y
CONFIG_TZDEV=y
CONFIG_TZDEV_IWI_EVENT=294
CONFIG_TZDEV_IWI_PANIC=295
CONFIG_TZDEV_SWD_PANIC_IS_CRITICAL=y
CONFIG_TZLOG=y
CONFIG_TZLOG_PG_CNT=8
CONFIG_TZDEV_SK_MULTICORE=y
CONFIG_ION_FD2PHYS_USE_ION_FROM_STAGING=y
CONFIG_TZIRS=y
CONFIG_TZ_BOOT_LOG=y
CONFIG_TEEGRIS_VERSION=4
CONFIG_SCSI=y
CONFIG_BLK_DEV_SD=y
CONFIG_SCSI_SCAN_ASYNC=y
# CONFIG_SCSI_LOWLEVEL is not set
CONFIG_BLK_DEV_DM=y
CONFIG_DM_CRYPT=y
CONFIG_DM_DEFAULT_KEY=y
CONFIG_DM_UEVENT=y
CONFIG_DM_VERITY_FEC=y
CONFIG_DM_VERITY_AVB=y
CONFIG_DM_BOW=y
CONFIG_IFB=y
# CONFIG_ETHERNET is not set
CONFIG_PPP_FILTER=y
CONFIG_PPP_MULTILINK=y
CONFIG_PPPOE=y
CONFIG_PPP_ASYNC=y
CONFIG_PPP_SYNC_TTY=y
CONFIG_USB_USBNET=y
# CONFIG_KEYBOARD_ATKBD is not set
CONFIG_KEYBOARD_MTK=y
CONFIG_TWOKEY_REBOOT_NORMAL_MODE=y
CONFIG_TWOKEY_REBOOT_OTHER_MODE=y
CONFIG_KPD_PWRKEY_USE_PMIC=y
CONFIG_MTK_MRDUMP_KEY=y
# CONFIG_INPUT_MOUSE is not set
CONFIG_INPUT_TOUCHSCREEN=y
CONFIG_SEC_DEBUG_TSP_LOG=y
CONFIG_TOUCHSCREEN_MELFAS_MSS100=y
CONFIG_INPUT_MISC=y
CONFIG_INPUT_UINPUT=y
# CONFIG_SERIO is not set
# CONFIG_VT is not set
CONFIG_LEGACY_PTY_COUNT=16
# CONFIG_DEVMEM is not set
CONFIG_SERIAL_8250=y
CONFIG_SERIAL_8250_CONSOLE=y
CONFIG_SERIAL_8250_NR_UARTS=2
CONFIG_SERIAL_8250_RUNTIME_UARTS=2
CONFIG_SERIAL_8250_MT6577=y
CONFIG_I2C_GPIO=y
CONFIG_I2C_MTK=y
CONFIG_SPI=y
CONFIG_SPI_MT65XX=y
CONFIG_HWMON=y
CONFIG_THERMAL=y
CONFIG_THERMAL_DEFAULT_GOV_BACKWARD_COMPATIBLE=y
CONFIG_WATCHDOG=y
CONFIG_MTK_WATCHDOG_COMMON=y
CONFIG_MTK_WATCHDOG_COMMON_V2=y
CONFIG_WATCHDOG_CORE=y
CONFIG_SOFT_WATCHDOG=y
CONFIG_SEC_DEBUG_SOFTDOG_PWDT=y
CONFIG_MFD_MT6358=y
CONFIG_MT6358_MISC=y
CONFIG_REGULATOR=y
CONFIG_REGULATOR_MT6358=y
CONFIG_REGULATOR_S2MPB03=y
CONFIG_MEDIA_SUPPORT=y
CONFIG_MEDIA_CAMERA_SUPPORT=y
CONFIG_V4L_PLATFORM_DRIVERS=y
CONFIG_V4L_MEM2MEM_DRIVERS=y
CONFIG_VIDEO_MEDIATEK_VCU_WO_FUSE=y
CONFIG_VB2_MEDIATEK_DMA_CONTIG=y
CONFIG_VIDEO_MEDIATEK_VCODEC=y
CONFIG_FB_MODE_HELPERS=y
CONFIG_FB_TILEBLITTING=y
CONFIG_LOGO=y
CONFIG_SND_HRTIMER=y
CONFIG_SND_DYNAMIC_MINORS=y
CONFIG_SND_VERBOSE_PRINTK=y
CONFIG_SND_DEBUG=y
CONFIG_SND_DEBUG_VERBOSE=y
CONFIG_SND_PCM_XRUN_DEBUG=y
CONFIG_SND_SEQUENCER=y
CONFIG_SND_SEQ_DUMMY=y
# CONFIG_SND_SPI is not set
CONFIG_SND_USB_AUDIO=y
CONFIG_SND_SOC=y
CONFIG_SND_SOC_MT6768_MT6358=y
CONFIG_SND_SOC_MTK_BTCVSD=y
CONFIG_HIDRAW=y
CONFIG_HID_A4TECH=y
CONFIG_HID_APPLE=y
CONFIG_HID_BELKIN=y
CONFIG_HID_CHERRY=y
CONFIG_HID_CHICONY=y
CONFIG_HID_CYPRESS=y
CONFIG_HID_DRAGONRISE=y
CONFIG_HID_EZKEY=y
CONFIG_HID_KYE=y
CONFIG_HID_GYRATION=y
CONFIG_HID_TWINHAN=y
CONFIG_HID_KENSINGTON=y
CONFIG_HID_LOGITECH=y
CONFIG_HID_MAGICMOUSE=y
CONFIG_HID_MICROSOFT=y
CONFIG_HID_MONTEREY=y
CONFIG_HID_PANTHERLORD=y
CONFIG_HID_PETALYNX=y
CONFIG_HID_SAMSUNG=y
CONFIG_HID_SUNPLUS=y
CONFIG_HID_GREENASIA=y
CONFIG_HID_SMARTJOYPLUS=y
CONFIG_HID_TOPSEED=y
CONFIG_HID_THRUSTMASTER=y
CONFIG_HID_ZEROPLUS=y
CONFIG_USB_HIDDEV=y
CONFIG_TABLET_USB_GTCO=y
CONFIG_TABLET_USB_HANWANG=y
CONFIG_TABLET_USB_KBTAB=y
CONFIG_TABLET_USB_WACOM=y
CONFIG_TABLET_USB_AIPTEK=y
CONFIG_TABLET_USB_ACECAD=y
CONFIG_USB_BELKIN=y
CONFIG_USB_ARMLINUX=y
CONFIG_USB_PRINTER=y
CONFIG_USB_ACM=y
CONFIG_USB_USBNET=y
CONFIG_USB_NET_SMSC95XX=y
CONFIG_USB_NET_CDCETHER=y
CONFIG_USB_NET_CDC_NCM=y
CONFIG_USB_NET_CDC_EEM=y
CONFIG_USB_NET_CDC_MBIM=y
CONFIG_USB_NET_CDC_SUBSET=y
CONFIG_USB_NET_ZAURUS=y
CONFIG_USB_NET_AX88179_178A=y
CONFIG_USB_NET_SMSC75XX=y
CONFIG_USB_NET_NET1080=y
CONFIG_USB_RTL8150=y
CONFIG_USB_NET_AX8817X=y
CONFIG_USB_STORAGE=y
CONFIG_USB_STORAGE_DATAFAB=y
CONFIG_USB_STORAGE_FREECOM=y
CONFIG_USB_STORAGE_ISD200=y
CONFIG_USB_STORAGE_USBAT=y
CONFIG_USB_STORAGE_SDDR09=y
CONFIG_USB_STORAGE_SDDR55=y
CONFIG_USB_STORAGE_JUMPSHOT=y
CONFIG_USB_STORAGE_ALAUDA=y
CONFIG_USB_STORAGE_ONETOUCH=y
CONFIG_USB_STORAGE_KARMA=y
CONFIG_USB_STORAGE_CYPRESS_ATACB=y
CONFIG_USB_TRANCEVIBRATOR=y
CONFIG_NOP_USB_XCEIV=y
# CONFIG_DUAL_ROLE_USB_INTF is not set
CONFIG_TYPEC=y
CONFIG_USB_HOST_NOTIFY=y
CONFIG_USB_NOTIFY_LAYER=y
CONFIG_USB_NOTIFY_PROC_LOG=y
CONFIG_USB_DEBUG_DETAILED_LOG=y
CONFIG_USB_EXTERNAL_NOTIFY=y
CONFIG_USB_NOTIFIER=y
CONFIG_USB_HW_PARAM=y
CONFIG_USB_ANNOUNCE_NEW_DEVICES=y
CONFIG_USB_INTERFACE_LPM_LIST=y
CONFIG_USB_GADGET_VBUS_DRAW=500
CONFIG_USB_CONFIGFS_SERIAL=y
CONFIG_USB_CONFIGFS_ACM=y
CONFIG_USB_CONFIGFS_RNDIS=y
CONFIG_USB_CONFIGFS_MASS_STORAGE=y
CONFIG_USB_CONFIGFS_F_HID=y
CONFIG_USB_CONFIGFS_F_DM=y
CONFIG_USB_CONFIGFS_UEVENT=y
CONFIG_USB_CONFIGFS_F_FS=y
CONFIG_USB_CONFIGFS_F_CONN_GADGET=y
CONFIG_USB_CONFIGFS_F_SS_MON_GADGET=y
CONFIG_USB_CONFIGFS_F_MTP=y
CONFIG_USB_CONFIGFS_F_PTP=y
CONFIG_USB_CONFIGFS_F_ACC=y
CONFIG_USB_CONFIGFS_F_AUDIO_SRC=y
CONFIG_USB_ANDROID_SAMSUNG_COMPOSITE=y
CONFIG_USB_DUN_SUPPORT=y
CONFIG_USB_RNDIS_MULTIPACKET=y
CONFIG_USB_CONFIGFS_F_MIDI=y
CONFIG_MMC=y
CONFIG_MMC_BLOCK_MINORS=32
CONFIG_MMC_BLOCK_DEFERRED_RESUME=y
CONFIG_MMC_CRYPTO=y
CONFIG_MMC_MTK_PRO=y
CONFIG_MTK_EMMC_SUPPORT=y
CONFIG_MTK_EMMC_CACHE=y
CONFIG_MTK_EMMC_SUPPORT_OTP=y
CONFIG_MTK_EMMC_HW_CQ=y
CONFIG_NEW_LEDS=y
CONFIG_LEDS_CLASS=y
CONFIG_LEDS_TRIGGERS=y
CONFIG_LEDS_TRIGGER_TIMER=y
# CONFIG_RTC_SYSTOHC is not set
CONFIG_RTC_DRV_MT6358=y
CONFIG_DMADEVICES=y
CONFIG_DMA_MTK_UART=y
CONFIG_ANDROID_INTF_ALARM_DEV=y
CONFIG_ION=y
CONFIG_MTK_ION=y
CONFIG_MAILBOX=y
CONFIG_MTK_CMDQ_MBOX=y
CONFIG_MTK_PMIC_WRAP=y
CONFIG_PM_DEVFREQ=y
CONFIG_IIO=y
CONFIG_MEDIATEK_MT6577_AUXADC=y
CONFIG_MT635X_AUXADC=y
CONFIG_SWITCH=y
CONFIG_FS_ENCRYPTION_INLINE_CRYPT=y
CONFIG_QUOTA_NETLINK_INTERFACE=y
CONFIG_INCREMENTAL_FS=y
CONFIG_ISO9660_FS=y
CONFIG_JOLIET=y
CONFIG_ZISOFS=y
CONFIG_MSDOS_FS=y
CONFIG_VFAT_FS=y
CONFIG_TMPFS=y
CONFIG_PSTORE=y
CONFIG_PSTORE_CONSOLE=y
CONFIG_PSTORE_PMSG=y
CONFIG_PSTORE_RAM=y
# CONFIG_NETWORK_FILESYSTEMS is not set
CONFIG_NLS_CODEPAGE_437=y
CONFIG_NLS_CODEPAGE_950=y
CONFIG_NLS_ASCII=y
CONFIG_NLS_ISO8859_1=y
CONFIG_NLS_UTF8=y
CONFIG_PRINTK_TIME=y
CONFIG_DYNAMIC_DEBUG=y
CONFIG_DEBUG_INFO=y
CONFIG_FRAME_WARN=2800
CONFIG_DEBUG_SECTION_MISMATCH=y
CONFIG_SECTION_MISMATCH_WARN_ONLY=y
CONFIG_PANIC_ON_OOPS=y
CONFIG_PANIC_TIMEOUT=1
CONFIG_SCHEDSTATS=y
# CONFIG_DEBUG_PREEMPT is not set
CONFIG_RCU_CPU_STALL_TIMEOUT=60
CONFIG_FAULT_INJECTION=y
CONFIG_ENABLE_DEFAULT_TRACERS=y
CONFIG_MTK_SCHED_TRACERS=y
CONFIG_STATIC_USERMODEHELPER_PATH="/system_ext/bin/aee_core_forwarder"
CONFIG_CRYPTO_TWOFISH=y
# CONFIG_CRYPTO_HW is not set
# SEC_PARAM
CONFIG_CM_OFFSET=3146292
# FMM
CONFIG_FMM_LOCK_OFFSET=3146356

# Enable SEC_PM Feature
CONFIG_SEC_PM=y
CONFIG_FOTA_LIMIT=y
CONFIG_SEC_THERMAL_LOG=y

# MT6769V/CT doesn't have a meltdown bug
# CONFIG_UNMAP_KERNEL_AT_EL0 is not set

# Hypervisor_Plugin # sep lite
# CONFIG_UH is not set

#RKP
# CONFIG_RUSTUH_RKP is not set
# CONFIG_RUSTUH_RKP_TEST is not set
# CONFIG_RUSTUH_KDP is not set
# CONFIG_RUSTUH_KDP_CRED is not set
# CONFIG_RUSTUH_KDP_NS is not set
# CONFIG_RUSTUH_KDP_TEST is not set

#EPDG
CONFIG_NET_SCH_PRIO=y
CONFIG_NET_CLS_BASIC=y
CONFIG_NET_ACT_MIRRED=y
####[LEGO-START] DO NOT SUBMIT

# CONFIG_ICD is not set
CONFIG_DEV_RIL_BRIDGE=y
CONFIG_SECURITY_DEFEX=y
CONFIG_PROCA=y
CONFIG_SEC_VIBRATOR=y
CONFIG_SEC_VIB_NOTIFIER=y
CONFIG_IIO=y
CONFIG_IIO_BUFFER=y
CONFIG_IIO_KFIFO_BUF=y
CONFIG_SHUB=y
CONFIG_SEC_NFC_LOGGER=y
CONFIG_SECURITY_DSMS=y
# CONFIG_FIVE_TEE_DRIVER is not set
CONFIG_SEC_ABC=y
CONFIG_SEC_ABC_HUB=y
CONFIG_SEC_ABC_COMMON=y
# CONFIG_SEC_ABC_MOTTO is not set
CONFIG_SEC_ABC_HUB_CORE=y
# CONFIG_SEC_ABC_HUB_COND is not set
CONFIG_SEC_ABC_HUB_BOOTC=y
CONFIG_MUIC_NOTIFIER=y
CONFIG_VBUS_NOTIFIER=y
CONFIG_MUIC_AFC_RETRY=y
CONFIG_USE_MUIC=y
CONFIG_SEC_STI=y
CONFIG_SEC_AUTO_INPUT=y
CONFIG_SEC_INPUT_BOOSTER=y
CONFIG_SEC_INPUT_BOOSTER_MTK=y
# CONFIG_TZIC is not set
CONFIG_FIVE=y
CONFIG_INPUT_SEC_INPUT=y
CONFIG_SEC_DEBUG_TSP_LOG=y
#CONFIG_INPUT_SEC_SECURE_TOUCH is not set
CONFIG_TOUCHSCREEN_DUMP_MODE=y
CONFIG_INPUT_TOUCHSCREEN_TCLMV2=y
CONFIG_SENSORS_FINGERPRINT=y
CONFIG_USB_TYPEC_MANAGER_NOTIFIER=y
CONFIG_IF_CB_MANAGER=y
CONFIG_PDIC_NOTIFIER=y
CONFIG_SHUB_MODULE=y
CONFIG_SHUB_PM_WAKEUP_LINUX_VER_5_4=y
CONFIG_SHUB_AP_STATUS_CMD=y
CONFIG_SHUB_MTK=y
# CONFIG_SHUB_FIRMWARE_DOWNLOAD is not set
# CONFIG_SHUB_DUMP is not set
CONFIG_I2C_GPIO=y
CONFIG_SENSORS_GW3X=y
CONFIG_FINGERPRINT_SECURE=y
CONFIG_SENSORS_FINGERPRINT_MTK=y
CONFIG_MFD_SM5714=y
CONFIG_SENSORS_SEC_THERMISTOR=y
CONFIG_REGULATOR_FIXED_VOLTAGE=y
CONFIG_DC_VIBRATOR=y
# CONFIG_MTK_VIBRATOR is not set
CONFIG_REGULATOR_S2MPB03=y
CONFIG_MUIC_SM5714=y
CONFIG_MUIC_SUPPORT_PDIC=y
CONFIG_MUIC_BCD_RESCAN=y
CONFIG_TOUCHSCREEN_STM=y
CONFIG_TOUCHSCREEN_MELFAS=y
CONFIG_SAMSUNG_NFC=y
CONFIG_NFC_PN547=y
#CONFIG_NFC_PN547_ESE_SUPPORT is not set
CONFIG_NFC_FEATURE_SN100U=y
#CONFIG_ESE_SECURE is not set
CONFIG_FUELGAUGE_SM5714=y
CONFIG_PDIC_SM5714=y
CONFIG_SM5714_FACTORY_MODE=y
CONFIG_SENSORS_SUPPORT_MTK=y
CONFIG_SENSORS_ISG5320A=y
CONFIG_SENSORS_ISG5320A_SUB=y
CONFIG_TEST_FOR_GRIP=y
CONFIG_CHARGER_SM5714=y
CONFIG_BATTERY_SAMSUNG=y
CONFIG_BATTERY_AGE_FORECAST=y
CONFIG_BATTERY_CISD=y
CONFIG_BATTERY_NOTIFIER=y
CONFIG_AFC_CHARGER_MODE=y
CONFIG_SUPPORT_HV_CTRL=y
####[LEGO-END] DO NOT SUBMIT
# CONFIG_SND_SOC_MT6660 is not set
CONFIG_SND_SOC_AW8896=y
CONFIG_SND_SOC_SAMSUNG_AUDIO=y
CONFIG_FOUR_KEY_HEADSET=y
CONFIG_FLIP_COVER_DETECTOR_FACTORY=y
# CONFIG_TOUCHSCREEN_ILITEK_ILI9881X is not set
# CONFIG_TOUCHSCREEN_NT36xxx_HOSTDL_SPI is not set
CONFIG_CUSTOM_KERNEL_LCM="smcdsd_panel"
CONFIG_SMCDSD_PANEL=y
CONFIG_SMCDSD_DPUI=y
CONFIG_SMCDSD_MDNIE=y
CONFIG_SMCDSD_DOZE=y
CONFIG_SMCDSD_USE_POINT_GPARA=y
CONFIG_SMCDSD_PANEL_A22=y
CONFIG_SMCDSD_DYNAMIC_MIPI=y
CONFIG_BACKLIGHT_LCD_SUPPORT=y
CONFIG_LCD_CLASS_DEVICE=y
CONFIG_BACKLIGHT_CLASS_DEVICE=y
# CONFIG_BACKLIGHT_GENERIC is not set
CONFIG_IMGSENSOR_CUSTOM_CAMERA=y
CONFIG_CAMERA_AAU_V22=y
CONFIG_CAMERA_SAMSUNG_MODEL_NAME="aau_v22"
CONFIG_CAMERA_SENSOR0="imx582_mipi_raw"
CONFIG_CAMERA_SENSOR1="imx258f_mipi_raw"
CONFIG_CAMERA_SENSOR2="imx355_mipi_raw"
CONFIG_CAMERA_SENSOR3="gc02m1b_mipi_raw"
CONFIG_CAMERA_SENSOR4="gc02m1_mipi_raw"
CONFIG_CAMERA_OIS_MCU=y
CONFIG_CAMERA_ADAPTIVE_MIPI=y
CONFIG_I2C_CHARDEV=y
CONFIG_MTK_NFC_CLKBUF_ENABLE=y
CONFIG_SEC_NAD=y
CONFIG_SAMSUNG_TUI=y
CONFIG_ZRAM_WRITEBACK=y
CONFIG_SEC_MSDC_SSC=y
CONFIG_DEBUG_PATCH_CMDQ_EMMC=y
CONFIG_SAMSUNG_PRODUCT_SHIP=y






CONFIG_PROCA_S_OS=y




# CONFIG_FIVE_PA_FEATURE is not set


CONFIG_GAF_V6=y






CONFIG_F2FS_FS=y


CONFIG_F2FS_FS_SECURITY=y


CONFIG_F2FS_FS_ENCRYPTION=y


CONFIG_F2FS_FS_COMPRESSION=y


CONFIG_EXT4_FS_POSIX_ACL=y


CONFIG_NTFS_FS=y


CONFIG_NTFS_DEBUG=y


CONFIG_NLS=y
```
