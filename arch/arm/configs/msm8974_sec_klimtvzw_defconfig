## arch/arm/plat-pxa/Kconfig
```kconfig
if PLAT_PXA

config PXA_SSP
	tristate
	help
	  Enable support for PXA2xx SSP ports

config PXA_PANIC_FLUSH
	bool "PXA cache flush when panic"
	depends on KEXEC
	help
	  Enable support for flush all cache during panic

config PXA_32KTIMER
	bool "PXA 32K Timer"
	depends on (ARCH_PXA || ARCH_MMP)
	default n
	help
	  32KHz timer support for PXA27x and PXA3xx/9xx Processor

config DUMP_REGS
	bool
	default y
	depends on (ARCH_PXA || ARCH_MMP)
	help
	  Dump soc registers, stack, and possible functions in the stack
endif
```

## arch/arm64/Kconfig
```kconfig
	def_bool y

	select SWIOTLB_XEN
	select PARAVIRT
	help
	  Say Y if you want to run Linux in a Virtual Machine on Xen on ARM64.

	default n
	help
	  Say Y if you want to run Linux as a guest of the OKL4 hypervisor

	default n
	help
	  It enables a micro hypervisor.
	  It's samsung's hypervisor and it should be combined with QC hyp.
	  So you must check a hypX(samsung hypervisor image)
	  RKP and etc can be loaded on it.

	select UH
	default n
	help
		it protects a kernel text and etc.

	default n
	help
	  it enables rkp test.

	default n
	help
	  Prevents unauthorized cred modification.

	default n
	help
	  enable KDP test.


	default y
	help
	  Randomizes the location of the module region without considering the
	  location of the core kernel. This way, it is impossible for modules
	  to leak information about the location of core kernel data structures
	  but it does imply that function calls between modules and the core
	  kernel will need to be resolved via veneers in the module PLT.

	  When this option is not set, the module region will be randomized over
	  a limited range that contains the [_stext, _etext] interval of the
	  core kernel, so branch relocations are always in range.



	select LIBFDT
	select UCS2_STRING
	select EFI_PARAMS_FROM_FDT
	select EFI_RUNTIME_WRAPPERS
	select EFI_STUB
	select EFI_ARMSTUB
	default y
	help
	  This option provides support for runtime services provided
	  by UEFI firmware (such as non-volatile variables, realtime
          clock, and platform reset). A UEFI stub is also provided to
	  allow the kernel to be booted as an EFI application. This
	  is only useful on systems that have UEFI firmware.

	select COMPAT_BINFMT_ELF if BINFMT_ELF
	select HAVE_UID16
	select OLD_SIGSUSPEND3
	select COMPAT_OLD_SIGACTION
	help
	  This option enables support for a 32-bit EL0 running under a 64-bit
	  kernel at EL1. AArch32-specific components such as system calls,
	  the user helper functions, VFP support and the ptrace interface are
	  handled appropriately by the kernel.

	  If you use a page size other than 4KB (i.e, 16KB or 64KB), please be aware
	  that you will only be able to execute AArch32 binaries that were compiled
	  with page size aligned segments.

	  If you want to execute 32-bit userspace applications, say Y.



config SEC_GTS6LWIFI_PROJECT
	default n
	bool "Samsung GTS6LWIFI Project"
	help
	  Support for Samsung GTS6LWIFI Project

config MACH_GTS6LWIFI_EUR_OPEN
        default n
        bool "Samsung GTS6LWIFI EUR OPEN"
        help
          Support for Samsung GTS6LWIFI EUR OPEN device.
```

## arch/arm64/Kconfig.projects
```kconfig
config SEC_A23_PROJECT
	default n
	bool "Samsung A23 Project"
	help
	  Support for Samsung A23 Project

config MACH_A23_KOR_SINGLE
	default n
	bool "Samsung A23 KOR SINGLE"
	help
	  Support for Samsung A23 KOR SINGLE device.
```

## arch/arm64/Kconfig.sec
```kconfig
config SEC_GTS4LV_PROJECT
        depends on ARCH_SDM670
        default n
        bool "Samsung GTS4LV Project"
        help
          Support for Samsung GTS4LV Project

config SEC_GTS4LV_MEA_PROJECT
        depends on SEC_GTS4LV_PROJECT
        default n
        bool "Samsung GTS4LV MEA Project"
        help
          Support for Samsung GTS4LV MEA Project

config SEC_GTS4LV_EUR_PROJECT
        depends on SEC_GTS4LV_PROJECT
        default n
        bool "Samsung GTS4LV EUR OPEN Project"
        help
          Support for Samsung GTS4LV EUR OPEN Project

config SEC_GTS4LVWIFI_EUR_PROJECT
        depends on SEC_GTS4LV_PROJECT
        default n
        bool "Samsung GTS4LVWIFI EUR OPEN Project"
        help
          Support for Samsung GTS4LVWIFI EUR OPEN Project
	  
config SEC_GTS4LVWIFI_EUR_LDU_PROJECT
        depends on SEC_GTS4LV_PROJECT
        default n
        bool "Samsung GTS4LVWIFI EUR LDU Project"
        help
          Support for Samsung GTS4LVWIFI EUR LDU Project

config SEC_GTS4LV_KOR_PROJECT
        depends on SEC_GTS4LV_PROJECT
        default n
        bool "Samsung GTS4LV KOR OPEN Project"
        help
          Support for Samsung GTS4LV KOR OPEN Project

config SEC_GTS4LV_USA_PROJECT
        depends on SEC_GTS4LV_PROJECT
        default n
        bool "Samsung GTS4LV USA Project"
        help
          Support for Samsung GTS4LV USA Project

config SEC_A8SQLTE_PROJECT
	depends on ARCH_SDM670
	default n
	bool "Samsung A8SQLTE Project"
	help
	  Support for Samsung A8SQLTE Project

config MACH_A8SQLTE_CHN_OPEN
	depends on SEC_A8SQLTE_PROJECT
	default n
	bool "Samsung A8SQLTE CHN OPEN"
	help
	  Support for Samsung A8SQLTE CHN OPEN device.

config MACH_A8SQLTE_CHN_TW
	depends on SEC_A8SQLTE_PROJECT
	default n
	bool "Samsung A8SQLTE CHN TW"
	help
	  Support for Samsung A8SQLTE CHN TW device.

config MACH_A8SQLTE_CHN_LDU
	depends on SEC_A8SQLTE_PROJECT
	default n
	bool "Samsung A8SQLTE CHN LDU"
	help
	  Support for Samsung A8SQLTE CHN LDU device.

config MACH_A8SQLTE_KOR_SINGLE
	depends on SEC_A8SQLTE_PROJECT
	default n
	bool "Samsung A8SQLTE KOR SINGLE"
	help
	  Support for Samsung A8SQLTE KOR SINGLE device.

config MACH_A8SQLTE_KOR_LDU
	depends on SEC_A8SQLTE_PROJECT
	default n
	bool "Samsung A8SQLTE KOR LDU"
	help
	  Support for Samsung A8SQLTE KOR LDU device.

config SEC_GTACTIVEXL_PROJECT
        depends on ARCH_SDM670
        default n
        bool "Samsung GTACTIVEXL Project"
        help
          Support for Samsung GTACTIVEXL Project
		  
config SEC_GTACTIVEXL_EUR_PROJECT
        depends on SEC_GTACTIVEXL_PROJECT
        default n
        bool "Samsung GTACTIVEXL EUR OPEN Project"
        help
          Support for Samsung GTACTIVEXL EUR OPEN Project
		  
config SEC_GTACTIVEXL_USA_PROJECT
        depends on SEC_GTACTIVEXL_PROJECT
        default n
        bool "Samsung GTACTIVEXL USA OPEN Project"
        help
          Support for Samsung GTACTIVEXL USA OPEN Project
		  
config SEC_GTACTIVEXLWIFI_EUR_PROJECT
        depends on SEC_GTACTIVEXL_PROJECT
        default n
        bool "Samsung GTACTIVEXLWIFI EUR OPEN Project"
        help
          Support for Samsung GTACTIVEXLWIFI EUR OPEN Project

config SEC_GTACTIVEXL_MEA_TUR_PROJECT
        depends on SEC_GTACTIVEXL_PROJECT
        default n
        bool "Samsung GTACTIVEXL MEA TUR Project"
        help
          Support for Samsung GTACTIVEXL MEA TUR Project

config SEC_GTACTIVEXL_CAN_SINGLE_PROJECT
        depends on SEC_GTACTIVEXL_PROJECT
        default n
        bool "Samsung GTACTIVEXL CAN SINGLE Project"
        help
          Support for Samsung GTACTIVEXL CAN SINGLE Project		  
		  
		  
```

## arch/arm64/Kconfig.tabs7l
```kconfig
config MACH_GTS7LWIFI_EUR_OPEN
	default n
	bool "Samsung GTS7LWIFI EUR OPEN"
	help
	  Support for Samsung GTS7LWIFI EUR OPEN device.
```

## arch/arm64/Kconfig.tabs7xl
```kconfig
config MACH_GTS7XLWIFI_EUR_OPEN
	default n
	bool "Samsung GTS7XLWIFI EUR OPEN"
	help
	  Support for Samsung GTS7XLWIFI EUR OPEN device.
```
