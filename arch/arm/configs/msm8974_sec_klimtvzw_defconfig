## arch/arm/configs/msm8974_sec_klimtvzw_defconfig
```kconfig
# klimt lte config
CONFIG_MACH_KLIMT=y
CONFIG_MACH_KLIMT_LTE=y
CONFIG_MACH_KLIMT_VZW=y
# MAXIM 77888
CONFIG_MFD_MAX77888=y
CONFIG_CHARGER_MAX77888=y
CONFIG_REGULATOR_MAX77888=y
CONFIG_MUIC_MAX77888_SUPPORT_SMART_DOCK=y
CONFIG_LEDS_MAX77888=y

# HALL SENSOR
CONFIG_SENSORS_HALL=y

CONFIG_FUELGAUGE_MAX17050=y
CONFIG_FUELGAUGE_MAX17050_COULOMB_COUNTING=y
CONFIG_CHARGING_VZWCONCEPT=y

# Earjack
CONFIG_SAMSUNG_JACK=y
CONFIG_INPUT_GPIO=y

# DHA Solution
CONFIG_SEC_DHA_SOL_MAL=y

#AUDIO
CONFIG_LDO_SUBMIC_BIAS=y

CONFIG_BATTERY_SAMSUNG=y
CONFIG_BATTERY_SAMSUNG_DATA_FILE="klimt_battery_data.h"
CONFIG_SAMSUNG_LPM_MODE=y

# Touchscreen
#CONFIG_TOUCHSCREEN_SYNAPTICS_DSX_I2C is not set
CONFIG_TOUCHSCREEN_SYNAPTICS_I2C_RMI=y
CONFIG_KEYBOARD_CYPRESS_TOUCHKEY_H=y

#VIBRATOR
CONFIG_MOTOR_DRV_MAX77888=y
CONFIG_VIBETONZ=y

#LED
CONFIG_LEDS_QPNP=y

# Display
CONFIG_LCD_CLASS_DEVICE=y
CONFIG_BACKLIGHT_LCD_SUPPORT=y
CONFIG_BACKLIGHT_CLASS_DEVICE=y
CONFIG_FB_MSM_MIPI_SAMSUNG_OCTA_CMD_WQXGA_S6E3HA1_PT_PANEL=y
CONFIG_MDNIE_LITE_TUNING=y

#
# Remove Qualcomm Wifi features
#
# CONFIG_WCNSS_CORE is not set
# CONFIG_WCNSS_CORE_PRONTO is not set
# CONFIG_WCNSS_MEM_PRE_ALLOC is not set
# CONFIG_MSM_PIL_PRONTO is not set

#
# Add Broadcomm Wifi features
#
CONFIG_NET_CORE=y
CONFIG_WIRELESS=y
CONFIG_WIRELESS_EXT_SYSFS=y
CONFIG_WEXT_CORE=y
CONFIG_WEXT_PROC=y
CONFIG_CFG80211=y
CONFIG_CFG80211_DEFAULT_PS=y
CONFIG_CFG80211_ALLOW_RECONNECT=y
CONFIG_WLAN=y
CONFIG_WIFI_CONTROL_FUNC=y
CONFIG_BCM4354=y
CONFIG_BCMDHD_FW_PATH="/system/etc/wifi/bcmdhd_sta.bin"
CONFIG_BCMDHD_NVRAM_PATH="/system/etc/wifi/nvram_net.txt"
CONFIG_BROADCOM_WIFI_RESERVED_MEM=y
CONFIG_WLAN_REGION_CODE=403
CONFIG_MMC_MSM_SDC2_SUPPORT=y
CONFIG_CFG80211_REG_NOT_UPDATED=y
CONFIG_WIFI_MULTICAST_LOG=y

#
# BT
#
CONFIG_BT_BCM4354=y

CONFIG_MHL_VERSION=0x21

#USB
CONFIG_USB_STORAGE_DETECT=y
CONFIG_USB_HOST_NOTIFY=y
CONFIG_USB_DEBUG_DETEAILED_LOG=y

#ethernet driver
CONFIG_USB_NET_SMSC75XX=y
CONFIG_USB_NET_SMSC95XX=y

#SENSOR
CONFIG_STAGING=y
# CONFIG_IIO is not set
# CONFIG_IIO_BUFFER is not set
# CONFIG_IIO_SW_RING is not set
# CONFIG_IIO_KFIFO_BUF is not set
# CONFIG_INV_MPU_IIO is not set
# CONFIG_SENSORS_GP2A_IIO is not set
# CONFIG_SENSORS_CORE is not set
# CONFIG_INV_TESTING is not set
# Sensors
CONFIG_SENSORS=y
CONFIG_SENSORS_BMI055=y
CONFIG_SENSORS_CM3323=y
CONFIG_SENSORS_AK09911C=y
CONFIG_SENSORS_SX9500=y
CONFIG_SENSORS_SX9500_INIT_TOUCH_THRESHOLD=8000
CONFIG_SENSORS_SX9500_NORMAL_TOUCH_THRESHOLD=9
#
# Finger print sensor
#
CONFIG_SENSORS_FINGERPRINT=y
CONFIG_SENSORS_FINGERPRINT_SYSFS=y
CONFIG_SENSORS_VFS61XX=y
CONFIG_SENSORS_VFS61XX_KO=y

CONFIG_SEC_FPGA=y
CONFIG_IR_REMOCON_FPGA=y

CONFIG_MSM_DMA_TEST=y
CONFIG_MEDIA_TUNER_SIMPLE=y
CONFIG_MEDIA_TUNER_TDA8290=y
CONFIG_MEDIA_TUNER_TDA827X=y
CONFIG_MEDIA_TUNER_TDA18271=y
CONFIG_MEDIA_TUNER_TDA9887=y
CONFIG_MEDIA_TUNER_TEA5761=y
CONFIG_MEDIA_TUNER_TEA5767=y
CONFIG_MEDIA_TUNER_MT20XX=y
CONFIG_MEDIA_TUNER_MT2060=y
CONFIG_MEDIA_TUNER_MT2063=y
CONFIG_MEDIA_TUNER_MT2266=y
CONFIG_MEDIA_TUNER_MT2131=y
CONFIG_MEDIA_TUNER_QT1010=y
CONFIG_MEDIA_TUNER_XC2028=y
CONFIG_MEDIA_TUNER_XC5000=y
CONFIG_MEDIA_TUNER_XC4000=y
CONFIG_MEDIA_TUNER_MXL5005S=y
CONFIG_MEDIA_TUNER_MXL5007T=y
CONFIG_MEDIA_TUNER_MC44S803=y
CONFIG_MEDIA_TUNER_MAX2165=y
CONFIG_MEDIA_TUNER_TDA18218=y
CONFIG_MEDIA_TUNER_TDA18212=y
CONFIG_USB_GSPCA=y

# SSWAP
CONFIG_SWAP=y
CONFIG_FRONTSWAP=y
CONFIG_ZSMALLOC_NEW=y
CONFIG_PGTABLE_MAPPING=y
CONFIG_ZSWAP=y
CONFIG_DIRECT_RECLAIM_FILE_PAGES_ONLY=n
CONFIG_INCREASE_MAXIMUM_SWAPPINESS=y
CONFIG_FIX_INACTIVE_RATIO=y
CONFIG_TIGHT_PGDAT_BALANCE=y
CONFIG_VNSWAP=y
CONFIG_SWAP_ENABLE_READAHEAD=n

# RCU
CONFIG_RCU_FAST_NO_HZ=y
CONFIG_RCU_FAST_NO_HZ_OFF_AT_BOOT=y

#Inside Secure
CONFIG_INSIDESECURE_VPNCLIENT=y

# MODEM SECURE CHECK
CONFIG_SEC_PERIPHERAL_SECURE_CHK=y
```

## arch/arm/configs/msm8974_sec_ks01_lgt_defconfig
```kconfig
# from msm8974_sec_defconfig
CONFIG_AUDIT=y
# CONFIG_MSM_PIL_PRONTO is not set
CONFIG_NET_KEY=y
CONFIG_IP_MULTICAST=y
CONFIG_INET_XFRM_MODE_TRANSPORT=y
CONFIG_INET_XFRM_MODE_TUNNEL=y
CONFIG_NF_CONNTRACK_SECMARK=y
# CONFIG_NF_CONNTRACK_SIP is not set
CONFIG_NETFILTER_XT_TARGET_CONNSECMARK=y
CONFIG_NETFILTER_XT_TARGET_NOTRACK=y
CONFIG_NETFILTER_XT_TARGET_SECMARK=y
CONFIG_NETFILTER_XT_TARGET_TCPMSS=y
CONFIG_IP_NF_SECURITY=y
CONFIG_PPP=y
CONFIG_PPP_BSDCOMP=y
CONFIG_PPP_DEFLATE=y
CONFIG_PPP_MPPE=y
CONFIG_PPPOLAC=y
CONFIG_PPPOPNS=y
# CONFIG_WCNSS_CORE is not set
# CONFIG_WCNSS_CORE_PRONTO is not set
# CONFIG_WCNSS_MEM_PRE_ALLOC is not set
CONFIG_SENSORS_QPNP_ADC_CURRENT=y
CONFIG_IMX132=y
CONFIG_MSM_WFD=y
# CONFIG_FB_MSM_MDSS_HDMI_MHL_SII8334 is not set
CONFIG_FB_MSM_MDSS_DBG_SEQ_TICK=y
CONFIG_FB_MSM_MDSS_DSI_DBG=y
CONFIG_SND_SOC_MSM_HDMI_CODEC_RX=y
CONFIG_LCD_CLASS_DEVICE=y
CONFIG_BACKLIGHT_LCD_SUPPORT=y
CONFIG_BACKLIGHT_CLASS_DEVICE=y
CONFIG_MDNIE_LITE_TUNING=y
CONFIG_LEDS_AN30259A=y
CONFIG_FB_MSM_MIPI_SAMSUNG_OCTA_VIDEO_FULL_HD_PT_PANEL=y
# CONFIG_IIO is not set
# CONFIG_IIO_BUFFER is not set
# CONFIG_IIO_SW_RING is not set
# CONFIG_IIO_KFIFO_BUF is not set
# CONFIG_INV_MPU_IIO is not set
# CONFIG_SENSORS_GP2A_IIO is not set
# CONFIG_SENSORS_CORE is not set
# CONFIG_INV_TESTING is not set
CONFIG_EXT4_FS_SECURITY=y
CONFIG_ENABLE_DEFAULT_TRACERS=y
CONFIG_SECURITY=y
CONFIG_SECURITY_NETWORK=y
CONFIG_LSM_MMAP_MIN_ADDR=4096
CONFIG_SECURITY_SELINUX=y

# HLTE config
CONFIG_SEC_KS01_PROJECT=y
CONFIG_SEC_LOCALE_KOR=y
#CONFIG_SEC_LOCALE_KOR_H=y
CONFIG_MACH_KS01LGT=y

#
# MAX77803 IC
#
CONFIG_MAX77803_MUIC=y
CONFIG_MFD_MAX77803=y
CONFIG_REGULATOR_MAX77803=y
CONFIG_MOTOR_DRV_MAX77803=y
CONFIG_VIBETONZ=y
CONFIG_TACTILE_ASSIST=y
CONFIG_LEDS_MAX77803=y

#
# Battery & Charger
#
CONFIG_BATTERY_SAMSUNG=y
CONFIG_SAMSUNG_LPM_MODE=y
# CONFIG_SMB350_CHARGER is not set
# CONFIG_BATTERY_BQ28400 is not set
# CONFIG_BATTERY_MSM is not set
# CONFIG_FUELGAUGE_DUMMY is not set
#
# MAX77803 Charger
#
# CONFIG_QPNP_CHARGER is not set
# CONFIG_QPNP_BMS is not set
CONFIG_FUELGAUGE_MAX17048=y
CONFIG_CHARGER_MAX77803=y

CONFIG_I2C_GPIO=y

#
# Actuator
#
CONFIG_I2C_ACTUATOR=y

# BT
CONFIG_BT_BCM4335=y
CONFIG_HID_KK_UPGRADE=y

# Earjack
# CONFIG_SAMSUNG_JACK is not set
CONFIG_INPUT_GPIO=y

# DHA Solution
CONFIG_SEC_DHA_SOL_MAL=y

# Ringtone Gain
CONFIG_SEC_DEVIDE_RINGTONE_GAIN=y

#
# Remove Qualcomm Wifi features
#
CONFIG_MSM_PIL_PRONTO=n
CONFIG_WCNSS_CORE=n
CONFIG_WCNSS_CORE_PRONTO=n
#
# Wifi features (Broadcomm)
#
CONFIG_MODULES=y
CONFIG_MODULE_UNLOAD=y
CONFIG_MODULE_FORCE_UNLOAD=y
CONFIG_NET_CORE=y
CONFIG_WIRELESS=y
CONFIG_WIRELESS_EXT_SYSFS=y
CONFIG_WEXT_CORE=y
CONFIG_WEXT_PROC=y
CONFIG_CFG80211=y
CONFIG_CFG80211_DEFAULT_PS=y
CONFIG_CFG80211_ALLOW_RECONNECT=y
CONFIG_WLAN=y
CONFIG_WIFI_CONTROL_FUNC=y
CONFIG_BCM4335=y
CONFIG_BROADCOM_WIFI_RESERVED_MEM=y
CONFIG_WLAN_REGION_CODE=203
CONFIG_MMC_MSM_SDC2_SUPPORT=y

# usb host
CONFIG_USB_STORAGE_DETECT=y
CONFIG_USB_HOST_NOTIFY=y

# Input Devices
CONFIG_TOUCHSCREEN_SYNAPTICS_I2C_RMI=n
CONFIG_TOUCHSCREEN_SYNAPTICS_I2C_RMI_S5000=y
CONFIG_KEYBOARD_CYPRESS_TOUCHKEY_KS01=y
#CONFIG_INPUT_WACOM=y
#
# eDP ESD FUNCTION
#
CONFIG_EDP_ESD_FUNCTION=y
CONFIG_EDP_TCON_MDNIE=y

#
# Sensor hub
#
CONFIG_SENSORS_SSP_ATMEL=y
CONFIG_SENSORS_SSP_MAX88920=y
CONFIG_SENSORS_SSP_CM3320=y
CONFIG_SENSORS_SSP=y
CONFIG_SENSORS_SYSFS=y
CONFIG_SENSORS_SSP_FACTORY=y
CONFIG_SENSORS_SSP_MPU6500=y
CONFIG_SENSORS_SSP_YAS532=y
CONFIG_SENSORS_SSP_BMP182=y
CONFIG_SENSORS_SSP_SHTC1=y
CONFIG_SENSORS_SSP_ATUC128L5HAR=y
CONFIG_SENSORS_SSP_SENSORHUB=y
CONFIG_SEC_FPGA=y
CONFIG_IR_REMOCON_FPGA=y
CONFIG_SENSORS_ADSP=n
# Audience
CONFIG_SND_SOC_ES325=y
CONFIG_SND_SOC_ES325_SLIM=y
CONFIG_FW_LOADER=y
CONFIG_FIRMWARE_IN_KERNEL=y
CONFIG_EXTRA_FIRMWARE="audience-es325-fw-kor-ks01.bin"
CONFIG_EXTRA_FIRMWARE_DIR="firmware/es325"

#Debug
# CONFIG_ANDROID_RAM_CONSOLE is not set
CONFIG_SEC_LOG_LAST_KMSG=y
CONFIG_SEC_DEBUG_NOCACHE_LOG_IN_LEVEL_LOW=y

# Hall ic
CONFIG_SENSORS_HALL=y

# DMB
CONFIG_TDMB=y
CONFIG_TDMB_VENDOR_FCI=y
CONFIG_TDMB_FC8050=y
CONFIG_TDMB_SPI=y
CONFIG_TDMB_ANT_DET=y
CONFIG_TDMB_QUALCOMM=y

# NFC
CONFIG_BCM2079X_NFC_I2C=y

# SSWAP
CONFIG_SWAP=y
CONFIG_FRONTSWAP=y
CONFIG_ZSMALLOC_NEW=y
CONFIG_PGTABLE_MAPPING=y
CONFIG_ZSWAP=y
CONFIG_DIRECT_RECLAIM_FILE_PAGES_ONLY=n
CONFIG_INCREASE_MAXIMUM_SWAPPINESS=y
CONFIG_FIX_INACTIVE_RATIO=y
CONFIG_TIGHT_PGDAT_BALANCE=y
CONFIG_VNSWAP=y
CONFIG_SWAP_ENABLE_READAHEAD=n

# LGU I-WLAN
CONFIG_LGUIWLAN=y
CONFIG_MODULES=y
CONFIG_MODULE_UNLOAD=y
CONFIG_MODULE_FORCE_UNLOAD=y

# SDC3
CONFIG_MMC_MSM_SDC3_SUPPORT=y

CONFIG_SEC_DEBUG_LMK_MEMINFO=y
```

## arch/arm/configs/msm8974_sec_ks01eur_defconfig
```kconfig
CONFIG_SEC_LOCALE_KOR=y
CONFIG_SEC_OPERATOR_OPEN=y
CONFIG_MACH_KS01SKT=y
CONFIG_MACH_KS01EUR=y
CONFIG_LCD_CLASS_DEVICE=y
CONFIG_BACKLIGHT_LCD_SUPPORT=y
CONFIG_BACKLIGHT_CLASS_DEVICE=y
CONFIG_MDNIE_LITE_TUNING=y
CONFIG_LEDS_AN30259A=y
CONFIG_FB_MSM_MIPI_SAMSUNG_OCTA_VIDEO_FULL_HD_PT_PANEL=y
#
# ODE and DIR Encryption
#
CONFIG_CRYPTO=y
CONFIG_CRYPTO_SHA1=y
CONFIG_CRYPTO_SHA256=y
CONFIG_CRYPTO_AES=y
CONFIG_CRYPTO_CBC=y
CONFIG_ECRYPT_FS=y
CONFIG_WTL_ENCRYPTION_FILTER=y
CONFIG_KEYS=y
CONFIG_KEYS_DEBUG_PROC_KEYS=y

# TSP and TOUCHKEY
CONFIG_KEYBOARD_CYPRESS_TOUCH=y
CONFIG_KEYBOARD_CYPRESS_TOUCHKEY_KS01=y
CONFIG_TOUCHSCREEN_SYNAPTICS_I2C_RMI_S5000=y
# BT
CONFIG_BT_BCM4335=y


#
# Remove Qualcomm Wifi features
#
CONFIG_MSM_PIL_PRONTO=n
CONFIG_WCNSS_CORE=n
CONFIG_WCNSS_CORE_PRONTO=n
#
# Wifi features (Broadcomm)
#
CONFIG_MODULES=y
CONFIG_MODULE_UNLOAD=y
CONFIG_MODULE_FORCE_UNLOAD=y
CONFIG_NET_CORE=y
CONFIG_WIRELESS=y
CONFIG_WIRELESS_EXT_SYSFS=y
CONFIG_WEXT_CORE=y
CONFIG_WEXT_PROC=y
CONFIG_CFG80211=y
CONFIG_CFG80211_DEFAULT_PS=y
CONFIG_CFG80211_ALLOW_RECONNECT=y
CONFIG_WLAN=y
CONFIG_WIFI_CONTROL_FUNC=y
CONFIG_BCM4335=y
CONFIG_BROADCOM_WIFI_RESERVED_MEM=y
CONFIG_WLAN_REGION_CODE=201
CONFIG_MMC_MSM_SDC2_SUPPORT=y

CONFIG_MMC_MSM_SDC3_SUPPORT=y
#
#SKT IWLAN
#
CONFIG_XFRM=y
CONFIG_XFRM_USER=y
CONFIG_NET_KEY=y
CONFIG_INET_ESP=y
CONFIG_INET_IPCOMP=y
CONFIG_INET_XFRM_MODE_TRANSPORT=y
CONFIG_INET_XFRM_MODE_TUNNEL=y
CONFIG_IP_ADVANCED_ROUTER=y
CONFIG_IP_MULTIPLE_TABLES=y
CONFIG_CRYPTO=y
CONFIG_CRYPTO_HMAC=y
CONFIG_CRYPTO_XCBC=y
CONFIG_CRYPTO_NULL=y
CONFIG_CRYPTO_MD5=y
CONFIG_CRYPTO_SHA1=y
CONFIG_CRYPTO_DES=y
CONFIG_CRYPTO_AES=y
CONFIG_CRYPTO_DEFLATE=y
#
# MAX77803 Charger
#
CONFIG_BATTERY_SAMSUNG=y
CONFIG_SAMSUNG_LPM_MODE=y
CONFIG_FUELGAUGE_MAX17048=y
CONFIG_CHARGER_MAX77803=y
CONFIG_SENSORS_HALL=y
#
# MAX77803 IC
#
CONFIG_MFD_MAX77803=y
CONFIG_MAX77803_MUIC=y
CONFIG_REGULATOR_MAX77803=y
CONFIG_MOTOR_DRV_MAX77803=y
CONFIG_VIBETONZ=y
CONFIG_TACTILE_ASSIST=y
CONFIG_LEDS_MAX77803=y
CONFIG_USB_PRINTER=y
CONFIG_USB_STORAGE_DETECT=y
CONFIG_USB_HOST_NOTIFY=y
CONFIG_USB=y
#
# DWC3 usb 3.0 driver
#
CONFIG_USB_XHCI_HCD=y
CONFIG_USB_DWC3=y
CONFIG_USB_DWC3_MSM=y
#
# Sensor hub
#
CONFIG_SENSORS_SSP_ATMEL=y
CONFIG_SENSORS_SSP_CM3320=y
CONFIG_SENSORS_SSP_MAX88920=y
CONFIG_BCM2079X_NFC_I2C=y
CONFIG_SENSORS_SSP=y
CONFIG_SENSORS_SYSFS=y
CONFIG_SENSORS_SSP_FACTORY=y
CONFIG_SENSORS_SSP_MPU6500=y
CONFIG_SENSORS_SSP_YAS532=y
CONFIG_SENSORS_SSP_BMP182=y
CONFIG_SENSORS_SSP_SHTC1=y
CONFIG_SENSORS_SSP_ATUC128L5HAR=y
CONFIG_SENSORS_SSP_SENSORHUB=y
#
# Actuator
#
CONFIG_I2C_ACTUATOR=y
# DHA Solution
CONFIG_SEC_DHA_SOL_MAL=y
# Ringback tone gain devide
CONFIG_SEC_DEVIDE_RINGTONE_GAIN=n
# Audience
CONFIG_SND_SOC_ES325=y
CONFIG_SND_SOC_ES325_SLIM=y
CONFIG_FW_LOADER=y
CONFIG_FIRMWARE_IN_KERNEL=y
CONFIG_EXTRA_FIRMWARE="audience-es325-fw-KS01-eur.bin"
CONFIG_EXTRA_FIRMWARE_DIR="firmware"

# SSWAP
CONFIG_SWAP=y
CONFIG_FRONTSWAP=y
CONFIG_ZSMALLOC_NEW=y
CONFIG_PGTABLE_MAPPING=y
CONFIG_ZSWAP=y
CONFIG_DIRECT_RECLAIM_FILE_PAGES_ONLY=n
CONFIG_INCREASE_MAXIMUM_SWAPPINESS=y
CONFIG_FIX_INACTIVE_RATIO=y
CONFIG_TIGHT_PGDAT_BALANCE=y
CONFIG_VNSWAP=y
CONFIG_SWAP_ENABLE_READAHEAD=n

CONFIG_BCMDHD_FW_PATH="/system/etc/wifi/bcmdhd_sta.bin"
CONFIG_BCMDHD_NVRAM_PATH="/system/etc/wifi/nvram_net.txt"
CONFIG_SEC_DEBUG_LMK_MEMINFO_VERBOSE=y
CONFIG_SEC_OOM_KILLER=y
CONFIG_SEC_LOG_LAST_KMSG=y
CONFIG_USER_RESET_DEBUG=y
CONFIG_SEC_FPGA=y
CONFIG_IR_REMOCON_FPGA=y
```

## arch/arm/configs/msm8974_sec_mondrianlte_att_defconfig
```kconfig
# mondrian lte config
CONFIG_MACH_MONDRIAN=y
CONFIG_MACH_MONDRIAN_LTE=y
CONFIG_MACH_MONDRIANATT=y

# MAXIM 77888
CONFIG_MFD_MAX77888=y
CONFIG_CHARGER_MAX77888=y
CONFIG_REGULATOR_MAX77888=y
CONFIG_MUIC_MAX77888_SUPPORT_SMART_DOCK=y

# HALL SENSOR
CONFIG_SENSORS_HALL=y

CONFIG_FUELGAUGE_MAX17050=y
CONFIG_FUELGAUGE_MAX17050_COULOMB_COUNTING=y

# Earjack
CONFIG_SAMSUNG_JACK=y
CONFIG_INPUT_GPIO=y

# DHA Solution
CONFIG_SEC_DHA_SOL_MAL=y

CONFIG_BATTERY_SAMSUNG=y
CONFIG_SAMSUNG_LPM_MODE=y

# Touchscreen
#CONFIG_TOUCHSCREEN_SYNAPTICS_DSX_I2C is not set
CONFIG_TOUCHSCREEN_SYNAPTICS_I2C_RMI=y

#VIBRATOR
CONFIG_MSM_VIBRATOR=y

#LED
CONFIG_LEDS_QPNP=y

# Display
CONFIG_CABC_TUNING=y
CONFIG_FB_MSM_MIPI_SAMSUNG_TFT_VIDEO_WQXGA_PT_PANEL=y

#
# Enable Qualcomm Wifi features
#
CONFIG_MSM_PIL_PRONTO=y
CONFIG_WCNSS_CORE=y
CONFIG_WCNSS_CORE_PRONTO=y
CONFIG_WCNSS_MEM_PRE_ALLOC=y

#
# Wifi features (Qualcomm)
#
CONFIG_NET_CORE=y
CONFIG_WIRELESS=y
CONFIG_WIRELESS_EXT_SYSFS=y
CONFIG_WEXT_CORE=y
CONFIG_WEXT_PROC=y
CONFIG_CFG80211=y
CONFIG_CFG80211_WEXT=y
CONFIG_CFG80211_DEFAULT_PS=y
# CONFIG_CFG80211_ALLOW_RECONNECT is not set
CONFIG_WLAN=y
CONFIG_WIRELESS_EXT=y
CONFIG_WEXT_PRIV=y

CONFIG_MODULES=y
CONFIG_MODULE_UNLOAD=y
CONFIG_MODULE_FORCE_UNLOAD=y
CONFIG_WCNSS_REGISTER_DUMP_ON_BITE =y

#
# Wifi features (Broadcomm)
# CONFIG_BCM4339 is not set
# CONFIG_BCMDHD_FW_PATH is not set
# CONFIG_BCMDHD_NVRAM_PATH is not set
# CONFIG_BROADCOM_WIFI_RESERVED_MEM is not set
# CONFIG_WLAN_REGION_CODE is not set
# CONFIG_MMC_MSM_SDC2_SUPPORT is not set
# CONFIG_H_EUR_WIFI is not set

CONFIG_MHL_VERSION=0x21

#USB
CONFIG_USB_STORAGE_DETECT=y
CONFIG_USB_HOST_NOTIFY=y
CONFIG_USB_DEBUG_DETEAILED_LOG=y

#ethernet driver
CONFIG_USB_NET_SMSC75XX=y
CONFIG_USB_NET_SMSC95XX=y

#SENSOR
CONFIG_STAGING=y
CONFIG_IIO=y
CONFIG_IIO_BUFFER=y
CONFIG_IIO_SW_RING=y
CONFIG_IIO_KFIFO_BUF=y
CONFIG_INV_MPU_IIO=y
# CONFIG_INV_TESTING is not set
CONFIG_SENSORS=y
CONFIG_SENSORS_GP2A030A=y
CONFIG_SENSORS_GP2A030A_PROX=y
CONFIG_SENSORS_SX9500=y
CONFIG_SENSORS_SX9500_INIT_TOUCH_THRESHOLD=3000
CONFIG_SENSORS_SX9500_NORMAL_TOUCH_THRESHOLD=17

CONFIG_SEC_FPGA=y
CONFIG_IR_REMOCON_FPGA=y

CONFIG_MSM_DMA_TEST=y
CONFIG_MEDIA_TUNER_SIMPLE=y
CONFIG_MEDIA_TUNER_TDA8290=y
CONFIG_MEDIA_TUNER_TDA827X=y
CONFIG_MEDIA_TUNER_TDA18271=y
CONFIG_MEDIA_TUNER_TDA9887=y
CONFIG_MEDIA_TUNER_TEA5761=y
CONFIG_MEDIA_TUNER_TEA5767=y
CONFIG_MEDIA_TUNER_MT20XX=y
CONFIG_MEDIA_TUNER_MT2060=y
CONFIG_MEDIA_TUNER_MT2063=y
CONFIG_MEDIA_TUNER_MT2266=y
CONFIG_MEDIA_TUNER_MT2131=y
CONFIG_MEDIA_TUNER_QT1010=y
CONFIG_MEDIA_TUNER_XC2028=y
CONFIG_MEDIA_TUNER_XC5000=y
CONFIG_MEDIA_TUNER_XC4000=y
CONFIG_MEDIA_TUNER_MXL5005S=y
CONFIG_MEDIA_TUNER_MXL5007T=y
CONFIG_MEDIA_TUNER_MC44S803=y
CONFIG_MEDIA_TUNER_MAX2165=y
CONFIG_MEDIA_TUNER_TDA18218=y
CONFIG_MEDIA_TUNER_TDA18212=y
CONFIG_USB_GSPCA=y

# SSWAP
CONFIG_SWAP=y
CONFIG_FRONTSWAP=y
CONFIG_ZSMALLOC_NEW=y
CONFIG_PGTABLE_MAPPING=y
CONFIG_ZSWAP=y
CONFIG_DIRECT_RECLAIM_FILE_PAGES_ONLY=n
CONFIG_INCREASE_MAXIMUM_SWAPPINESS=y
CONFIG_FIX_INACTIVE_RATIO=y
CONFIG_TIGHT_PGDAT_BALANCE=y
CONFIG_VNSWAP=y
CONFIG_SWAP_ENABLE_READAHEAD=n

#Inside Secure
CONFIG_INSIDESECURE_VPNCLIENT=y
```
