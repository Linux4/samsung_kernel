## arch/arm64/configs/S96818BA1_defconfig
```kconfig
CONFIG_PREEMPT=y
CONFIG_IKHEADERS=m
CONFIG_LOG_BUF_SHIFT=21
CONFIG_UCLAMP_TASK=y
CONFIG_UCLAMP_TASK_GROUP=y
CONFIG_CPUSETS=y
CONFIG_SCHED_TUNE=y
# CONFIG_RD_BZIP2 is not set
# CONFIG_RD_LZMA is not set
# CONFIG_RD_XZ is not set
# CONFIG_RD_LZO is not set
# CONFIG_RD_LZ4 is not set
CONFIG_SYSCTL_SYSCALL=y
# CONFIG_FHANDLE is not set
# CONFIG_KALLSYMS_BASE_RELATIVE is not set
CONFIG_MTK_SCHED_EXTENSION=y
CONFIG_MTK_IDLE_BALANCE_ENHANCEMENT=y
CONFIG_MTK_SCHED_INTEROP=y
CONFIG_MTK_SCHED_LB_ENHANCEMENT=y
CONFIG_MTK_SCHED_TRACERS=y
CONFIG_MTK_SCHED_CPU_PREFER=y
CONFIG_MTK_SCHED_BIG_TASK_MIGRATE=y
# CONFIG_SLUB_DEBUG is not set
CONFIG_MACH_MT6768=y
CONFIG_SCHED_MC=y
CONFIG_NR_CPUS=8
CONFIG_RANDOMIZE_BASE=y
CONFIG_CMDLINE="console=tty0 console=ttyMT3,921600n1 root=/dev/ram vmalloc=496M slub_max_order=0 slub_debug=O "
# CONFIG_EFI is not set
CONFIG_WQ_POWER_EFFICIENT_DEFAULT=y
CONFIG_ENERGY_MODEL=y
CONFIG_CPU_FREQ=y
CONFIG_CPU_FREQ_STAT=y
CONFIG_CPU_FREQ_DEFAULT_GOV_SCHEDUTIL=y
CONFIG_CPU_FREQ_GOV_POWERSAVE=y
CONFIG_CPU_FREQ_GOV_USERSPACE=y
CONFIG_CPU_FREQ_GOV_ONDEMAND=y
CONFIG_MODULE_SRCVERSION_ALL=y
# CONFIG_BLK_DEV_BSG is not set
CONFIG_BLK_INLINE_ENCRYPTION=y
CONFIG_BLK_INLINE_ENCRYPTION_FALLBACK=y
# CONFIG_CORE_DUMP_DEFAULT_ELF_HEADERS is not set
CONFIG_ZSMALLOC=y
CONFIG_XFRM_MIGRATE=y
CONFIG_SYN_COOKIES=y
CONFIG_VLAN_8021Q=y
CONFIG_CLS_U32_PERF=y
CONFIG_CLS_U32_MARK=y
CONFIG_CFG80211=y
CONFIG_NL80211_TESTMODE=y
CONFIG_CFG80211_DEVELOPER_WARNINGS=y
# CONFIG_CFG80211_DEFAULT_PS is not set
# CONFIG_UEVENT_HELPER is not set
CONFIG_FW_LOADER_USER_HELPER=y
CONFIG_FW_LOADER_USER_HELPER_FALLBACK=y
# CONFIG_FW_CACHE is not set
CONFIG_ZRAM=y
CONFIG_BLK_DEV_LOOP_MIN_COUNT=16
CONFIG_ANDROID_DEFAULT_SETTING=y
CONFIG_MTK_ANDROID_DEFAULT_SETTING=y
CONFIG_USB_MTK_HDRC=y
CONFIG_MTK_MUSB_QMU_SUPPORT=y
CONFIG_MTK_MUSB_QMU_PURE_ZLP_SUPPORT=y
CONFIG_MTK_MUSB_DRV_36BIT=y
CONFIG_USB_MTK_OTG=y
CONFIG_MTK_MUSB_DUAL_ROLE=y
CONFIG_MTK_TC10_FEATURE=y
CONFIG_MTK_PLATFORM="mt6768"
CONFIG_ARCH_MTK_PROJECT="S96818BA1"
CONFIG_NONLINEAR_FREQ_CTL=y
CONFIG_PMIC_LBAT_SERVICE=y
CONFIG_MTK_PTPOD=y
CONFIG_MTK_STATIC_POWER=y
CONFIG_MTK_UNIFY_POWER=y
CONFIG_MTK_CPU_FREQ=y
CONFIG_MTK_PBM=y
CONFIG_MTK_PMIC_NEW_ARCH=y
CONFIG_MTK_PMIC_COMMON=y
CONFIG_MTK_PMIC_CHIP_MT6358=y
CONFIG_MTK_EXTERNAL_CHARGER_TYPE_DETECT=y
# CONFIG_MFD_MT6370_PMU=y
# CONFIG_MT6370_PMU_CHARGER=y
# CONFIG_MT6370_PMU_FLED=n
# CONFIG_MT6370_PMU_BLED=n
# CONFIG_MT6370_PMU_LDO=n
# CONFIG_MT6370_PMU_DSV=n
CONFIG_CHARGER_SC89601=y
CONFIG_CHARGER_SD7601=y
CONFIG_CHARGER_UPM6910=y
CONFIG_CHARGER_PUMP=y
CONFIG_MTK_CLASS=y
# CONFIG_BATTERY_MT6357=y
# CONFIG_CHARGER_TYPE_MT6357=y
CONFIG_MTK_PMIC_WRAP_HAL=y
CONFIG_MTK_SEC_VIDEO_PATH_SUPPORT=y
CONFIG_MTK_DRM_KEY_MNG_SUPPORT=y
CONFIG_CUSTOM_KERNEL_IMGSENSOR="n28hi5021qreartruly_mipi_raw n28hi5021qreardc_mipi_raw n28hi5022qreartxd_mipi_raw n28gc50e0reargkw_mipi_raw n28s5kjn1reartruly_mipi_raw n28s5kjn1reardc_mipi_raw n28hi846fronttruly_mipi_raw n28gc08a3frontcxt_mipi_raw n28sc800csfrontdc_mipi_raw n28c8496frontdc_mipi_raw n28sc800csafrontdc_mipi_raw n28c2519depcxt_mipi_mono n28c2519depcxt2_mipi_mono n28c2519depcxt3_mipi_mono n28c2519depcxt4_mipi_mono n28c2519depcxt5_mipi_mono n28gc2375hdeplh_mipi_raw n28gc2375hdeplh2_mipi_raw n28gc2375hdeplh3_mipi_raw n28gc2375hdeplh4_mipi_raw n28gc2375hdeplh5_mipi_raw"
CONFIG_MTK_LCM=y
#+S96818BA1-1936,liyuhong1.wt,add,2023/08/22,icnl9916c lcd bringup
CONFIG_CUSTOM_KERNEL_LCM="n28_nt36528_dsi_vdo_hdp_truly_truly n28_ft8057s_dsi_vdo_hdp_dsbj_mantix n28_td4160_dsi_vdo_hdp_xinxian_inx n28_gc7272_dsi_vdo_hdp_txd_sharp n28_td4160_dsi_vdo_hdp_boe_boe n28_icnl9916c_dsi_vdo_hdp_xinxian_hkc n28_icnl9916c_dsi_vdo_hdp_dsbj_mdt virtual_dsi_vdo_default"
#-S96818BA1-1936,liyuhong1.wt,add,2023/08/22,icnl9916c lcd bringup
CONFIG_LCM_HEIGHT="1600"
CONFIG_LCM_WIDTH="720"
CONFIG_MTK_SYNC=y
CONFIG_MTK_FB=y
CONFIG_MTK_LCM_PHYSICAL_ROTATION="0"
CONFIG_MTK_AAL_SUPPORT=y
CONFIG_MTK_M4U=y
CONFIG_MTK_FLASHLIGHT=y
#CONFIG_MTK_FLASHLIGHT_MT6370=y
CONFIG_MTK_FLASHLIGHT_OCP8111=y
CONFIG_MTK_PWM=y
#CONFIG_MTK_FLASHLIGHT_PT=y
#CONFIG_MTK_FLASHLIGHT_PT_STRICT=y
#CONFIG_MTK_FLASHLIGHT_DLPT=y
CONFIG_RT_FLASHLIGHT=y
CONFIG_MTK_IMGSENSOR=y
CONFIG_MTK_LENS=y
CONFIG_MTK_CAM_CAL=y
CONFIG_MTK_CMDQ_V3=y
CONFIG_MTK_CMDQ=y
CONFIG_MTK_SMI_EXT=y
CONFIG_MTK_JPEG=y
CONFIG_MTK_CCU=y
CONFIG_MTK_CAM_SECURITY_SUPPORT=y
CONFIG_MTK_CAM_GENIEZONE_SUPPORT=y
CONFIG_MTK_SENSOR_SUPPORT=y
CONFIG_MTK_SENSOR_ARCHITECTURE="1.0"
CONFIG_CUSTOM_KERNEL_ACCELEROMETER=y
CONFIG_MTK_ACCELHUB=y
CONFIG_CUSTOM_KERNEL_ALSPS=y
CONFIG_MTK_ALSPSHUB=y
# CONFIG_CUSTOM_KERNEL_GYROSCOPE is not set
CONFIG_MTK_GYROHUB=y
CONFIG_CUSTOM_KERNEL_MAGNETOMETER=y
CONFIG_MTK_MAGHUB=y
CONFIG_MTK_HWMON=y
CONFIG_CUSTOM_KERNEL_BAROMETER=y
CONFIG_MTK_BAROHUB=y
CONFIG_CUSTOM_KERNEL_STEP_COUNTER=y
CONFIG_MTK_STEPSIGNHUB=y
CONFIG_CUSTOM_KERNEL_SITUATION=y
CONFIG_MTK_STATHUB=y
CONFIG_MTK_WAKEHUB=y
CONFIG_MTK_GLGHUB=y
CONFIG_MTK_PICKUPHUB=y
CONFIG_MTK_DEVICE_ORIENTATION_HUB=y
CONFIG_MTK_MOTION_DETECT_HUB=y
CONFIG_MTK_TILTDETECTHUB=y
CONFIG_CUSTOM_KERNEL_SENSORHUB=y
CONFIG_NANOHUB=y
CONFIG_NANOHUB_MTK_IPI=y
CONFIG_CUSTOM_KERNEL_SENSOR_FUSION=y
CONFIG_CUSTOM_KERNEL_GRV_SENSOR=y
CONFIG_CUSTOM_KERNEL_GMRV_SENSOR=y
CONFIG_CUSTOM_KERNEL_RV_SENSOR=y
CONFIG_CUSTOM_KERNEL_LINEARACCEL_SENSOR=y
CONFIG_CUSTOM_KERNEL_GRAVITY_SENSOR=y
CONFIG_CUSTOM_KERNEL_UNCALI_ACC_SENSOR=y
CONFIG_CUSTOM_KERNEL_UNCALI_GYRO_SENSOR=y
CONFIG_CUSTOM_KERNEL_UNCALI_MAG_SENSOR=y
CONFIG_MTK_UNCALI_MAGHUB=y
CONFIG_MTK_UNCALI_GYROHUB=y
CONFIG_MTK_UNCALI_ACCHUB=y
CONFIG_MTK_CCCI_DEVICES=y
CONFIG_MTK_MD1_SUPPORT=9
CONFIG_MTK_ECCCI_DRIVER=y
CONFIG_MTK_ECCCI_C2K=y
CONFIG_MTK_BTIF=y
CONFIG_MTK_COMBO=y
CONFIG_MTK_COMBO_CHIP_CONSYS_6768=y
CONFIG_MTK_COMBO_GPS=y
CONFIG_MTK_COMBO_WIFI=y
CONFIG_MTK_DHCPV6C_WIFI=y
CONFIG_MTK_GPS_SUPPORT=y
CONFIG_MTK_FMRADIO=y
CONFIG_MTK_FM_CHIP="MT6631_FM"
CONFIG_MTK_CONNSYS_DEDICATED_LOG_PATH=y
CONFIG_MTK_TEE_GP_SUPPORT=y
CONFIG_HAVE_MTK_ENABLE_GENIEZONE=y
CONFIG_MTK_ENABLE_GENIEZONE=y
CONFIG_MTK_GZ_MAIN=y
CONFIG_MTK_GZ_LOG=y
CONFIG_MTK_GZ_VIRTIO=y
CONFIG_MTK_GZ_VIRTIO_IPC=y
CONFIG_MTK_GZ_IRQ=y
CONFIG_HAVE_MTK_GZ_LOG=y
CONFIG_EXTCON_MTK_USB=y
CONFIG_MTK_USB_TYPEC_U3_MUX=y
CONFIG_TCPC_CLASS=y
# CONFIG_TCPC_MT6370=y
CONFIG_TCPC_RT1711H=y
CONFIG_USB_POWER_DELIVERY=y
CONFIG_MTK_LEDS=y
CONFIG_MTK_PWM=y
CONFIG_MTK_ACCDET=y
CONFIG_ACCDET_EINT_IRQ=y
CONFIG_ACCDET_SUPPORT_EINT0=y
CONFIG_MTK_RTC=y
CONFIG_MTK_PERF_COMMON=y
CONFIG_MTK_PERF_TRACKER=y
CONFIG_MTK_LOAD_TRACKER=y
CONFIG_MTK_CPU_CTRL_CFP=y
CONFIG_MTK_PERF_OBSERVER=y
CONFIG_MTK_RESYM=y
CONFIG_MTK_FPSGO_V3=n
CONFIG_MTK_TASK_TURBO=y
CONFIG_MTK_TINYSYS_SCP_SUPPORT=y
CONFIG_MTK_TINYSYS_SSPM_SUPPORT=y
CONFIG_MTK_TINYSYS_SSPM_VERSION="v1"

CONFIG_MTK_MET_PLF=m
CONFIG_MTPROF=y
CONFIG_MTK_AEE_HANGDET=y
CONFIG_MTK_CM_MGR_LEGACY=y
CONFIG_MTK_VIBRATOR=y
CONFIG_MTK_LEGACY_THERMAL=y
CONFIG_MTK_THERMAL_PA_VIA_ATCMD=y
CONFIG_MTK_CAMERA_ISP_RSC_SUPPORT=y
CONFIG_MTK_CAMERA_ISP_WPE_SUPPORT=y
CONFIG_MTK_CAMERA_ISP_DPE_SUPPORT=y
CONFIG_MTK_CAMERA_ISP_FD_SUPPORT=y
CONFIG_MTK_SELINUX_AEE_WARNING=y
CONFIG_MTK_DRAM_LOG_STORE=y
CONFIG_MTK_DRAM_LOG_STORE_ADDR=0x10E700
CONFIG_MTK_DRAM_LOG_STORE_SIZE=0x100
CONFIG_MTK_FREQ_HOPPING=y
CONFIG_SCSI=y
CONFIG_BLK_DEV_SD=y
CONFIG_SCSI_SCAN_ASYNC=y
# CONFIG_SCSI_LOWLEVEL is not set
CONFIG_DM_CRYPT=y
CONFIG_DM_DEFAULT_KEY=y
CONFIG_DM_UEVENT=y
CONFIG_DM_VERITY_AVB=y
CONFIG_DM_VERITY_FEC=y
CONFIG_DM_BOW=y
CONFIG_IFB=y
# CONFIG_ETHERNET is not set
CONFIG_PPP_FILTER=y
CONFIG_PPP_MULTILINK=y
CONFIG_PPPOE=y
CONFIG_PPP_ASYNC=y
CONFIG_PPP_SYNC_TTY=y
CONFIG_USB_USBNET=y
# CONFIG_KEYBOARD_ATKBD is not set
CONFIG_KEYBOARD_MTK=y
#+S96818BA1-2426, wangzhuquan1.wt,add, 20230423,Volume down key + power key enter dump mode for 7 seconds
CONFIG_ONEKEY_REBOOT_NORMAL_MODE=n
CONFIG_ONEKEY_REBOOT_OTHER_MODE=n
CONFIG_KPD_PMIC_LPRST_TD=0
CONFIG_TWOKEY_REBOOT_NORMAL_MODE=y
CONFIG_TWOKEY_REBOOT_OTHER_MODE=y
#-S96818BA1-2426, wangzhuquan1.wt,add, 20230423,Volume down key + power key enter dump mode for 7 seconds
CONFIG_KPD_PWRKEY_USE_PMIC=y
CONFIG_MTK_MRDUMP_KEY=y
# CONFIG_INPUT_MOUSE is not set
CONFIG_INPUT_TOUCHSCREEN=y
CONFIG_TOUCHSCREEN_MTK=y
#+S96818AA1-1936,daijun1.wt,add,2023/08/17,incl9916_hkc tp bringup
CONFIG_TOUCHSCREEN_CHIPONE_N28=y
#-S96818AA1-1936,daijun1.wt,add,2023/08/17,incl9916_hkc tp bringup
CONFIG_TOUCHSCREEN_NT36528_HOSTDL_SPI=y
#+S96818BA1-1936,wangtao14.wt,modify,2023/05/16,ft8057s bringup
CONFIG_TOUCHSCREEN_FTS_FT8057S=y
#-S96818BA1-1936,wangtao14.wt,modify,2023/05/16,ft8057s bringup
#+S96818BA1-1936,daijun1.wt,modify,2023/05/16,td4160 tp bringup
CONFIG_TOUCHSCREEN_OMNIVISION_TCM=y
#-S96818BA1-1936,daijun1.wt,modify,2023/05/16,td4160 tp bringup
#+S96818AA1-1936,wangtao14.wt,modify,2023/07/5,gc7272 bringup
CONFIG_TOUCHSCREEN_GC7272=y
#-S96818AA1-1936,wangtao14.wt,modify,2023/07/5,gc7272 bringup
CONFIG_WT_PROJECT_S96818BA1=y
# CONFIG_TOUCHSCREEN_MTK_TOUCH is not set
CONFIG_INPUT_MISC=y
CONFIG_INPUT_UINPUT=y
# CONFIG_SERIO is not set
# CONFIG_VT is not set
CONFIG_LEGACY_PTY_COUNT=16
# CONFIG_DEVMEM is not set
CONFIG_SERIAL_8250=y
CONFIG_SERIAL_8250_CONSOLE=y
CONFIG_SERIAL_8250_NR_UARTS=2
CONFIG_SERIAL_8250_RUNTIME_UARTS=2
CONFIG_SERIAL_8250_MT6577=y
CONFIG_RPMB=y
CONFIG_I2C_MTK=y
CONFIG_SPI=y
CONFIG_SPI_MT65XX=y
CONFIG_MTK_CHARGER=y
#CONFIG_CHARGER_MANAGER=y
CONFIG_MTK_KERNEL_POWER_OFF_CHARGING=y
CONFIG_MTK_GAUGE_VERSION=30
# CONFIG_HWMON is not set
CONFIG_THERMAL=y
CONFIG_THERMAL_DEFAULT_GOV_BACKWARD_COMPATIBLE=y
CONFIG_WATCHDOG=y
CONFIG_MEDIATEK_WATCHDOG=y
CONFIG_MT6358_MISC=y
CONFIG_REGULATOR_MT6358=y
CONFIG_MEDIA_SUPPORT=y
CONFIG_MEDIA_CAMERA_SUPPORT=y
CONFIG_V4L_PLATFORM_DRIVERS=y
CONFIG_V4L_MEM2MEM_DRIVERS=y
CONFIG_VIDEO_MEDIATEK_VCU_WO_FUSE=y
CONFIG_VIDEO_MEDIATEK_VCODEC=y
CONFIG_MTK_GPU_SUPPORT=y
CONFIG_MTK_GPU_VERSION="mali valhall r32p1"
CONFIG_MTK_GPU_COMMON_DVFS_SUPPORT=y
CONFIG_FB_MODE_HELPERS=y
CONFIG_FB_TILEBLITTING=y
CONFIG_LOGO=y
CONFIG_SND_HRTIMER=y
CONFIG_SND_DYNAMIC_MINORS=y
CONFIG_SND_VERBOSE_PRINTK=y
CONFIG_SND_DEBUG=y
CONFIG_SND_DEBUG_VERBOSE=y
CONFIG_SND_PCM_XRUN_DEBUG=y
CONFIG_SND_SEQUENCER=y
CONFIG_SND_SEQ_DUMMY=y
# CONFIG_SND_SPI is not set
CONFIG_SND_USB_AUDIO=y
CONFIG_SND_SOC=y
CONFIG_SND_SOC_MT6768_MT6358=y
CONFIG_SND_SOC_MTK_BTCVSD=y
CONFIG_SND_SOC_MT6660=y
CONFIG_HIDRAW=y
CONFIG_HID_A4TECH=y
CONFIG_HID_APPLE=y
CONFIG_HID_BELKIN=y
CONFIG_HID_CHERRY=y
CONFIG_HID_CHICONY=y
CONFIG_HID_CYPRESS=y
CONFIG_HID_DRAGONRISE=y
CONFIG_HID_EZKEY=y
CONFIG_HID_KYE=y
CONFIG_HID_GYRATION=y
CONFIG_HID_TWINHAN=y
CONFIG_HID_KENSINGTON=y
CONFIG_HID_LOGITECH=y
CONFIG_HID_MAGICMOUSE=y
CONFIG_HID_MICROSOFT=y
CONFIG_HID_MONTEREY=y
CONFIG_HID_PANTHERLORD=y
CONFIG_HID_PETALYNX=y
CONFIG_HID_SAMSUNG=y
CONFIG_HID_SUNPLUS=y
CONFIG_HID_GREENASIA=y
CONFIG_HID_SMARTJOYPLUS=y
CONFIG_HID_TOPSEED=y
CONFIG_HID_THRUSTMASTER=y
CONFIG_HID_ZEROPLUS=y
CONFIG_USB_STORAGE=y
CONFIG_USB_STORAGE_DATAFAB=y
CONFIG_USB_STORAGE_FREECOM=y
CONFIG_USB_STORAGE_ISD200=y
CONFIG_USB_STORAGE_USBAT=y
CONFIG_USB_STORAGE_SDDR09=y
CONFIG_USB_STORAGE_SDDR55=y
CONFIG_USB_STORAGE_JUMPSHOT=y
CONFIG_USB_STORAGE_ALAUDA=y
CONFIG_USB_STORAGE_ONETOUCH=y
CONFIG_USB_STORAGE_KARMA=y
CONFIG_USB_STORAGE_CYPRESS_ATACB=y
CONFIG_USB_TRANCEVIBRATOR=y
CONFIG_NOP_USB_XCEIV=y
CONFIG_USB_GADGET_VBUS_DRAW=500
CONFIG_USB_CONFIGFS_SERIAL=y
CONFIG_USB_CONFIGFS_ACM=y
CONFIG_USB_CONFIGFS_RNDIS=y
CONFIG_USB_CONFIGFS_MASS_STORAGE=y
CONFIG_USB_CONFIGFS_MTK_FASTMETA=y
CONFIG_USB_CONFIGFS_F_HID=y
CONFIG_MMC=y
CONFIG_MMC_BLOCK_MINORS=32
CONFIG_MMC_CRYPTO=y
CONFIG_MTK_EMMC_SUPPORT_OTP=y
CONFIG_MMC_CQHCI=y
CONFIG_MMC_MTK=y
CONFIG_NEW_LEDS=y
CONFIG_LEDS_CLASS=y
CONFIG_LEDS_TRIGGERS=y
CONFIG_LEDS_TRIGGER_TIMER=y
# CONFIG_RTC_SYSTOHC is not set
CONFIG_RTC_DRV_MT6358=y
CONFIG_DMADEVICES=y
CONFIG_MTK_UART_APDMA=y
CONFIG_ANDROID_INTF_ALARM_DEV=y
CONFIG_ION=y
CONFIG_MTK_ION=y
CONFIG_MTK_PMIC_WRAP=y
CONFIG_PM_DEVFREQ=y
CONFIG_IIO=y
CONFIG_MEDIATEK_MT6577_AUXADC=y
CONFIG_MT635X_AUXADC=y
CONFIG_PHY_MTK_TPHY=y
CONFIG_MTK_DEVINFO=y
CONFIG_TEE=y
CONFIG_TZDEV=y
CONFIG_TZDEV_IWI_EVENT=294
CONFIG_TZDEV_IWI_PANIC=295
CONFIG_TZDEV_SWD_PANIC_IS_CRITICAL=y
CONFIG_TZLOG=y
CONFIG_TZLOG_PG_CNT=8
CONFIG_TZDEV_SK_MULTICORE=y
CONFIG_ION_FD2PHYS_USE_ION_FROM_STAGING=y
CONFIG_TZIRS=y
CONFIG_TZ_BOOT_LOG=y
CONFIG_TEEGRIS_VERSION=4
CONFIG_TEEGRIS_TEE_SUPPORT=y
CONFIG_FS_ENCRYPTION_INLINE_CRYPT=y
CONFIG_QUOTA_NETLINK_INTERFACE=y
CONFIG_INCREMENTAL_FS=y
CONFIG_ISO9660_FS=y
CONFIG_JOLIET=y
CONFIG_ZISOFS=y
CONFIG_MSDOS_FS=y
CONFIG_VFAT_FS=y
#+S96818BA1-2024,wangchunhua2.wt,add,2023/05/15,support exfat fs
CONFIG_EXFAT_FS=y
#-S96818BA1-2024,wangchunhua2.wt,add,2023/05/15,support exfat fs
CONFIG_PSTORE=y
CONFIG_PSTORE_CONSOLE=y
CONFIG_PSTORE_PMSG=y
CONFIG_PSTORE_RAM=y
# CONFIG_NETWORK_FILESYSTEMS is not set
CONFIG_NLS_CODEPAGE_437=y
CONFIG_NLS_CODEPAGE_950=y
CONFIG_NLS_ASCII=y
CONFIG_NLS_ISO8859_1=y
CONFIG_NLS_UTF8=y
CONFIG_STATIC_USERMODEHELPER=y
CONFIG_STATIC_USERMODEHELPER_PATH="/system_ext/bin/aee_core_forwarder"
# CONFIG_SECURITY_SELINUX_DEVELOP is not set
CONFIG_CRYPTO_TWOFISH=y
# CONFIG_CRYPTO_HW is not set
CONFIG_PRINTK_TIME=y
CONFIG_DYNAMIC_DEBUG=y
CONFIG_DEBUG_INFO=y
CONFIG_FRAME_WARN=2800
CONFIG_PANIC_ON_OOPS=y
CONFIG_PANIC_TIMEOUT=1
CONFIG_SCHEDSTATS=y
# CONFIG_DEBUG_PREEMPT is not set
# CONFIG_DEBUG_BUGVERBOSE is not set
CONFIG_RCU_CPU_STALL_TIMEOUT=60
CONFIG_FAULT_INJECTION=y
CONFIG_ENABLE_DEFAULT_TRACERS=y
CONFIG_AFC_CHARGER=y
CONFIG_W2_CHARGER_PRIVATE=y
CONFIG_N28_CHARGER_PRIVATE=y
CONFIG_SND_SOC_SIA8159=y
CONFIG_MTK_S96818_CAMERA=y
CONFIG_KEYBOARD_MTK_PMIC=y
CONFIG_AW35615_PD=y
CONFIG_SENSORS=y
CONFIG_HX9023S_SAR=y
CONFIG_HX9031AS_SAR=y
# +Req S96818BA1-1936, liuling3.wt,ADD, 2023/06/05, sar sx9338 & sx9328 bringup
CONFIG_SX9328_SAR=y
CONFIG_SX9338_SAR=y
# -Req S96818BA1-1936, liuling3.wt,ADD, 2023/06/05, sar sx9338 & sx9328 bringup
# +Req S96818AA1-1936 shenwenlei.wt 20230524  audio bringup
CONFIG_WT_PROJECT_AUDIO_PA=y
CONFIG_WT_PROJECT_HEADPHONE_NODE=y
# -Req S96818AA1-1936 shenwenlei.wt 20230524  audio bringup
# geqirui.wt, add, 20230424, enable CONFIG_DM_ANDROID_VERITY_AT_MOST_ONCE_DEFAULT_ENABLED
CONFIG_DM_ANDROID_VERITY_AT_MOST_ONCE_DEFAULT_ENABLED=y
#[+Chk 127645, zhonghuijie2, add ntc add the thermal to S96818, 20230413]
#CONFIG_WT_FLASH_THERMAL_FEATURE is not set

# +Req S96818BA1-2216, liuling3.wt,ADD, 2023/06/07, add smart alert sensor
CONFIG_N28_SMART_ALERT_HUB=y
CONFIG_N28_LIFT_TO_WAKE=y
# -Req S96818BA1-2216, liuling3.wt,ADD, 2023/06/07, add smart alert sensor
```
