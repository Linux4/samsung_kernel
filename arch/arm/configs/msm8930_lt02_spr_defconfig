## arch/arm/configs/msm8939_sec_a73g_eur_defconfig
```kconfig
CONFIG_SEC_A7_PROJECT=y
CONFIG_MACH_A73G_EUR_OPEN=y
# CONFIG_TOUCHSCREEN_SYNAPTICS_I2C_RMI_G is not set
CONFIG_KEYBOARD_ABOV_TOUCH=y
CONFIG_TOUCHSCREEN_CYTTSP5=y
CONFIG_TOUCHSCREEN_CYTTSP5_DEVICETREE_SUPPORT=y

#VIBTONZ
CONFIG_VIBETONZ=y
CONFIG_TACTILE_ASSIST=y 

# MUIC
CONFIG_SM5502_MUIC=y
CONFIG_USBID_STANDARD_VER_01=y
CONFIG_MUIC_SUPPORT_RUSTPROOF_INBATT=y
CONFIG_MUIC_SUPPORT_CHARGING_CABLE=y
CONFIG_MUIC_SUPPORT_DESKDOCK=y
CONFIG_MUIC_SUPPORT_SMARTDOCK=y

# IFPMIC
CONFIG_MFD_RT5033_RESET_WA=y

#HALL IC
CONFIG_SENSORS_HALL=y
# CONFIG_SENSORS_HALL_REAR is not set

#USB Host
CONFIG_USB_HOST_NOTIFY=y

#NFC
# CONFIG_NFC_PN547 is not set
# CONFIG_NFC_PN547_8916_USE_BBCLK2 is not set

#BATTERY
CONFIG_BATTERY_SWELLING=y

#AUDIO
CONFIG_AUDIO_SPEAKER_OUT_NXP_AMP_ENABLE=y
CONFIG_AUDIO_QUAT_I2S_ENABLE=y

#SENSORS
CONFIG_SENSORS=y
CONFIG_SENSORS_CORE=y
CONFIG_SENSORS_USE_SYMLINK=y
CONFIG_SYSFS=y
CONFIG_INPUT=y
CONFIG_INPUT_MISC=y
CONFIG_INPUT_GPIO=y
CONFIG_INPUT_POLLDEV=y
CONFIG_SENSORS_TMD3782S=y
# BMC150
CONFIG_SENSORS_BMA2X2=y
CONFIG_SENSORS_BMM050=y
CONFIG_INPUT_BMA2x2_ACC_ALERT_INT=y
# CONFIG_SENSORS_BMA2X2_ENABLE_INT1 is not set
# CONFIG_BOSCH_BMA2X2_ENABLE_INT2 is not set

#DISPLAY
CONFIG_PANEL_S6E3FA2_AMS549EH01_FHD=y

# TIMA LOG
CONFIG_ARCH_MSM8939_TIMA=y

#SELINUX
CONFIG_EXT2_FS_XATTR=y
CONFIG_EXT2_FS_SECURITY=y
CONFIG_EXT4_FS_XATTR=y
CONFIG_EXT4_FS_SECURITY=y
CONFIG_AUDIT=y
CONFIG_AUDITSYSCALL=y
CONFIG_SECURITY=y
CONFIG_LSM_MMAP_MIN_ADDR=4096
CONFIG_SECURITY_NETWORK=y
CONFIG_SECURITY_SELINUX=y
CONFIG_SECURITY_SELINUX_DEVELOP=y
CONFIG_SECURITY_SELINUX_AVC_STATS=y
CONFIG_SECURITY_SELINUX_CHECKREQPROT_VALUE=y
CONFIG_NETWORK_SECMARK=y
CONFIG_NF_CONNTRACK_SECMARK=y
CONFIG_NETFILTER_XT_TARGET_CONNSECMARK=y
CONFIG_NETFILTER_ADVANCED=y
CONFIG_IP_NF_SECURITY=y
CONFIG_DEFAULT_SECURITY=y
CONFIG_DEFAULT_SECURITY="selinux"
CONFIG_PROC_AVC=y

# DUAL SIM / SINGLE SIM Detection
CONFIG_CHECK_SIMSLOT_COUNT=y
# CONFIG_CHECK_SIMSLOT_COUNT_GPIO is not set
CONFIG_CHECK_SIMSLOT_COUNT_DT=y

#CAMERA
CONFIG_MSM_OTP=y
# debugging more information
CONFIG_DEBUG_FS=y
CONFIG_SEC_NET_FILTER=y

#MMC
CONFIG_SEC_HYBRID_TRAY=y

# SSWAP
CONFIG_SWAP=y
CONFIG_FRONTSWAP=y
CONFIG_ZSMALLOC=y
CONFIG_PGTABLE_MAPPING=y
CONFIG_ZSWAP=y
CONFIG_ZPOOL=y
CONFIG_DIRECT_RECLAIM_FILE_PAGES_ONLY=y
CONFIG_INCREASE_MAXIMUM_SWAPPINESS=y
CONFIG_FIX_INACTIVE_RATIO=y
CONFIG_TIGHT_PGDAT_BALANCE=y
CONFIG_VNSWAP=y
CONFIG_SWAP_ENABLE_READAHEAD=n

CONFIG_ZRAM=n
```

## arch/arm/configs/msm8939_sec_a7_chnctc_defconfig
```kconfig
CONFIG_SEC_A7_PROJECT=y
CONFIG_MACH_A7_CHN_CTC=y
# CONFIG_TOUCHSCREEN_SYNAPTICS_I2C_RMI_G is not set
CONFIG_KEYBOARD_ABOV_TOUCH=y
CONFIG_TOUCHSCREEN_CYTTSP5=y
CONFIG_TOUCHSCREEN_CYTTSP5_DEVICETREE_SUPPORT=y
CONFIG_DEBUG_SPINLOCK=y

#VIBTONZ
CONFIG_VIBETONZ=y
CONFIG_TACTILE_ASSIST=y

# MUIC
CONFIG_SM5502_MUIC=y
CONFIG_USBID_STANDARD_VER_01=y
CONFIG_MUIC_SUPPORT_RUSTPROOF_INBATT=y
CONFIG_MUIC_SUPPORT_CHARGING_CABLE=y
CONFIG_MUIC_SUPPORT_DESKDOCK=y
CONFIG_MUIC_SUPPORT_SMARTDOCK=y

# IFPMIC
CONFIG_MFD_RT5033_RESET_WA=y

#HALL IC
CONFIG_SENSORS_HALL=y
#CONFIG_SENSORS_HALL_REAR is not set

#USB Host
CONFIG_USB_HOST_NOTIFY=y

#NFC
CONFIG_NFC_PN547=y
CONFIG_NFC_PN547_8916_USE_BBCLK2=y

CONFIG_BATTERY_SWELLING=y
#AUDIO
CONFIG_AUDIO_SPEAKER_OUT_NXP_AMP_ENABLE=y
CONFIG_AUDIO_QUAT_I2S_ENABLE=y

#SENSORS
CONFIG_SENSORS=y
CONFIG_SENSORS_CORE=y
CONFIG_SENSORS_USE_SYMLINK=y
CONFIG_SYSFS=y
CONFIG_INPUT=y
CONFIG_INPUT_MISC=y
CONFIG_INPUT_GPIO=y
CONFIG_INPUT_POLLDEV=y
CONFIG_SENSORS_TMD3782S=y
CONFIG_SENSORS_TAOS_CHECK_REV=y
# BMC150
CONFIG_SENSORS_BMA2X2=y
CONFIG_SENSORS_BMM050=y
CONFIG_INPUT_BMA2x2_ACC_ALERT_INT=y
# CONFIG_SENSORS_BMA2X2_ENABLE_INT1 is not set
# CONFIG_BOSCH_BMA2X2_ENABLE_INT2 is not set

#Power off Alarm
CONFIG_RTC_AUTO_PWRON=y
CONFIG_RTC_AUTO_PWRON_PARAM=y

#DISPLAY
CONFIG_PANEL_S6E3FA2_AMS549EH01_FHD=y

#CAMERA
CONFIG_MSM_OTP=y

#PPPoe feature (WIFI TG)
CONFIG_PPP_FILTER=y
CONFIG_PPP_ASYNC=y
CONFIG_PPP_SYNC_TTY=y

#MMC
CONFIG_SEC_HYBRID_TRAY=y

# SSWAP
CONFIG_SWAP=y
CONFIG_FRONTSWAP=y
CONFIG_ZSMALLOC=y
CONFIG_PGTABLE_MAPPING=y
CONFIG_ZSWAP=y
CONFIG_ZPOOL=y
CONFIG_DIRECT_RECLAIM_FILE_PAGES_ONLY=y
CONFIG_INCREASE_MAXIMUM_SWAPPINESS=y
CONFIG_FIX_INACTIVE_RATIO=y
CONFIG_TIGHT_PGDAT_BALANCE=y
CONFIG_VNSWAP=y
CONFIG_SWAP_ENABLE_READAHEAD=n

CONFIG_ZRAM=n
```

## arch/arm/configs/msm8939_sec_a7_chnopen_defconfig
```kconfig
CONFIG_SEC_A7_PROJECT=y
CONFIG_MACH_A7_CHN_OPEN=y

# HARD RESET
CONFIG_RESTART_REASON_SEC_PARAM=y

# GPIO SETTING
#CONFIG_SEC_GPIO_SETTINGS=y

#INPUT MODULES
CONFIG_KEYBOARD_ABOV_TOUCH_A7=y
# CONFIG_TOUCHSCREEN_SYNAPTICS_I2C_RMI_G is not set
CONFIG_TOUCHSCREEN_CYTTSP5=y
CONFIG_TOUCHSCREEN_CYTTSP5_DEVICETREE_SUPPORT=y
# CONFIG_TOUCHSCREEN_SYNAPTICS_DSX_v21 is not set
# CONFIG_TOUCHSCREEN_SYNAPTICS_DSX_CORE_v21 is not set
# CONFIG_TOUCHSCREEN_SYNAPTICS_DSX_RMI_DEV_v21 is not set
# CONFIG_TOUCHSCREEN_SYNAPTICS_DSX_FW_UPDATE_v21 is not set
# CONFIG_TOUCHSCREEN_ATMEL_MXT is not set
# CONFIG_TOUCHSCREEN_FT5X06 is not set
# CONFIG_TOUCHSCREEN_MSTAR21XX is not set
# CONFIG_TOUCHSCREEN_GEN_VKEYS is not set
# CONFIG_TOUCHSCREEN_SYNAPTICS_I2C_RMI4 is not set
# CONFIG_TOUCHSCREEN_SYNAPTICS_DSX_RMI4_DEV is not set
# CONFIG_TOUCHSCREEN_SYNAPTICS_DSX_FW_UPDATE is not set
# CONFIG_SECURE_TOUCH is not set
# CONFIG_TOUCHSCREEN_BU21150 is not set
# CONFIG_INPUT_MT_WRAPPER is not set
CONFIG_INPUT_UINPUT=y
CONFIG_INPUT_GPIO=y

#HALL IC
CONFIG_SENSORS_HALL=y
# CONFIG_SENSORS_HALL_REAR is not set

#Vibrator
CONFIG_SS_VIBRATOR=y


# MUIC
CONFIG_SM5502_MUIC=y
CONFIG_USBID_STANDARD_VER_01=y
CONFIG_MUIC_SUPPORT_RUSTPROOF_INBATT=y
CONFIG_MUIC_SUPPORT_CHARGING_CABLE=y
CONFIG_MUIC_SUPPORT_DESKDOCK=y
CONFIG_MUIC_SUPPORT_SMARTDOCK=y

# IFPMIC
CONFIG_MFD_RT5033_RESET_GPIO=y
CONFIG_MFD_RT5033_SLDO_VBUSDET=n

# Charging/Battery
CONFIG_MFD_RT5033=y
CONFIG_REGULATOR_RT5033=y
CONFIG_CHARGER_RT5033=y
CONFIG_BATTERY_SAMSUNG=y
CONFIG_BATTERY_SAMSUNG_DATA_FILE="a7_battery_data.h"
CONFIG_SAMSUNG_LPM_MODE=y
CONFIG_FUELGAUGE_RT5033=y
CONFIG_PREVENT_SOC_JUMP=y

#USB Host
CONFIG_USB_HOST_NOTIFY=y


#BATTERY
CONFIG_BATTERY_SWELLING=y
CONFIG_BATTERY_SWELLING_LOW_TEMP_SECOND=y

#AUDIO
CONFIG_AUDIO_SPEAKER_OUT_NXP_AMP_ENABLE=y
CONFIG_AUDIO_QUAT_I2S_ENABLE=y

#SENSORS
CONFIG_SENSORS=y
CONFIG_SENSORS_CORE=y
CONFIG_SENSORS_USE_SYMLINK=y
CONFIG_SYSFS=y
CONFIG_INPUT=y
CONFIG_INPUT_MISC=y
CONFIG_INPUT_GPIO=y
CONFIG_INPUT_POLLDEV=y
CONFIG_SENSORS_TMD3782S=y
CONFIG_SENSORS_TAOS_CHECK_REV=y
# BMC150
CONFIG_SENSORS_BMA2X2=y
CONFIG_SENSORS_BMM050=y
# CONFIG_INPUT_BMA2x2_ACC_ALERT_INT is not set
CONFIG_SENSORS_BMC150_VDD=y
CONFIG_SENSORS_BMA2X2_ENABLE_INT1=y
# CONFIG_BOSCH_BMA2X2_ENABLE_INT2 is not set
CONFIG_SENSORS_ACCELEROMETER_2G=y

#Wifi
#
# Enable Qualcomm Wifi features
#
CONFIG_MSM_PIL_PRONTO=y
CONFIG_WCNSS_CORE=y
CONFIG_WCNSS_CORE_PRONTO=y
CONFIG_WCNSS_MEM_PRE_ALLOC=y

#
# Wifi features (Qualcomm)
#
CONFIG_NET_CORE=y
CONFIG_WIRELESS=y
CONFIG_WIRELESS_EXT_SYSFS=y
CONFIG_WEXT_CORE=y
CONFIG_WEXT_PROC=y
CONFIG_CFG80211=y
CONFIG_CFG80211_DEFAULT_PS=y
#CONFIG_CFG80211_ALLOW_RECONNECT is not set
CONFIG_WLAN=y
CONFIG_WIRELESS_EXT=y
CONFIG_WEXT_PRIV=y

CONFIG_MODULES=y
CONFIG_MODULE_UNLOAD=y
CONFIG_MODULE_FORCE_UNLOAD=y
CONFIG_WCNSS_REGISTER_DUMP_ON_BITE=y
CONFIG_WCNSS_IRIS_REGISTER_DUMP=y
CONFIG_CFG80211_INTERNAL_REGDB=y

#Power off Alarm
CONFIG_RTC_AUTO_PWRON=y
CONFIG_RTC_AUTO_PWRON_PARAM=y

#DISPLAY
CONFIG_PANEL_S6E3FA2_AMS549EH01_FHD=y

# TIMA LOG
# CONFIG_ARCH_MSM8939_TIMA=y

#FLASH
CONFIG_FLASHLIGHT=y
CONFIG_RT_FLASH_LED=y
CONFIG_FLED_RT5033=y
CONFIG_FLED_RT5033_EXT_GPIO=y
CONFIG_LEDS_MSM_GPIO_FLASH=y

#CAMERA
#CONFIG_MSM_OTP is not set
CONFIG_S5K5E3YX=y
CONFIG_IMX135=y

# debugging more information
#CONFIG_DEBUG_FS=y

#MMC
CONFIG_SEC_HYBRID_TRAY=y

# SSWAP
CONFIG_SWAP=y
CONFIG_FRONTSWAP=y
CONFIG_ZSMALLOC=y
CONFIG_PGTABLE_MAPPING=y
CONFIG_ZSWAP=y
CONFIG_ZPOOL=y
CONFIG_DIRECT_RECLAIM_FILE_PAGES_ONLY=y
CONFIG_INCREASE_MAXIMUM_SWAPPINESS=y
CONFIG_FIX_INACTIVE_RATIO=y
CONFIG_TIGHT_PGDAT_BALANCE=y
CONFIG_VNSWAP=y
CONFIG_SWAP_ENABLE_READAHEAD=n

#ODE and DIR Encryption
CONFIG_CRYPTO_AES_ARM=y
```

## arch/arm/configs/msm8939_sec_a7_chntw_defconfig
```kconfig
CONFIG_SEC_A7_PROJECT=y
CONFIG_MACH_A7_CHN_TW=y
# CONFIG_TOUCHSCREEN_SYNAPTICS_I2C_RMI_G is not set
CONFIG_KEYBOARD_ABOV_TOUCH=y
CONFIG_TOUCHSCREEN_CYTTSP5=y
CONFIG_TOUCHSCREEN_CYTTSP5_DEVICETREE_SUPPORT=y
CONFIG_DEBUG_SPINLOCK=y

# GPIO SETTING
CONFIG_SEC_GPIO_SETTINGS=y

#VIBTONZ
CONFIG_VIBETONZ=y
CONFIG_TACTILE_ASSIST=y

# MUIC
CONFIG_SM5502_MUIC=y
CONFIG_USBID_STANDARD_VER_01=y
CONFIG_MUIC_SUPPORT_RUSTPROOF_INBATT=y
CONFIG_MUIC_SUPPORT_CHARGING_CABLE=y
CONFIG_MUIC_SUPPORT_DESKDOCK=y
CONFIG_MUIC_SUPPORT_SMARTDOCK=y

# IFPMIC
CONFIG_MFD_RT5033_RESET_WA=y

#HALL IC
CONFIG_SENSORS_HALL=y
# CONFIG_SENSORS_HALL_REAR is not set

#USB Host
CONFIG_USB_HOST_NOTIFY=y

#NFC
CONFIG_NFC_PN547=y
CONFIG_NFC_PN547_8916_USE_BBCLK2=y

#BATTERY
CONFIG_BATTERY_SWELLING=y

#AUDIO
CONFIG_AUDIO_SPEAKER_OUT_NXP_AMP_ENABLE=y
CONFIG_AUDIO_QUAT_I2S_ENABLE=y

#SENSORS
CONFIG_SENSORS=y
CONFIG_SENSORS_CORE=y
CONFIG_SENSORS_USE_SYMLINK=y
CONFIG_SYSFS=y
CONFIG_INPUT=y
CONFIG_INPUT_MISC=y
CONFIG_INPUT_GPIO=y
CONFIG_INPUT_POLLDEV=y
CONFIG_SENSORS_TMD3782S=y
# BMC150
CONFIG_SENSORS_BMA2X2=y
CONFIG_SENSORS_BMM050=y
CONFIG_INPUT_BMA2x2_ACC_ALERT_INT=y
# CONFIG_SENSORS_BMA2X2_ENABLE_INT1 is not set
# CONFIG_BOSCH_BMA2X2_ENABLE_INT2 is not set

#Wifi
#
# Enable Qualcomm Wifi features
#
CONFIG_MSM_PIL_PRONTO=y
CONFIG_WCNSS_CORE=y
CONFIG_WCNSS_CORE_PRONTO=y
CONFIG_WCNSS_MEM_PRE_ALLOC=y

#
# Wifi features (Qualcomm)
#
CONFIG_NET_CORE=y
CONFIG_WIRELESS=y
CONFIG_WIRELESS_EXT_SYSFS=y
CONFIG_WEXT_CORE=y
CONFIG_WEXT_PROC=y
CONFIG_CFG80211=y
CONFIG_CFG80211_DEFAULT_PS=y
#CONFIG_CFG80211_ALLOW_RECONNECT is not set
CONFIG_WLAN=y
CONFIG_WIRELESS_EXT=y
CONFIG_WEXT_PRIV=y

CONFIG_MODULES=y
CONFIG_MODULE_UNLOAD=y
CONFIG_MODULE_FORCE_UNLOAD=y
CONFIG_WCNSS_REGISTER_DUMP_ON_BITE=y
CONFIG_WCNSS_IRIS_REGISTER_DUMP=y
CONFIG_CFG80211_INTERNAL_REGDB=y

#Power off Alarm
CONFIG_RTC_AUTO_PWRON=y
CONFIG_RTC_AUTO_PWRON_PARAM=y

#DISPLAY
CONFIG_PANEL_S6E3FA2_AMS549EH01_FHD=y

#CAMERA
CONFIG_MSM_OTP=y

CONFIG_CRYPTO_GCM=y
CONFIG_XFRM_USER=y
CONFIG_NET_KEY=y
CONFIG_INET=y
CONFIG_IP_ADVANCED_ROUTER=y
CONFIG_IP_MULTIPLE_TABLES=y
CONFIG_INET_AH=y
CONFIG_INET_ESP=y
CONFIG_INET_IPCOMP=y
CONFIG_INET_XFRM_MODE_TRANSPORT=y
CONFIG_INET_XFRM_MODE_TUNNEL=y
CONFIG_INET_XFRM_MODE_BEET=y
CONFIG_IPV6=y
CONFIG_INET6_AH=y
CONFIG_INET6_ESP=y
CONFIG_INET6_IPCOMP=y
CONFIG_INET6_XFRM_MODE_TRANSPORT=y
CONFIG_INET6_XFRM_MODE_TUNNEL=y
CONFIG_INET6_XFRM_MODE_BEET=y 
CONFIG_IPV6_MULTIPLE_TABLES=y
CONFIG_NETFILTER=y
CONFIG_NETFILTER_XTABLES=y
CONFIG_NETFILTER_XT_MATCH_POLICY=y

#MMC
CONFIG_SEC_HYBRID_TRAY=y

# SSWAP
CONFIG_SWAP=y
CONFIG_FRONTSWAP=y
CONFIG_ZSMALLOC=y
CONFIG_PGTABLE_MAPPING=y
CONFIG_ZSWAP=y
CONFIG_ZPOOL=y
CONFIG_DIRECT_RECLAIM_FILE_PAGES_ONLY=y
CONFIG_INCREASE_MAXIMUM_SWAPPINESS=y
CONFIG_FIX_INACTIVE_RATIO=y
CONFIG_TIGHT_PGDAT_BALANCE=y
CONFIG_VNSWAP=y
CONFIG_SWAP_ENABLE_READAHEAD=n

CONFIG_ZRAM=n
```

## arch/arm/configs/msm8939_sec_a7_eur_defconfig
```kconfig
CONFIG_SEC_A7_PROJECT=y
CONFIG_MACH_A7_EUR_OPEN=y

# HARD RESET
CONFIG_RESTART_REASON_SEC_PARAM=y

# GPIO SETTING
#CONFIG_SEC_GPIO_SETTINGS=y

#INPUT MODULES
CONFIG_KEYBOARD_ABOV_TOUCH_A7=y
# CONFIG_TOUCHSCREEN_SYNAPTICS_I2C_RMI_G is not set
CONFIG_TOUCHSCREEN_CYTTSP5=y
CONFIG_TOUCHSCREEN_CYTTSP5_DEVICETREE_SUPPORT=y
# CONFIG_TOUCHSCREEN_SYNAPTICS_DSX_v21 is not set
# CONFIG_TOUCHSCREEN_SYNAPTICS_DSX_CORE_v21 is not set
# CONFIG_TOUCHSCREEN_SYNAPTICS_DSX_RMI_DEV_v21 is not set
# CONFIG_TOUCHSCREEN_SYNAPTICS_DSX_FW_UPDATE_v21 is not set
# CONFIG_TOUCHSCREEN_ATMEL_MXT is not set
# CONFIG_TOUCHSCREEN_FT5X06 is not set
# CONFIG_TOUCHSCREEN_MSTAR21XX is not set
# CONFIG_TOUCHSCREEN_GEN_VKEYS is not set
# CONFIG_TOUCHSCREEN_SYNAPTICS_I2C_RMI4 is not set
# CONFIG_TOUCHSCREEN_SYNAPTICS_DSX_RMI4_DEV is not set
# CONFIG_TOUCHSCREEN_SYNAPTICS_DSX_FW_UPDATE is not set
# CONFIG_SECURE_TOUCH is not set
# CONFIG_TOUCHSCREEN_BU21150 is not set
# CONFIG_INPUT_MT_WRAPPER is not set
CONFIG_INPUT_UINPUT=y
CONFIG_INPUT_GPIO=y

#HALL IC
CONFIG_SENSORS_HALL=y
# CONFIG_SENSORS_HALL_REAR is not set

#Vibrator
CONFIG_SS_VIBRATOR=y

# MUIC
CONFIG_SM5502_MUIC=y
CONFIG_USBID_STANDARD_VER_01=y
CONFIG_MUIC_SUPPORT_RUSTPROOF_INBATT=y
CONFIG_MUIC_SUPPORT_CHARGING_CABLE=y
CONFIG_MUIC_SUPPORT_DESKDOCK=y
CONFIG_MUIC_SUPPORT_SMARTDOCK=y

# IFPMIC
CONFIG_MFD_RT5033_RESET_GPIO=y
CONFIG_MFD_RT5033_SLDO_VBUSDET=n

# Charging/Battery
CONFIG_MFD_RT5033=y
CONFIG_REGULATOR_RT5033=y
CONFIG_CHARGER_RT5033=y
CONFIG_BATTERY_SAMSUNG=y
CONFIG_BATTERY_SAMSUNG_DATA_FILE="a7_battery_data.h"
CONFIG_SAMSUNG_LPM_MODE=y
CONFIG_FUELGAUGE_RT5033=y
CONFIG_PREVENT_SOC_JUMP=y

#USB Host
CONFIG_USB_HOST_NOTIFY=y

#NFC
CONFIG_NFC=y
CONFIG_NFC_PN547=y
CONFIG_NFC_PN547_8916_USE_BBCLK2=y

#BATTERY
CONFIG_BATTERY_SWELLING=y

#AUDIO
CONFIG_AUDIO_SPEAKER_OUT_NXP_AMP_ENABLE=y
CONFIG_AUDIO_QUAT_I2S_ENABLE=y

#SENSORS
CONFIG_SENSORS=y
CONFIG_SENSORS_CORE=y
CONFIG_SENSORS_USE_SYMLINK=y
CONFIG_SYSFS=y
CONFIG_INPUT=y
CONFIG_INPUT_MISC=y
CONFIG_INPUT_GPIO=y
CONFIG_INPUT_POLLDEV=y
CONFIG_SENSORS_TMD3782S=y
CONFIG_SENSORS_TAOS_CHECK_REV=y
# BMC150
CONFIG_SENSORS_BMA2X2=y
CONFIG_SENSORS_BMM050=y
CONFIG_INPUT_BMA2x2_ACC_ALERT_INT=y
CONFIG_SENSORS_BMC150_VDD=y
CONFIG_SENSORS_BMA2X2_ENABLE_INT1=y
# CONFIG_BOSCH_BMA2X2_ENABLE_INT2 is not set
CONFIG_SENSORS_ACCELEROMETER_2G=y

#DISPLAY
CONFIG_PANEL_S6E3FA2_AMS549EH01_FHD=y

# TIMA LOG
# CONFIG_ARCH_MSM8939_TIMA=y

#FLASH
CONFIG_FLASHLIGHT=y
CONFIG_RT_FLASH_LED=y
CONFIG_FLED_RT5033=y
CONFIG_FLED_RT5033_EXT_GPIO=y
CONFIG_LEDS_MSM_GPIO_FLASH=y

#CAMERA
#CONFIG_MSM_OTP is not set
CONFIG_S5K5E3YX=y
CONFIG_IMX135=y

# debugging more information
#CONFIG_DEBUG_FS=y

#MMC
CONFIG_SEC_HYBRID_TRAY=y

# SSWAP
CONFIG_SWAP=y
CONFIG_FRONTSWAP=y
CONFIG_ZSMALLOC=y
CONFIG_PGTABLE_MAPPING=y
CONFIG_ZSWAP=y
CONFIG_ZPOOL=y
CONFIG_DIRECT_RECLAIM_FILE_PAGES_ONLY=y
CONFIG_INCREASE_MAXIMUM_SWAPPINESS=y
CONFIG_FIX_INACTIVE_RATIO=y
CONFIG_TIGHT_PGDAT_BALANCE=y
CONFIG_VNSWAP=y
CONFIG_SWAP_ENABLE_READAHEAD=n

#ODE and DIR Encryption
CONFIG_CRYPTO_AES_ARM=y

#EPDG
CONFIG_NET_CORE=y
CONFIG_NET_SCH_PRIO=y
CONFIG_NET_SCHED=y   #depends on CONFIG_NET  which is enabled by default.. coz not seeing in the config file
CONFIG_NET_CLS_BASIC=y # required if basic is being used as a filter. depends on CONFIG_NET_CLS so enabling it by default
CONFIG_NET_CLS=y
CONFIG_NET_CLS_ACT=y # for enabling the action target.
CONFIG_NET_ACT_MIRRED=y  # for enabling the mirred target for redirecting the packet between the devices.
CONFIG_NET_EMATCH=y   #basic uses extended matches so this has to be present
CONFIG_NET_SCH_INGRESS=y # classifier for ingress packet
```
