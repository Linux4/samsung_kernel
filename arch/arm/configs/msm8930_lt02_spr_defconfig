## arch/arm/configs/msm8939_sec_a7_kor_lgt_defconfig
```kconfig
CONFIG_SEC_A7_PROJECT=y
CONFIG_MACH_A7_KOR_OPEN=y

#INPUT MODULES
CONFIG_TOUCHSCREEN_CYTTSP5=y
CONFIG_TOUCHSCREEN_CYTTSP5_DEVICETREE_SUPPORT=y
CONFIG_KEYBOARD_ABOV_TOUCH_A7=y

# HARD RESET
CONFIG_RESTART_REASON_SEC_PARAM=y

# GPIO SETTING
CONFIG_SEC_GPIO_SETTINGS=y

#VIBTONZ
CONFIG_VIBETONZ=y
CONFIG_TACTILE_ASSIST=y

# MUIC
CONFIG_SM5502_MUIC=y
CONFIG_USBID_STANDARD_VER_01=y
CONFIG_MUIC_SUPPORT_RUSTPROOF_INBATT=y
CONFIG_MUIC_SUPPORT_CHARGING_CABLE=y
CONFIG_MUIC_SUPPORT_DESKDOCK=y
CONFIG_MUIC_SUPPORT_SMARTDOCK=y

# IFPMIC
CONFIG_MFD_RT5033_RESET_WA=y

#HALL IC
CONFIG_SENSORS_HALL=y
# CONFIG_SENSORS_HALL_REAR is not set

#USB
CONFIG_USB_HOST_NOTIFY=y
CONFIG_USB_LOCK_SUPPORT_FOR_MDM=y

#NFC
CONFIG_NFC_PN547=y
CONFIG_NFC_PN547_8916_USE_BBCLK2=y
CONFIG_NFC_PN547_8916_CLK_CTL=y

# Charging/Battery
CONFIG_MFD_RT5033=y
CONFIG_REGULATOR_RT5033=y
CONFIG_CHARGER_RT5033=y
CONFIG_BATTERY_SAMSUNG=y
CONFIG_BATTERY_SAMSUNG_DATA_FILE="a7_battery_data.h"
CONFIG_SAMSUNG_LPM_MODE=y
CONFIG_FUELGAUGE_RT5033=y
CONFIG_PREVENT_SOC_JUMP=y
CONFIG_BATTERY_SWELLING=y

#AUDIO
CONFIG_AUDIO_SPEAKER_OUT_NXP_AMP_ENABLE=y
CONFIG_AUDIO_QUAT_I2S_ENABLE=y

#SENSORS
CONFIG_SENSORS=y
CONFIG_SENSORS_CORE=y
CONFIG_SENSORS_USE_SYMLINK=y
CONFIG_SYSFS=y
CONFIG_INPUT=y
CONFIG_INPUT_MISC=y
CONFIG_INPUT_GPIO=y
CONFIG_INPUT_POLLDEV=y
CONFIG_SENSORS_TMD3782S=y
CONFIG_SENSORS_TAOS_CHECK_REV=y
# BMC150
CONFIG_SENSORS_BMA2X2=y
CONFIG_SENSORS_BMM050=y
CONFIG_SENSORS_BMA2X2_ENABLE_INT1=y
# CONFIG_BOSCH_BMA2X2_ENABLE_INT2 is not set
CONFIG_SENSORS_ACCELEROMETER_2G=y

#DISPLAY
CONFIG_PANEL_S6E3FA2_AMS549EH01_FHD=y

# TIMA LOG
CONFIG_ARCH_MSM8939_TIMA=y

#SELINUX
CONFIG_EXT2_FS_XATTR=y
CONFIG_EXT2_FS_SECURITY=y
CONFIG_EXT4_FS_XATTR=y
CONFIG_EXT4_FS_SECURITY=y
CONFIG_AUDIT=y
CONFIG_AUDITSYSCALL=y
CONFIG_SECURITY=y
CONFIG_LSM_MMAP_MIN_ADDR=4096
CONFIG_SECURITY_NETWORK=y
CONFIG_SECURITY_SELINUX=y
CONFIG_SECURITY_SELINUX_DEVELOP=y
CONFIG_SECURITY_SELINUX_AVC_STATS=y
CONFIG_SECURITY_SELINUX_CHECKREQPROT_VALUE=y
CONFIG_NETWORK_SECMARK=y
CONFIG_NF_CONNTRACK_SECMARK=y
CONFIG_NETFILTER_XT_TARGET_CONNSECMARK=y
CONFIG_NETFILTER_ADVANCED=y
CONFIG_IP_NF_SECURITY=y
CONFIG_DEFAULT_SECURITY=y
CONFIG_DEFAULT_SECURITY="selinux"
CONFIG_PROC_AVC=y

#FLASH
CONFIG_FLASHLIGHT=y
CONFIG_RT_FLASH_LED=y
CONFIG_FLED_RT5033=y
CONFIG_FLED_RT5033_EXT_GPIO=y

#CAMERA
CONFIG_MSM_OTP=y
CONFIG_S5K5E3YX=y
CONFIG_IMX135=y

# DMB
CONFIG_TDMB=y
CONFIG_TDMB_VENDOR_FCI=y
CONFIG_TDMB_FC8080=y
CONFIG_TDMB_SPI=y
CONFIG_TDMB_QUALCOMM=y
CONFIG_TDMB_XTAL_FREQ=y

#LGU I-WLAN
CONFIG_LGUIWLAN=y
CONFIG_MODULES=y
CONFIG_MODULE_UNLOAD=y
CONFIG_MODULE_FORCE_UNLOAD=y

#MMC
CONFIG_SEC_HYBRID_TRAY=y

# SSWAP
CONFIG_SWAP=y
CONFIG_FRONTSWAP=y
CONFIG_ZSMALLOC=y
CONFIG_PGTABLE_MAPPING=y
CONFIG_ZSWAP=y
CONFIG_ZPOOL=y
CONFIG_DIRECT_RECLAIM_FILE_PAGES_ONLY=y
CONFIG_INCREASE_MAXIMUM_SWAPPINESS=y
CONFIG_FIX_INACTIVE_RATIO=y
CONFIG_TIGHT_PGDAT_BALANCE=y
CONFIG_VNSWAP=y
CONFIG_SWAP_ENABLE_READAHEAD=n

CONFIG_ZRAM=n
# Ringback tone gain devide
CONFIG_SEC_DEVIDE_RINGTONE_GAIN=y

#APC CPR QUOTIENT
CONFIG_APC_CPR_QUOT_BOOST=y
```

## arch/arm/configs/msm8939_sec_a7x_chnldu_defconfig
```kconfig
CONFIG_SEC_A7X_PROJECT=y
CONFIG_MACH_A7X_CHN_OPEN=y

# 3GB RAM
CONFIG_3G_DDR_SUPPORT=y

# HARD RESET
CONFIG_RESTART_REASON_SEC_PARAM=y

# GPIO SETTING
#CONFIG_SEC_GPIO_SETTINGS=y

# GPIO EXPANDER
CONFIG_GPIO_PCAL6416A=y

# VIBRATOR
CONFIG_MSM_VIBRATOR=y

# MUIC
CONFIG_USE_MUIC=y
CONFIG_MUIC_NOTIFIER=y
CONFIG_MUIC_UNIVERSAL=y
CONFIG_MUIC_UNIVERSAL_SM5705=y
CONFIG_MUIC_PINCTRL=y
CONFIG_MUIC_UNIVERSAL_SM5705_AFC=y
CONFIG_VBUS_NOTIFIER=y

# HALL IC
CONFIG_SENSORS_HALL=y
CONFIG_SENSORS_HALL_REAR=y

#############################################
# SOUND FEATURE
#############################################
CONFIG_AUDIO_SPEAKER_OUT_NXP_AMP_ENABLE=y
CONFIG_AUDIO_QUAT_I2S_ENABLE=y
CONFIG_SW_100K_TO_GND=y
CONFIG_JACK_AUDIO=y
#############################################

#SENSOR
CONFIG_SENSORS=y
CONFIG_SENSORS_CORE=y
CONFIG_SENSORS_CM36655=y
CONFIG_SENSORS_SX9310 is not set
CONFIG_SENSORS_AK09916C=y
CONFIG_SENSORS_BHI=y
CONFIG_IIO=y
CONFIG_IIO_BUFFER=y
CONFIG_IIO_KFIFO_BUF=y
CONFIG_IIO_TRIGGER=y

#NFC
CONFIG_NFC=y
CONFIG_SEC_NFC=y
CONFIG_SEC_NFC_IF_I2C=y
CONFIG_SEC_NFC_PRODUCT_N5=y
CONFIG_SEC_NFC_USE_8916_BBCLK2=y
CONFIG_SEC_NFC_IO_EN=y
CONFIG_ESE_P3=y

#USB Host
CONFIG_USB_HOST_NOTIFY=y

# Charging/Battery
CONFIG_CHARGER_SM5705=y
CONFIG_FUELGAUGE_SM5705=y
CONFIG_BATTERY_SAMSUNG=y
CONFIG_BATTERY_SAMSUNG_DATA_FILE="a7x_battery_data.h"
CONFIG_SAMSUNG_LPM_MODE=y
CONFIG_BATTERY_SWELLING=y
# CONFIG_BATTERY_SWELLING_SELF_DISCHARGING is not set
CONFIG_PREVENT_SOC_JUMP=y
CONFIG_INBATTERY=y
CONFIG_MFD_SM5705=y
CONFIG_REGULATOR_SM5705=y

#Power off Alarm
CONFIG_RTC_AUTO_PWRON=y
CONFIG_RTC_AUTO_PWRON_PARAM=y

#DISPLAY
CONFIG_PANEL_S6E3FA3_AMS549JR01_FHD=y

# TIMA LOG
# CONFIG_ARCH_MSM8939_TIMA=y

#CAMERA
CONFIG_CAM_DISABLE_LPM_MODE=y
CONFIG_S5K3L2XX=y
CONFIG_S5K5E3YX=y
CONFIG_MSM_FRONT_EEPROM=y
CONFIG_CAM_PN547_PVDD_EN_CONTROL=y
CONFIG_SW_LANDING_FOR_MULTI_TASKING=y
CONFIG_CAMERA_SYSFS_V2=y
CONFIG_OIS=y
#CONFIG_MSM_OTP is not set

#FLASH
CONFIG_FLASHLIGHT=y
CONFIG_SM_FLASH_LED=y
#CONFIG_FLED_SM5703_EXT_GPIO=y
CONFIG_LEDS_SM5705=y

# debugging more information
#CONFIG_DEBUG_FS=y

#MMC
CONFIG_SEC_HYBRID_TRAY=y

# INPUT
# CONFIG_TOUCHSCREEN_MELFAS_MMS449 is not set
# CONFIG_TOUCHSCREEN_DUMP_MODE is not set
# CONFIG_TOUCHSCREEN_SYNAPTICS_I2C_RMI_G is not set
# CONFIG_TOUCHSCREEN_CYTTSP5 is not set
# CONFIG_TOUCHSCREEN_CYTTSP5_DEVICETREE_SUPPORT is not set
# CONFIG_TOUCHSCREEN_SYNAPTICS_DSX_v21 is not set
# CONFIG_TOUCHSCREEN_SYNAPTICS_DSX_CORE_v21 is not set
# CONFIG_TOUCHSCREEN_SYNAPTICS_DSX_RMI_DEV_v21 is not set
# CONFIG_TOUCHSCREEN_SYNAPTICS_DSX_FW_UPDATE_v21 is not set
# CONFIG_TOUCHSCREEN_ATMEL_MXT is not set
# CONFIG_TOUCHSCREEN_FT5X06 is not set
# CONFIG_TOUCHSCREEN_MSTAR21XX is not set
# CONFIG_TOUCHSCREEN_GEN_VKEYS is not set
# CONFIG_TOUCHSCREEN_SYNAPTICS_I2C_RMI4 is not set
# CONFIG_TOUCHSCREEN_SYNAPTICS_DSX_RMI4_DEV is not set
# CONFIG_TOUCHSCREEN_SYNAPTICS_DSX_FW_UPDATE is not set
# CONFIG_SECURE_TOUCH is not set
# CONFIG_TOUCHSCREEN_BU21150 is not set
# CONFIG_INPUT_MT_WRAPPER is not set
# CONFIG_KEYBOARD_ABOV_TOUCH_A8 is not set
# CONFIG_INPUT_BOOSTER is not set
CONFIG_TOUCHSCREEN_SEC_TS=y
CONFIG_KEYBOARD_ABOV_TOUCH_FT18XX=y
CONFIG_KEYBOARD_ABOV_TOUCH_FT16XX=y
CONFIG_TOUCHKEY_GRIP=y

# SSWAP
CONFIG_SWAP=y
CONFIG_FRONTSWAP=y
CONFIG_ZSMALLOC=y
CONFIG_PGTABLE_MAPPING=y
CONFIG_ZSWAP=y
CONFIG_ZPOOL=y
CONFIG_DIRECT_RECLAIM_FILE_PAGES_ONLY=y
CONFIG_INCREASE_MAXIMUM_SWAPPINESS=y
CONFIG_FIX_INACTIVE_RATIO=y
CONFIG_TIGHT_PGDAT_BALANCE=y
CONFIG_VNSWAP=y
CONFIG_SWAP_ENABLE_READAHEAD=n

# SDP
CONFIG_SDP=y

#MST
CONFIG_MST_LDO=y
```

## arch/arm/configs/msm8939_sec_a8_chnopen_defconfig
```kconfig
CONFIG_SEC_A8_PROJECT=y
CONFIG_MACH_A8_CHN_OPEN=y

# HARD RESET
CONFIG_RESTART_REASON_SEC_PARAM=y

# GPIO SETTING
#CONFIG_SEC_GPIO_SETTINGS=y

# GPIO EXPANDER
CONFIG_GPIO_PCAL6416A=y

# VIBRATOR
CONFIG_SS_VIBRATOR=y

# MUIC
CONFIG_SM5703_MUIC=y
CONFIG_S2MM001_VBUS_CHECK=y
CONFIG_USBID_STANDARD_VER_01=y
CONFIG_MUIC_SUPPORT_CHARGING_CABLE=y
CONFIG_MUIC_SUPPORT_DESKDOCK=y
CONFIG_MUIC_SUPPORT_RUSTPROOF=y

#############################################
# SOUND FEATURE
#############################################
CONFIG_AUDIO_SPEAKER_OUT_NXP_AMP_ENABLE=y
CONFIG_AUDIO_QUAT_I2S_ENABLE=y
CONFIG_SW_100K_TO_GND=y
#############################################

#SENSOR
CONFIG_SENSORS=y
CONFIG_SENSORS_CORE=y
CONFIG_SENSORS_TMD3782S=y
CONFIG_SENSORS_SX9310 is not set
# CONFIG_SENSORS_CM36652 is not set
# CONFIG_SENSORS_CM36652_SENSOR_EN_GPIO is not set
# CONFIG_SENSORS_CM36652_LEDA_EN_GPIO is not set
# BMC150
CONFIG_SENSORS_BMA2X2=y
CONFIG_SENSORS_BMM050=y
CONFIG_INPUT_BMA2x2_ACC_ALERT_INT=y
CONFIG_SENSORS_BMA2X2_ENABLE_INT1=y
# CONFIG_BOSCH_BMA2X2_ENABLE_INT2 is not set

# Finger print sensor
CONFIG_SENSORS_FINGERPRINT=y
CONFIG_SENSORS_FINGERPRINT_SYSFS=y
CONFIG_SENSORS_VFS7XXX=y
CONFIG_SENSORS_FP_SPI_GPIO_START=8
CONFIG_SENSORS_FP_SPI_GPIO_END=11
CONFIG_SENSORS_FP_MASTER_ID=86
CONFIG_SENSORS_FP_LOCKSCREEN_MODE=y

#NFC
CONFIG_NFC=y
CONFIG_NFC_PN547=y
CONFIG_NFC_PN547_8916_USE_BBCLK2=y
CONFIG_NFC_PN547_LDO_CONTROL=y
CONFIG_NFC_PN547_PVDD_EN_CONTROL=y
CONFIG_ESE_P61=y
CONFIG_NFC_PN547_ESE_SUPPORT=y

#USB Host
CONFIG_USB_HOST_NOTIFY=y

# Charging/Battery
CONFIG_CHARGER_SM5703=y
CONFIG_FUELGAUGE_SM5703=y
CONFIG_CHARGER_S2MU003=y
CONFIG_FUELGAUGE_S2MU003=y
CONFIG_BATTERY_SAMSUNG=y
CONFIG_BATTERY_SAMSUNG_DATA_FILE="a8_battery_data.h"
CONFIG_SAMSUNG_LPM_MODE=y
CONFIG_BATTERY_SWELLING=y
CONFIG_BATTERY_SWELLING_SELF_DISCHARGING=y
CONFIG_PREVENT_SOC_JUMP=y
CONFIG_INBATTERY=y

#Power off Alarm
CONFIG_RTC_AUTO_PWRON=y
CONFIG_RTC_AUTO_PWRON_PARAM=y

# PMIC/MISC
CONFIG_MFD_SM5703=y
CONFIG_REGULATOR_SM5703=y
CONFIG_MFD_S2MU003=y
CONFIG_REGULATOR_S2MU003=y

#DISPLAY
CONFIG_PANEL_S6E3FA3_AMS568HN01_FHD=y

# TIMA LOG
# CONFIG_ARCH_MSM8939_TIMA=y

#CAMERA
CONFIG_CAM_DISABLE_LPM_MODE=y
CONFIG_S5K3P3SX=y
CONFIG_S5K5E3YX=y
CONFIG_MSM_FRONT_EEPROM=y
CONFIG_CAM_PN547_PVDD_EN_CONTROL=y
CONFIG_SW_LANDING_FOR_MULTI_TASKING=y
CONFIG_CAMERA_SYSFS_V2=y
#CONFIG_MSM_OTP is not set

#FLASH
CONFIG_FLASHLIGHT=y
CONFIG_LEDS_S2MU003=y
CONFIG_SM_FLASH_LED=y
CONFIG_FLED_SM5703=y
CONFIG_FLED_SM5703_EXT_GPIO=y

# debugging more information
#CONFIG_DEBUG_FS=y

#MMC
CONFIG_SEC_HYBRID_TRAY=y

# INPUT
CONFIG_TOUCHSCREEN_MELFAS_MMS449=y
CONFIG_TOUCHSCREEN_DUMP_MODE=y
# CONFIG_TOUCHSCREEN_SYNAPTICS_I2C_RMI_G is not set
# CONFIG_TOUCHSCREEN_CYTTSP5 is not set
# CONFIG_TOUCHSCREEN_CYTTSP5_DEVICETREE_SUPPORT is not set
# CONFIG_TOUCHSCREEN_SYNAPTICS_DSX_v21 is not set
# CONFIG_TOUCHSCREEN_SYNAPTICS_DSX_CORE_v21 is not set
# CONFIG_TOUCHSCREEN_SYNAPTICS_DSX_RMI_DEV_v21 is not set
# CONFIG_TOUCHSCREEN_SYNAPTICS_DSX_FW_UPDATE_v21 is not set
# CONFIG_TOUCHSCREEN_ATMEL_MXT is not set
# CONFIG_TOUCHSCREEN_FT5X06 is not set
# CONFIG_TOUCHSCREEN_MSTAR21XX is not set
# CONFIG_TOUCHSCREEN_GEN_VKEYS is not set
# CONFIG_TOUCHSCREEN_SYNAPTICS_I2C_RMI4 is not set
# CONFIG_TOUCHSCREEN_SYNAPTICS_DSX_RMI4_DEV is not set
# CONFIG_TOUCHSCREEN_SYNAPTICS_DSX_FW_UPDATE is not set
# CONFIG_SECURE_TOUCH is not set
# CONFIG_TOUCHSCREEN_BU21150 is not set
# CONFIG_INPUT_MT_WRAPPER is not set
CONFIG_KEYBOARD_ABOV_TOUCH_A8=y
CONFIG_INPUT_BOOSTER=y

# TZDEV
# CONFIG_MOBICORE_SUPPORT is not set
# CONFIG_MOBICORE_API is not set
CONFIG_TZDEV=y
CONFIG_TZDEV_32BIT_SECURE_KERNEL=y
# CONFIG_TZDEV_USE_ARM_CALLING_CONVENTION is not set
# CONFIG_TZDEV_CMA is not set
CONFIG_TZDEV_IWI_EVENT=280
CONFIG_TZDEV_IWI_PANIC=0
CONFIG_TZLOG=y
CONFIG_TZLOG_POLLING=y
CONFIG_TZLOG_POLLING_PERIOD=100
CONFIG_TZLOG_PG_CNT=2
# CONFIG_TZDEV_PANIC_HANDLER is not set
# CONFIG_TZDEV_MULTI_CORE_AUX_CHANNELS is not set
# CONFIG_TZDEV_MSM_CRYPTO_WORKAROUND is not set
CONFIG_TZDEV_QC_CRYPTO_CLOCKS_MANAGEMENT=y
CONFIG_TZDEV_QC_CRYPTO_CLOCKS_USR_MNG=y
CONFIG_ION_FD2PHYS=y
CONFIG_TZIRS=y
CONFIG_QCOM_SCM_ARMV8=y
# CONFIG_TZ_CORE_MIGRATION is not set
CONFIG_TZDEV_PAGE_MIGRATION=y

# SSWAP
CONFIG_SWAP=y
CONFIG_FRONTSWAP=y
CONFIG_ZSMALLOC=y
CONFIG_PGTABLE_MAPPING=y
CONFIG_ZSWAP=y
CONFIG_ZPOOL=y
CONFIG_DIRECT_RECLAIM_FILE_PAGES_ONLY=y
CONFIG_INCREASE_MAXIMUM_SWAPPINESS=y
CONFIG_FIX_INACTIVE_RATIO=y
CONFIG_TIGHT_PGDAT_BALANCE=y
CONFIG_VNSWAP=y
CONFIG_SWAP_ENABLE_READAHEAD=n

# SDP
CONFIG_SDP=y
```

## arch/arm/configs/msm8952_sec_c5lte_chnldu_defconfig
```kconfig
CONFIG_SEC_C5LTE_PROJECT=y
CONFIG_MACH_C5LTE_CHN_OPEN=y
CONFIG_DRV_SAMSUNG=y

#SKU theme
CONFIG_SKU_THEME=y

#
# MAX77843 IC
#
# CONFIG_EXTCON is not set
# CONFIG_EXTCON_MAX77843 is not set
# CONFIG_MFD_MAX77843 is not set

#MUIC
CONFIG_USE_MUIC=y
CONFIG_MUIC_NOTIFIER=y
CONFIG_MUIC_UNIVERSAL=y
CONFIG_MUIC_UNIVERSAL_SM5705=y
CONFIG_MUIC_PINCTRL=y
CONFIG_MUIC_UNIVERSAL_SM5705_AFC=y
CONFIG_VBUS_NOTIFIER=y
CONFIG_MFD_SM5705=y

CONFIG_USB_HOST_NOTIFY=y

# RUSTPROOF
CONFIG_MUIC_SUPPORT_RUSTPROOF=y

# VBUS_NOTI
CONFIG_VBUS_NOTIFIER=y

# HALL IC
CONFIG_SENSORS_HALL=y

# Service LED
CONFIG_LEDS_KTD2026=y
CONFIG_LEDS_SM5705_RGB=y
CONFIG_LEDS_CLASS=y

#
# MOTOR
#
CONFIG_SS_VIBRATOR=y
CONFIG_DC_MOTOR_PMIC=y
# CONFIG_VIBETONZ=y
# CONFIG_TACTILE_ASSIST=y
#
# DISPLAY(MDSS)
#
CONFIG_PANEL_S6E3FA3_AMS520KG09_FHD=y

#FLASH
CONFIG_FLASHLIGHT=y
CONFIG_SM_FLASH_LED=y
CONFIG_LEDS_SM5705=y
CONFIG_DUAL_LEDS_FLASH=y

#CAMERA
CONFIG_MSM_FRONT_EEPROM=y

# XO SHUTDOWN
CONFIG_UART3=y

#OIS
#CONFIG_BU24219_OIS=y
#CONFIG_CAM_EXTERNAL=y

# BATTERY & CHARGER
CONFIG_CHARGER_SM5705=y
CONFIG_FUELGAUGE_SM5705=y
CONFIG_CHARGER_DA9155=y
CONFIG_BATTERY_SAMSUNG=y
CONFIG_BATTERY_SAMSUNG_V2=y
CONFIG_MULTI_CHARGING=y
CONFIG_STEP_CHARGING=y
CONFIG_SAMSUNG_LPM_MODE=y
CONFIG_BATTERY_SWELLING=y
CONFIG_PREVENT_SOC_JUMP=y
CONFIG_REGULATOR_SM5705=y
CONFIG_AFC_CHARGER_MODE=y
CONFIG_SW_SELF_DISCHARGING=y
CONFIG_SEC_MPP_SHARE=y
CONFIG_STORE_MODE=y

#Power off Alarm
CONFIG_RTC_AUTO_PWRON=y
CONFIG_RTC_AUTO_PWRON_PARAM=y

#
# InputDevice
#
CONFIG_TOUCHSCREEN_ZT7538=y
CONFIG_KEYBOARD_ABOV_TOUCH_16XX=y

# CONFIG_MFD_S2MPB02 is not set
# CONFIG_REGULATOR_S2MPB02 is not set
# CONFIG_MFD_SM5705=y
# CONFIG_REGULATOR_SM5705=y

# Finger print sensor
CONFIG_SENSORS_FINGERPRINT=y
CONFIG_SENSORS_FINGERPRINT_SYSFS=y
# CONFIG_SENSORS_VFS7XXX is not set
CONFIG_SENSORS_FP_SPI_NUMBER=0
CONFIG_SENSORS_FP_SPI_GPIO_START=0
CONFIG_SENSORS_FP_SPI_GPIO_END=3
# CONFIG_SENSORS_ET320 is not set
# CONFIG_SENSORS_FINGERPRINT_DUALIZATION is not set
# CONFIG_SENSORS_FP_LOCKSCREEN_MODE is not set

#
# SD Card
#
CONFIG_SEC_HYBRID_TRAY=y

#
# Sensor
#
CONFIG_SENSORS=y
CONFIG_SENSORS_CORE=y
CONFIG_SENSORS_SSC=y
CONFIG_SENSORS_BHI=y
CONFIG_IIO_BUFFER=y
CONFIG_IIO=y
CONFIG_IIO_KFIFO_BUF=y
CONFIG_IIO_TRIGGER=y
CONFIG_IIO_ST_HWMON=y
CONFIG_SENSORS_TMD3700=y
CONFIG_SENSORS_TMD3700_RESET_DEFENCE_CODE=y
CONFIG_SENSORS_YAS539=y
CONFIG_SENSORS_YAS_RESET_DEFENCE_CODE=y
CONFIG_SENSORS_SW_RESET=y

#NFC
CONFIG_SAMSUNG_NFC=y
CONFIG_NFC_PN547=y
CONFIG_NFC_PN547_8916_USE_BBCLK2=y
CONFIG_NFC_PN547_PVDD_EN_CONTROL=y
CONFIG_NFC_PN547_ESE_SUPPORT=y
CONFIG_ESE_SECURE=y
CONFIG_ESE_SECURE_SPI_PORT=8
CONFIG_ESE_SPI_GPIO_START=96
CONFIG_ESE_SPI_GPIO_END=99

# GPIO DVS feature
CONFIG_SEC_GPIO_DVS=y

# GPIO EXPANDER
CONFIG_GPIO_PCAL6416A=y

#
# Audio
CONFIG_SND_SOC_MSM8X16_WCD=y
CONFIG_AUDIO_SPEAKER_OUT_NXP_AMP_ENABLE=y
CONFIG_SND_SOC_MSM8X16_RT5659=y
CONFIG_AUDIO_NXP_AMP_WITH_QUAT_I2S=y
# Earjack
CONFIG_SAMSUNG_JACK=y
CONFIG_INPUT_GPIO=y
CONFIG_SW_100K_TO_GND=y

#MST
CONFIG_MST_LDO=y
# CONFIG_SCHED_TASK_BEHAVIOR is not set

# SSWAP
CONFIG_SWAP=y
CONFIG_FRONTSWAP=y
CONFIG_ZSMALLOC=y
CONFIG_PGTABLE_MAPPING=y
CONFIG_ZSWAP=y
CONFIG_ZPOOL=y
CONFIG_DIRECT_RECLAIM_FILE_PAGES_ONLY=y
CONFIG_INCREASE_MAXIMUM_SWAPPINESS=y
CONFIG_FIX_INACTIVE_RATIO=y
CONFIG_TIGHT_PGDAT_BALANCE=y
CONFIG_VNSWAP=y
CONFIG_SWAP_ENABLE_READAHEAD=n
```
