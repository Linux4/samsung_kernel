## arch/arm/configs/msm8930_lt02_spr_defconfig
```kconfig
CONFIG_MACH_LT02_SPR=y
#CONFIG_ADC_STMPE811=y
CONFIG_INSIDESECURE_VPNCLIENT=y
CONFIG_FB_MDP4_ENHANCE=y

# Battery charging and BMS
CONFIG_BATTERY_SAMSUNG=y
CONFIG_CHARGER_SMB358=y
CONFIG_FUELGAUGE_MAX17050=y
CONFIG_FUELGAUGE_MAX17050_COULOMB_COUNTING=y
CONFIG_SAMSUNG_LPM_MODE=y

#MUIC driver
CONFIG_USB_SWITCH_FSA9485=y
```

## arch/arm/configs/msm8937_sec_eng_defconfig
```kconfig
########################################################################################
# SAMSUNG MSM8937/8917 project : Diff between msm8937-perf_defconfig and msm8937_defconfig
########################################################################################
CONFIG_CMA_DEBUGFS=y
CONFIG_CGROUP_DEBUG=y
CONFIG_OPROFILE=m
CONFIG_KPROBES=y
CONFIG_DEBUG_GPIO=y
CONFIG_MSMB_CAMERA_DEBUG=y
# CONFIG_MSM_SPMI_DEBUGFS_RO is not set
CONFIG_MSM_DEBUG_LAR_UNLOCK=y
CONFIG_MSM_CORE_HANG_DETECT=y
CONFIG_MSM_DCC=y
CONFIG_MSM_IPC_ROUTER_GLINK_XPRT=y
CONFIG_MSM_GLINK_PKT=y
CONFIG_CORESIGHT_TPDA=y
CONFIG_CORESIGHT_TPDM=y
CONFIG_CORESIGHT_DBGUI=y
CONFIG_CORESIGHT_ETMV4=y
CONFIG_CORESIGHT_REMOTE_ETM=y
CONFIG_CORESIGHT_QPDI=y
CONFIG_LOG_BUF_MAGIC=y
CONFIG_DYNAMIC_DEBUG=y
CONFIG_PAGE_OWNER=y
CONFIG_DEBUG_PAGEALLOC=y
CONFIG_SLUB_DEBUG_PANIC_ON=y
CONFIG_DEBUG_OBJECTS=y
CONFIG_DEBUG_OBJECTS_FREE=y
CONFIG_DEBUG_OBJECTS_TIMERS=y
CONFIG_DEBUG_OBJECTS_WORK=y
CONFIG_DEBUG_OBJECTS_RCU_HEAD=y
CONFIG_DEBUG_OBJECTS_PERCPU_COUNTER=y
#CONFIG_SLUB_DEBUG_ON is not set
CONFIG_DEBUG_KMEMLEAK=y
CONFIG_DEBUG_KMEMLEAK_EARLY_LOG_SIZE=4000
CONFIG_DEBUG_KMEMLEAK_DEFAULT_OFF=y
CONFIG_DEBUG_STACK_USAGE=y
CONFIG_DEBUG_VM=y
CONFIG_DEBUG_MEMORY_INIT=y
CONFIG_DEBUG_HIGHMEM=y
CONFIG_DEBUG_SPINLOCK=y
CONFIG_DEBUG_MUTEXES=y
CONFIG_DEBUG_ATOMIC_SLEEP=y
CONFIG_DEBUG_LIST=y
CONFIG_FAULT_INJECTION=y
CONFIG_FAIL_PAGE_ALLOC=y
CONFIG_UFS_FAULT_INJECTION=y
CONFIG_FAULT_INJECTION_DEBUG_FS=y
CONFIG_FAULT_INJECTION_STACKTRACE_FILTER=y
CONFIG_MSM_RTB=y
CONFIG_MSM_RTB_SEPARATE_CPUS=y
CONFIG_BLK_DEV_IO_TRACE=y
# CONFIG_LKDTM is not set
CONFIG_PANIC_ON_DATA_CORRUPTION=y
CONFIG_DEBUG_USER=y
CONFIG_FREE_PAGES_RDONLY=y
CONFIG_DEBUG_SET_MODULE_RONX=y
CONFIG_TRUSTONIC_TEE_DEBUG=y

CONFIG_FTRACE=y

#
# Enable SEC_PM Feature
#
CONFIG_SEC_GPIO_DVS=y

# SEC DEBUG features
CONFIG_USER_RESET_DEBUG_TEST=y
CONFIG_SEC_DEBUG_FORCE_ERROR=y

#knox test
CONFIG_KNOX_TEST=y

#factory feature
CONFIG_KEEP_JIG_LOW=y
```

## arch/arm/configs/msm8937_sec_gtesy18lte_usa_vzw_defconfig
```kconfig
CONFIG_SEC_MSM8917_PROJECT=y
CONFIG_SEC_GTESY18LTE_PROJECT=y
CONFIG_MACH_GTESY18LTE_USA_VZW=y

CONFIG_DRV_SAMSUNG=y

#INPUT MODULES
CONFIG_TOUCHSCREEN_ZINITIX_ZT75XX_TCLM=y
CONFIG_TOUCHSCREEN_DUMP_MODE=y
CONFIG_INPUT_TOUCHSCREEN_TCLMV2=n
CONFIG_INPUT_TOUCHSCREEN_TCLM=n

#MUIC
CONFIG_USE_MUIC=y
CONFIG_MUIC_NOTIFIER=y
CONFIG_MUIC_S2MU005=y
CONFIG_MFD_S2MU005=y
CONFIG_MUIC_SUPPORT_RUSTPROOF=y
CONFIG_MUIC_UART_SWITCH=y

#USB Host
CONFIG_USB_HOST_NOTIFY=y
CONFIG_VBUS_NOTIFIER=y

# BATTERY & CHARGER
CONFIG_SAMSUNG_LPM_MODE=y
CONFIG_BATTERY_SAMSUNG_V2=y
CONFIG_BATTERY_SAMSUNG=y
CONFIG_BATTERY_NOTIFIER=y
CONFIG_PREVENT_SOC_JUMP=y
CONFIG_CHARGER_S2MU005=y
CONFIG_FUELGAUGE_S2MU005=y
CONFIG_S2MU005_INNER_BATTERY=y \
CONFIG_BATTERY_SWELLING=y
CONFIG_SEC_MPP_SHARE=y
CONFIG_TABLET_MODEL_CONCEPT=y
#CONFIG_BATTERY_CISD=y
CONFIG_BATTERY_AGE_FORECAST=y
CONFIG_USE_IFPMIC_NTC_PIN_FOR_BLKT=y
CONFIG_S2MU005_DISABLE_BUCK_MODE=y

CONFIG_SYSFS=y
CONFIG_INPUT=y
CONFIG_INPUT_MISC=y
CONFIG_INPUT_GPIO=y
CONFIG_INPUT_POLLDEV=y

#SENSORS
CONFIG_SENSORS=y
CONFIG_SENSORS_CORE=y
CONFIG_SENSORS_LIS2DS=y
CONFIG_SENSORS_LIS2DS_I2C=y
CONFIG_SENSORS_A96T3X6_SUB=y
CONFIG_SENSORS_A96T3X6_WIFI=y
CONFIG_SENSORS_A96T3X6=y
CONFIG_SENSORS_GRIP_CHK_HALLIC=y
#NFC

#HALL IC
CONFIG_SENSORS_HALL=y

#CAMERA
CONFIG_SR544=y
CONFIG_MSM_EEPROM=n
CONFIG_MSM_OTP=y
CONFIG_SR259=y

#AUDIO
CONFIG_SAMSUNG_JACK=y
# CONFIG_SLIMBUS is not set
# CONFIG_SLIMBUS_MSM_NGD is not set
# CONFIG_SOUNDWIRE is not set
# CONFIG_SEC_SND_SOLUTION is not set
# CONFIG_SEC_VOC_SOLUTION is not set
CONFIG_SEC_SND_ADAPTATION=y

#FLASH
# CONFIG_FLASHLIGHT is not set
# CONFIG_SM_FLASH_LED is not set
# CONFIG_LEDS_S2MU005 is not set
# CONFIG_LEDS_S2MU005_FLASH is not set

#SD
CONFIG_SEC_HYBRID_TRAY=y

#DISPLAY
CONFIG_FRAME_WARN=2048
CONFIG_PANEL_S6D7AA0X11_TV080WXM_WXGA=y
CONFIG_SAMSUNG_12_8MHZ_ESC_CLOCK=y

# MOTOR
CONFIG_MSM_VIBRATOR=y

#SVC LEDS
CONFIG_LEDS_KTD2026=y

#Power off Alarm
# CONFIG_RTC_AUTO_PWRON is not set

# Legacy alarm dev
# CONFIG_ANDROID_INTF_ALARM_DEV is not set

CONFIG_NR_CPUS=4

# KNOX SDP and DLP
CONFIG_SDP=y
CONFIG_DLP=y

# HQM
CONFIG_SEC_DEBUG_APPS_CLK_LOGGING=y
CONFIG_SEC_AP_HEALTH=y

# EPDG
CONFIG_NET_CORE=y
CONFIG_NET_SCH_PRIO=y
CONFIG_NET_SCHED=y   #depends on CONFIG_NET  which is enabled by default.. coz not seeing in the config file
CONFIG_NET_CLS_BASIC=y # required if basic is being used as a filter. depends on CONFIG_NET_CLS so enabling it by default
CONFIG_NET_CLS=y
CONFIG_NET_CLS_ACT=y # for enabling the action target.
CONFIG_NET_ACT_MIRRED=y  # for enabling the mirred target for redirecting the packet between the devices.
CONFIG_NET_EMATCH=y   #basic uses extended matches so this has to be present
CONFIG_NET_SCH_INGRESS=y # classifier for ingress packet

# IPSec
CONFIG_CRYPTO_NULL=y

# SSWAP
CONFIG_SWAP=y
CONFIG_FRONTSWAP=y
CONFIG_ZSMALLOC=y
CONFIG_ZSMALLOC_STAT=y
CONFIG_ZSMALLOC_OBJ_SEQ=n
CONFIG_PGTABLE_MAPPING=y
CONFIG_ZSWAP=y
CONFIG_ZSWAP_COMPACTION=y
CONFIG_ZSWAP_ENABLE_WRITEBACK=n
CONFIG_ZSWAP_SAME_PAGE_SHARING=n
CONFIG_ZPOOL=y
CONFIG_DIRECT_RECLAIM_FILE_PAGES_ONLY=y
CONFIG_INCREASE_MAXIMUM_SWAPPINESS=y
CONFIG_FIX_INACTIVE_RATIO=y
CONFIG_TIGHT_PGDAT_BALANCE=y
CONFIG_VNSWAP=y
CONFIG_SWAP_ENABLE_READAHEAD=n

# MMAP READAROUND
CONFIG_MMAP_READAROUND_LIMIT=16
```

## arch/arm/configs/msm8937_sec_j5y18lte_swa_open_defconfig
```kconfig
CONFIG_SEC_MSM8917_PROJECT=y
CONFIG_SEC_J5Y18LTE_PROJECT=y
CONFIG_MACH_J5Y18LTE_SWA_OPEN=y

CONFIG_3G_DDR_SUPPORT=y
CONFIG_PHYS_OFFSET=0x40000000
CONFIG_DRV_SAMSUNG=y

#INPUT MODULES
CONFIG_SEC_DEBUG_TSP_LOG=y
CONFIG_TOUCHSCREEN_DUMP_MODE=y
CONFIG_TOUCHSCREEN_SEC_INCELL_TS=y
CONFIG_INPUT_TOUCHSCREEN_TCLMV2=y
CONFIG_INPUT_TOUCHSCREEN_TCLM=n

#MUIC
CONFIG_USE_MUIC=y
CONFIG_MUIC_NOTIFIER=y
CONFIG_MUIC_S2MU005=y
CONFIG_MFD_S2MU005=y
CONFIG_MUIC_S2MU005_DISCHARGING_WA=y 
CONFIG_MUIC_SUPPORT_RUSTPROOF=y
CONFIG_MUIC_S2MU005_INNER_BATTERY=y
CONFIG_MUIC_UART_SWITCH=y
CONFIG_MUIC_S2MU005_JIGB_CONTROL=y
CONFIG_MUIC_S2MU005_WATER_WA_DISABLE=y

#USB Host
CONFIG_USB_HOST_NOTIFY=y
CONFIG_VBUS_NOTIFIER=y

# BATTERY & CHARGER
CONFIG_SAMSUNG_LPM_MODE=y
CONFIG_BATTERY_SAMSUNG=y
CONFIG_BATTERY_SAMSUNG_V2=y
CONFIG_PREVENT_SOC_JUMP=y
CONFIG_CHARGER_S2MU005=y
CONFIG_FUELGAUGE_S2MU005=y
CONFIG_S2MU005_INNER_BATTERY=y
CONFIG_BATTERY_SWELLING=y
CONFIG_SEC_MPP_SHARE=y
#CONFIG_BATTERY_AGE_FORECAST=y
#CONFIG_BATTERY_AGE_FORECAST_DETACHABLE=y

CONFIG_SYSFS=y
CONFIG_INPUT=y
CONFIG_INPUT_MISC=y
CONFIG_INPUT_GPIO=y
CONFIG_INPUT_POLLDEV=y

#SENSORS
CONFIG_SENSORS=y
CONFIG_SENSORS_CORE=y
CONFIG_SENSORS_LSM6DSL=y
CONFIG_SENSORS_LSM6DSL_I2C=y
CONFIG_SENSORS_CM36686=y
CONFIG_SENSORS_YAS539=y

# Fingerprint sensor
CONFIG_SENSORS_FINGERPRINT=y
CONFIG_SENSORS_FINGERPRINT_SYSFS=y
CONFIG_SENSORS_ET5XX=y
CONFIG_SENSORS_FP_SPI_NUMBER=7
CONFIG_SENSORS_FP_SPI_GPIO_START=85
CONFIG_SENSORS_FP_SPI_GPIO_END=88

#NFC

#HALL IC
# CONFIG_SENSORS_HALL is not set

#CAMERA
#CONFIG_S5K5E3YX=y
#CONFIG_ACTIVE_FLASH=y
#CONFIG_MSM_FRONT_OTP=y
#CONFIG_J2Y18_ACTUATOR=y


#EEPROM
CONFIG_GET_REAR_MODULE_ID=y

#AUDIO
CONFIG_SAMSUNG_JACK=y
# CONFIG_SLIMBUS is not set
# CONFIG_SLIMBUS_MSM_NGD is not set
# CONFIG_SOUNDWIRE is not set

#FLASH
#CONFIG_FLASHLIGHT=y
CONFIG_LEDS_S2MU005=y
CONFIG_LEDS_S2MU005_FLASH=y

#DISPLAY
CONFIG_PANEL_S6D7AT0B01_PM6003XB1_HDP=y
CONFIG_PANEL_POWER_LM3632A=y

# MOTOR
CONFIG_MSM_VIBRATOR=y

#SVC LEDS
CONFIG_LEDS_KTD2026=y

#Power off Alarm
# CONFIG_RTC_AUTO_PWRON is not set

# Legacy alarm dev
# CONFIG_ANDROID_INTF_ALARM_DEV is not set

CONFIG_NR_CPUS=4

# SSWAP
CONFIG_SWAP=y
CONFIG_FRONTSWAP=y
CONFIG_ZSMALLOC=y
CONFIG_ZSMALLOC_STAT=y
CONFIG_ZSMALLOC_OBJ_SEQ=n
CONFIG_PGTABLE_MAPPING=y
CONFIG_ZSWAP=y
CONFIG_ZSWAP_COMPACTION=y
CONFIG_ZSWAP_ENABLE_WRITEBACK=n
CONFIG_ZSWAP_SAME_PAGE_SHARING=y
CONFIG_ZPOOL=y
CONFIG_DIRECT_RECLAIM_FILE_PAGES_ONLY=y
CONFIG_INCREASE_MAXIMUM_SWAPPINESS=y
CONFIG_FIX_INACTIVE_RATIO=y
CONFIG_TIGHT_PGDAT_BALANCE=y
CONFIG_VNSWAP=y
CONFIG_SWAP_ENABLE_READAHEAD=n

CONFIG_BALANCE_ANON_FILE_RECLAIM=y

# KNOX SDP and DLP
CONFIG_SDP=y
CONFIG_DLP=y

# EPDG
CONFIG_NET_CORE=y
CONFIG_NET_SCH_PRIO=y
CONFIG_NET_SCHED=y   #depends on CONFIG_NET  which is enabled by default.. coz not seeing in the config file
CONFIG_NET_CLS_BASIC=y # required if basic is being used as a filter. depends on CONFIG_NET_CLS so enabling it by default
CONFIG_NET_CLS=y
CONFIG_NET_CLS_ACT=y # for enabling the action target.
CONFIG_NET_ACT_MIRRED=y  # for enabling the mirred target for redirecting the packet between the devices.
CONFIG_NET_EMATCH=y   #basic uses extended matches so this has to be present
CONFIG_NET_SCH_INGRESS=y # classifier for ingress packet
```

## arch/arm/configs/msm8937_sec_j6primelte_swa_open_defconfig
```kconfig
CONFIG_SEC_MSM8917_PROJECT=y
CONFIG_SEC_J6PRIMELTE_PROJECT=y
CONFIG_MACH_J6PRIMELTE_SWA_OPEN=y

CONFIG_DRV_SAMSUNG=y

#INPUT MODULES
CONFIG_SEC_DEBUG_TSP_LOG=y
CONFIG_TOUCHSCREEN_DUMP_MODE=y
CONFIG_TOUCHSCREEN_SEC_INCELL_TS=y
CONFIG_INPUT_TOUCHSCREEN_TCLMV2=y
CONFIG_INPUT_TOUCHSCREEN_TCLM=n

#MUIC
CONFIG_USE_MUIC=y
CONFIG_MUIC_NOTIFIER=y
CONFIG_MUIC_S2MU005=y
CONFIG_MFD_S2MU005=y
CONFIG_MUIC_S2MU005_DISCHARGING_WA=y 
CONFIG_MUIC_SUPPORT_RUSTPROOF=y
CONFIG_MUIC_S2MU005_INNER_BATTERY=y
CONFIG_MUIC_UART_SWITCH=y
CONFIG_MUIC_S2MU005_JIGB_CONTROL=y
CONFIG_MUIC_S2MU005_WATER_WA_DISABLE=y
CONFIG_MUIC_DOCK_NOTIFIER=n

#USB Host
CONFIG_USB_HOST_NOTIFY=y
CONFIG_VBUS_NOTIFIER=y
# CONFIG_DUAL_ROLE_USB_INTF is not set

# BATTERY & CHARGER
CONFIG_SAMSUNG_LPM_MODE=y
CONFIG_BATTERY_SAMSUNG=y
CONFIG_BATTERY_SAMSUNG_V2=y
CONFIG_BATTERY_NOTIFIER=y
CONFIG_PREVENT_SOC_JUMP=y
CONFIG_CHARGER_S2MU005=y
CONFIG_FUELGAUGE_S2MU005=y
CONFIG_S2MU005_INNER_BATTERY=y
CONFIG_BATTERY_SWELLING=y
CONFIG_SEC_MPP_SHARE=y
CONFIG_BATTERY_AGE_FORECAST=y
CONFIG_S2MU005_DISABLE_BUCK_MODE=y

CONFIG_SYSFS=y
CONFIG_INPUT=y
CONFIG_INPUT_MISC=y
CONFIG_INPUT_GPIO=y
CONFIG_INPUT_POLLDEV=y

#SENSORS
CONFIG_SENSORS=y
CONFIG_SENSORS_CORE=y
CONFIG_SENSORS_LSM6DSL=y
CONFIG_SENSORS_LSM6DSL_I2C=y
CONFIG_SENSORS_CM36686=y
CONFIG_SENSORS_STK3328=y
CONFIG_SENSORS_YAS539=y

# Fingerprint sensor
CONFIG_SENSORS_FINGERPRINT=y
CONFIG_SENSORS_FINGERPRINT_SYSFS=y
CONFIG_SENSORS_ET5XX=y
CONFIG_SENSORS_FP_SPI_NUMBER=7
CONFIG_SENSORS_FP_SPI_GPIO_START=85
CONFIG_SENSORS_FP_SPI_GPIO_END=88

#NFC
CONFIG_SAMSUNG_NFC=y
CONFIG_NFC_PN547=y
CONFIG_SEC_NFC_LOGGER=y

#HALL IC
# CONFIG_SENSORS_HALL is not set

#CAMERA
CONFIG_MSM_FRONT_EEPROM=y
CONFIG_SAMSUNG_MULTI_CAMERA=y
CONFIG_CAMERA_DUAL_REAR=y
CONFIG_GET_REAR_MODULE_ID=y
CONFIG_GET_FRONT_MODULE_ID=y
CONFIG_CAMERA_SYSFS_V2=y
CONFIG_GET_REAR_SENSOR_ID=y
CONFIG_GET_FRONT_SENSOR_ID=y

#AUDIO
CONFIG_SAMSUNG_JACK=y
# CONFIG_SLIMBUS is not set
# CONFIG_SLIMBUS_MSM_NGD is not set
# CONFIG_SOUNDWIRE is not set
# CONFIG_SEC_SND_SOLUTION is not set
# CONFIG_SEC_VOC_SOLUTION is not set
CONFIG_SEC_SND_ADAPTATION=y

#FLASH
#CONFIG_FLASHLIGHT=y
CONFIG_LEDS_S2MU005=y
CONFIG_LEDS_S2MU005_FLASH=y

#DISPLAY
CONFIG_PANEL_S6D7AT0B01_PM6003XB1_HDP=y
CONFIG_PANEL_S6D7AT0B01_BS060WKM_HDP=y
CONFIG_PANEL_HX83102D_BS060WKM_HDP=y
CONFIG_BLIC_LM3632A=y

# MOTOR
CONFIG_MSM_VIBRATOR=y

#SVC LEDS
CONFIG_LEDS_KTD2026=y

#Power off Alarm
# CONFIG_RTC_AUTO_PWRON is not set

# Legacy alarm dev
# CONFIG_ANDROID_INTF_ALARM_DEV is not set

CONFIG_NR_CPUS=4

# SSWAP
CONFIG_SWAP=y
CONFIG_FRONTSWAP=y
CONFIG_ZSMALLOC=y
CONFIG_ZSMALLOC_STAT=y
CONFIG_ZSMALLOC_OBJ_SEQ=n
CONFIG_PGTABLE_MAPPING=y
CONFIG_ZSWAP=y
#CONFIG_ZSWAP_COMPACTION is not set
CONFIG_ZSWAP_ENABLE_WRITEBACK=n
#CONFIG_ZSWAP_SAME_PAGE_SHARING is not set
CONFIG_ZPOOL=y
CONFIG_DIRECT_RECLAIM_FILE_PAGES_ONLY=y
CONFIG_INCREASE_MAXIMUM_SWAPPINESS=y
CONFIG_FIX_INACTIVE_RATIO=y
CONFIG_TIGHT_PGDAT_BALANCE=y
CONFIG_VNSWAP=y
CONFIG_SWAP_ENABLE_READAHEAD=n

#CONFIG_BALANCE_ANON_FILE_RECLAIM is not set

# MMC
CONFIG_SEC_HYBRID_TRAY=y

# KNOX SDP and DLP
CONFIG_SDP=y
CONFIG_DLP=y

# EPDG
CONFIG_NET_CORE=y
CONFIG_NET_SCH_PRIO=y
CONFIG_NET_SCHED=y   #depends on CONFIG_NET  which is enabled by default.. coz not seeing in the config file
CONFIG_NET_CLS_BASIC=y # required if basic is being used as a filter. depends on CONFIG_NET_CLS so enabling it by default
CONFIG_NET_CLS=y
CONFIG_NET_CLS_ACT=y # for enabling the action target.
CONFIG_NET_ACT_MIRRED=y  # for enabling the mirred target for redirecting the packet between the devices.
CONFIG_NET_EMATCH=y   #basic uses extended matches so this has to be present
CONFIG_NET_SCH_INGRESS=y # classifier for ingress packet
```

## arch/arm/configs/msm8939_sec_a5x_chnopen_defconfig
```kconfig
CONFIG_SEC_A5X_PROJECT=y
CONFIG_MACH_A5X_CHN_OPEN=y

# HARD RESET
CONFIG_RESTART_REASON_SEC_PARAM=y

# GPIO SETTING
#CONFIG_SEC_GPIO_SETTINGS=y

# GPIO EXPANDER
CONFIG_GPIO_PCAL6416A=y

# VIBRATOR
CONFIG_MSM_VIBRATOR=y

# MUIC
CONFIG_USE_MUIC=y
CONFIG_MUIC_NOTIFIER=y
CONFIG_MUIC_UNIVERSAL=y
CONFIG_MUIC_UNIVERSAL_SM5705=y
CONFIG_MUIC_PINCTRL=y
CONFIG_MUIC_UNIVERSAL_SM5705_AFC=y
CONFIG_VBUS_NOTIFIER=y

# HALL IC
CONFIG_SENSORS_HALL=y
CONFIG_SENSORS_HALL_REAR=y

#############################################
# SOUND FEATURE
#############################################
CONFIG_AUDIO_SPEAKER_OUT_NXP_AMP_ENABLE=y
CONFIG_AUDIO_QUAT_I2S_ENABLE=y
CONFIG_SW_100K_TO_GND=y
CONFIG_JACK_AUDIO=y
#############################################

#SENSOR
CONFIG_SENSORS=y
CONFIG_SENSORS_CORE=y
CONFIG_SENSORS_SX9310 is not set
CONFIG_SENSORS_CM36655=y
# CONFIG_SENSORS_CM36652_SENSOR_EN_GPIO is not set
# CONFIG_SENSORS_CM36652_LEDA_EN_GPIO is not set
CONFIG_SENSORS_AK09916C=y
CONFIG_SENSORS_BHI=y
CONFIG_IIO=y
CONFIG_IIO_BUFFER=y
CONFIG_IIO_KFIFO_BUF=y
CONFIG_IIO_TRIGGER=y

# Finger print sensor
CONFIG_SENSORS_FINGERPRINT=y
CONFIG_SENSORS_FINGERPRINT_SYSFS=y
CONFIG_SENSORS_VFS7XXX=y
CONFIG_SENSORS_FP_SPI_GPIO_START=8
CONFIG_SENSORS_FP_SPI_GPIO_END=11
CONFIG_SENSORS_FP_MASTER_ID=86
CONFIG_SENSORS_FP_LOCKSCREEN_MODE=y

#NFC
CONFIG_NFC=y
CONFIG_SEC_NFC=y
CONFIG_SEC_NFC_IF_I2C=y
CONFIG_SEC_NFC_PRODUCT_N5=y
CONFIG_SEC_NFC_USE_8916_BBCLK2=y
CONFIG_SEC_NFC_IO_EN=y
CONFIG_ESE_P3=y

#USB Host
CONFIG_USB_HOST_NOTIFY=y

# Charging/Battery
CONFIG_CHARGER_SM5705=y
CONFIG_FUELGAUGE_SM5705=y
CONFIG_BATTERY_SAMSUNG=y
CONFIG_BATTERY_SAMSUNG_DATA_FILE="a5x_battery_data.h"
CONFIG_SAMSUNG_LPM_MODE=y
CONFIG_BATTERY_SWELLING=y
CONFIG_BATTERY_SWELLING_SELF_DISCHARGING=y
CONFIG_PREVENT_SOC_JUMP=y
CONFIG_INBATTERY=y
CONFIG_MFD_SM5705=y
CONFIG_REGULATOR_SM5705=y
CONFIG_AFC_CHARGER_MODE=y

#Power off Alarm
CONFIG_RTC_AUTO_PWRON=y
CONFIG_RTC_AUTO_PWRON_PARAM=y

#DISPLAY
CONFIG_PANEL_S6E3FA3_AMS520KG01_FHD=y

# TIMA LOG
# CONFIG_ARCH_MSM8939_TIMA=y

#CAMERA
CONFIG_CAM_DISABLE_LPM_MODE=y
CONFIG_S5K3L2XX=y
CONFIG_S5K5E3YX=y
CONFIG_MSM_FRONT_EEPROM=y
CONFIG_CAM_PN547_PVDD_EN_CONTROL=y
CONFIG_SW_LANDING_FOR_MULTI_TASKING=y
CONFIG_CAMERA_SYSFS_V2=y
CONFIG_OIS=y
#CONFIG_MSM_OTP is not set

#FLASH
CONFIG_FLASHLIGHT=y
CONFIG_SM_FLASH_LED=y
#CONFIG_FLED_SM5703_EXT_GPIO=y
CONFIG_LEDS_SM5705=y

# debugging more information
#CONFIG_DEBUG_FS=y

#MMC
CONFIG_SEC_HYBRID_TRAY=y

# INPUT
CONFIG_TOUCHSCREEN_ZT7538=y
CONFIG_KEYBOARD_ABOV_TOUCH_FT18XX=y
CONFIG_KEYBOARD_ABOV_TOUCH_FT16XX=y
# CONFIG_SECURE_TOUCH is not set

# SSWAP
CONFIG_SWAP=y
CONFIG_FRONTSWAP=y
CONFIG_ZSMALLOC=y
CONFIG_PGTABLE_MAPPING=y
CONFIG_ZSWAP=y
CONFIG_ZPOOL=y
CONFIG_DIRECT_RECLAIM_FILE_PAGES_ONLY=y
CONFIG_INCREASE_MAXIMUM_SWAPPINESS=y
CONFIG_FIX_INACTIVE_RATIO=y
CONFIG_TIGHT_PGDAT_BALANCE=y
CONFIG_VNSWAP=y
CONFIG_SWAP_ENABLE_READAHEAD=n

# SDP
CONFIG_SDP=y

# MST
CONFIG_MST_LDO=y
```
