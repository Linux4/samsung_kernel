## arch/arm/configs/msm8952_sec_eng_defconfig
```kconfig
CONFIG_LIMITS_MONITOR=y
CONFIG_LIMITS_LITE_HW=y

# CONFIG_CORESIGHT_CTI_SAVE_DISABLE is not set

CONFIG_CORESIGHT_ETMV4=y
CONFIG_CORESIGHT_REMOTE_ETM=y
CONFIG_CORESIGHT_QPDI=y
CONFIG_CORESIGHT_DBGUI=y

# CONFIG_MSM_FORCE_WDOG_BITE_ON_PANIC is not set

CONFIG_PAGE_OWNER=y
CONFIG_LOCKUP_DETECTOR=y
CONFIG_BOOTPARAM_SOFTLOCKUP_PANIC=y
# CONFIG_DETECT_HUNG_TASK is not set

CONFIG_DEBUG_OBJECTS=y
CONFIG_DEBUG_OBJECTS_FREE=y
CONFIG_DEBUG_OBJECTS_TIMERS=y
CONFIG_DEBUG_OBJECTS_WORK=y
CONFIG_DEBUG_OBJECTS_RCU_HEAD=y
CONFIG_DEBUG_OBJECTS_PERCPU_COUNTER=y
CONFIG_DEBUG_KMEMLEAK=y
CONFIG_DEBUG_KMEMLEAK_DEFAULT_OFF=y
CONFIG_DEBUG_KMEMLEAK_EARLY_LOG_SIZE=4000
CONFIG_DEBUG_TASK_STACK_SCAN_OFF=y
CONFIG_DEBUG_MODULE_SCAN_OFF=y
CONFIG_DEBUG_SPINLOCK=y
CONFIG_DEBUG_MUTEXES=y
CONFIG_DEBUG_ATOMIC_SLEEP=y
CONFIG_DEBUG_STACK_USAGE=y
CONFIG_DEBUG_HIGHMEM=y
CONFIG_DEBUG_VM=y
CONFIG_DEBUG_LIST=y
CONFIG_FAULT_INJECTION=y
CONFIG_FAIL_PAGE_ALLOC=y
CONFIG_FAULT_INJECTION_DEBUG_FS=y
CONFIG_FAULT_INJECTION_STACKTRACE_FILTER=y
CONFIG_SLUB_DEBUG_PANIC_ON=y
#CONFIG_MSM_RTB is not set
#CONFIG_MSM_RTB_SEPARATE_CPUS is not set
CONFIG_BLK_DEV_IO_TRACE=y
CONFIG_PANIC_ON_DATA_CORRUPTION=y
CONFIG_FREE_PAGES_RDONLY=y
CONFIG_KERNEL_TEXT_RDONLY=y
CONFIG_DEBUG_LL=y
CONFIG_EARLY_PRINTK=y

# GPIO DVS feature
CONFIG_SEC_GPIO_DVS=y

# MMC
CONFIG_BLOCK=y
CONFIG_BLK_DEV_IO_TRACE=y

#MSM8952 SEC_DEBUG
CONFIG_SEC_DEBUG=y
CONFIG_SEC_DEBUG_SEC_WDOG_BITE=y
CONFIG_USER_RESET_DEBUG_TEST=y
CONFIG_PHYS_OFFSET=y

CONFIG_DEBUG_THERMAL=y
#CONFIG_SEC_DEBUG_SUMMARY is not set

CONFIG_SLUB_DEBUG=y
CONFIG_MSM_ENABLE_WDOG_DEBUG_CONTROL=y
CONFIG_DEBUG_GPIO=y
CONFIG_MSM_SMD_DEBUG=y
CONFIG_DEBUG_MEMORY_INIT=y
CONFIG_DYNAMIC_DEBUG=y
CONFIG_DEBUG_SET_MODULE_RONX=y
CONFIG_CGROUP_DEBUG=y
```

## arch/arm/configs/msm8952_sec_j7xlte_chn_defconfig
```kconfig
CONFIG_SEC_J7XLTE_PROJECT=y
CONFIG_MACH_J7XLTE_CHN_CTC=y
CONFIG_DRV_SAMSUNG=y

#
# MAX77843 IC
#
# CONFIG_EXTCON is not set
# CONFIG_EXTCON_MAX77843 is not set
# CONFIG_MFD_MAX77843 is not set

#MUIC
CONFIG_USE_MUIC=y
CONFIG_MUIC_NOTIFIER=y
CONFIG_MUIC_S2MU005=y
CONFIG_MFD_S2MU005=y

CONFIG_USB_HOST_NOTIFY=y

# RUSTPROOF
CONFIG_MUIC_SUPPORT_RUSTPROOF=y

# VBUS_NOTI
CONFIG_VBUS_NOTIFIER=y

# HALL IC
CONFIG_SENSORS_HALL=y
# CONFIG_CERTIFY_HALL is not set

# Service LED
# CONFIG_LEDS_MAX77843_RGB is not set

#
# MOTOR
#
CONFIG_MSM_VIBRATOR=y
# CONFIG_VIBETONZ=y
# CONFIG_TACTILE_ASSIST=y
#
# DISPLAY(MDSS)
#
CONFIG_PANEL_S6E3FA3_AMS549JR01_FHD=y

#FLASH
CONFIG_FLASHLIGHT=y
CONFIG_SM_FLASH_LED=y
# CONFIG_LEDS_SM5705=y

#CAMERA
#CONFIG_MSM_FRONT_EEPROM=y

# XO SHUTDOWN
CONFIG_UART3=y

#OIS
#CONFIG_BU24219_OIS=y
#CONFIG_CAM_EXTERNAL=y

# BATTERY & CHARGER
CONFIG_SAMSUNG_LPM_MODE=y
CONFIG_BATTERY_SAMSUNG=y
CONFIG_PREVENT_SOC_JUMP=y
CONFIG_SW_SELF_DISCHARGING=y
CONFIG_CHARGER_S2MU005=y
CONFIG_FUELGAUGE_S2MU005=y
CONFIG_BATTERY_SWELLING=y

#Power off Alarm
CONFIG_RTC_AUTO_PWRON=y
CONFIG_RTC_AUTO_PWRON_PARAM=y

#
# InputDevice
#
CONFIG_TOUCHSCREEN_MELFAS_MMS438=y
CONFIG_KEYBOARD_TC300K=y
#CONFIG_SECURE_TOUCH=y

# CONFIG_MFD_S2MPB02 is not set
# CONFIG_REGULATOR_S2MPB02 is not set
# CONFIG_MFD_SM5705=y
# CONFIG_REGULATOR_SM5705=y

#
# Sensor
#
CONFIG_SENSORS=y
CONFIG_SENSORS_SSC=n
CONFIG_SENSORS_CORE=y
CONFIG_SENSORS_K2HH=y
# CONFIG_SENSORS_K2HH_VDD is not set
CONFIG_SENSORS_CM36686=y

#NFC
CONFIG_NFC_PN547=y
CONFIG_NFC_PN547_8916_USE_BBCLK2=y
CONFIG_NFC_PN547_PVDD_EN_CONTROL=y

# GPIO DVS feature
CONFIG_SEC_GPIO_DVS=y

#
# Audio
CONFIG_SND_SOC_MSM8X16_WCD=y
# CONFIG_AUDIO_SPEAKER_OUT_NXP_AMP_ENABLE is not set
CONFIG_SND_SOC_MSM8X16_RT5659=y
# Earjack
CONFIG_SAMSUNG_JACK=y
CONFIG_INPUT_GPIO=y
CONFIG_SW_100K_TO_GND=y

#MST
CONFIG_MST_LDO=y
# CONFIG_SCHED_TASK_BEHAVIOR is not set

#CAMERA
CONFIG_S5K3L2XX=y
CONFIG_S5K5E3YX=y

# SSWAP
CONFIG_SWAP=y
CONFIG_FRONTSWAP=y
CONFIG_ZSMALLOC=y
CONFIG_PGTABLE_MAPPING=y
CONFIG_ZSWAP=y
CONFIG_ZPOOL=y
CONFIG_DIRECT_RECLAIM_FILE_PAGES_ONLY=y
CONFIG_INCREASE_MAXIMUM_SWAPPINESS=y
CONFIG_FIX_INACTIVE_RATIO=y
CONFIG_TIGHT_PGDAT_BALANCE=y
CONFIG_VNSWAP=y
CONFIG_SWAP_ENABLE_READAHEAD=n
```

## arch/arm/configs/msm8952_sec_on5xlte_chn_defconfig
```kconfig
CONFIG_SEC_ON5XLTE_PROJECT=y
CONFIG_MACH_ON5XLTE_CHN_OPEN=y
CONFIG_DRV_SAMSUNG=y

#CPUSET
CONFIG_CPUSETS=y

#SKU theme
CONFIG_SKU_THEME=y

#
# MAX77843 IC
#
# CONFIG_EXTCON is not set
# CONFIG_EXTCON_MAX77843 is not set
# CONFIG_MFD_MAX77843 is not set

#MUIC
CONFIG_USE_MUIC=y
CONFIG_MUIC_NOTIFIER=y
CONFIG_MUIC_S2MU005=y
CONFIG_MFD_S2MU005=y
# CONFIG_MUIC_UNIVERSAL is not set
# CONFIG_MUIC_UNIVERSAL_SM5705 is not set
# CONFIG_MUIC_PINCTRL is not set
# CONFIG_MUIC_UNIVERSAL_SM5705_AFC is not set
# CONFIG_MFD_SM5705 is not set
# CONFIG_SM5705_SUPPORT_GAMEPAD is not set

# VBUS_NOTI
CONFIG_VBUS_NOTIFIER=y

CONFIG_USB_HOST_NOTIFY=y

# RUSTPROOF
CONFIG_MUIC_SUPPORT_RUSTPROOF=y

# VBUS_NOTI
CONFIG_VBUS_NOTIFIER=y

# HALL IC
# CONFIG_SENSORS_HALL is not set

# Service LED
CONFIG_LEDS_S2MU005_RGB=y
CONFIG_LEDS_CLASS=y

#
# MOTOR
#
CONFIG_SS_VIBRATOR=y
CONFIG_DC_MOTOR_PMIC=y
# CONFIG_VIBETONZ=y
# CONFIG_TACTILE_ASSIST=y

#
# DISPLAY(MDSS)
#
CONFIG_PANEL_HX83100A_C5001H3F_HD=y
CONFIG_BLIC_ISL98611=y
CONFIG_PANEL_TD4100_C5001H3F_HD=y

#EEPROM
CONFIG_GET_REAR_MODULE_ID=y

#FLASH
CONFIG_FLASHLIGHT=y
CONFIG_SM_FLASH_LED=y
# CONFIG_LEDS_SM5705 is not set
# CONFIG_DUAL_LEDS_FLASH is not set
CONFIG_LEDS_S2MU005=y
CONFIG_LEDS_S2MU005_FLASH=y

#CAMERA
CONFIG_MSM_FRONT_EEPROM=y

# XO SHUTDOWN
CONFIG_UART3=y

#OIS
#CONFIG_BU24219_OIS=y
#CONFIG_CAM_EXTERNAL=y

# BATTERY & CHARGER
CONFIG_BATTERY_SAMSUNG=y
CONFIG_BATTERY_SAMSUNG_V2=y
CONFIG_SAMSUNG_LPM_MODE=y
CONFIG_BATTERY_SWELLING=y
CONFIG_PREVENT_SOC_JUMP=y
CONFIG_FUELGAUGE_S2MU005=y
CONFIG_CHARGER_S2MU005=y
CONFIG_INBATVOLT_FG=y
CONFIG_BATTERY_AGE_FORECAST=y

#Power off Alarm
CONFIG_RTC_AUTO_PWRON=y
CONFIG_RTC_AUTO_PWRON_PARAM=y

#
# InputDevice
#
CONFIG_SEC_INCELL=y
CONFIG_TOUCHSCREEN_SYNAPTICS_INCELL=y
CONFIG_KEYBOARD_MELFAS_MHS204=y

# CONFIG_MFD_S2MPB02 is not set
# CONFIG_REGULATOR_S2MPB02 is not set
# CONFIG_MFD_SM5705=y
# CONFIG_REGULATOR_SM5705=y

# Finger print sensor
CONFIG_SENSORS_FINGERPRINT=y
CONFIG_SENSORS_FINGERPRINT_SYSFS=y
CONFIG_SENSORS_ET510=y
CONFIG_SENSORS_FP_SPI_NUMBER=0
CONFIG_SENSORS_FP_SPI_GPIO_START=0
CONFIG_SENSORS_FP_SPI_GPIO_END=3

#
# SD Card
#
CONFIG_SEC_HYBRID_TRAY=y

#
# Sensor
#
CONFIG_SENSORS=y
CONFIG_SENSORS_CORE=y
CONFIG_SENSORS_K2HH=y
CONFIG_SENSORS_STK3013=y
CONFIG_SENSORS_STK3013_SENSOR_EN_GPIO=y

# GPIO EXPANDER
CONFIG_GPIO_PCAL6416A=y

#
# Audio
CONFIG_SND_SOC_MSM8X16_WCD=y
# Earjack
CONFIG_SAMSUNG_JACK=y
CONFIG_INPUT_GPIO=y
CONFIG_SW_100K_TO_GND=y

#MST
# CONFIG_MST_LDO is not set
# CONFIG_SCHED_TASK_BEHAVIOR is not set

# SSWAP
CONFIG_SWAP=y
CONFIG_FRONTSWAP=y
CONFIG_ZSMALLOC=y
CONFIG_PGTABLE_MAPPING=y
CONFIG_ZSWAP=y
CONFIG_ZPOOL=y
CONFIG_DIRECT_RECLAIM_FILE_PAGES_ONLY=y
CONFIG_INCREASE_MAXIMUM_SWAPPINESS=y
CONFIG_FIX_INACTIVE_RATIO=y
CONFIG_TIGHT_PGDAT_BALANCE=y
CONFIG_VNSWAP=y
CONFIG_SWAP_ENABLE_READAHEAD=n

#WLAN Built-in driver
CONFIG_PRONTO_WLAN=y
CONFIG_PRIMA_WLAN_BTAMP=n
CONFIG_PRIMA_WLAN_LFR=y
CONFIG_PRIMA_WLAN_11AC_HIGH_TP=y
CONFIG_QCOM_TDLS=y
CONFIG_QCOM_VOWIFI_11R=y
CONFIG_ENABLE_LINUX_REG=y
CONFIG_WLAN_OFFLOAD_PACKETS=y
CONFIG_QCOM_ESE=n
CONFIG_QCOM_ESE_UPLOAD=n
CONFIG_WLAN_FEATURE_11W=y

CONFIG_IP_NF_MATCH_RPFILTER=y
CONFIG_IP6_NF_MATCH_RPFILTER=y
```

## arch/arm/configs/msm8974_sec_chagallspr_defconfig
```kconfig
# from msm8974_sec_defconfig
CONFIG_AUDIT=y
# CONFIG_MSM_PIL_PRONTO is not set
CONFIG_NET_KEY=y
CONFIG_IP_MULTICAST=y
CONFIG_INET_XFRM_MODE_TRANSPORT=y
CONFIG_INET_XFRM_MODE_TUNNEL=y
CONFIG_NF_CONNTRACK_SECMARK=y
# CONFIG_NF_CONNTRACK_SIP is not set
CONFIG_NETFILTER_XT_TARGET_CONNSECMARK=y
CONFIG_NETFILTER_XT_TARGET_NOTRACK=y
CONFIG_NETFILTER_XT_TARGET_SECMARK=y
CONFIG_NETFILTER_XT_TARGET_TCPMSS=y
CONFIG_IP_NF_SECURITY=y
CONFIG_UHID=y
CONFIG_HID=y
CONFIG_HIDRAW=y
#CONFIG_BT_HCISMD=y
# CONFIG_BT_HCISMD is not set
# CONFIG_MSM_BT_POWER is not set
CONFIG_PPP=y
CONFIG_PPP_BSDCOMP=y
CONFIG_PPP_DEFLATE=y
CONFIG_PPP_MPPE=y
CONFIG_PPPOLAC=y
CONFIG_PPPOPNS=y
# CONFIG_WCNSS_CORE is not set
# CONFIG_WCNSS_CORE_PRONTO is not set
# CONFIG_WCNSS_MEM_PRE_ALLOC is not set
CONFIG_SENSORS_QPNP_ADC_CURRENT=y
CONFIG_IMX132=y
CONFIG_MSM_WFD=y
# CONFIG_FB_MSM_MDSS_HDMI_MHL_SII8334 is not set
CONFIG_FB_MSM_MDSS_DBG_SEQ_TICK=y
CONFIG_FB_MSM_MDSS_DSI_DBG=y
CONFIG_SND_SOC_MSM_HDMI_CODEC_RX=y
# CONFIG_LCD_CLASS_DEVICE is not set
# CONFIG_HID_PID is not set
# CONFIG_USB_HIDDEV is not set
CONFIG_HID_A4TECH=y
CONFIG_HID_ACRUX=y
# CONFIG_HID_ACRUX_FF is not set
CONFIG_HID_BELKIN=y
CONFIG_HID_CHERRY=y
CONFIG_HID_CHICONY=y
CONFIG_HID_PRODIKEYS=y
CONFIG_HID_CYPRESS=y
CONFIG_HID_DRAGONRISE=y
CONFIG_HID_EMS_FF=y
CONFIG_HID_ELECOM=y
CONFIG_HID_EZKEY=y
CONFIG_HID_KEYTOUCH=y
CONFIG_HID_KYE=y
CONFIG_HID_UCLOGIC=y
CONFIG_HID_WALTOP=y
CONFIG_HID_GYRATION=y
CONFIG_HID_TWINHAN=y
CONFIG_HID_KENSINGTON=y
CONFIG_HID_LCPOWER=y
CONFIG_HID_LOGITECH=y
CONFIG_HID_MONTEREY=y
CONFIG_HID_MULTITOUCH=y
CONFIG_HID_NTRIG=y
CONFIG_HID_ORTEK=y
CONFIG_HID_PANTHERLORD=y
CONFIG_HID_PETALYNX=y
CONFIG_HID_PICOLCD=y
# CONFIG_HID_PICOLCD_FB is not set
# CONFIG_HID_PICOLCD_BACKLIGHT is not set
# CONFIG_HID_PICOLCD_LCD is not set
# CONFIG_HID_PICOLCD_LEDS is not set
CONFIG_HID_QUANTA=y
CONFIG_HID_ROCCAT=y
CONFIG_HID_ROCCAT_COMMON=y
CONFIG_HID_ROCCAT_ARVO=y
CONFIG_HID_ROCCAT_KONE=y
CONFIG_HID_ROCCAT_KONEPLUS=y
CONFIG_HID_ROCCAT_KOVAPLUS=y
CONFIG_HID_ROCCAT_PYRA=y
CONFIG_HID_SAMSUNG=y
CONFIG_HID_SONY=y
CONFIG_HID_SUNPLUS=y
CONFIG_HID_GREENASIA=y
CONFIG_HID_SMARTJOYPLUS=y
CONFIG_HID_TOPSEED=y
CONFIG_HID_THRUSTMASTER=y
CONFIG_HID_WACOM=y
CONFIG_HID_WACOM_POWER_SUPPLY=y
CONFIG_HID_ZEROPLUS=y
CONFIG_HID_ZYDACRON=y
# CONFIG_IIO is not set
# CONFIG_IIO_BUFFER is not set
# CONFIG_IIO_SW_RING is not set
# CONFIG_IIO_KFIFO_BUF is not set
# CONFIG_INV_MPU_IIO is not set
# CONFIG_SENSORS_GP2A_IIO is not set
# CONFIG_SENSORS_CORE is not set
# CONFIG_INV_TESTING is not set
CONFIG_EXT4_FS_SECURITY=y
CONFIG_ENABLE_DEFAULT_TRACERS=y
CONFIG_SECURITY=y
CONFIG_SECURITY_NETWORK=y
CONFIG_LSM_MMAP_MIN_ADDR=4096
CONFIG_SECURITY_SELINUX=y
CONFIG_MHL_VERSION=0x21

CONFIG_MACH_CHAGALL=y
CONFIG_MACH_CHAGALL_LTE=y
CONFIG_MACH_CHAGALL_SPR=y
CONFIG_LCD_CLASS_DEVICE=y
CONFIG_BACKLIGHT_LCD_SUPPORT=y
CONFIG_BACKLIGHT_CLASS_DEVICE=y
CONFIG_FB_MSM_MIPI_SAMSUNG_OCTA_CMD_WQXGA_S6TNMR7_PT_PANEL=y

#
# ODE and DIR Encryption
#
CONFIG_CRYPTO=y
CONFIG_CRYPTO_SHA1=y
CONFIG_CRYPTO_SHA256=y
CONFIG_CRYPTO_AES=y
CONFIG_CRYPTO_CBC=y
CONFIG_ECRYPT_FS=y
CONFIG_WTL_ENCRYPTION_FILTER=y
CONFIG_KEYS_DEBUG_PROC_KEYS=y

# BT
CONFIG_BT_BCM4354=y

#
# Battery driver(Charger, Fuelgauge)
#

CONFIG_BATTERY_SAMSUNG=y
CONFIG_BATTERY_SAMSUNG_DATA_FILE="chagall_battery_data.h"
CONFIG_SAMSUNG_LPM_MODE=y
CONFIG_FUELGAUGE_MAX17050=y
CONFIG_FUELGAUGE_MAX17050_COULOMB_COUNTING=y
CONFIG_CHARGER_SMB358=y

CONFIG_SENSORS_HALL=y
CONFIG_GLOVE_TOUCH=y
#
# Motor
CONFIG_VIBETONZ=y
CONFIG_MOTOR_DRV_DRV2603=y
# Actuator
#
CONFIG_I2C_ACTUATOR=y

#LED
#CONFIG_LEDS_QPNP=y


# Earjack
CONFIG_SAMSUNG_JACK=y
CONFIG_INPUT_GPIO=y

#
# Remove Qualcomm Wifi features
#
# CONFIG_WCNSS_CORE is not set
# CONFIG_WCNSS_CORE_PRONTO is not set
# CONFIG_MSM_PIL_PRONTO is not set
# CONFIG_WCNSS_MEM_PRE_ALLOC is not set

#
# Add Broadcomm Wifi features
#
CONFIG_NET_CORE=y
CONFIG_WIRELESS=y
CONFIG_WIRELESS_EXT_SYSFS=y
CONFIG_WEXT_CORE=y
CONFIG_WEXT_PROC=y
CONFIG_CFG80211=y
CONFIG_CFG80211_DEFAULT_PS=y
CONFIG_CFG80211_ALLOW_RECONNECT=y
CONFIG_WLAN=y
CONFIG_WIFI_CONTROL_FUNC=y
CONFIG_BCM4354=y
CONFIG_BCMDHD_FW_PATH="/system/etc/wifi/bcmdhd_sta.bin"
CONFIG_BCMDHD_NVRAM_PATH="/system/etc/wifi/nvram_net.txt"
CONFIG_BROADCOM_WIFI_RESERVED_MEM=y
CONFIG_WLAN_REGION_CODE=404
CONFIG_MMC_MSM_SDC2_SUPPORT=y
CONFIG_CFG80211_REG_NOT_UPDATED=y
CONFIG_WIFI_MULTICAST_LOG=y
CONFIG_WIFI_BROADCOM_COB=y

#
# DWC3 usb 3.0 driver
#
CONFIG_USB_DWC3=y
CONFIG_USB_ANDROID_SAMSUNG_SIDESYNC=y

# TouchScreen / TouchKey
CONFIG_TOUCHSCREEN_SYNAPTICS_I2C_RMI=y
CONFIG_KEYBOARD_TC360_TOUCHKEY=y
CONFIG_USB_SWITCH_FSA9485=y
CONFIG_MUIC_FSA9485_SUPPORT_LANHUB=y
CONFIG_USB_STORAGE_DETECT=y
CONFIG_USB_HOST_NOTIFY=y
#ethernet driver
CONFIG_USB_NET_SMSC75XX=y
CONFIG_USB_NET_SMSC95XX=y

# Sensors
CONFIG_SENSORS=y
CONFIG_SENSORS_BMI055=y
CONFIG_SENSORS_CM3323=y
CONFIG_SENSORS_AK09911C=y
CONFIG_SENSORS_SX9500=y
CONFIG_SENSORS_SX9500_INIT_TOUCH_THRESHOLD=8000
CONFIG_SENSORS_SX9500_NORMAL_TOUCH_THRESHOLD=6
#
# Finger print sensor
#
CONFIG_SENSORS_FINGERPRINT=y
CONFIG_SENSORS_FINGERPRINT_SYSFS=y
CONFIG_SENSORS_VFS61XX=y
CONFIG_SENSORS_VFS61XX_KO=y

CONFIG_SEC_FPGA=y
CONFIG_IR_REMOCON_FPGA=y

#
# NFC features (NXP)
#
# CONFIG_PN547_NFC is not set
#
# Camera 8M sensor
#
# CONFIG_IMX135 is not set
CONFIG_IMX134=y

# SSWAP
CONFIG_SWAP=y
CONFIG_FRONTSWAP=y
CONFIG_ZSMALLOC_NEW=y
CONFIG_PGTABLE_MAPPING=y
CONFIG_ZSWAP=y
CONFIG_DIRECT_RECLAIM_FILE_PAGES_ONLY=n
CONFIG_INCREASE_MAXIMUM_SWAPPINESS=y
CONFIG_FIX_INACTIVE_RATIO=y
CONFIG_TIGHT_PGDAT_BALANCE=y
CONFIG_VNSWAP=y
CONFIG_SWAP_ENABLE_READAHEAD=n

# RCU
CONFIG_RCU_FAST_NO_HZ=y
CONFIG_RCU_FAST_NO_HZ_OFF_AT_BOOT=y
```
