## arch/arm/configs/msm8974_sec_hlte_tmo_defconfig
```kconfig
# from msm8974_sec_defconfig
CONFIG_AUDIT=y
# CONFIG_MSM_PIL_PRONTO is not set
CONFIG_NET_KEY=y
CONFIG_IP_MULTICAST=y
CONFIG_INET_XFRM_MODE_TRANSPORT=y
CONFIG_INET_XFRM_MODE_TUNNEL=y
CONFIG_NF_CONNTRACK_SECMARK=y
# CONFIG_NF_CONNTRACK_SIP is not set
CONFIG_NETFILTER_XT_TARGET_CONNSECMARK=y
CONFIG_NETFILTER_XT_TARGET_NOTRACK=y
CONFIG_NETFILTER_XT_TARGET_SECMARK=y
CONFIG_NETFILTER_XT_TARGET_TCPMSS=y
CONFIG_IP_NF_SECURITY=y
CONFIG_UHID=y
CONFIG_HID=y
CONFIG_HIDRAW=y
#CONFIG_BT_HCISMD=y
# CONFIG_BT_HCISMD is not set
# CONFIG_MSM_BT_POWER is not set
CONFIG_PPP=y
CONFIG_PPP_BSDCOMP=y
CONFIG_PPP_DEFLATE=y
CONFIG_PPP_MPPE=y
CONFIG_PPPOLAC=y
CONFIG_PPPOPNS=y
# CONFIG_WCNSS_CORE is not set
# CONFIG_WCNSS_CORE_PRONTO is not set
# CONFIG_WCNSS_MEM_PRE_ALLOC is not set
CONFIG_SENSORS_QPNP_ADC_CURRENT=y
CONFIG_IMX132=y
CONFIG_MSM_WFD=y
# CONFIG_FB_MSM_MDSS_HDMI_MHL_SII8334 is not set
CONFIG_FB_MSM_MDSS_DBG_SEQ_TICK=y
CONFIG_FB_MSM_MDSS_DSI_DBG=y
CONFIG_SND_SOC_MSM_HDMI_CODEC_RX=y
CONFIG_MDNIE_LITE_TUNING=y
CONFIG_LCD_CLASS_DEVICE=y
CONFIG_BACKLIGHT_LCD_SUPPORT=y
CONFIG_BACKLIGHT_CLASS_DEVICE=y
CONFIG_FB_MSM_MIPI_SAMSUNG_OCTA_CMD_FULL_HD_PT_PANEL=y
# CONFIG_HID_PID is not set
# CONFIG_USB_HIDDEV is not set
CONFIG_HID_A4TECH=y
CONFIG_HID_ACRUX=y
# CONFIG_HID_ACRUX_FF is not set
CONFIG_HID_BELKIN=y
CONFIG_HID_CHERRY=y
CONFIG_HID_CHICONY=y
CONFIG_HID_PRODIKEYS=y
CONFIG_HID_CYPRESS=y
CONFIG_HID_DRAGONRISE=y
CONFIG_HID_EMS_FF=y
CONFIG_HID_ELECOM=y
CONFIG_HID_EZKEY=y
CONFIG_HID_KEYTOUCH=y
CONFIG_HID_KYE=y
CONFIG_HID_UCLOGIC=y
CONFIG_HID_WALTOP=y
CONFIG_HID_GYRATION=y
CONFIG_HID_TWINHAN=y
CONFIG_HID_KENSINGTON=y
CONFIG_HID_LCPOWER=y
CONFIG_HID_LOGITECH=y
CONFIG_HID_MONTEREY=y
CONFIG_HID_MULTITOUCH=y
CONFIG_HID_NTRIG=y
CONFIG_HID_ORTEK=y
CONFIG_HID_PANTHERLORD=y
CONFIG_HID_PETALYNX=y
CONFIG_HID_PICOLCD=y
# CONFIG_HID_PICOLCD_FB is not set
# CONFIG_HID_PICOLCD_BACKLIGHT is not set
# CONFIG_HID_PICOLCD_LCD is not set
# CONFIG_HID_PICOLCD_LEDS is not set
CONFIG_HID_QUANTA=y
CONFIG_HID_ROCCAT=y
CONFIG_HID_ROCCAT_COMMON=y
CONFIG_HID_ROCCAT_ARVO=y
CONFIG_HID_ROCCAT_KONE=y
CONFIG_HID_ROCCAT_KONEPLUS=y
CONFIG_HID_ROCCAT_KOVAPLUS=y
CONFIG_HID_ROCCAT_PYRA=y
CONFIG_HID_SAMSUNG=y
CONFIG_HID_SONY=y
CONFIG_HID_SUNPLUS=y
CONFIG_HID_GREENASIA=y
CONFIG_HID_SMARTJOYPLUS=y
CONFIG_HID_TOPSEED=y
CONFIG_HID_THRUSTMASTER=y
CONFIG_HID_WACOM=y
CONFIG_HID_WACOM_POWER_SUPPLY=y
CONFIG_HID_ZEROPLUS=y
CONFIG_HID_ZYDACRON=y
CONFIG_IIO=y
CONFIG_IIO_BUFFER=y
# CONFIG_IIO_SW_RING is not set
CONFIG_IIO_KFIFO_BUF=y
CONFIG_IIO_TRIGGER=y
CONFIG_IIO_ST_HWMON=y
# CONFIG_INV_MPU_IIO is not set
# CONFIG_SENSORS_GP2A_IIO is not set
# CONFIG_SENSORS_CORE is not set
# CONFIG_INV_TESTING is not set
CONFIG_EXT4_FS_SECURITY=y
CONFIG_ENABLE_DEFAULT_TRACERS=y
CONFIG_SECURITY=y
CONFIG_SECURITY_NETWORK=y
CONFIG_LSM_MMAP_MIN_ADDR=4096
CONFIG_SECURITY_SELINUX=y

CONFIG_SEC_H_PROJECT=y
CONFIG_MACH_HLTETMO=y

CONFIG_I2C_GPIO=y

#
# MAX77803 IC
#
CONFIG_MAX77803_MUIC=y
CONFIG_MFD_MAX77803=y
CONFIG_REGULATOR_MAX77803=y
CONFIG_MOTOR_DRV_MAX77803=y
CONFIG_VIBETONZ=y
CONFIG_TACTILE_ASSIST=y
CONFIG_LEDS_MAX77803=y

#LED FLAG
CONFIG_LEDS_QPNP=y


#one wire
CONFIG_W1=y
CONFIG_W1_MASTER_GPIO_MSM=y
CONFIG_W1_SLAVE_DS28EL15=y
CONFIG_SENSORS_HALL=y
CONFIG_SENSORS_HALL_DEBOUNCE=y

#
# Battery & Charger
#
CONFIG_BATTERY_SAMSUNG=y
CONFIG_SAMSUNG_LPM_MODE=y
# CONFIG_SMB350_CHARGER is not set
# CONFIG_BATTERY_BQ28400 is not set
# CONFIG_BATTERY_MSM is not set
# CONFIG_FUELGAUGE_DUMMY is not set
#
# MAX77803 Charger
#
# CONFIG_QPNP_CHARGER is not set
# CONFIG_QPNP_BMS is not set
CONFIG_FUELGAUGE_MAX17048=y
CONFIG_CHARGER_MAX77803=y


# BT
CONFIG_BT_BCM4339=y

# Earjack
CONFIG_SAMSUNG_JACK=y
CONFIG_INPUT_GPIO=y

# DHA Solution
CONFIG_SEC_DHA_SOL_MAL=y

#
# Remove Qualcomm Wifi features
#
CONFIG_MSM_PIL_PRONTO=n
CONFIG_WCNSS_CORE=n
CONFIG_WCNSS_CORE_PRONTO=n
#
# Wifi features (Broadcomm)
#
CONFIG_NET_CORE=y
CONFIG_WIRELESS=y
CONFIG_WIRELESS_EXT_SYSFS=y
CONFIG_WEXT_CORE=y
CONFIG_WEXT_PROC=y
CONFIG_CFG80211=y
CONFIG_CFG80211_DEFAULT_PS=y
CONFIG_CFG80211_ALLOW_RECONNECT=y
CONFIG_WLAN=y
CONFIG_WIFI_CONTROL_FUNC=y
CONFIG_BCM4339=y
CONFIG_BCMDHD_FW_PATH="/system/etc/wifi/bcmdhd_sta.bin"
CONFIG_BCMDHD_NVRAM_PATH="/system/etc/wifi/nvram_net.txt"
CONFIG_BROADCOM_WIFI_RESERVED_MEM=y
CONFIG_WLAN_REGION_CODE=402
CONFIG_MMC_MSM_SDC2_SUPPORT=y
CONFIG_WIFI_MULTICAST_LOG=y
CONFIG_CFG80211_REG_NOT_UPDATED=y
CONFIG_H_USA_WIFI=y

# usb host
CONFIG_USB_STORAGE_DETECT=y
CONFIG_USB_HOST_NOTIFY=y

# Input Devices
CONFIG_TOUCHSCREEN_SYNAPTICS_I2C_RMI=y
CONFIG_KEYBOARD_CYPRESS_TOUCHKEY_H=y
CONFIG_INPUT_WACOM=y

#
# Sensor hub
#
CONFIG_SENSORS_SSP_STM_32F=y
CONFIG_SENSORS_SSP_MAX88921=y
CONFIG_SENSORS_SSP=y
CONFIG_SENSORS_SYSFS=y
CONFIG_SENSORS_SSP_FACTORY=y
CONFIG_SENSORS_SSP_MPU6500=y
CONFIG_SENSORS_SSP_YAS532=y
CONFIG_SENSORS_SSP_BMP182=y
CONFIG_SENSORS_SSP_SHTC1=y
CONFIG_SENSORS_SSP_ATUC128L5HAR=y
CONFIG_SENSORS_SSP_SENSORHUB=y
CONFIG_SEC_FPGA=y
CONFIG_IR_REMOCON_FPGA=y
# Audience
CONFIG_SND_SOC_ES325=y
CONFIG_SND_SOC_ES325_SLIM=y
CONFIG_FW_LOADER=y
CONFIG_FIRMWARE_IN_KERNEL=y
CONFIG_EXTRA_FIRMWARE="audience-es325-fw-h-tmo.bin"
CONFIG_EXTRA_FIRMWARE_DIR="firmware/es325"

# InsideSecure VPN Client
CONFIG_VPNCLIENT_SECURITY=y

# NFC
CONFIG_NFC_PN547=y
CONFIG_NFC_PN547_PMC8974_CLK_REQ=y

#EPDG
CONFIG_NET_SCHED=y   #depends on CONFIG_NET  which is enabled by default.. coz not seeing in the config file
CONFIG_NET_CLS_BASIC=y # required if basic is being used as a filter. depends on CONFIG_NET_CLS so enabling it by default
CONFIG_NET_CLS=y
CONFIG_NET_CLS_ACT=y # for enabling the action target.
CONFIG_NET_ACT_MIRRED=y  # for enabling the mirred target for redirecting the packet between the devices.
CONFIG_NET_EMATCH=y   #basic uses extended matches so this has to be present
CONFIG_NET_SCH_INGRESS=y # classifier for ingress packet
CONFIG_CRYPTO_NULL=y

#
# RCU
#
CONFIG_RCU_FAST_NO_HZ=y

# SSWAP
CONFIG_SWAP=y
CONFIG_FRONTSWAP=y
CONFIG_ZSMALLOC_NEW=y
CONFIG_PGTABLE_MAPPING=y
CONFIG_ZSWAP=y
CONFIG_DIRECT_RECLAIM_FILE_PAGES_ONLY=y
CONFIG_INCREASE_MAXIMUM_SWAPPINESS=y
CONFIG_FIX_INACTIVE_RATIO=y
CONFIG_TIGHT_PGDAT_BALANCE=y
CONFIG_VNSWAP=y
CONFIG_SWAP_ENABLE_READAHEAD=n
```

## arch/arm/configs/msm8974_sec_jactive_skt_defconfig
```kconfig
# from msm8974_sec_defconfig
CONFIG_AUDIT=y
# CONFIG_MSM_PIL_PRONTO is not set
CONFIG_NET_KEY=y
CONFIG_IP_MULTICAST=y
CONFIG_INET_XFRM_MODE_TRANSPORT=y
CONFIG_INET_XFRM_MODE_TUNNEL=y
CONFIG_NF_CONNTRACK_SECMARK=y
# CONFIG_NF_CONNTRACK_SIP is not set
CONFIG_NETFILTER_XT_TARGET_CONNSECMARK=y
CONFIG_NETFILTER_XT_TARGET_NOTRACK=y
CONFIG_NETFILTER_XT_TARGET_SECMARK=y
CONFIG_NETFILTER_XT_TARGET_TCPMSS=y
CONFIG_IP_NF_SECURITY=y
CONFIG_PPP=y
CONFIG_PPP_BSDCOMP=y
CONFIG_PPP_DEFLATE=y
CONFIG_PPP_MPPE=y
CONFIG_PPPOLAC=y
CONFIG_PPPOPNS=y
# CONFIG_WCNSS_CORE is not set
# CONFIG_WCNSS_CORE_PRONTO is not set
# CONFIG_WCNSS_MEM_PRE_ALLOC is not set
CONFIG_SENSORS_QPNP_ADC_CURRENT=y
CONFIG_IMX132=y
CONFIG_MSM_WFD=y
# CONFIG_FB_MSM_MDSS_HDMI_MHL_SII8334 is not set
CONFIG_FB_MSM_MDSS_DBG_SEQ_TICK=y
CONFIG_FB_MSM_MDSS_DSI_DBG=y
CONFIG_SND_SOC_MSM_HDMI_CODEC_RX=y
CONFIG_LCD_CLASS_DEVICE=y
CONFIG_BACKLIGHT_LCD_SUPPORT=y
CONFIG_BACKLIGHT_CLASS_DEVICE=y
CONFIG_FB_MSM_MIPI_JDI_TFT_VIDEO_FULL_HD_PT_PANEL=y
CONFIG_SUPPORT_DISPLAY_OCTA_TFT=y
CONFIG_MDNIE_LITE_TUNING=y
CONFIG_LEDS_QPNP=y
# CONFIG_LEDS_AN30259A is not set

# CONFIG_FB_MSM_MIPI_SAMSUNG_OCTA_VIDEO_FULL_HD_PT_PANEL is not set
# CONFIG_IIO is not set
# CONFIG_IIO_BUFFER is not set
# CONFIG_IIO_SW_RING is not set
# CONFIG_IIO_KFIFO_BUF is not set
# CONFIG_INV_MPU_IIO is not set
# CONFIG_SENSORS_GP2A_IIO is not set
# CONFIG_SENSORS_CORE is not set
# CONFIG_INV_TESTING is not set
CONFIG_EXT4_FS_SECURITY=y
CONFIG_ENABLE_DEFAULT_TRACERS=y
CONFIG_SECURITY=y
CONFIG_SECURITY_NETWORK=y
CONFIG_LSM_MMAP_MIN_ADDR=4096
CONFIG_SECURITY_SELINUX=y

# HLTE config
# CONFIG_SEC_KS01_PROJECT is not set
CONFIG_SEC_JACTIVE_PROJECT=y
CONFIG_SEC_LOCALE_KOR=y
#CONFIG_SEC_LOCALE_KOR_H=y
# CONFIG_MACH_KS01SKT is not set
CONFIG_MACH_JACTIVESKT=y

#
# MAX77803 IC
#
CONFIG_MAX77803_MUIC=y
CONFIG_MFD_MAX77803=y
CONFIG_REGULATOR_MAX77803=y
CONFIG_MOTOR_DRV_MAX77803=y
CONFIG_VIBETONZ=y
CONFIG_LEDS_MAX77803=y

#
# Battery & Charger
#
CONFIG_BATTERY_SAMSUNG=y
CONFIG_SAMSUNG_LPM_MODE=y
# CONFIG_SMB350_CHARGER is not set
# CONFIG_BATTERY_BQ28400 is not set
# CONFIG_BATTERY_MSM is not set
# CONFIG_FUELGAUGE_DUMMY is not set
#
# MAX77803 Charger
#
# CONFIG_QPNP_CHARGER is not set
# CONFIG_QPNP_BMS is not set
CONFIG_FUELGAUGE_MAX17048=y
CONFIG_CHARGER_MAX77803=y
CONFIG_SAMSUNG_BATTERY_DISALLOW_DEEP_SLEEP=y

CONFIG_I2C_GPIO=y

#
# Actuator
#
CONFIG_I2C_ACTUATOR=y

# BT
CONFIG_BT_BCM4335=y
CONFIG_HID_KK_UPGRADE=y

# Earjack
CONFIG_SAMSUNG_JACK=y
CONFIG_INPUT_GPIO=y

# DHA Solution
CONFIG_SEC_DHA_SOL_MAL=y

# Ringtone Gain
CONFIG_SEC_DEVIDE_RINGTONE_GAIN=y

#
# Remove Qualcomm Wifi features
#
CONFIG_MSM_PIL_PRONTO=n
CONFIG_WCNSS_CORE=n
CONFIG_WCNSS_CORE_PRONTO=n
#
# Wifi features (Broadcomm)
#
CONFIG_MODULES=y
CONFIG_MODULE_UNLOAD=y
CONFIG_MODULE_FORCE_UNLOAD=y
CONFIG_NET_CORE=y
CONFIG_WIRELESS=y
CONFIG_WIRELESS_EXT_SYSFS=y
CONFIG_WEXT_CORE=y
CONFIG_WEXT_PROC=y
CONFIG_CFG80211=y
CONFIG_CFG80211_DEFAULT_PS=y
CONFIG_CFG80211_ALLOW_RECONNECT=y
CONFIG_WLAN=y
CONFIG_WIFI_CONTROL_FUNC=y
CONFIG_BCM4335=m
CONFIG_BROADCOM_WIFI_RESERVED_MEM=y
CONFIG_WLAN_REGION_CODE=201
CONFIG_MMC_MSM_SDC2_SUPPORT=y

#
#SKT IWLAN
#
CONFIG_XFRM=y
CONFIG_XFRM_USER=y
CONFIG_NET_KEY=y
CONFIG_INET_ESP=y
CONFIG_INET_IPCOMP=y
CONFIG_INET_XFRM_MODE_TRANSPORT=y
CONFIG_INET_XFRM_MODE_TUNNEL=y
CONFIG_IP_ADVANCED_ROUTER=y
CONFIG_IP_MULTIPLE_TABLES=y
CONFIG_CRYPTO=y
CONFIG_CRYPTO_HMAC=y
CONFIG_CRYPTO_XCBC=y
CONFIG_CRYPTO_NULL=y
CONFIG_CRYPTO_MD5=y
CONFIG_CRYPTO_SHA1=y
CONFIG_CRYPTO_DES=y
CONFIG_CRYPTO_AES=y
CONFIG_CRYPTO_DEFLATE=y

#SKT IWLAN FOR TBASE
CONFIG_NETFILTER=y
CONFIG_IP_NF_IPTABLES=y
CONFIG_NETFILTER_ADVANCED=y

# usb host
CONFIG_USB_STORAGE_DETECT=y
CONFIG_USB_HOST_NOTIFY=y

# Input Devices
CONFIG_TOUCHSCREEN_SYNAPTICS_I2C_RMI=n
CONFIG_TOUCHSCREEN_SYNAPTICS_I2C_RMI_S5000=y
CONFIG_TOUCHSCREEN_SYNAPTICS_PREVENT_HSYNC_LEAKAGE=y
# CONFIG_KEYBOARD_CYPRESS_TOUCHKEY_KS01 is not set
#CONFIG_INPUT_WACOM=y
#
# eDP ESD FUNCTION
#
CONFIG_EDP_ESD_FUNCTION=y
CONFIG_EDP_TCON_MDNIE=y

#
# Sensor hub
#
CONFIG_SENSORS_SSP_ATMEL=y
CONFIG_SENSORS_SSP_MAX88920=y
CONFIG_SENSORS_SSP_CM3320=y
CONFIG_SENSORS_SSP=y
CONFIG_SENSORS_SYSFS=y
CONFIG_SENSORS_SSP_FACTORY=y
CONFIG_SENSORS_SSP_MPU6500=y
CONFIG_SENSORS_SSP_YAS532=y
CONFIG_SENSORS_SSP_BMP182=y
CONFIG_SENSORS_SSP_SHTC1=y
CONFIG_SENSORS_SSP_ATUC128L5HAR=y
CONFIG_SENSORS_SSP_SENSORHUB=y
CONFIG_SEC_FPGA=y
CONFIG_IR_REMOCON_FPGA=y
CONFIG_SENSORS_ADSP=n
# Audience
CONFIG_SND_SOC_ES325=y
CONFIG_SND_SOC_ES325_SLIM=y
CONFIG_FW_LOADER=y
CONFIG_FIRMWARE_IN_KERNEL=y
CONFIG_EXTRA_FIRMWARE="audience-es325-fw-fortius-kor-skt.bin"
CONFIG_EXTRA_FIRMWARE_DIR="firmware/es325"

#TCP Congestion Control Change to BIC
CONFIG_TCP_CONG_ADVANCED=y
CONFIG_TCP_CONG_BIC=y
CONFIG_DEFAULT_BIC=y
CONFIG_DEFAULT_TCP_CONG="bic"

#Debug
# CONFIG_ANDROID_RAM_CONSOLE is not set
CONFIG_SEC_LOG_LAST_KMSG=y
CONFIG_SEC_DEBUG_NOCACHE_LOG_IN_LEVEL_LOW=y

# Hall ic
# CONFIG_SENSORS_HALL is not set

# DMB
# CONFIG_TDMB is not set
# CONFIG_TDMB_VENDOR_FCI is not set
# CONFIG_TDMB_FC8050 is not set
# CONFIG_TDMB_SPI is not set
# CONFIG_TDMB_ANT_DET is not set
# CONFIG_TDMB_QUALCOMM is not set

# NFC
CONFIG_BCM2079X_NFC_I2C=y

# SSWAP
CONFIG_SWAP=y
CONFIG_FRONTSWAP=y
CONFIG_ZSMALLOC_NEW=y
CONFIG_PGTABLE_MAPPING=y
CONFIG_ZSWAP=y
CONFIG_DIRECT_RECLAIM_FILE_PAGES_ONLY=n
CONFIG_INCREASE_MAXIMUM_SWAPPINESS=y
CONFIG_FIX_INACTIVE_RATIO=y
CONFIG_TIGHT_PGDAT_BALANCE=y
CONFIG_VNSWAP=y
CONFIG_SWAP_ENABLE_READAHEAD=n

# SDC3
CONFIG_MMC_MSM_SDC3_SUPPORT=y

# KOR USER RESET DEBUG
CONFIG_USER_RESET_DEBUG=y
CONFIG_SEC_DEBUG_LMK_MEMINFO=y
```
