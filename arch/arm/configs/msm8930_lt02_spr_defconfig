## arch/arm/configs/msm8974_sec_flte_skt_defconfig
```kconfig
# from msm8974_sec_defconfig
CONFIG_AUDIT=y
# CONFIG_MSM_PIL_PRONTO is not set
CONFIG_NET_KEY=y
CONFIG_IP_MULTICAST=y
CONFIG_INET_XFRM_MODE_TRANSPORT=y
CONFIG_INET_XFRM_MODE_TUNNEL=y
CONFIG_NF_CONNTRACK_SECMARK=y
# CONFIG_NF_CONNTRACK_SIP is not set
CONFIG_NETFILTER_XT_TARGET_CONNSECMARK=y
CONFIG_NETFILTER_XT_TARGET_NOTRACK=y
CONFIG_NETFILTER_XT_TARGET_SECMARK=y
CONFIG_NETFILTER_XT_TARGET_TCPMSS=y
CONFIG_IP_NF_SECURITY=y
#CONFIG_BT_HCISMD=y
# CONFIG_BT_HCISMD is not set
# CONFIG_MSM_BT_POWER is not set
CONFIG_PPP=y
CONFIG_PPP_BSDCOMP=y
CONFIG_PPP_DEFLATE=y
CONFIG_PPP_MPPE=y
CONFIG_PPPOLAC=y
CONFIG_PPPOPNS=y
# CONFIG_WCNSS_CORE is not set
# CONFIG_WCNSS_CORE_PRONTO is not set
# CONFIG_WCNSS_MEM_PRE_ALLOC is not set
CONFIG_SENSORS_QPNP_ADC_CURRENT=y
CONFIG_IMX132=y
CONFIG_MSM_WFD=y
# CONFIG_FB_MSM_MDSS_HDMI_MHL_SII8334 is not set
CONFIG_FB_MSM_MDSS_DBG_SEQ_TICK=y
CONFIG_FB_MSM_MDSS_DSI_DBG=y
CONFIG_SND_SOC_MSM_HDMI_CODEC_RX=y
CONFIG_MDNIE_LITE_TUNING=y
CONFIG_LCD_CLASS_DEVICE=y
CONFIG_BACKLIGHT_LCD_SUPPORT=y
CONFIG_BACKLIGHT_CLASS_DEVICE=y
CONFIG_FB_MSM_MIPI_SAMSUNG_YOUM_CMD_FULL_HD_PT_PANEL=y
# CONFIG_HID_PID is not set
# CONFIG_USB_HIDDEV is not set
# CONFIG_HID_ACRUX_FF is not set
# CONFIG_HID_PICOLCD_FB is not set
# CONFIG_HID_PICOLCD_BACKLIGHT is not set
# CONFIG_HID_PICOLCD_LCD is not set
# CONFIG_HID_PICOLCD_LEDS is not set
CONFIG_IIO=y
CONFIG_IIO_BUFFER=y
# CONFIG_IIO_SW_RING is not set
CONFIG_IIO_KFIFO_BUF=y
CONFIG_IIO_TRIGGER=y
CONFIG_IIO_ST_HWMON=y
# CONFIG_INV_MPU_IIO is not set
# CONFIG_SENSORS_GP2A_IIO is not set
# CONFIG_SENSORS_CORE is not set
# CONFIG_INV_TESTING is not set
CONFIG_EXT4_FS_SECURITY=y
CONFIG_ENABLE_DEFAULT_TRACERS=y
CONFIG_SECURITY=y
CONFIG_SECURITY_NETWORK=y
CONFIG_LSM_MMAP_MIN_ADDR=4096
CONFIG_SECURITY_SELINUX=y

# FLTE config
CONFIG_SEC_LOCALE_KOR=y
CONFIG_MACH_FLTESKT=y
CONFIG_SEC_F_PROJECT=y

#
# MAX77803 IC
#
CONFIG_MAX77803_MUIC=y
CONFIG_MFD_MAX77803=y
CONFIG_REGULATOR_MAX77803=y
CONFIG_MOTOR_DRV_MAX77803=y
CONFIG_SS_VIBRATOR=y
CONFIG_LEDS_MAX77803=y


#LEDS FLAG
CONFIG_LEDS_QPNP=y


#
# Battery & Charger
#
CONFIG_BATTERY_SAMSUNG=y
CONFIG_SAMSUNG_LPM_MODE=y
# CONFIG_SMB350_CHARGER is not set
# CONFIG_BATTERY_BQ28400 is not set
# CONFIG_BATTERY_MSM is not set
# CONFIG_FUELGAUGE_DUMMY is not set
#
# MAX77803 Charger
#
# CONFIG_QPNP_CHARGER is not set
# CONFIG_QPNP_BMS is not set
CONFIG_FUELGAUGE_MAX17048=y
CONFIG_CHARGER_MAX77803=y

CONFIG_I2C_GPIO=y

#
# Actuator
#
CONFIG_I2C_ACTUATOR=y

#
# NFC features (NXP)
#
CONFIG_NFC_PN547=y
CONFIG_NFC_PN547_PMC8974_CLK_REQ=y
CONFIG_NFC_I2C_OVERWRITE=y

# BT
CONFIG_BT_BCM4339=y

# Earjack
CONFIG_SAMSUNG_JACK=y
CONFIG_INPUT_GPIO=y

# DHA Solution
CONFIG_SEC_DHA_SOL_MAL=y

# Ringtone Gain
CONFIG_SEC_DEVIDE_RINGTONE_GAIN=y

#
# Remove Qualcomm Wifi features
#
CONFIG_MSM_PIL_PRONTO=n
CONFIG_WCNSS_CORE=n
CONFIG_WCNSS_CORE_PRONTO=n
#
# Wifi features (Broadcomm)
#
CONFIG_NET_CORE=y
CONFIG_WIRELESS=y
CONFIG_WIRELESS_EXT_SYSFS=y
CONFIG_WEXT_CORE=y
CONFIG_WEXT_PROC=y
CONFIG_CFG80211=y
CONFIG_CFG80211_DEFAULT_PS=y
CONFIG_CFG80211_ALLOW_RECONNECT=y
CONFIG_WLAN=y
CONFIG_WIFI_CONTROL_FUNC=y
CONFIG_BCM4339=y
CONFIG_BCMDHD_FW_PATH="/system/etc/wifi/bcmdhd_sta.bin"
CONFIG_BCMDHD_NVRAM_PATH="/system/etc/wifi/nvram_net.txt"
CONFIG_BROADCOM_WIFI_RESERVED_MEM=y
CONFIG_WLAN_REGION_CODE=201
CONFIG_MMC_MSM_SDC2_SUPPORT=y
#
#SKT IWLAN
#
CONFIG_XFRM=y
CONFIG_XFRM_USER=y
CONFIG_NET_KEY=y
CONFIG_INET_ESP=y
CONFIG_INET_IPCOMP=y
CONFIG_INET_XFRM_MODE_TRANSPORT=y
CONFIG_INET_XFRM_MODE_TUNNEL=y
CONFIG_IP_ADVANCED_ROUTER=y
CONFIG_IP_MULTIPLE_TABLES=y
CONFIG_CRYPTO=y
CONFIG_CRYPTO_HMAC=y
CONFIG_CRYPTO_XCBC=y
CONFIG_CRYPTO_NULL=y
CONFIG_CRYPTO_MD5=y
CONFIG_CRYPTO_SHA1=y
CONFIG_CRYPTO_DES=y
CONFIG_CRYPTO_AES=y
CONFIG_CRYPTO_DEFLATE=y

#SKT IWLAN FOR TBASE
CONFIG_NETFILTER=y
CONFIG_IP_NF_IPTABLES=y
CONFIG_NETFILTER_ADVANCED=y


# usb host
CONFIG_USB_STORAGE_DETECT=y
CONFIG_USB_HOST_NOTIFY=y

# Input Devices
CONFIG_TOUCHSCREEN_SYNAPTICS_I2C_RMI=y
# CONFIG_KEYBOARD_CYPRESS_TOUCHKEY_H is not set
# CONFIG_INPUT_WACOM is not set
CONFIG_SENSORS_HALL=y

#
# eDP ESD FUNCTION
#
CONFIG_EDP_ESD_FUNCTION=y
CONFIG_EDP_TCON_MDNIE=y

#
# Sensor hub
#
CONFIG_SENSORS_SSP_STM_32F=y
CONFIG_SENSORS_SSP_MAX88921=y
CONFIG_SENSORS_SSP=y
CONFIG_SENSORS_SYSFS=y
CONFIG_SENSORS_SSP_FACTORY=y
CONFIG_SENSORS_SSP_MPU6500=y
CONFIG_SENSORS_SSP_YAS532=y
CONFIG_SENSORS_SSP_BMP182=y
CONFIG_SENSORS_SSP_SHTC1=y
CONFIG_SENSORS_SSP_ATUC128L5HAR=y
CONFIG_SENSORS_SSP_SENSORHUB=y
CONFIG_SEC_FPGA=y
CONFIG_IR_REMOCON_FPGA=y
CONFIG_SENSORS_SSP_BOUNCE_FIRMWARE=y

# Audience
CONFIG_SND_SOC_ES325=y
CONFIG_SND_SOC_ES325_SLIM=y
CONFIG_FW_LOADER=y
CONFIG_FIRMWARE_IN_KERNEL=y
CONFIG_EXTRA_FIRMWARE="audience-es325-fw-kor-flte.bin"
CONFIG_EXTRA_FIRMWARE_DIR="firmware/es325"

#TCP Congestion Control Change to BIC
CONFIG_TCP_CONG_ADVANCED=y
CONFIG_TCP_CONG_BIC=y
CONFIG_DEFAULT_BIC=y
CONFIG_DEFAULT_TCP_CONG="bic"

#Debug
# CONFIG_ANDROID_RAM_CONSOLE is not set
CONFIG_SEC_LOG_LAST_KMSG=y
CONFIG_SEC_DEBUG_NOCACHE_LOG_IN_LEVEL_LOW=y

#one wire
#CONFIG_W1 is not set
#CONFIG_W1_MASTER_GPIO_MSM is not set
#CONFIG_W1_SLAVE_DS28EL15 is not set
#CONFIG_W1_WORKQUEUE is not set

# SDC3
CONFIG_MMC_MSM_SDC3_SUPPORT=y

CONFIG_SEC_DEBUG_LMK_MEMINFO=y
```

## arch/arm/configs/msm8974_sec_frescolte_ktt_defconfig
```kconfig
# from msm8974_sec_defconfig
CONFIG_AUDIT=y
# CONFIG_MSM_PIL_PRONTO is not set
CONFIG_NET_KEY=y
CONFIG_IP_MULTICAST=y
CONFIG_INET_XFRM_MODE_TRANSPORT=y
CONFIG_INET_XFRM_MODE_TUNNEL=y
CONFIG_NF_CONNTRACK_SECMARK=y
# CONFIG_NF_CONNTRACK_SIP is not set
CONFIG_NETFILTER_XT_TARGET_CONNSECMARK=y
CONFIG_NETFILTER_XT_TARGET_NOTRACK=y
CONFIG_NETFILTER_XT_TARGET_SECMARK=y
CONFIG_NETFILTER_XT_TARGET_TCPMSS=y
CONFIG_IP_NF_SECURITY=y
#CONFIG_BT_HCISMD=y
# CONFIG_BT_HCISMD is not set
# CONFIG_MSM_BT_POWER is not set
CONFIG_PPP=y
CONFIG_PPP_BSDCOMP=y
CONFIG_PPP_DEFLATE=y
CONFIG_PPP_MPPE=y
CONFIG_PPPOLAC=y
CONFIG_PPPOPNS=y
# CONFIG_WCNSS_CORE is not set
# CONFIG_WCNSS_CORE_PRONTO is not set
# CONFIG_WCNSS_MEM_PRE_ALLOC is not set
CONFIG_SENSORS_QPNP_ADC_CURRENT=y
#CONFIG_IMX132 is not set
CONFIG_IMX134=y
CONFIG_MSM_WFD=y
# CONFIG_FB_MSM_MDSS_HDMI_MHL_SII8334 is not set
CONFIG_FB_MSM_MDSS_DBG_SEQ_TICK=y
CONFIG_FB_MSM_MDSS_DSI_DBG=y
CONFIG_SND_SOC_MSM_HDMI_CODEC_RX=y
CONFIG_MDNIE_LITE_TUNING=y
CONFIG_LCD_CLASS_DEVICE=y
CONFIG_BACKLIGHT_LCD_SUPPORT=y
CONFIG_BACKLIGHT_CLASS_DEVICE=y
#CONFIG_FB_MSM_MIPI_SAMSUNG_OCTA_CMD_FULL_HD_PT_PANEL is not set
CONFIG_FB_MSM_MDSS_SAMSUNG_OCTA_VIDEO_720P_PT_PANEL=y
CONFIG_ESD_ERR_FG_RECOVERY=y
# CONFIG_HID_PID is not set
# CONFIG_USB_HIDDEV is not set
# CONFIG_HID_ACRUX_FF is not set
# CONFIG_HID_PICOLCD_FB is not set
# CONFIG_HID_PICOLCD_BACKLIGHT is not set
# CONFIG_HID_PICOLCD_LCD is not set
# CONFIG_HID_PICOLCD_LEDS is not set

#
# Sensors
#
CONFIG_SENSORS=y
CONFIG_SENSORS_TMD27723=y
CONFIG_SENSORS_CORE=y
CONFIG_INPUT_MPU6500_SELFTEST=y
# CONFIG_INPUT_MPU6500_FRESCO is not set
# CONFIG_INPUT_MPU6500_POLLING is not set
# CONFIG_SENSORS_YAS532 is not set
# CONFIG_INPUT_YAS_MAGNETOMETER_POSITION is not set
CONFIG_SENSORS_YAS_MAGNETOMETER=y
# MPL start
CONFIG_SYSFS=y
CONFIG_STAGING=y
CONFIG_INV_MPU_IIO_MPL=y
CONFIG_IIO_SW_RING=y
CONFIG_IIO_ST_HWMON=y
CONFIG_IIO=y
CONFIG_IIO_KFIFO_BUF=y
CONFIG_IIO_TRIGGER=y
CONFIG_IIO_BUFFER=y
# MPL end
# CONFIG_SENSORS_SYSFS is not set
# CONFIG_SENSORS_SSP is not set
# CONFIG_SENSORS_SSP_YAS532 is not set
# CONFIG_SENSORS_SSP_ACCELEROMETER_POSITION is not set
# CONFIG_SENSORS_SSP_GYROSCOPE_POSITION is not set
# CONFIG_SENSORS_SSP_MAGNETOMETER_POSITION is not set
# CONFIG_SENSORS_SSP_SENSORHUB is not set
# CONFIG_SENSORS_SSP_FACTORY is not set
# CONFIG_SENSORS_SSP_MPU6500 is not set
# CONFIG_SENSORS_SSP_BMP182 is not set
# CONFIG_SENSORS_SSP_ATUC128L5HAR is not set
# CONFIG_SENSORS_SSP_SHTC1 is not set

CONFIG_EXT4_FS_SECURITY=y
CONFIG_ENABLE_DEFAULT_TRACERS=y
CONFIG_SECURITY=y
CONFIG_SECURITY_NETWORK=y
CONFIG_LSM_MMAP_MIN_ADDR=4096
CONFIG_SECURITY_SELINUX=y

# FRESCOLTE config
CONFIG_SEC_FRESCO_PROJECT=y
CONFIG_SEC_LOCALE_KOR=y
CONFIG_SEC_LOCALE_KOR_FRESCO=y
CONFIG_MACH_FRESCOLTEKTT=y

#
# MAX77803 IC
#
CONFIG_MAX77803_MUIC=y
CONFIG_MFD_MAX77803=y
CONFIG_REGULATOR_MAX77803=y
CONFIG_MOTOR_DRV_MAX77803=y
CONFIG_VIBETONZ=y
CONFIG_LEDS_MAX77803=y

#LED FLAG
#CONFIG_LEDS_QPNP is not set
CONFIG_LEDS_AN30259A=y

#one wire
CONFIG_W1=y
CONFIG_W1_MASTER_GPIO_MSM=y
CONFIG_W1_SLAVE_DS28EL15=y
CONFIG_W1_WORKQUEUE=y
CONFIG_SENSORS_HALL=y

#
# Battery & Charger
#
CONFIG_BATTERY_SAMSUNG=y
CONFIG_SAMSUNG_LPM_MODE=y
# CONFIG_SMB350_CHARGER is not set
# CONFIG_BATTERY_BQ28400 is not set
# CONFIG_BATTERY_MSM is not set
# CONFIG_FUELGAUGE_DUMMY is not set
#
# MAX77803 Charger
#
# CONFIG_QPNP_CHARGER is not set
# CONFIG_QPNP_BMS is not set
CONFIG_FUELGAUGE_MAX17048=y
CONFIG_CHARGER_MAX77803=y

CONFIG_I2C_GPIO=y

# BT
CONFIG_BT_BCM4339=y

# Earjack
CONFIG_SAMSUNG_JACK=y
CONFIG_INPUT_GPIO=y

# DHA Solution
CONFIG_SEC_DHA_SOL_MAL=y

# Ringtone Gain
CONFIG_SEC_DEVIDE_RINGTONE_GAIN=y

#
# Remove Qualcomm Wifi features
#
CONFIG_MSM_PIL_PRONTO=n
CONFIG_WCNSS_CORE=n
CONFIG_WCNSS_CORE_PRONTO=n
#
# Wifi features (Broadcomm)
#
CONFIG_NET_CORE=y
CONFIG_WIRELESS=y
CONFIG_WIRELESS_EXT_SYSFS=y
CONFIG_WEXT_CORE=y
CONFIG_WEXT_PROC=y
CONFIG_CFG80211=y
CONFIG_CFG80211_DEFAULT_PS=y
CONFIG_CFG80211_ALLOW_RECONNECT=y
CONFIG_WLAN=y
CONFIG_WIFI_CONTROL_FUNC=y
CONFIG_BCM4339=y
CONFIG_BCMDHD_FW_PATH="/system/etc/wifi/bcmdhd_sta.bin"
CONFIG_BCMDHD_NVRAM_PATH="/system/etc/wifi/nvram_net.txt"
CONFIG_BROADCOM_WIFI_RESERVED_MEM=y
CONFIG_WLAN_REGION_CODE=202
CONFIG_MMC_MSM_SDC2_SUPPORT=y

#
#SKT IWLAN
#
CONFIG_XFRM=y
CONFIG_XFRM_USER=y
CONFIG_NET_KEY=y
CONFIG_INET_ESP=y
CONFIG_INET_IPCOMP=y
CONFIG_INET_XFRM_MODE_TRANSPORT=y
CONFIG_INET_XFRM_MODE_TUNNEL=y
CONFIG_IP_ADVANCED_ROUTER=y
CONFIG_IP_MULTIPLE_TABLES=y
CONFIG_CRYPTO=y
CONFIG_CRYPTO_HMAC=y
CONFIG_CRYPTO_XCBC=y
CONFIG_CRYPTO_NULL=y
CONFIG_CRYPTO_MD5=y
CONFIG_CRYPTO_SHA1=y
CONFIG_CRYPTO_DES=y
CONFIG_CRYPTO_AES=y
CONFIG_CRYPTO_DEFLATE=y

#SKT IWLAN FOR TBASE
CONFIG_NETFILTER=y
CONFIG_IP_NF_IPTABLES=y
CONFIG_NETFILTER_ADVANCED=y

# usb host
CONFIG_USB_STORAGE_DETECT=y
CONFIG_USB_HOST_NOTIFY=y

# Input Devices
CONFIG_TOUCHSCREEN_FTS=y
CONFIG_GLOVE_TOUCH=y
CONFIG_KEYBOARD_CYPRESS_TKEY_HL=y
CONFIG_INPUT_WACOM_HL=y
CONFIG_EPEN_WACOM_G9PM=y
#
# eDP ESD FUNCTION
#
# CONFIG_EDP_ESD_FUNCTION is not set
# CONFIG_EDP_TCON_MDNIE is not set

CONFIG_SEC_FPGA=y
CONFIG_IR_REMOCON_FPGA=y
# Audience
CONFIG_SND_SOC_ES325=y
CONFIG_SND_SOC_ES325_SLIM=y
CONFIG_FW_LOADER=y
CONFIG_FIRMWARE_IN_KERNEL=y
CONFIG_EXTRA_FIRMWARE="audience-es325-fw-kor-frescolte.bin"
CONFIG_EXTRA_FIRMWARE_DIR="firmware/es325"

#TCP Congestion Control Change to BIC
CONFIG_TCP_CONG_ADVANCED=y
CONFIG_TCP_CONG_BIC=y
CONFIG_DEFAULT_BIC=y
CONFIG_DEFAULT_TCP_CONG="bic"

# NFC
CONFIG_SEC_NFC_I2C=y

#CAMERA
CONFIG_IMX134=y

#Debug
# CONFIG_ANDROID_RAM_CONSOLE is not set
CONFIG_SEC_LOG_LAST_KMSG=y
CONFIG_SEC_DEBUG_NOCACHE_LOG_IN_LEVEL_LOW=y
CONFIG_SEC_DEBUG_LMK_MEMINFO=y
```

## arch/arm/configs/msm8974_sec_hlte_lgt_defconfig
```kconfig
# from msm8974_sec_defconfig
CONFIG_AUDIT=y
# CONFIG_MSM_PIL_PRONTO is not set
CONFIG_NET_KEY=y
CONFIG_IP_MULTICAST=y
CONFIG_INET_XFRM_MODE_TRANSPORT=y
CONFIG_INET_XFRM_MODE_TUNNEL=y
CONFIG_NF_CONNTRACK_SECMARK=y
# CONFIG_NF_CONNTRACK_SIP is not set
CONFIG_NETFILTER_XT_TARGET_CONNSECMARK=y
CONFIG_NETFILTER_XT_TARGET_NOTRACK=y
CONFIG_NETFILTER_XT_TARGET_SECMARK=y
CONFIG_NETFILTER_XT_TARGET_TCPMSS=y
CONFIG_IP_NF_SECURITY=y
#CONFIG_BT_HCISMD=y
# CONFIG_BT_HCISMD is not set
# CONFIG_MSM_BT_POWER is not set
CONFIG_PPP=y
CONFIG_PPP_BSDCOMP=y
CONFIG_PPP_DEFLATE=y
CONFIG_PPP_MPPE=y
CONFIG_PPPOLAC=y
CONFIG_PPPOPNS=y
# CONFIG_WCNSS_CORE is not set
# CONFIG_WCNSS_CORE_PRONTO is not set
# CONFIG_WCNSS_MEM_PRE_ALLOC is not set
CONFIG_SENSORS_QPNP_ADC_CURRENT=y
CONFIG_IMX132=y
CONFIG_MSM_WFD=y
# CONFIG_FB_MSM_MDSS_HDMI_MHL_SII8334 is not set
CONFIG_FB_MSM_MDSS_DBG_SEQ_TICK=y
CONFIG_FB_MSM_MDSS_DSI_DBG=y
CONFIG_SND_SOC_MSM_HDMI_CODEC_RX=y
CONFIG_MDNIE_LITE_TUNING=y
CONFIG_LCD_CLASS_DEVICE=y
CONFIG_BACKLIGHT_LCD_SUPPORT=y
CONFIG_BACKLIGHT_CLASS_DEVICE=y
CONFIG_FB_MSM_MIPI_SAMSUNG_OCTA_CMD_FULL_HD_PT_PANEL=y
# CONFIG_HID_PID is not set
# CONFIG_USB_HIDDEV is not set
# CONFIG_HID_ACRUX_FF is not set
# CONFIG_HID_PICOLCD_FB is not set
# CONFIG_HID_PICOLCD_BACKLIGHT is not set
# CONFIG_HID_PICOLCD_LCD is not set
# CONFIG_HID_PICOLCD_LEDS is not set
CONFIG_IIO=y
CONFIG_IIO_BUFFER=y
# CONFIG_IIO_SW_RING is not set
CONFIG_IIO_KFIFO_BUF=y
CONFIG_IIO_TRIGGER=y
CONFIG_IIO_ST_HWMON=y
# CONFIG_INV_MPU_IIO is not set
# CONFIG_SENSORS_GP2A_IIO is not set
# CONFIG_SENSORS_CORE is not set
# CONFIG_INV_TESTING is not set
CONFIG_EXT4_FS_SECURITY=y
CONFIG_ENABLE_DEFAULT_TRACERS=y
CONFIG_SECURITY=y
CONFIG_SECURITY_NETWORK=y
CONFIG_LSM_MMAP_MIN_ADDR=4096
CONFIG_SECURITY_SELINUX=y

# HLTE config
CONFIG_SEC_H_PROJECT=y
CONFIG_SEC_LOCALE_KOR=y
CONFIG_SEC_LOCALE_KOR_H=y
CONFIG_MACH_HLTELGT=y

#
# MAX77803 IC
#
CONFIG_MAX77803_MUIC=y
CONFIG_MFD_MAX77803=y
CONFIG_REGULATOR_MAX77803=y
CONFIG_MOTOR_DRV_MAX77803=y
CONFIG_VIBETONZ=y
CONFIG_TACTILE_ASSIST=y
CONFIG_LEDS_MAX77803=y


#LED FLAG
CONFIG_LEDS_QPNP=y


#one wire
CONFIG_W1=y
CONFIG_W1_MASTER_GPIO_MSM=y
CONFIG_W1_SLAVE_DS28EL15=y
CONFIG_SENSORS_HALL=y
CONFIG_SENSORS_HALL_DEBOUNCE=y

#
# Battery & Charger
#
CONFIG_BATTERY_SAMSUNG=y
CONFIG_SAMSUNG_LPM_MODE=y
# CONFIG_SMB350_CHARGER is not set
# CONFIG_BATTERY_BQ28400 is not set
# CONFIG_BATTERY_MSM is not set
# CONFIG_FUELGAUGE_DUMMY is not set
#
# MAX77803 Charger
#
# CONFIG_QPNP_CHARGER is not set
# CONFIG_QPNP_BMS is not set
CONFIG_FUELGAUGE_MAX17048=y
CONFIG_CHARGER_MAX77803=y

CONFIG_I2C_GPIO=y

# BT
CONFIG_BT_BCM4339=y

# Earjack
CONFIG_SAMSUNG_JACK=y
CONFIG_INPUT_GPIO=y

# DHA Solution
CONFIG_SEC_DHA_SOL_MAL=y

# Ringtone Gain
CONFIG_SEC_DEVIDE_RINGTONE_GAIN=y

#
# Remove Qualcomm Wifi features
#
CONFIG_MSM_PIL_PRONTO=n
CONFIG_WCNSS_CORE=n
CONFIG_WCNSS_CORE_PRONTO=n
#
# Wifi features (Broadcomm)
#
CONFIG_NET_CORE=y
CONFIG_WIRELESS=y
CONFIG_WIRELESS_EXT_SYSFS=y
CONFIG_WEXT_CORE=y
CONFIG_WEXT_PROC=y
CONFIG_CFG80211=y
CONFIG_CFG80211_DEFAULT_PS=y
CONFIG_CFG80211_ALLOW_RECONNECT=y
CONFIG_WLAN=y
CONFIG_WIFI_CONTROL_FUNC=y
CONFIG_BCM4339=y
CONFIG_BCMDHD_FW_PATH="/system/etc/wifi/bcmdhd_sta.bin"
CONFIG_BCMDHD_NVRAM_PATH="/system/etc/wifi/nvram_net.txt"
CONFIG_BROADCOM_WIFI_RESERVED_MEM=y
CONFIG_WLAN_REGION_CODE=203
CONFIG_MMC_MSM_SDC2_SUPPORT=y

# usb host
CONFIG_USB_STORAGE_DETECT=y
CONFIG_USB_HOST_NOTIFY=y

# Input Devices
CONFIG_TOUCHSCREEN_SYNAPTICS_I2C_RMI=y
CONFIG_KEYBOARD_CYPRESS_TOUCHKEY_H=y
CONFIG_INPUT_WACOM=y
#
# eDP ESD FUNCTION
#
CONFIG_EDP_ESD_FUNCTION=y
CONFIG_EDP_TCON_MDNIE=y

#
# Sensor hub
#
CONFIG_SENSORS_SSP_STM_32F=y
CONFIG_SENSORS_SSP_MAX88921=y
CONFIG_SENSORS_SSP=y
CONFIG_SENSORS_SYSFS=y
CONFIG_SENSORS_SSP_FACTORY=y
CONFIG_SENSORS_SSP_MPU6500=y
CONFIG_SENSORS_SSP_YAS532=y
CONFIG_SENSORS_SSP_BMP182=y
CONFIG_SENSORS_SSP_SHTC1=y
CONFIG_SENSORS_SSP_ATUC128L5HAR=y
CONFIG_SENSORS_SSP_SENSORHUB=y
CONFIG_SEC_FPGA=y
CONFIG_IR_REMOCON_FPGA=y
# Audience
CONFIG_SND_SOC_ES325=y
CONFIG_SND_SOC_ES325_SLIM=y
CONFIG_FW_LOADER=y
CONFIG_FIRMWARE_IN_KERNEL=y
CONFIG_EXTRA_FIRMWARE="audience-es325-fw-kor-hlte.bin"
CONFIG_EXTRA_FIRMWARE_DIR="firmware/es325"

# DMB
CONFIG_TDMB=y
CONFIG_TDMB_VENDOR_RAONTECH=y
CONFIG_TDMB_MTV319=y
CONFIG_TDMB_SPI=y
CONFIG_TDMB_ANT_DET=y
CONFIG_TDMB_QUALCOMM=y

# NFC
CONFIG_BCM2079X_NFC_I2C=y
#Debug
# CONFIG_ANDROID_RAM_CONSOLE is not set
CONFIG_SEC_LOG_LAST_KMSG=y
CONFIG_SEC_DEBUG_NOCACHE_LOG_IN_LEVEL_LOW=y
# LGU I-WLAN
CONFIG_LGUIWLAN=y
CONFIG_MODULES=y
CONFIG_MODULE_UNLOAD=y
CONFIG_MODULE_FORCE_UNLOAD=y

#
# RCU
#
CONFIG_RCU_FAST_NO_HZ=y
```
