## arch/arm/configs/msm8926-sec_rubenslte_defconfig
```kconfig
#variant defconfig
CONFIG_MACH_RUBENSLTE_OPEN=y
CONFIG_SEC_RUBENS_PROJECT=y
CONFIG_SEC_RUBENSLTE_COMMON=y

#Power Management
CONFIG_SEC_PM=y
CONFIG_SEC_PM_DEBUG=y
CONFIG_SAMSUNG_DEBUG_DISPLAY=y
CONFIG_FB_MSM_MDSS_SDC_WXGA_PANEL=y
CONFIG_FB_MSM8x26_MDSS_CHECK_LCD_CONNECTION=y
CONFIG_ESD_ERR_FG_RECOVERY=y
CONFIG_FB_MSM_MDSS=y
CONFIG_FB_MSM_MDSS_WRITEBACK=y
CONFIG_BACKLIGHT_LCD_SUPPORT=y
CONFIG_MDNIE_TFT_MSM8X26=y
CONFIG_LCD_CLASS_DEVICE=y
CONFIG_BACKLIGHT_CLASS_DEVICE=y
#CONFIG_MDSS_UD_FLIP=y
# CONFIG_BACKLIGHT_GENERIC is not set

#VIBRATOR
#CONFIG_QPNP_VIBRATOR is not set
CONFIG_MSM_VIBRATOR=y

#TSP
#CONFIG_TOUCHSCREEN_MMS252=y
#CONFIG_TOUCHSCREEN_BCMTCH15XXX is not set
#CONFIG_KEYBOARD_CYPRESS_TOUCH is not set
CONFIG_TOUCHSCREEN_SYNAPTICS_I2C_RMI=y

#SENSOR
CONFIG_SENSORS=y
CONFIG_SENSORS_K2HH=y
CONFIG_SENSORS_TMD3782S=y
CONFIG_SENSORS_SX9500=y
CONFIG_SENSORS_SX9500_REGULATOR_ONOFF=y
CONFIG_SENSORS_SX9500_INIT_TOUCH_THRESHOLD=3000
CONFIG_SENSORS_SX9500_NORMAL_TOUCH_THRESHOLD=15

#NFC
CONFIG_NFC_PN547=y

# TIMA LOG
CONFIG_ARCH_MSM8926_LTE=y

CONFIG_INPUT=y
CONFIG_INPUT_GPIO=y
#CONFIG_SENSORS_HALL is not set

#CAMERA
CONFIG_SR352=y
CONFIG_SR130PC20=y
CONFIG_LEDS_MAX77804K=y

#USB
CONFIG_USB_ANDROID_SAMSUNG_COMPOSITE=y
CONFIG_USB_ANDROID_SAMSUNG_MTP=y
CONFIG_USB_DUN_SUPPORT=y
CONFIG_USB_ANDROID_SAMSUNG_SIDESYNC=y

#USB Host
CONFIG_USB_HOST_NOTIFY=y
CONFIG_USB_STORAGE_DETECT=y
CONFIG_USB_NET_SMSC75XX=y
CONFIG_USB_NET_SMSC95XX=y

#EXTCON
CONFIG_EXTCON=y

#MUIC
#CONFIG_MFD_MAX77693=y
#CONFIG_USB_SWITCH_MAX77693=y
#CONFIG_REGULATOR_MAX77693=y
#CONFIG_DI_MUIC=n
#CONFIG_MUIC_INIT_DETECT_DELAY=3000
#CONFIG_MUIC_USB_DETECT_DELAY=17000
#CONFIG_USB_SWITCH_TSU6721=y
#CONFIG_SM5502_MUIC=y
#CONFIG_MAX77804K_MUIC is not set
#CONFIG_MUIC_SUPPORT_DESK_DOCK is not set

CONFIG_MFD_MAX77804K=y
CONFIG_REGULATOR_MAX77804K=y
CONFIG_EXTCON_MAX77804K=y
CONFIG_ADC_ONESHOT=y
CONFIG_MUIC_SUPPORT_INCOMPATIBLE_CHARGER=y
CONFIG_MUIC_MAX77804K_SUPPORT_LANHUB=y
CONFIG_MUIC_SUPPORT_RUSTPROOF=y

# IRDA support
#CONFIG_IR_REMOCON_MC96=y

#Battery charging & BMS
CONFIG_BATTERY_SAMSUNG=y
CONFIG_BATTERY_SAMSUNG_DATA_FILE="rubenslte_battery_data.h"
CONFIG_FUELGAUGE_MAX17048=y
CONFIG_CHARGER_MAX77804K=y
CONFIG_SAMSUNG_LPM_MODE=y

#BT
CONFIG_HID_ZAGG=y

#Sec Thermistor
#CONFIG_SEC_THERMISTOR=y

#Wifi
#
# Enable Qualcomm Wifi features
#
CONFIG_MSM_PIL_PRONTO=y
#CONFIG_WCNSS_CORE=y
#CONFIG_WCNSS_CORE_PRONTO=y
#CONFIG_WCNSS_MEM_PRE_ALLOC=y

#
# Wifi features (Qualcomm)
#
CONFIG_NET_CORE=y
CONFIG_WIRELESS=y
CONFIG_WIRELESS_EXT_SYSFS=y
CONFIG_WEXT_CORE=y
CONFIG_WEXT_PROC=y
CONFIG_CFG80211=y
CONFIG_CFG80211_DEFAULT_PS=y
# CONFIG_CFG80211_ALLOW_RECONNECT is not set
CONFIG_WLAN=y
CONFIG_WIRELESS_EXT=y
CONFIG_WEXT_PRIV=y

CONFIG_MODULES=y
CONFIG_MODULE_UNLOAD=y
CONFIG_MODULE_FORCE_UNLOAD=y
CONFIG_WCNSS_REGISTER_DUMP_ON_BITE=y
CONFIG_WCNSS_IRIS_REGISTER_DUMP=y

# Earjack
CONFIG_SAMSUNG_JACK=y

# CODEC
#CONFIG_SND_SOC_MAX98504=y
CONFIG_GPIO_MAINMIC_BIAS=y

# GPIO DVS
#CONFIG_SEC_GPIO_DVS is not set
# DHA Solution
#CONFIG_SEC_DHA_SOL_MAL is not set

# SSWAP
CONFIG_SWAP=y
CONFIG_FRONTSWAP=y
CONFIG_ZSMALLOC_NEW=y
CONFIG_PGTABLE_MAPPING=y
CONFIG_ZSWAP=y
CONFIG_DIRECT_RECLAIM_FILE_PAGES_ONLY=n
CONFIG_INCREASE_MAXIMUM_SWAPPINESS=y
CONFIG_FIX_INACTIVE_RATIO=y
CONFIG_TIGHT_PGDAT_BALANCE=y
CONFIG_VNSWAP=y
CONFIG_SWAP_ENABLE_READAHEAD=n

#Input Booster
CONFIG_INPUT_BOOSTER=y
```

## arch/arm/configs/msm8926-sec_vastalte_chn_ctc_defconfig
```kconfig
#variant defconfig
CONFIG_MACH_VASTALTE=y
CONFIG_MACH_VASTALTE_CTC=y
CONFIG_SEC_VASTA_PROJECT=y

#Power Management
CONFIG_SEC_PM=n

CONFIG_FB_MSM_MDSS_HX8394C_TFT_VIDEO_720P_PANEL=y
#CONFIG_FB_MSM8x26_MDSS_CHECK_LCD_CONNECTION=y
#CONFIG_ESD_ERR_FG_RECOVERY=y
CONFIG_FB_MSM_MDSS_MSM8X26=y
CONFIG_FB_MSM_MDSS=y
CONFIG_FB_MSM_MDSS_WRITEBACK=y
CONFIG_BACKLIGHT_LCD_SUPPORT=y
#CONFIG_MDNIE_TFT_MSM8X26=y
CONFIG_LCD_CLASS_DEVICE=y
CONFIG_BACKLIGHT_CLASS_DEVICE=y
CONFIG_SAMSUNG_DEBUG_DISPLAY=y
# CONFIG_BACKLIGHT_GENERIC is not set

#VIBRATOR
#CONFIG_QPNP_VIBRATOR is not set
CONFIG_MSM_VIBRATOR=y

#TKEY LEDS
#CONFIG_LEDS_GPIO=y

#SVC LEDS
CONFIG_LEDS_KTD2026=y

#TSP
#CONFIG_TOUCHSCREEN_ATMEL_MXT1188S=y
#CONFIG_TOUCHSCREEN_MMS252=y
#CONFIG_TOUCHSCREEN_BCMTCH15XXX is not set
#CONFIG_KEYBOARD_CYPRESS_TOUCH is not set
#CONFIG_TOUCHSCREEN_CYTTSP4=y
#CONFIG_TOUCHSCREEN_CYTTSP5=y
#CONFIG_TOUCHSCREEN_CYTTSP5_DEVICETREE_SUPPORT=y
CONFIG_TOUCHSCREEN_ZINITIX_BT532=y

#KEYS
CONFIG_KEYBOARD_GPIO=y
CONFIG_KEYBOARD_ABOV_TOUCH=y

#SENSOR
#CONFIG_SENSORS=y
#CONFIG_SENSORS_BMA255=y
#CONFIG_SENSORS_HSCDTD008A=y
CONFIG_INPUT_POLLDEV=y
#CONFIG_SENSORS_GP2A002=y
#CONFIG_SENSORS_POWERCONTROL=y
#CONFIG_SENSORS_GP2A_VDDCONTROL=y
#CONFIG_SENSORS_K3DH=y
#CONFIG_SENSOR_K3DH_INPUTDEV=y
#CONFIG_SENSORS_SX9500=y
#CONFIG_SENSORS_SX9500_INIT_TOUCH_THRESHOLD=3000
#CONFIG_SENSORS_SX9500_NORMAL_TOUCH_THRESHOLD=17

#CONFIG_PROXIMITY_SENSOR=y
#CONFIG_OPTICAL_TAOS_TMD2672X=y
#CONFIG_SENSORS_ASP01=y

CONFIG_INPUT=y
CONFIG_INPUT_GPIO=y

#S-View(Hall Sensor)
#CONFIG_SENSORS_HALL=y

#CONFIG_SEC_NFC_I2C=y

#Audience
#CONFIG_SND_SOC_ES325=y
#CONFIG_SND_SOC_ES325_SLIM=y
#CONFIG_FW_LOADER=y
#CONFIG_FIRMWARE_IN_KERNEL=y
#CONFIG_EXTRA_FIRMWARE="audience-es325-fw-h-eur.bin"
#CONFIG_EXTRA_FIRMWARE_DIR="firmware/es325"

#CAMERA
CONFIG_MSM_CPP=y
#CONFIG_S5K4ECGX=y
#CONFIG_SR030PC50=y

#USB
CONFIG_USB_ANDROID_SAMSUNG_COMPOSITE=y
CONFIG_USB_ANDROID_SAMSUNG_MTP=y
CONFIG_USB_DUN_SUPPORT=y
CONFIG_USB_HOST_NOTIFY=y
CONFIG_USB_STORAGE_DETECT=y
CONFIG_USB_ANDROID_SAMSUNG_SIDESYNC=y

#MUIC
#CONFIG_MFD_MAX77693=y
#CONFIG_USB_SWITCH_MAX77693=y
#CONFIG_REGULATOR_MAX77693=y
#CONFIG_DI_MUIC=n
#CONFIG_MUIC_INIT_DETECT_DELAY=3000
#CONFIG_MUIC_USB_DETECT_DELAY=17000
#CONFIG_USB_SWITCH_TSU6721=y
CONFIG_SM5502_MUIC=y

# IRDA support
#CONFIG_IR_REMOCON_MC96=y
#CONFIG_IR_REMOCON_KMINI=y

#Battery charging & BMS
CONFIG_BATTERY_SAMSUNG=y
CONFIG_CHARGER_SMB358=y
CONFIG_BATTERY_BCL=y
CONFIG_QPNP_BMS=y

#BT
no need

#Wifi
#
# Enable Qualcomm Wifi features
#
CONFIG_MSM_PIL_PRONTO=y
CONFIG_WCNSS_CORE=y
CONFIG_WCNSS_CORE_PRONTO=y
CONFIG_WCNSS_MEM_PRE_ALLOC=y

#
# Wifi features (Qualcomm)
#
CONFIG_NET_CORE=y
CONFIG_WIRELESS=y
CONFIG_WIRELESS_EXT_SYSFS=y
CONFIG_WEXT_CORE=y
CONFIG_WEXT_PROC=y
CONFIG_CFG80211=y
CONFIG_CFG80211_DEFAULT_PS=y
#CONFIG_CFG80211_ALLOW_RECONNECT is not set
CONFIG_WLAN=y
CONFIG_WIRELESS_EXT=y
CONFIG_WEXT_PRIV=y

CONFIG_MODULES=y
CONFIG_MODULE_UNLOAD=y
CONFIG_MODULE_FORCE_UNLOAD=y
CONFIG_WCNSS_REGISTER_DUMP_ON_BITE =y

# Earjack
CONFIG_SAMSUNG_JACK=y

#CONFIG_EXTRA_FIRMWARE="audience-es325-fw-h-eur.bin"
```

## arch/arm/configs/msm8926-sec_vastaltectc_defconfig
```kconfig
#variant defconfig
CONFIG_MACH_VICTORLTE=y
CONFIG_MACH_VICTORLTE_CTC=y
CONFIG_SEC_VICTOR_PROJECT=y

#Power Management
CONFIG_SEC_PM=n

CONFIG_SAMSUNG_DEBUG_DISPLAY=y
CONFIG_MSM_EVENT_TIMER=y

#MDSS and LCD
#CONFIG_ESD_ERR_FG_RECOVERY=y
CONFIG_FB_MSM_MDSS=y
CONFIG_FB_MSM_MDSS_WRITEBACK=y
CONFIG_BACKLIGHT_LCD_SUPPORT=y
#CONFIG_MDNIE_TFT_MSM8X26=y
CONFIG_LCD_CLASS_DEVICE=y
CONFIG_BACKLIGHT_CLASS_DEVICE=y
# CONFIG_BACKLIGHT_GENERIC is not set
CONFIG_FB_MSM_MDSS_HX8369B_TFT_VIDEO_WVGA_PT_PANEL=y
CONFIG_FB_MSM8x26_MDSS_CHECK_LCD_CONNECTION=y
CONFIG_BACKLIGHT_IC_KTD253=y

#VIBRATOR
#CONFIG_QPNP_VIBRATOR is not set
CONFIG_MSM_VIBRATOR=y

#TSP
CONFIG_TOUCHSCREEN_MMS136=y
#CONFIG_TOUCHSCREEN_MMS144 is not set
#CONFIG_TOUCHSCREEN_MMS252 is not set
#CONFIG_TOUCHSCREEN_BCMTCH15XXX is not set
#CONFIG_KEYBOARD_CYPRESS_TOUCH is not set
#CONFIG_TOUCHSCREEN_ZINITIX_BT531 is not set
#CONFIG_TOUCHSCREEN_ATMEL_MXTS is not set
#CONFIG_KEYBOARD_CYPRESS_TOUCH_20234 is not set

#SENSORS
CONFIG_SENSORS=y
CONFIG_SENSORS_CORE=y
CONFIG_INPUT=y
CONFIG_INPUT_GPIO=y
CONFIG_INPUT_POLLDEV=y
CONFIG_SENSORS_TMD27723=y
CONFIG_SENSORS_BMA254=y

#CAMERA
CONFIG_MSM_CPP=y
#CONFIG_S5K3H5XA=y
#CONFIG_S5K4H5YB=y
#CONFIG_S5K6A3YX=y
#CONFIG_ISX012=y
#CONFIG_SR352=y
#CONFIG_SR130PC20=y

#USB
CONFIG_USB_ANDROID_SAMSUNG_COMPOSITE=y
CONFIG_USB_ANDROID_SAMSUNG_MTP=y
CONFIG_USB_DUN_SUPPORT=y
CONFIG_USB_ANDROID_SAMSUNG_SIDESYNC=y

#USB Host
CONFIG_USB_HOST_NOTIFY=y
CONFIG_USB_STORAGE_DETECT=y
CONFIG_USB_NET_SMSC75XX=y
CONFIG_USB_NET_SMSC95XX=y

#MUIC
#CONFIG_MFD_MAX77693=y
#CONFIG_USB_SWITCH_MAX77693=y
#CONFIG_REGULATOR_MAX77693=y
#CONFIG_DI_MUIC=n
#CONFIG_MUIC_INIT_DETECT_DELAY=3000
#CONFIG_MUIC_USB_DETECT_DELAY=17000
#CONFIG_USB_SWITCH_TSU6721=y
#CONFIG_SM5502_MUIC=y
CONFIG_USB_SWITCH_RT8973=y

# IRDA support
#CONFIG_IR_REMOCON_MC96=y

#Battery charging & BMS
CONFIG_QPNP_SEC_CHARGER=y
CONFIG_BATTERY_BCL=y
CONFIG_QPNP_BMS=y
CONFIG_NOT_USE_EXT_OVP=y

#BT
no need

#Sec Thermistor
CONFIG_SEC_THERMISTOR=y

#Wifi
no need
#
# Enable Qualcomm Wifi features
#
CONFIG_MSM_PIL_PRONTO=y
CONFIG_WCNSS_CORE=y
CONFIG_WCNSS_CORE_PRONTO=y
CONFIG_WCNSS_MEM_PRE_ALLOC=y

#
# Wifi features (Qualcomm)
#
CONFIG_NET_CORE=y
CONFIG_WIRELESS=y
CONFIG_WIRELESS_EXT_SYSFS=y
CONFIG_WEXT_CORE=y
CONFIG_WEXT_PROC=y
CONFIG_CFG80211=y
CONFIG_CFG80211_DEFAULT_PS=y
# CONFIG_CFG80211_ALLOW_RECONNECT is not set
CONFIG_WLAN=y
CONFIG_WIRELESS_EXT=y
CONFIG_WEXT_PRIV=y

CONFIG_MODULES=y
CONFIG_MODULE_UNLOAD=y
CONFIG_MODULE_FORCE_UNLOAD=y
CONFIG_WCNSS_REGISTER_DUMP_ON_BITE=y

CONFIG_PPP_FILTER=y
CONFIG_PPP_ASYNC=y
CONFIG_PPP_SYNC_TTY=y

# Earjack
CONFIG_SAMSUNG_JACK=y

# CODEC
# CONFIG_SND_SOC_MAX98504 is not set

# GPIO DVS
#CONFIG_SEC_GPIO_DVS is not set
# DHA Solution
#CONFIG_SEC_DHA_SOL_MAL is not set

## CHINA
#configs for Wi-Fi
CONFIG_TARGET_LOCALE_CHN=y
CONFIG_WLAN_REGION_CODE=300
```

## arch/arm/configs/msm8926-sec_vastalteduos_defconfig
```kconfig
#variant defconfig
CONFIG_MACH_VASTALTE_CHN_CMCC_DUOS=y
CONFIG_SEC_VASTALTE_CHN_CMMCC_DUOS_PROJECT=y

#Power Management
CONFIG_SEC_PM=y

CONFIG_SAMSUNG_DEBUG_DISPLAY=y
CONFIG_MSM_EVENT_TIMER=y

#MDSS and LCD
CONFIG_FB_MSM_MDSS_HX8394C_TFT_VIDEO_720P_PANEL=y
CONFIG_FB_MSM8x26_MDSS_CHECK_LCD_CONNECTION=y
#CONFIG_ESD_ERR_FG_RECOVERY=y
CONFIG_FB_MSM_MDSS_MSM8X26=y
CONFIG_FB_MSM_MDSS=y
CONFIG_FB_MSM_MDSS_WRITEBACK=y
CONFIG_BACKLIGHT_LCD_SUPPORT=y
CONFIG_MDNIE_TFT_MSM8X26=y
CONFIG_CABC_TUNING_HX8394C=y
CONFIG_LCD_CLASS_DEVICE=y
CONFIG_BACKLIGHT_CLASS_DEVICE=y
CONFIG_SAMSUNG_DEBUG_DISPLAY=y
# CONFIG_BACKLIGHT_GENERIC is not set

#VIBRATOR
#CONFIG_QPNP_VIBRATOR is not set
CONFIG_MSM_VIBRATOR=y

#SVC LEDS
CONFIG_LEDS_KTD2026=y

#TSP
#CONFIG_TOUCHSCREEN_MMS136=y
#CONFIG_TOUCHSCREEN_MMS144 is not set
#CONFIG_TOUCHSCREEN_MMS252 is not set
#CONFIG_TOUCHSCREEN_BCMTCH15XXX is not set
#CONFIG_KEYBOARD_CYPRESS_TOUCH is not set
#CONFIG_TOUCHSCREEN_ATMEL_MXTS is not set
#CONFIG_KEYBOARD_CYPRESS_TOUCH_20234 is not set
CONFIG_TOUCHSCREEN_ZINITIX_BT532=y

#NFC
CONFIG_NFC_PN547=y
#CONFIG_NFC_PN547_8226_USE_BBCLK2=y

#SENSORS
CONFIG_SENSORS=y
CONFIG_SENSORS_CORE=y
CONFIG_INPUT=y
CONFIG_INPUT_GPIO=y
#CONFIG_SENSORS_HALL is not set
CONFIG_INPUT_POLLDEV=y
CONFIG_SENSORS_CM36686=y
CONFIG_SENSORS_CM36686_LEDA_EN_GPIO=y
CONFIG_SENSORS_K303C=y

#CAMERA
#CONFIG_MSM_CPP=y
#CONFIG_S5K4ECGX=y
#CONFIG_S5K3H5XA=y
#CONFIG_S5K4H5YB=y
#CONFIG_S5K6A3YX=y
#CONFIG_ISX012=y
#CONFIG_SR352=y
#CONFIG_SR130PC20=y

#USB
CONFIG_USB_ANDROID_SAMSUNG_COMPOSITE=y
CONFIG_USB_ANDROID_SAMSUNG_MTP=y
CONFIG_USB_DUN_SUPPORT=y
CONFIG_USB_ANDROID_SAMSUNG_SIDESYNC=y

#USB Host
#CONFIG_USB_HOST_NOTIFY is not set
#CONFIG_USB_STORAGE_DETECT is not set
#CONFIG_USB_NET_SMSC75XX is not set
#CONFIG_USB_NET_SMSC95XX is not set

#MUIC
#CONFIG_MFD_MAX77693=y
#CONFIG_USB_SWITCH_MAX77693=y
#CONFIG_REGULATOR_MAX77693=y
#CONFIG_DI_MUIC=n
#CONFIG_MUIC_INIT_DETECT_DELAY=3000
#CONFIG_MUIC_USB_DETECT_DELAY=17000
#CONFIG_USB_SWITCH_TSU6721=y
CONFIG_SM5502_MUIC=y
CONFIG_USB_SWITCH_RT8973=y

# IRDA support
#CONFIG_IR_REMOCON_MC96=y

# Charger
CONFIG_BATTERY_SAMSUNG=y
CONFIG_QPNP_CHARGER=y
CONFIG_BATTERY_BCL=y
CONFIG_QPNP_BMS=y

#BT
no need

#Sec Thermistor
CONFIG_SEC_THERMISTOR=y

#Wifi
no need
#
# Enable Qualcomm Wifi features
#
CONFIG_MSM_PIL_PRONTO=y
CONFIG_WCNSS_CORE=y
CONFIG_WCNSS_CORE_PRONTO=y
CONFIG_WCNSS_MEM_PRE_ALLOC=y

#
# Wifi features (Qualcomm)
#
CONFIG_NET_CORE=y
CONFIG_WIRELESS=y
CONFIG_WIRELESS_EXT_SYSFS=y
CONFIG_WEXT_CORE=y
CONFIG_WEXT_PROC=y
CONFIG_CFG80211=y
CONFIG_CFG80211_DEFAULT_PS=y
# CONFIG_CFG80211_ALLOW_RECONNECT is not set
CONFIG_WLAN=y
CONFIG_WIRELESS_EXT=y
CONFIG_WEXT_PRIV=y

CONFIG_MODULES=y
CONFIG_MODULE_UNLOAD=y
CONFIG_MODULE_FORCE_UNLOAD=y
CONFIG_WCNSS_REGISTER_DUMP_ON_BITE=y

CONFIG_PPP_FILTER=y
CONFIG_PPP_ASYNC=y
CONFIG_PPP_SYNC_TTY=y
CONFIG_IP_MULTICAST=y

# Earjack
CONFIG_SAMSUNG_JACK=y

# DSDA via HS_UART
CONFIG_DSDA_VIA_UART=y

# CODEC
# CONFIG_SND_SOC_MAX98504 is not set

# GPIO DVS
#CONFIG_SEC_GPIO_DVS is not set
# DHA Solution
#CONFIG_SEC_DHA_SOL_MAL is not set

## CHINA
#configs for Wi-Fi
CONFIG_TARGET_LOCALE_CHN=y
CONFIG_WLAN_REGION_CODE=300

#SAPA
CONFIG_RTC_AUTO_PWRON=y
CONFIG_RTC_AUTO_PWRON_PARAM=y

# PARAM partition size
CONFIG_PARAM_SIZE_983000=y

# SSWAP
CONFIG_SWAP=y
CONFIG_FRONTSWAP=y
CONFIG_ZSMALLOC_NEW=y
CONFIG_PGTABLE_MAPPING=y
CONFIG_ZSWAP=y
CONFIG_DIRECT_RECLAIM_FILE_PAGES_ONLY=n
CONFIG_INCREASE_MAXIMUM_SWAPPINESS=y
CONFIG_FIX_INACTIVE_RATIO=y
CONFIG_TIGHT_PGDAT_BALANCE=y
CONFIG_VNSWAP=y
CONFIG_SWAP_ENABLE_READAHEAD=n

#SUMX
CONFIG_USB_QCOM_DIAG_BRIDGE=y
CONFIG_N_SMUX=y
CONFIG_N_SMUX_LOOPBACK=y
CONFIG_SMUX_CTL=y
CONFIG_MSM_RMNET_SMUX=y
CONFIG_SERIAL_MSM_HS=y
CONFIG_SGLTE_QSC_MODEM=y

CONFIG_MACH_BAFFIN2_SGLTE=y
```
