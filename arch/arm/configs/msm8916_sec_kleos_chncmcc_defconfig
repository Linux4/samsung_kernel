## arch/arm/configs/msm8916_sec_kleos_chncmcc_defconfig
```kconfig
CONFIG_SEC_KLEOS_PROJECT=y
CONFIG_MACH_KLEOS_CMCC=y

CONFIG_DEBUG_SPINLOCK=y

CONFIG_SEC_GPIO_SETTINGS=y

# MUIC
CONFIG_SM5502_MUIC=y
CONFIG_SM5504_MUIC=y
CONFIG_MUIC_SUPPORT_RUSTPROOF=y
# CONFIG_MUIC_SM5502_SUPPORT_LANHUB_TA is not set
CONFIG_USBID_STANDARD_VER_01=y

#Touch Key
CONFIG_KEYBOARD_TC360_TOUCHKEY=y
CONFIG_KEYBOARD_ABOV_TOUCH=y
CONFIG_KEYBOARD_CYPRESS_TOUCHKEY=y

#LCD
CONFIG_FB_MSM_MIPI_SAMSUNG_QHD_VIDEO_PT_PANEL=y
CONFIG_MDNIE_LITE_TUNING=y

CONFIG_REGULATOR_FIXED_VOLTAGE=y

#Touch Screen
CONFIG_TOUCHSCREEN_MXTS=y
CONFIG_TOUCHSCREEN_MXT336S=y
CONFIG_TOUCHSCREEN_MMS300=y
CONFIG_SEC_DVFS=y

CONFIG_MFD_RT5033=y
CONFIG_BATTERY_SAMSUNG=y
CONFIG_BATTERY_SAMSUNG_DATA_FILE="kleos_battery_data.h"
CONFIG_SAMSUNG_LPM_MODE=y
CONFIG_CHARGER_RT5033=y
CONFIG_FUELGAUGE_RT5033=y
CONFIG_REGULATOR_RT5033=y

#Wifi
#
# Enable Qualcomm Wifi features
#
CONFIG_MSM_PIL_PRONTO=y
CONFIG_WCNSS_CORE=y
CONFIG_WCNSS_CORE_PRONTO=y
CONFIG_WCNSS_MEM_PRE_ALLOC=y

CONFIG_WLAN_REGION_CODE=300
CONFIG_TARGET_LOCALE_CHN=y

#
# Wifi features (Qualcomm)
#
CONFIG_NET_CORE=y
CONFIG_WIRELESS=y
CONFIG_WIRELESS_EXT_SYSFS=y
CONFIG_WEXT_CORE=y
CONFIG_WEXT_PROC=y
CONFIG_CFG80211=y
CONFIG_CFG80211_DEFAULT_PS=y
#CONFIG_CFG80211_ALLOW_RECONNECT is not set
CONFIG_WLAN=y
CONFIG_WIRELESS_EXT=y
CONFIG_WEXT_PRIV=y

CONFIG_MODULES=y
CONFIG_MODULE_UNLOAD=y
CONFIG_MODULE_FORCE_UNLOAD=y
CONFIG_WCNSS_REGISTER_DUMP_ON_BITE =y

#AUDIO
CONFIG_RADIO_IRIS=y
CONFIG_RADIO_IRIS_TRANSPORT=m

#SENSOR
CONFIG_SENSORS_K303C=y
CONFIG_SENSORS_CM36686=y
CONFIG_SENSORS_CM36686_LEDA_EN_GPIO=y

#NFC
# CONFIG_SEC_NFC=y is not set
# CONFIG_SEC_NFC_I2C=y is not set
# CONFIG_SEC_NFC_USE_8916_BBCLK2=y is not set
# CONFIG_SEC_NFC_IF_I2C=y is not set
# CONFIG_SEC_NFC_PRODUCT_N5=y is not set

#FLASH
CONFIG_FLASHLIGHT=y
CONFIG_RT_FLASH_LED=y
CONFIG_FLED_RT5033=y
CONFIG_FLED_RT5033_EXT_GPIO=y

CONFIG_FRONT_EEPROM=y

# RTCC v3
CONFIG_SWAP=y
CONFIG_ZSMALLOC=y
CONFIG_ZRAM=y
CONFIG_RUNTIME_COMPCACHE=y
CONFIG_KSWAPD_NOSWAP=y

# TIMA LOG
CONFIG_ARCH_MSM8916_TIMA=y

#optimize mmc block delay on resume
CONFIG_MMC_BLOCK_DEFERRED_RESUME=y

# Pre-power on alarm
CONFIG_RTC_AUTO_PWRON=y
CONFIG_RTC_AUTO_PWRON_PARAM=y
```

## arch/arm/configs/msm8916_sec_kleos_eur_defconfig
```kconfig
CONFIG_SEC_KLEOS_PROJECT=y
CONFIG_MACH_KLEOS_EUR=y

# MUIC
CONFIG_SM5502_MUIC=y
# CONFIG_MUIC_SM5502_SUPPORT_LANHUB_TA is not set

#Touch Key
CONFIG_KEYBOARD_TC360_TOUCHKEY=y

#LCD
CONFIG_FB_MSM_MIPI_SAMSUNG_QHD_VIDEO_PT_PANEL=y

#Touch Screen
CONFIG_TOUCHSCREEN_MXTS=y
CONFIG_TOUCHSCREEN_MXT336S=y

CONFIG_MFD_RT5033=y
CONFIG_BATTERY_SAMSUNG=y
CONFIG_SAMSUNG_LPM_MODE=y
CONFIG_CHARGER_RT5033=y
CONFIG_FUELGAUGE_RT5033=y
CONFIG_REGULATOR_RT5033=y

#AUDIO
CONFIG_RADIO_IRIS=y
CONFIG_RADIO_IRIS_TRANSPORT=m

# TIMA LOG
CONFIG_ARCH_MSM8916_TIMA=y

#optimize mmc block delay on resume
CONFIG_MMC_BLOCK_DEFERRED_RESUME=y
```

## arch/arm/configs/msm8916_sec_matissevewifi_eur_defconfig
```kconfig
CONFIG_SEC_MATISSEVE_PROJECT=y
CONFIG_MACH_MATISSEVEWIFI_EUR_OPEN=y

# HARD RESET
CONFIG_RESTART_REASON_SEC_PARAM=y

# MUIC
CONFIG_SM5502_MUIC=y
CONFIG_USBID_STANDARD_VER_01=y
CONFIG_MUIC_SUPPORT_CHARGING_CABLE=y
CONFIG_MUIC_SUPPORT_RUSTPROOF_INBATT=y
CONFIG_MUIC_SUPPORT_DESKDOCK=y
#CONFIG_MUIC_SM5502_SUPPORT_LANHUB_TA=y


#USB HOST
CONFIG_USB_HOST_NOTIFY=y

#AUDIO
CONFIG_AUDIO_SPEAKER_OUT_MAXIM_AMP_ENABLE=y
# CONFIG_AUDIO_SPEAKER_OUT_NXP_AMP_ENABLE is not set
CONFIG_AUDIO_QUAT_I2S_ENABLE=y
# CONFIG_AUDIO_GND_REF_CONTROL is not set

#HALL IC
CONFIG_SENSORS_HALL=y

#TSP BOOSTER
#CONFIG_COMMON_INPUT_BOOSTER=y
#CONFIG_CPU_FREQ_LIMIT_USERSPACE=y
#CONFIG_CPU_FREQ_LIMIT=y
# TSP
CONFIG_TOUCHSCREEN_ATMEL_MXT1188S=y
CONFIG_INPUT_BOOSTER=y
#LCD
CONFIG_PANEL_TC358764_LTL101AL06_KTD3156_WXGA=y

# BATTERY
CONFIG_BATTERY_SAMSUNG=y
CONFIG_SAMSUNG_LPM_MODE=y
CONFIG_CHARGER_SM5418=y
CONFIG_FUELGAUGE_STC3117=y
CONFIG_BATTERY_SWELLING=y
CONFIG_BATTERY_SAMSUNG_DATA_FILE="matisse_battery_data.h"

#SENSOR
CONFIG_SENSORS=y
CONFIG_SENSORS_CORE=y
CONFIG_SENSORS_K2HH=y
CONFIG_SENSORS_K2HH_VDD=y

#CAMERA
CONFIG_SR352=y
CONFIG_SR130PC20=y
CONFIG_SENSOR_8_BPP=y

# EXTEND SERIAL NUM LENGTH
CONFIG_EXTEND_SERIAL_NUM_16=y

# SSWAP
CONFIG_SWAP=y
CONFIG_FRONTSWAP=y
CONFIG_ZSMALLOC=y
CONFIG_PGTABLE_MAPPING=y
CONFIG_ZSWAP=y
CONFIG_ZPOOL=y
CONFIG_DIRECT_RECLAIM_FILE_PAGES_ONLY=y
CONFIG_INCREASE_MAXIMUM_SWAPPINESS=y
CONFIG_FIX_INACTIVE_RATIO=y
CONFIG_TIGHT_PGDAT_BALANCE=y
CONFIG_VNSWAP=y
CONFIG_SWAP_ENABLE_READAHEAD=n
```

## arch/arm/configs/msm8916_sec_o7lte_swaopen_defconfig
```kconfig
CONFIG_SEC_O7_PROJECT=y
CONFIG_MACH_O7_SWA_OPEN=y

# HARD RESET
CONFIG_RESTART_REASON_SEC_PARAM=y

# SS Pinctrl Driver
CONFIG_SEC_GPIO_SETTINGS=y

# MUIC
CONFIG_SM5703_MUIC=y
CONFIG_USBID_STANDARD_VER_01=y
CONFIG_MUIC_SUPPORT_CHARGING_CABLE=y
CONFIG_MUIC_SUPPORT_RUSTPROOF=y
CONFIG_MUIC_SUPPORT_DESKDOCK=y

#USB Host
CONFIG_USB_HOST_NOTIFY=y

#Touch Screen
CONFIG_TOUCHSCREEN_IST30XXC=y
CONFIG_TOUCHSCREEN_ZT7538_TS=y

# Vibrator
CONFIG_SM5703_VIBRATOR=y

#LCD
CONFIG_PANEL_S6D7AA0X62_BV050HDM_HD_5_5=y
CONFIG_PANEL_ILI9881C_SKI550002_HD=y
CONFIG_MFD_LM3632=y

#SENSOR
CONFIG_SENSORS=y
CONFIG_SENSORS_CORE=y
CONFIG_SENSORS_K2HH=y
CONFIG_SENSORS_CM36672P=y
CONFIG_SENSORS_STK3013=y

#FLASH
CONFIG_FLASHLIGHT=y
CONFIG_SM_FLASH_LED=y
CONFIG_FLED_SM5703=y
CONFIG_FLED_SM5703_EXT_GPIO=y

#CAMERA
CONFIG_S5K3L2XX=y
CONFIG_S5K5E3YX=y
CONFIG_CAMERA_SYSFS_V2=y

#Wifi
#
# Enable Qualcomm Wifi features
#
CONFIG_MSM_PIL_PRONTO=y
CONFIG_WCNSS_CORE=y
CONFIG_WCNSS_CORE_PRONTO=y
CONFIG_WCNSS_MEM_PRE_ALLOC=y

#
# Wifi features (Qualcomm)
#
CONFIG_NET_CORE=y
CONFIG_WIRELESS=y
CONFIG_WIRELESS_EXT_SYSFS=y
CONFIG_WEXT_CORE=y
CONFIG_WEXT_PROC=y
CONFIG_CFG80211=y
CONFIG_CFG80211_DEFAULT_PS=y
#CONFIG_CFG80211_ALLOW_RECONNECT is not set
CONFIG_WLAN=y
CONFIG_WIRELESS_EXT=y
CONFIG_WEXT_PRIV=y
CONFIG_MODULES=y
CONFIG_MODULE_UNLOAD=y
CONFIG_MODULE_FORCE_UNLOAD=y
CONFIG_WCNSS_REGISTER_DUMP_ON_BITE =y

#AUDIO
CONFIG_RADIO_IRIS=y
CONFIG_RADIO_IRIS_TRANSPORT=m
CONFIG_SW_100K_TO_GND=y

#optimize mmc block delay on resume
CONFIG_MMC_BLOCK_DEFERRED_RESUME=y

# IPSec
CONFIG_CRYPTO_NULL=y

#CONFIGURE Knox UID PID
CONFIG_KNOX_VPN_UID_PID=y

# Charging/Battery
CONFIG_MFD_SM5703=y
CONFIG_REGULATOR_SM5703=y
CONFIG_CHARGER_SM5703=y
CONFIG_BATTERY_SAMSUNG=y
CONFIG_BATTERY_SAMSUNG_DATA_FILE="o7_battery_data.h"
CONFIG_SAMSUNG_LPM_MODE=y
CONFIG_FUELGAUGE_SM5703=y
CONFIG_BATTERY_SWELLING=y
CONFIG_SIOP_CHARGING_LIMIT_CURRENT=700
CONFIG_PREVENT_SOC_JUMP=y
CONFIG_CHARGER_SM5703_SOFT_START_CHARGING=y
CONFIG_CHARGER_SM5703_DUALPATH=y
CONFIG_SW_SELF_DISCHARGING=y

# DUAL SIM / SINGLE SIM Detection
CONFIG_CHECK_SIMSLOT_COUNT=y
# CONFIG_CHECK_SIMSLOT_COUNT_GPIO is not set
CONFIG_CHECK_SIMSLOT_COUNT_DT=y

# MMC
# CONFIG_SEC_HYBRID_TRAY=y is not set

# SDP
CONFIG_SDP=y
CONFIG_SDP_VAULT=y

CONFIG_FEATURE_NFF=y

#EPDG
CONFIG_NET_CORE=y
CONFIG_NET_SCH_PRIO=y
CONFIG_NET_SCHED=y   #depends on CONFIG_NET  which is enabled by default.. coz not seeing in the config file
CONFIG_NET_CLS_BASIC=y # required if basic is being used as a filter. depends on CONFIG_NET_CLS so enabling it by default
CONFIG_NET_CLS=y
CONFIG_NET_CLS_ACT=y # for enabling the action target.
CONFIG_NET_ACT_MIRRED=y  # for enabling the mirred target for redirecting the packet between the devices.
CONFIG_NET_EMATCH=y   #basic uses extended matches so this has to be present
CONFIG_NET_SCH_INGRESS=y # classifier for ingress packet
#EPDG

# SSWAP
CONFIG_SWAP=y
CONFIG_FRONTSWAP=y
CONFIG_ZSMALLOC=y
CONFIG_PGTABLE_MAPPING=y
CONFIG_ZSWAP=y
CONFIG_ZPOOL=y
CONFIG_DIRECT_RECLAIM_FILE_PAGES_ONLY=y
CONFIG_INCREASE_MAXIMUM_SWAPPINESS=y
CONFIG_FIX_INACTIVE_RATIO=y
CONFIG_TIGHT_PGDAT_BALANCE=y
CONFIG_VNSWAP=y
CONFIG_SWAP_ENABLE_READAHEAD=n

# MMAP read-around
CONFIG_MMAP_READAROUND_LIMIT=16
```

## arch/arm/configs/msm8916_sec_rossa_eur_defconfig
```kconfig
CONFIG_SEC_ROSSA_PROJECT=y
CONFIG_MACH_ROSSA_EUR_OPEN=y

# SS Pinctrl Driver
CONFIG_SEC_GPIO_SETTINGS=y

#sensor
# CONFIG_SENSORS_ADSP is not set
# CONFIG_SENSORS_BMA255 is not set
# CONFIG_SENSORS_GP2A030A is not set
# CONFIG_SENSORS_GP2A030A_PROX is not set
# CONFIG_SENSORS_HSCDTD008A is not set

#SENSOR
CONFIG_SENSORS_CORE=y
CONFIG_SENSORS_K2HH=y
CONFIG_SENSORS_K2HH_VDD=y
CONFIG_SENSORS_GP2A002=y


#Wifi
#
# Enable Qualcomm Wifi features
#
#CONFIG_MSM_PIL_PRONTO=y
#CONFIG_WCNSS_CORE=y
#CONFIG_WCNSS_CORE_PRONTO=y
#CONFIG_WCNSS_MEM_PRE_ALLOC=y
#
# Wifi features (Qualcomm)
#
#CONFIG_NET_CORE=y
#CONFIG_WIRELESS=y
#CONFIG_WIRELESS_EXT_SYSFS=y
#CONFIG_WEXT_CORE=y
#CONFIG_WEXT_PROC=y
#CONFIG_CFG80211=y
#CONFIG_CFG80211_DEFAULT_PS=y
#CONFIG_WLAN_REGION_CODE=300
#CONFIG_TARGET_LOCALE_CHN=y
#CONFIG_CFG80211_ALLOW_RECONNECT is not set
#CONFIG_WLAN=y
#CONFIG_WIRELESS_EXT=y
#CONFIG_WEXT_PRIV=y
#CONFIG_MODULES=y
#CONFIG_MODULE_UNLOAD=y
#CONFIG_MODULE_FORCE_UNLOAD=y
#CONFIG_WCNSS_REGISTER_DUMP_ON_BITE =y

# MUIC
CONFIG_SM5504_MUIC=y
# CONFIG_MUIC_SM5502_SUPPORT_LANHUB_TA is not set
CONFIG_MUIC_SUPPORT_RUSTPROOF=y
CONFIG_USBID_STANDARD_VER_01=y

#Touch Screen
CONFIG_TOUCHSCREEN_IST30XX_CORE3=y

# VIBRATOR
CONFIG_MSM_VIBRATOR=y

#AUDIO
CONFIG_RADIO_IRIS=y
CONFIG_RADIO_IRIS_TRANSPORT=m

#LCD
CONFIG_PANEL_SC7798A_BV045WVM_WVGA=y
CONFIG_PANEL_HX8369B_BV045WVM_WVGA=y

CONFIG_MFD_RT5033=y
CONFIG_MFD_RT5033_RESET_WA=y
CONFIG_MFD_RT5033_SLDO_VBUSDET=n
CONFIG_BATTERY_SAMSUNG=y
CONFIG_BATTERY_SAMSUNG_DATA_FILE="rossa_battery_data.h"
CONFIG_SAMSUNG_LPM_MODE=y
CONFIG_CHARGER_RT5033=y
CONFIG_FUELGAUGE_RT5033=y
CONFIG_REGULATOR_RT5033=y
#CONFIG_BATTERY_SWELLING is not set

# Pre-power on alarm
# CONFIG_RTC_AUTO_PWRON is not set
# CONFIG_RTC_AUTO_PWRON_PARAM is not set

#CAMERA
CONFIG_SR200PC20=y
CONFIG_MSM_EEPROM=n
CONFIG_MSM_OTP=y
CONFIG_SR544=y

#FLASH
CONFIG_FLASHLIGHT=y
CONFIG_RT_FLASH_LED=y
CONFIG_FLED_RT5033=y
CONFIG_FLED_RT5033_EXT_GPIO=y

#optimize mmc block delay on resume
CONFIG_MMC_BLOCK_DEFERRED_RESUME=y

# RTCC v3
CONFIG_SWAP=y
CONFIG_ZSMALLOC=y
CONFIG_ZRAM=y
CONFIG_RUNTIME_COMPCACHE=y
CONFIG_KSWAPD_NOSWAP=y


#NFC
CONFIG_SEC_NFC=y
CONFIG_SEC_NFC_I2C=y
CONFIG_SEC_NFC_USE_8916_BBCLK2=y
CONFIG_SEC_NFC_IF_I2C=y
CONFIG_SEC_NFC_PRODUCT_N5=y

#CONFIGURE Knox UID PID
#CONFIG_KNOX_VPN_UID_PID is not set

# DUAL SIM / SINGLE SIM Detection
CONFIG_CHECK_SIMSLOT_COUNT=y
# CONFIG_CHECK_SIMSLOT_COUNT_GPIO is not set
CONFIG_CHECK_SIMSLOT_COUNT_DT=y

# IPSec
#CONFIG_CRYPTO_NULL=y

# A-KSM
#disable KSM for power consumption problem
#CONFIG_KSM=y
#CONFIG_ADAPTIVE_KSM=y

#EPDG
CONFIG_NET_CORE=y
CONFIG_NET_SCH_PRIO=y
CONFIG_NET_SCHED=y   #depends on CONFIG_NET  which is enabled by default.. coz not seeing in the config file
CONFIG_NET_CLS_BASIC=y # required if basic is being used as a filter. depends on CONFIG_NET_CLS so enabling it by default
CONFIG_NET_CLS=y
CONFIG_NET_CLS_ACT=y # for enabling the action target.
CONFIG_NET_ACT_MIRRED=y  # for enabling the mirred target for redirecting the packet between the devices.
CONFIG_NET_EMATCH=y   #basic uses extended matches so this has to be present
CONFIG_NET_SCH_INGRESS=y # classifier for ingress packet
#EPDG
```

## arch/arm/configs/msm8916_sec_rossa_tmo_defconfig
```kconfig
CONFIG_SEC_ROSSA_PROJECT=y
CONFIG_MACH_ROSSA_TMO=y

# HARD RESET
CONFIG_RESTART_REASON_SEC_PARAM=y

# SS Pinctrl Driver
CONFIG_SEC_GPIO_SETTINGS=y

#SENSOR
CONFIG_SENSORS_CORE=y
CONFIG_SENSORS_K2HH=y
CONFIG_SENSORS_K2HH_VDD=y
CONFIG_SENSORS_GP2A002=y
CONFIG_SENSORS_GP2A_VDD=y

#Wifi
#
# Enable Qualcomm Wifi features
#
#CONFIG_MSM_PIL_PRONTO=y
#CONFIG_WCNSS_CORE=y
#CONFIG_WCNSS_CORE_PRONTO=y
#CONFIG_WCNSS_MEM_PRE_ALLOC=y
#
# Wifi features (Qualcomm)
#
#CONFIG_NET_CORE=y
#CONFIG_WIRELESS=y
#CONFIG_WIRELESS_EXT_SYSFS=y
#CONFIG_WEXT_CORE=y
#CONFIG_WEXT_PROC=y
#CONFIG_CFG80211=y
#CONFIG_CFG80211_DEFAULT_PS=y
#CONFIG_WLAN_REGION_CODE=300
#CONFIG_TARGET_LOCALE_CHN=y
#CONFIG_CFG80211_ALLOW_RECONNECT is not set
#CONFIG_WLAN=y
#CONFIG_WIRELESS_EXT=y
#CONFIG_WEXT_PRIV=y
#CONFIG_MODULES=y
#CONFIG_MODULE_UNLOAD=y
#CONFIG_MODULE_FORCE_UNLOAD=y
#CONFIG_WCNSS_REGISTER_DUMP_ON_BITE =y

# MUIC
CONFIG_SM5504_MUIC=y
# CONFIG_MUIC_SM5502_SUPPORT_LANHUB_TA is not set
CONFIG_MUIC_SUPPORT_RUSTPROOF=y
CONFIG_USBID_STANDARD_VER_01=y

# VIBRATOR
CONFIG_MSM_VIBRATOR=y

#Touch Screen
CONFIG_TOUCHSCREEN_IST30XX_CORE3=y
CONFIG_COMMON_INPUT_BOOSTER=y

#AUDIO
#CONFIG_RADIO_IRIS=y
#CONFIG_RADIO_IRIS_TRANSPORT=m

#LCD
CONFIG_PANEL_SC7798A_BV045WVM_WVGA=y

#BATTERY
CONFIG_MFD_RT5033=y
CONFIG_BATTERY_SAMSUNG=y
CONFIG_BATTERY_SAMSUNG_DATA_FILE="rossa_battery_data.h"
CONFIG_SAMSUNG_LPM_MODE=y
CONFIG_CHARGER_RT5033=y
CONFIG_FUELGAUGE_RT5033=y
CONFIG_REGULATOR_RT5033=y

# Pre-power on alarm
#CONFIG_RTC_AUTO_PWRON=y
#CONFIG_RTC_AUTO_PWRON_PARAM=y
#CAMERA
#CONFIG_MSM_EEPROM=n
#CONFIG_MSM_OTP=y

#optimize mmc block delay on resume
CONFIG_MMC_BLOCK_DEFERRED_RESUME=y

#front cam
CONFIG_SR200PC20=y
CONFIG_SR544=y
CONFIG_SENSOR_8_BPP=y

CONFIG_MSM_EEPROM=n
CONFIG_MSM_OTP=y
#FLASH
CONFIG_FLASHLIGHT=y
CONFIG_RT_FLASH_LED=y
CONFIG_FLED_RT5033=y
CONFIG_FLED_RT5033_EXT_GPIO=y

#disable KSM for power consumption problem
#CONFIG_KSM=y
#CONFIG_ADAPTIVE_KSM=y
#CONFIG_KSM_MEMCMP=y



# MODEM SECURE CHECK
#CONFIG_SEC_PERIPHERAL_SECURE_CHK=y
#EPDG
CONFIG_NET_CORE=y
CONFIG_NET_SCH_PRIO=y
CONFIG_NET_SCHED=y   #depends on CONFIG_NET  which is enabled by default.. coz not seeing in the config file
CONFIG_NET_CLS_BASIC=y # required if basic is being used as a filter. depends on CONFIG_NET_CLS so enabling it by default
CONFIG_NET_CLS=y
CONFIG_NET_CLS_ACT=y # for enabling the action target.
CONFIG_NET_ACT_MIRRED=y  # for enabling the mirred target for redirecting the packet between the devices.
CONFIG_NET_EMATCH=y   #basic uses extended matches so this has to be present
CONFIG_NET_SCH_INGRESS=y # classifier for ingress packet

CONFIG_VPNCLIENT_SECURITY=y

# SSWAP
CONFIG_SWAP=y
CONFIG_FRONTSWAP=y
CONFIG_ZSMALLOC=y
CONFIG_PGTABLE_MAPPING=y
CONFIG_ZSWAP=y
CONFIG_ZPOOL=y
CONFIG_DIRECT_RECLAIM_FILE_PAGES_ONLY=y
CONFIG_INCREASE_MAXIMUM_SWAPPINESS=y
CONFIG_FIX_INACTIVE_RATIO=y
CONFIG_TIGHT_PGDAT_BALANCE=y
CONFIG_VNSWAP=y
CONFIG_SWAP_ENABLE_READAHEAD=n

#APC CPR QUOTIENT
CONFIG_APC_CPR_QUOT_BOOST=y
```
