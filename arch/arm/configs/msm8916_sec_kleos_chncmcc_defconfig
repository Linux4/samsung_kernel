## arch/arm/configs/msm8926-sec_degaslte_spr_defconfig
```kconfig
#variant defconfig
CONFIG_MACH_DEGASLTE_SPR=y
CONFIG_SEC_DEGAS_PROJECT=y
CONFIG_SEC_DEGASLTE_COMMON=y

#Power Management
CONFIG_SEC_PM=y
CONFIG_SEC_PM_DEBUG=y
CONFIG_SAMSUNG_DEBUG_DISPLAY=y
#CONFIG_FB_MSM_MDSS_SHARP_HD_PANEL=y
CONFIG_FB_MSM_MDSS_SDC_WXGA_PANEL=y
CONFIG_FB_MSM8x26_MDSS_CHECK_LCD_CONNECTION=y
CONFIG_ESD_ERR_FG_RECOVERY=y
CONFIG_FB_MSM_MDSS=y
CONFIG_FB_MSM_MDSS_WRITEBACK=y
CONFIG_BACKLIGHT_LCD_SUPPORT=y
CONFIG_MDNIE_TFT_MSM8X26=y
CONFIG_LCD_CLASS_DEVICE=y
CONFIG_BACKLIGHT_CLASS_DEVICE=y
# CONFIG_BACKLIGHT_GENERIC is not set

#VIBRATOR
#CONFIG_QPNP_VIBRATOR is not set
CONFIG_MSM_VIBRATOR=y

#TSP
CONFIG_TOUCHSCREEN_ZINITIX_BT532=y

#SENSOR
CONFIG_SENSORS=y
CONFIG_SENSORS_K2HH=y
CONFIG_SENSORS_SX9500=y
CONFIG_SENSORS_SX9500_INIT_TOUCH_THRESHOLD=3000
CONFIG_SENSORS_SX9500_NORMAL_TOUCH_THRESHOLD=11

# TIMA LOG
CONFIG_ARCH_MSM8926_LTE=y

CONFIG_INPUT=y
CONFIG_INPUT_GPIO=y
#CONFIG_SENSORS_HALL is not set

#CAMERA
CONFIG_MSM_CPP=y
#CONFIG_S5K3H5XA=y
#CONFIG_S5K4H5YB=y
#CONFIG_S5K6A3YX=y
#CONFIG_ISX012=y
CONFIG_SR352=y
CONFIG_SR130PC20=y

#USB
CONFIG_USB_ANDROID_SAMSUNG_COMPOSITE=y
CONFIG_USB_ANDROID_SAMSUNG_MTP=y
CONFIG_USB_DUN_SUPPORT=y
CONFIG_USB_ANDROID_SAMSUNG_SIDESYNC=y

#USB Host
CONFIG_USB_HOST_NOTIFY=y
CONFIG_USB_STORAGE_DETECT=y
CONFIG_USB_NET_SMSC75XX=y
CONFIG_USB_NET_SMSC95XX=y

#MUIC
#CONFIG_MFD_MAX77693=y
#CONFIG_USB_SWITCH_MAX77693=y
#CONFIG_REGULATOR_MAX77693=y
#CONFIG_DI_MUIC=n
#CONFIG_MUIC_INIT_DETECT_DELAY=3000
#CONFIG_MUIC_USB_DETECT_DELAY=17000
#CONFIG_USB_SWITCH_TSU6721=y
CONFIG_SM5502_MUIC=y
CONFIG_MUIC_SM5502_SUPPORT_LANHUB_TA=y

# IRDA support
CONFIG_IR_REMOCON_MC96FR116=y

#Battery charging & BMS
CONFIG_BATTERY_SAMSUNG=y
CONFIG_CHARGER_SMB358=y
CONFIG_FUELGAUGE_MAX17050=y
CONFIG_FUELGAUGE_MAX17050_COULOMB_COUNTING=y
CONFIG_SAMSUNG_LPM_MODE=y
#CONFIG_CHARGING_VZWCONCEPT=y
#BT
no need

#Sec Thermistor
CONFIG_SEC_THERMISTOR=y

#Wifi
#
# Enable Qualcomm Wifi features
#
CONFIG_MSM_PIL_PRONTO=y
CONFIG_WCNSS_CORE=y
CONFIG_WCNSS_CORE_PRONTO=y
CONFIG_WCNSS_MEM_PRE_ALLOC=y

#
# Wifi features (Qualcomm)
#
CONFIG_NET_CORE=y
CONFIG_WIRELESS=y
CONFIG_WIRELESS_EXT_SYSFS=y
CONFIG_WEXT_CORE=y
CONFIG_WEXT_PROC=y
CONFIG_CFG80211=y
CONFIG_CFG80211_DEFAULT_PS=y
# CONFIG_CFG80211_ALLOW_RECONNECT is not set
CONFIG_WLAN=y
CONFIG_WIRELESS_EXT=y
CONFIG_WEXT_PRIV=y

CONFIG_MODULES=y
CONFIG_MODULE_UNLOAD=y
CONFIG_MODULE_FORCE_UNLOAD=y
CONFIG_WCNSS_REGISTER_DUMP_ON_BITE =y

# Earjack
CONFIG_SAMSUNG_JACK=y

# CODEC
# CONFIG_SND_SOC_MAX98504 is not set

#InsideSecure VPN
CONFIG_INSIDESECURE_VPNCLIENT=y

# GPIO DVS
CONFIG_SEC_GPIO_DVS=y
# DHA Solution
#CONFIG_SEC_DHA_SOL_MAL is not set

# SSWAP
CONFIG_SWAP=y
CONFIG_FRONTSWAP=y
CONFIG_ZSMALLOC_NEW=y
CONFIG_PGTABLE_MAPPING=y
CONFIG_ZSWAP=y
CONFIG_DIRECT_RECLAIM_FILE_PAGES_ONLY=n
CONFIG_INCREASE_MAXIMUM_SWAPPINESS=y
CONFIG_FIX_INACTIVE_RATIO=y
CONFIG_TIGHT_PGDAT_BALANCE=y
CONFIG_VNSWAP=y
CONFIG_SWAP_ENABLE_READAHEAD=n
```

## arch/arm/configs/msm8926-sec_fresconeoltectc_defconfig
```kconfig
#variant defconfig
CONFIG_MACH_FRESCONEOLTE_CTC=y
CONFIG_SEC_FRESCONEO_PROJECT=y
#Power Management
CONFIG_SEC_PM=n
CONFIG_SAMSUNG_DEBUG_DISPLAY=y
CONFIG_MSM_EVENT_TIMER=y
#CONFIG_ESD_ERR_FG_RECOVERY=y
CONFIG_FB_MSM_MDSS_WRITEBACK=y
CONFIG_BACKLIGHT_LCD_SUPPORT=y
# CONFIG_BACKLIGHT_GENERIC is not set

#MDSS and LCD
CONFIG_FB_MSM_MDSS_MAGNA_OCTA_VIDEO_720P_PT_PANEL=y
CONFIG_FB_MSM_MDSS_MAGNA_LDI_EA8061=y
CONFIG_FB_MSM_MDSS_MSM8X26=y
CONFIG_FB_MSM_MDSS=y
CONFIG_LCD_CLASS_DEVICE=y
#CONFIG_MDNIE_TFT_MSM8X26=y
CONFIG_BACKLIGHT_CLASS_DEVICE=y
CONFIG_FB_MSM8x26_MDSS_CHECK_LCD_CONNECTION=y

#VIBRATOR
#CONFIG_QPNP_VIBRATOR is not set
CONFIG_MSM_VIBRATOR=y

#TSP
#CONFIG_TOUCHSCREEN_MMS252 is not set
#CONFIG_TOUCHSCREEN_BCMTCH15XXX is not set
#CONFIG_KEYBOARD_CYPRESS_TOUCH is not set
#CONFIG_TOUCHSCREEN_MMS152 is not set
#CONFIG_TOUCHSCREEN_BCMTCH15XXX is not set
#CONFIG_TOUCHSCREEN_ZINITIX_BT531 is not set
CONFIG_TOUCHSCREEN_FTS=y
CONFIG_GLOVE_TOUCH=y
#CONFIG_INPUT_BOOSTER=y

#TKEY
CONFIG_KEYBOARD_CYPRESS_TKEY_HL=y

#E-PEN
CONFIG_INPUT_WACOM_HL=y
CONFIG_EPEN_WACOM_G9PM=y

#SENSOR
CONFIG_SENSORS=y
# CONFIG_SENSORS_K3DH is not set
# CONFIG_SENSORS_K2HH is not set
# CONFIG_SENSOR_K3DH_INPUTDEV is not set
# CONFIG_SENSORS_SX9500 is not set
# CONFIG_SENSORS_SX9500_INIT_TOUCH_THRESHOLD=3000
# CONFIG_SENSORS_SX9500_NORMAL_TOUCH_THRESHOLD=15
# CONFIG_SENSORS_TMD3782S is not set

CONFIG_SENSORS_TMD27723=y
CONFIG_SENSORS_AK09911C=y
CONFIG_INPUT_MPU6500=y
CONFIG_INPUT_MPU6500_SELFTEST=y
CONFIG_INPUT_MPU6500_POLLING=y

CONFIG_INPUT_POLLDEV=y
CONFIG_INPUT=y
CONFIG_INPUT_GPIO=y
CONFIG_SENSORS_HALL=y

#CAMERA
CONFIG_MSM_CPP=y
#CONFIG_S5K3H5XA=y
#CONFIG_S5K4H5YB=y
#CONFIG_S5K6A3YX=y
#CONFIG_ISX012=y
#CONFIG_SR352=y
#CONFIG_SR130PC20=y

#USB
CONFIG_USB_ANDROID_SAMSUNG_COMPOSITE=y
CONFIG_USB_ANDROID_SAMSUNG_MTP=y
CONFIG_USB_DUN_SUPPORT=y
CONFIG_USB_ANDROID_SAMSUNG_SIDESYNC=y

#USB Host
CONFIG_USB_HOST_NOTIFY=y
CONFIG_USB_STORAGE_DETECT=y
CONFIG_USB_NET_SMSC75XX=y
CONFIG_USB_NET_SMSC95XX=y

#MUIC
#CONFIG_MFD_MAX77693=y
#CONFIG_USB_SWITCH_MAX77693=y
#CONFIG_REGULATOR_MAX77693=y
#CONFIG_DI_MUIC=n
#CONFIG_MUIC_INIT_DETECT_DELAY=3000
#CONFIG_MUIC_USB_DETECT_DELAY=17000
#CONFIG_USB_SWITCH_TSU6721=y
CONFIG_SM5502_MUIC=y 


# IRDA support
#CONFIG_IR_REMOCON_MC96=y

#Battery charging & BMS
CONFIG_BATTERY_SAMSUNG=y
CONFIG_CHARGER_SMB358=y
CONFIG_BATTERY_BCL=y
CONFIG_QPNP_BMS=y
CONFIG_SAMSUNG_LPM_MODE=y

#BT
no need

#Sec Thermistor
CONFIG_SEC_THERMISTOR=y

#Wifi
no need
#
# Enable Qualcomm Wifi features
#
CONFIG_MSM_PIL_PRONTO=y
CONFIG_WCNSS_CORE=y
CONFIG_WCNSS_CORE_PRONTO=y
CONFIG_WCNSS_MEM_PRE_ALLOC=y

#
# Wifi features (Qualcomm)
#
CONFIG_NET_CORE=y
CONFIG_WIRELESS=y
CONFIG_WIRELESS_EXT_SYSFS=y
CONFIG_WEXT_CORE=y
CONFIG_WEXT_PROC=y
CONFIG_CFG80211=y
CONFIG_CFG80211_DEFAULT_PS=y
CONFIG_CFG80211_ALLOW_RECONNECT=y
CONFIG_WLAN=y
CONFIG_WIRELESS_EXT=y
CONFIG_WEXT_PRIV=y

CONFIG_MODULES=y
CONFIG_MODULE_UNLOAD=y
CONFIG_MODULE_FORCE_UNLOAD=y

# Earjack
CONFIG_SAMSUNG_JACK=y

# GPIO DVS
#CONFIG_SEC_GPIO_DVS is not set
# DHA Solution
#CONFIG_SEC_DHA_SOL_MAL is not set

#NFC
CONFIG_BCM2079X_NFC_I2C=y
CONFIG_NFC_PN544=n
CONFIG_SEC_NFC_I2C=n
```

## arch/arm/configs/msm8926-sec_gnotelteds_defconfig
```kconfig
#variant defconfig
CONFIG_MACH_GNOTELTEDS_OPEN=y
CONFIG_SEC_GNOTELTEDS_COMMON=y
CONFIG_SEC_GNOTE_PROJECT=y

#Power Management
CONFIG_SEC_PM=y
CONFIG_SEC_PM_DEBUG=y

#LCD
CONFIG_FB_MSM_MIPI_S6E88A0_QHD_VIDEO_PT_PANEL=y
#CONFIG_ESD_ERR_FG_RECOVERY is not set
CONFIG_FB_MSM_MDSS=y
CONFIG_FB_MSM_MDSS_MSM8X26=y
CONFIG_FB_MSM_MDSS_WRITEBACK=y
CONFIG_BACKLIGHT_LCD_SUPPORT=y
#CONFIG_MDNIE_LITE_TUNING is not set
CONFIG_LCD_CLASS_DEVICE=y
CONFIG_BACKLIGHT_CLASS_DEVICE=y
#CONFIG_BACKLIGHT_GENERIC is not set

#VIBRATOR
#CONFIG_QPNP_VIBRATOR is not set
CONFIG_MSM_VIBRATOR=y
#CONFIG_VIBETONZ is not set
#CONFIG_MOTOR_DRV_DRV2603 is not set

#TSP
#CONFIG_TOUCHSCREEN_MMS252 is not set
#CONFIG_TOUCHSCREEN_BCMTCH15XXX is not set
#CONFIG_KEYBOARD_CYPRESS_TOUCH is not set
#CONFIG_KEYBOARD_CYPRESS_TOUCHKEY_C is not set
#CONFIG_TOUCHSCREEN_CYTTSP5 is not set
#CONFIG_TOUCHSCREEN_CYTTSP5_DEVICETREE_SUPPORT  is not set
CONFIG_TOUCHSCREEN_SYNAPTICS_I2C_RMI=y

#KEYS
CONFIG_KEYBOARD_GPIO=y
CONFIG_KEYBOARD_ABOV_TOUCH=y

#SENSOR
CONFIG_SENSORS=y
CONFIG_SENSORS_BMA255=y
CONFIG_SENSORS_HSCDTD008A=y
CONFIG_INPUT_POLLDEV=y
CONFIG_SENSORS_TMD27723=y

CONFIG_INPUT_POLLDEV=y
CONFIG_INPUT=y
CONFIG_INPUT_GPIO=y
CONFIG_SENSORS_HALL=y

#CAMERA
#CONFIG_MSM_CPP  is not set
#CONFIG_S5K4H5YB is not set
#CONFIG_S5K6A3YX is not set

#USB
CONFIG_USB_ANDROID_SAMSUNG_COMPOSITE=y
CONFIG_USB_ANDROID_SAMSUNG_MTP=y
CONFIG_USB_DUN_SUPPORT=y
CONFIG_USB_HOST_NOTIFY=y
CONFIG_USB_STORAGE_DETECT=y
CONFIG_USB_ANDROID_SAMSUNG_SIDESYNC=y

#MUIC
#CONFIG_MFD_MAX77693=y
#CONFIG_USB_SWITCH_MAX77693=y
#CONFIG_REGULATOR_MAX77693=y
#CONFIG_DI_MUIC=n
#CONFIG_MUIC_INIT_DETECT_DELAY=3000
#CONFIG_MUIC_USB_DETECT_DELAY=17000
CONFIG_USB_SWITCH_TSU6721=y

# IRDA support
# CONFIG_IR_REMOCON_MC96 is not set

#Battery charging & BMS
CONFIG_QPNP_SEC_CHARGER=y
CONFIG_BATTERY_BCL=y
CONFIG_QPNP_BMS=y

#BT
no need

#Sec Thermistor
CONFIG_SEC_THERMISTOR=y

#Wifi
no need

# Earjack
CONFIG_SAMSUNG_JACK=y

# CODEC
#CONFIG_SND_SOC_MAX98504 is not set

# GPIO DVS
#CONFIG_SEC_GPIO_DVS is not set
# DHA Solution
#CONFIG_SEC_DHA_SOL_MAL is not set

# NFC
#CONFIG_NFC_DEVICES is not set
#CONFIG_SEC_NFC is not set
#CONFIG_SEC_NFC_IF_I2C is not set
#CONFIG_SEC_NFC_PRODUCT_N5 is not set
#CONFIG_SEC_NFC_CLK_REQ is not set
#CONFIG_SEC_NFC_USE_8226_RFCLK2 is not set
```

## arch/arm/configs/msm8926-sec_matisselte_defconfig
```kconfig
#variant defconfig
CONFIG_MACH_MATISSELTE_OPEN=y
CONFIG_SEC_MATISSE_PROJECT=y
CONFIG_SEC_MATISSELTE_COMMON=y
CONFIG_RESTART_REASON_SEC_PARAM=y

#Power Management
CONFIG_SEC_PM=y
CONFIG_SEC_PM_DEBUG=y
CONFIG_SAMSUNG_DEBUG_DISPLAY=y
CONFIG_FB_MSM_MDSS_TC_DSI2LVDS_WXGA_PANEL=y
CONFIG_FB_MSM8x26_MDSS_CHECK_LCD_CONNECTION=y
#CONFIG_ESD_ERR_FG_RECOVERY=y
CONFIG_FB_MSM_MDSS=y
CONFIG_FB_MSM_MDSS_WRITEBACK=y
CONFIG_BACKLIGHT_LCD_SUPPORT=y
CONFIG_MDNIE_TFT_MSM8X26=y
CONFIG_LCD_CLASS_DEVICE=y
CONFIG_BACKLIGHT_CLASS_DEVICE=y
# CONFIG_BACKLIGHT_GENERIC is not set
#CONFIG_TC358764_I2C_CONTROL=y

#VIBRATOR
#CONFIG_QPNP_VIBRATOR is not set
#CONFIG_MSM_VIBRATOR=y
CONFIG_HAPTIC_ISA1200=y
CONFIG_VIBRATOR_UPDATE=y

#TKEY LEDS
CONFIG_LEDS_GPIO=y

#TSP
CONFIG_TOUCHSCREEN_ATMEL_MXT1188S=y
#CONFIG_TOUCHSCREEN_MMS252=y
#CONFIG_TOUCHSCREEN_BCMTCH15XXX is not set
#CONFIG_KEYBOARD_CYPRESS_TOUCH is not set

#SENSOR
CONFIG_SENSORS=y
CONFIG_SENSORS_K2HH=y
CONFIG_SENSORS_SX9500=y
CONFIG_SENSORS_SX9500_INIT_TOUCH_THRESHOLD=3000
CONFIG_SENSORS_SX9500_NORMAL_TOUCH_THRESHOLD=15


CONFIG_INPUT=y
CONFIG_INPUT_GPIO=y
CONFIG_SENSORS_HALL=y

# TIMA LOG
CONFIG_ARCH_MSM8926_LTE=y

#CAMERA
CONFIG_MSM_CPP=y
#CONFIG_S5K3H5XA=y
#CONFIG_S5K4H5YB=y
#CONFIG_S5K6A3YX=y
#CONFIG_ISX012=y
CONFIG_SR352=y
CONFIG_SR130PC20=y

#USB
CONFIG_USB_ANDROID_SAMSUNG_COMPOSITE=y
CONFIG_USB_ANDROID_SAMSUNG_MTP=y
CONFIG_USB_DUN_SUPPORT=y
CONFIG_USB_ANDROID_SAMSUNG_SIDESYNC=y

#USB Host
CONFIG_USB_HOST_NOTIFY=y
CONFIG_USB_STORAGE_DETECT=y
CONFIG_USB_NET_SMSC75XX=y
CONFIG_USB_NET_SMSC95XX=y

#MUIC
#CONFIG_MFD_MAX77693=y
#CONFIG_USB_SWITCH_MAX77693=y
#CONFIG_REGULATOR_MAX77693=y
#CONFIG_DI_MUIC=n
#CONFIG_MUIC_INIT_DETECT_DELAY=3000
#CONFIG_MUIC_USB_DETECT_DELAY=17000
#CONFIG_USB_SWITCH_TSU6721=y
CONFIG_SM5502_MUIC=y
CONFIG_MUIC_SM5502_SUPPORT_LANHUB_TA=y

# IRDA support
#CONFIG_IR_REMOCON_MC96=y

#Battery charging & BMS
CONFIG_BATTERY_SAMSUNG=y
CONFIG_CHARGER_SMB358=y
CONFIG_BATTERY_BCL=y
CONFIG_QPNP_BMS=y
CONFIG_SAMSUNG_LPM_MODE=y
#BT
no need

#Sec Thermistor
CONFIG_SEC_THERMISTOR=y

#Wifi
#
# Enable Qualcomm Wifi features
#
CONFIG_MSM_PIL_PRONTO=y
CONFIG_WCNSS_CORE=y
CONFIG_WCNSS_CORE_PRONTO=y
CONFIG_WCNSS_MEM_PRE_ALLOC=y

#
# Wifi features (Qualcomm)
#
CONFIG_NET_CORE=y
CONFIG_WIRELESS=y
CONFIG_WIRELESS_EXT_SYSFS=y
CONFIG_WEXT_CORE=y
CONFIG_WEXT_PROC=y
CONFIG_CFG80211=y
CONFIG_CFG80211_DEFAULT_PS=y
# CONFIG_CFG80211_ALLOW_RECONNECT is not set
CONFIG_WLAN=y
CONFIG_WIRELESS_EXT=y
CONFIG_WEXT_PRIV=y

CONFIG_MODULES=y
CONFIG_MODULE_UNLOAD=y
CONFIG_MODULE_FORCE_UNLOAD=y
CONFIG_WCNSS_REGISTER_DUMP_ON_BITE=y
CONFIG_WCNSS_IRIS_REGISTER_DUMP=y
CONFIG_PARAM_SIZE_983000=y


# Earjack
CONFIG_SAMSUNG_JACK=y

# SSWAP
CONFIG_SWAP=y
CONFIG_FRONTSWAP=y
CONFIG_ZSMALLOC_NEW=y
CONFIG_PGTABLE_MAPPING=y
CONFIG_ZSWAP=y
CONFIG_DIRECT_RECLAIM_FILE_PAGES_ONLY=y
CONFIG_INCREASE_MAXIMUM_SWAPPINESS=y
CONFIG_FIX_INACTIVE_RATIO=y
CONFIG_TIGHT_PGDAT_BALANCE=y
CONFIG_VNSWAP=y
CONFIG_SWAP_ENABLE_READAHEAD=n
```

## arch/arm/configs/msm8926-sec_ms01lte_lgt_defconfig
```kconfig
CONFIG_SWAP=y
CONFIG_ZRAM=y
CONFIG_ZRAM_DEBUG=y
CONFIG_ZRAM_FOR_ANDROID=y

#variant defconfig
CONFIG_MACH_MS01_LTE_LGT=y
CONFIG_MACH_MS01_LTE_KOR=y
CONFIG_USBIRQ_BALANCING_LTE_HIGHTP=y

#SEC OOM KILLER
CONFIG_SEC_OOM_KILLER=y

#Debug
# CONFIG_ANDROID_RAM_CONSOLE is not set
CONFIG_SEC_LOG_LAST_KMSG=y
CONFIG_SEC_DEBUG_NOCACHE_LOG_IN_LEVEL_LOW=y

#B10
CONFIG_USER_RESET_DEBUG=y

#Battery
CONFIG_QPNP_SEC_CHARGER=y
CONFIG_QPNP_BMS=y
CONFIG_BATTERY_BCL=y

#Do not use external OVP
CONFIG_NOT_USE_EXT_OVP=y

#LCD
CONFIG_FB_MSM_MDSS_SHARP_HD_PANEL=y
#CONFIG_ESD_ERR_FG_RECOVERY is not set
CONFIG_FB_MSM_MDSS=y
CONFIG_FB_MSM_MDSS_WRITEBACK=y
CONFIG_BACKLIGHT_LCD_SUPPORT=y
CONFIG_MDNIE_LITE_TUNING=y
CONFIG_LCD_CLASS_DEVICE=y
CONFIG_BACKLIGHT_CLASS_DEVICE=y
CONFIG_LCD_CONNECTION_CHECK=y
#CONFIG_BACKLIGHT_GENERIC is not set

#TOUCH
CONFIG_TOUCHSCREEN_MMS152=y
CONFIG_TOUCHSCREEN_BCMTCH15XXX=y
CONFIG_KEYBOARD_CYPRESS_TOUCH=y
CONFIG_TOUCHSCREEN_ZINITIX_BT531=y

#Vibrator
CONFIG_MSM_VIBRATOR=y
CONFIG_QPNP_VIBRATOR=y

#HallSensor
CONFIG_SENSORS_HALL=y

#USB
CONFIG_USB_ANDROID_SAMSUNG_COMPOSITE=y
CONFIG_USB_ANDROID_SAMSUNG_MTP=y
CONFIG_USB_HOST_NOTIFY=y
CONFIG_USB_DUN_SUPPORT=y


#MUIC
CONFIG_USB_SWITCH_TSU6721=y

#SENSORS
CONFIG_SENSORS_CORE=y
CONFIG_SENSORS_HSCDTD008A=y
CONFIG_BMA250_ACC_DRIVER=y
CONFIG_INPUT=y
CONFIG_INPUT_GPIO=y
CONFIG_INPUT_POLLDEV=y

#NFC
CONFIG_SEC_NFC_I2C=y

#CAMERA
CONFIG_S5K3H5XA=y
CONFIG_S5K4H5YA=y
CONFIG_S5K4H5YB=y
CONFIG_S5K6A3YX=y

#WIFI
#no need

#BT
#no need

# Earjack
CONFIG_SAMSUNG_JACK=y

# DMB
CONFIG_TDMB=y
CONFIG_TDMB_VENDOR_FCI=y
CONFIG_TDMB_FC8080=y
CONFIG_TDMB_SPI=y

# LGU I-WLAN
CONFIG_LGUIWLAN=y

# Ringback tone gain devide
CONFIG_SEC_DEVIDE_RINGTONE_GAIN=y

# WiFi 11ac TP
# CONFIG_SLUB_DEBUG is not set
# CONFIG_ZRAM_DEBUG is not set
# CONFIG_DEBUG_PREEMPT is not set
```
