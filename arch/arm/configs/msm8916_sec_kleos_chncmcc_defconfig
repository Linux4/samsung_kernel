## arch/arm/configs/msm8916_sec_rossa_vzw_defconfig
```kconfig
CONFIG_SEC_ROSSA_PROJECT=y
CONFIG_MACH_ROSSA_VZW=y

# SS Pinctrl Driver
CONFIG_SEC_GPIO_SETTINGS=y

#SENSOR
CONFIG_SENSORS_CORE=y
CONFIG_SENSORS_K2HH=y
CONFIG_SENSORS_K2HH_VDD=y
CONFIG_SENSORS_GP2A002=y
CONFIG_SENSORS_GP2A_VDD=y

#Wifi
#
# Enable Qualcomm Wifi features
#
#CONFIG_MSM_PIL_PRONTO=y
#CONFIG_WCNSS_CORE=y
#CONFIG_WCNSS_CORE_PRONTO=y
#CONFIG_WCNSS_MEM_PRE_ALLOC=y
#
# Wifi features (Qualcomm)
#
#CONFIG_NET_CORE=y
#CONFIG_WIRELESS=y
#CONFIG_WIRELESS_EXT_SYSFS=y
#CONFIG_WEXT_CORE=y
#CONFIG_WEXT_PROC=y
#CONFIG_CFG80211=y
#CONFIG_CFG80211_DEFAULT_PS=y
#CONFIG_WLAN_REGION_CODE=300
#CONFIG_TARGET_LOCALE_CHN=y
#CONFIG_CFG80211_ALLOW_RECONNECT is not set
#CONFIG_WLAN=y
#CONFIG_WIRELESS_EXT=y
#CONFIG_WEXT_PRIV=y
#CONFIG_MODULES=y
#CONFIG_MODULE_UNLOAD=y
#CONFIG_MODULE_FORCE_UNLOAD=y
#CONFIG_WCNSS_REGISTER_DUMP_ON_BITE =y

# MUIC
CONFIG_SM5502_MUIC=y
#CONFIG_MUIC_SUPPORT_RUSTPROOF=y
# CONFIG_MUIC_SM5502_SUPPORT_LANHUB_TA is not set
CONFIG_USBID_STANDARD_VER_01=y

# VIBRATOR
CONFIG_MSM_VIBRATOR=y

#Touch Screen
CONFIG_TOUCHSCREEN_IST30XX_CORE3=y

#AUDIO
#CONFIG_RADIO_IRIS=y
#CONFIG_RADIO_IRIS_TRANSPORT=m

#LCD
CONFIG_PANEL_HX8369B_BV045WVM_WVGA=y

CONFIG_MFD_RT5033=y
CONFIG_BATTERY_SAMSUNG=y
CONFIG_BATTERY_SAMSUNG_DATA_FILE="rossa_battery_data.h"
CONFIG_SAMSUNG_LPM_MODE=y
CONFIG_CHARGER_RT5033=y
CONFIG_FUELGAUGE_RT5033=y
CONFIG_REGULATOR_RT5033=y

# Pre-power on alarm
#CONFIG_RTC_AUTO_PWRON=y
#CONFIG_RTC_AUTO_PWRON_PARAM=y
#CAMERA
#CONFIG_MSM_EEPROM=n
#CONFIG_MSM_OTP=y

#optimize mmc block delay on resume
CONFIG_MMC_BLOCK_DEFERRED_RESUME=y

#front cam
#CONFIG_SR200PC20=y

#FLASH
#CONFIG_FLASHLIGHT=y
#CONFIG_RT_FLASH_LED=y
#CONFIG_FLED_RT5033=y
#CONFIG_FLED_RT5033_EXT_GPIO=y

# RTCC v3
#CONFIG_SWAP=y
#CONFIG_ZSMALLOC=y
#CONFIG_ZRAM=y
#CONFIG_RUNTIME_COMPCACHE=y
#CONFIG_KSWAPD_NOSWAP=y
CONFIG_KSM=y
CONFIG_ADAPTIVE_KSM=y
CONFIG_KSM_MEMCMP=y

#LEDS
CONFIG_LEDS_KTD2026=y

# MODEM SECURE CHECK
#CONFIG_SEC_PERIPHERAL_SECURE_CHK=y

CONFIG_VPNCLIENT_SECURITY=y

CONFIG_RESTART_REASON_SEC_PARAM=n
```

## arch/arm/configs/msm8916_sec_signumlte_eur_defconfig
```kconfig
CONFIG_SEC_SIGNUM_PROJECT=y
CONFIG_MACH_SIGNUMLTE_EUR_OPEN=y

# HARD RESET
CONFIG_RESTART_REASON_SEC_PARAM=y

# MUIC
CONFIG_SM5502_MUIC=y
CONFIG_USBID_STANDARD_VER_01=y

#USB HOST
CONFIG_USB_HOST_NOTIFY=y

#AUDIO
# CONFIG_AUDIO_SPEAKER_OUT_MAXIM_AMP_ENABLE is not set
# CONFIG_AUDIO_SPEAKER_OUT_NXP_AMP_ENABLE is not set
# CONFIG_SAMSUNG_JACK is not set
# CONFIG_SND_SOC_MSM8X16 is not set
CONFIG_AUDIO_QUAT_I2S_ENABLE=y

# wm1814
CONFIG_SND_SOC_MSM8X16_WM1814=y

# BOOSTER
# CONFIG_COMMON_INPUT_BOOSTER is not set
CONFIG_CPU_FREQ_LIMIT_USERSPACE=y
CONFIG_CPU_FREQ_LIMIT=y

# TSP
# CONFIG_TOUCHSCREEN_MMS300 is not set
# CONFIG_KEYBOARD_TC360_TKEY is not set
# CONFIG_TOUCHSCREEN_SYNAPTICS_S7301 is not set
# CONFIG_TOUCHSCREEN_SYNAPTICS_S7301_KEYS is not set
# CONFIG_TOUCHSCREEN_SYNAPTICS_S7301_WORKAROUND is not set
# CONFIG_TOUCHSCREEN_SYNAPTICS_S7301_KEYLED is not set
# CONFIG_SEC_TOUCHSCREEN_SURFACE_TOUCH is not set
# CONFIG_TOUCHSCREEN_ATMEL_MXT1664T is not set
# CONFIG_NO_ERROR_ON_MISMATCH is not set
# CONFIG_DEBUG_SECTION_MISMATCH is not set
# CONFIG_TOUCHSCREEN_MELFAS_MMS449 is not set
# CONFIG_TOUCHSCREEN_SYNAPTICS_I2C_RMI_G is not set
# CONFIG_TOUCHSCREEN_CYTTSP5 is not set
# CONFIG_TOUCHSCREEN_CYTTSP5_DEVICETREE_SUPPORT is not set
# CONFIG_TOUCHSCREEN_SYNAPTICS_DSX_v21 is not set
# CONFIG_TOUCHSCREEN_SYNAPTICS_DSX_CORE_v21 is not set
# CONFIG_TOUCHSCREEN_SYNAPTICS_DSX_RMI_DEV_v21 is not set
# CONFIG_TOUCHSCREEN_SYNAPTICS_DSX_FW_UPDATE_v21 is not set
# CONFIG_TOUCHSCREEN_ATMEL_MXT is not set
# CONFIG_TOUCHSCREEN_FT5X06 is not set
# CONFIG_TOUCHSCREEN_MSTAR21XX is not set
# CONFIG_TOUCHSCREEN_GEN_VKEYS is not set
# CONFIG_TOUCHSCREEN_SYNAPTICS_I2C_RMI4 is not set
# CONFIG_TOUCHSCREEN_SYNAPTICS_DSX_RMI4_DEV is not set
# CONFIG_TOUCHSCREEN_SYNAPTICS_DSX_FW_UPDATE is not set
# CONFIG_SECURE_TOUCH is not set
# CONFIG_TOUCHSCREEN_BU21150 is not set
# CONFIG_INPUT_MT_WRAPPER is not set

#LCD
CONFIG_PANEL_VX5B3D_LTI550HN06_FHD=y
CONFIG_PANEL_VX5B3D_LTM215HT05_FHD=y
CONFIG_PANEL_VX5B3D_LTM184HL01_FHD=y

#SENSOR
CONFIG_SENSORS=y
CONFIG_SENSORS_CORE=y
CONFIG_SENSORS_K2HH=y
CONFIG_SENSORS_K2HH_VDD=y
CONFIG_SENSORS_CM3323=y
CONFIG_SENSORS_TCS3490=y
CONFIG_SENSORS_SX9500=y
CONFIG_SENSORS_SX9500_NORMAL_TOUCH_THRESHOLD=17
CONFIG_SENSORS_SX9500_INIT_TOUCH_THRESHOLD=8000
CONFIG_SENSORS_SX9500_REGULATOR_ONOFF=y
CONFIG_SENSORS_SX9500_WIFI=y
CONFIG_SENSORS_SX9500_WIFI_NORMAL_TOUCH_THRESHOLD=11
CONFIG_SENSORS_SX9500_WIFI_INIT_TOUCH_THRESHOLD=8000
CONFIG_SENSORS_SX9500_WIFI_REGULATOR_ONOFF=y

#CAMERA
CONFIG_SR544=y
CONFIG_SR200PC20=y
CONFIG_MSM_EEPROM=n
CONFIG_MSM_OTP=y
CONFIG_SENSOR_8_BPP=y

# TIMA LOG
CONFIG_ARCH_MSM8939_TIMA=y
```

## arch/arm/configs/msm8916_sec_vasta3g_eur_defconfig
```kconfig
CONFIG_SEC_VASTA3G_PROJECT=y
CONFIG_MACH_VASTA3G_EUR=y

CONFIG_DEBUG_SPINLOCK=y

CONFIG_SEC_GPIO_SETTINGS=y
# MUIC
CONFIG_SM5502_MUIC=y
# CONFIG_MUIC_SM5502_SUPPORT_LANHUB_TA is not set

#HALL IC
CONFIG_SENSORS_HALL=y

#LCD
CONFIG_FB_MSM_MDSS_PANEL_COMMON=y
CONFIG_BL_ISL98611=y
CONFIG_FB_MSM_MIPI_HX8394C_PANEL=y
CONFIG_EXTERNAL_POWER_GPIO=y

#Touch Screen
CONFIG_TOUCHSCREEN_ZINITIX_BT532=y

#SVC LEDS
CONFIG_LEDS_KTD2026=y
CONFIG_LEDS_GPIO=y

CONFIG_MFD_RT5033=y
CONFIG_BATTERY_SAMSUNG=y
CONFIG_BATTERY_SAMSUNG_DATA_FILE="vasta3g_battery_data.h"
CONFIG_SAMSUNG_LPM_MODE=y
CONFIG_CHARGER_RT5033=y
CONFIG_FUELGAUGE_RT5033=y
CONFIG_REGULATOR_RT5033=y

#SENSORS
CONFIG_SENSORS=y
CONFIG_SENSORS_CORE=y
CONFIG_SENSOR_USE_SYMLINK=y
CONFIG_INPUT_MPU6515=y
CONFIG_INPUT_MPU6500_SELFTEST=y
CONFIG_INPUT_MPU6500_POLLING=y
CONFIG_SENSORS_HSCDTD008A=y
CONFIG_INPUT_POLLDEV=y
CONFIG_SENSORS_CM36686=y
CONFIG_SENSORS_CM36686_LEDA_EN_GPIO=y
# CONFIG_SENSORS_ADSP is not set
# CONFIG_SENSORS_BMA255 is not set
# CONFIG_SENSORS_GP2A030A is not set
# CONFIG_SENSORS_GP2A030A_PROX is not set

CONFIG_SYSFS=y
CONFIG_INPUT=y
CONFIG_INPUT_GPIO=y

CONFIG_NFC_PN547=y
CONFIG_NFC_PN547_8916_USE_BBCLK2=y

#Wifi
#
# Enable Qualcomm Wifi features
#
CONFIG_MSM_PIL_PRONTO=y
CONFIG_WCNSS_CORE=y
CONFIG_WCNSS_CORE_PRONTO=y
CONFIG_WCNSS_MEM_PRE_ALLOC=y

#
# Wifi features (Qualcomm)
#
CONFIG_NET_CORE=y
CONFIG_WIRELESS=y
CONFIG_WIRELESS_EXT_SYSFS=y
CONFIG_WEXT_CORE=y
CONFIG_WEXT_PROC=y
CONFIG_CFG80211=y
CONFIG_CFG80211_DEFAULT_PS=y
#CONFIG_CFG80211_ALLOW_RECONNECT is not set
CONFIG_WLAN=y
CONFIG_WIRELESS_EXT=y
CONFIG_WEXT_PRIV=y

CONFIG_MODULES=y
CONFIG_MODULE_UNLOAD=y
CONFIG_MODULE_FORCE_UNLOAD=y
CONFIG_WCNSS_REGISTER_DUMP_ON_BITE =y

#AUDIO
CONFIG_RADIO_IRIS=y
CONFIG_RADIO_IRIS_TRANSPORT=m

#FLASH
CONFIG_FLASHLIGHT=y
CONFIG_RT_FLASH_LED=y
CONFIG_FLED_RT5033=y
CONFIG_FLED_RT5033_EXT_GPIO=y
#
# ID Chip
#
CONFIG_W1=y
CONFIG_W1_MASTER_GPIO_MSM=y
CONFIG_W1_SLAVE_DS28EL15=y
CONFIG_W1_WORKQUEUE=y
# CONFIG_W1_SN is not set
CONFIG_W1_FAST_CHECK=y

#Power off Alarm
#CONFIG_RTC_AUTO_PWRON is not set
#CONFIG_RTC_AUTO_PWRON_PARAM is not set

#optimize mmc block delay on resume
CONFIG_MMC_BLOCK_DEFERRED_RESUME=y
```

## arch/arm/configs/msm8916_sec_vasta_cmcc_defconfig
```kconfig
CONFIG_SEC_VASTA_PROJECT=y
CONFIG_MACH_VASTA_CMCC=y

CONFIG_DEBUG_SPINLOCK=y

CONFIG_SEC_GPIO_SETTINGS=y
# MUIC
CONFIG_SM5502_MUIC=y
# CONFIG_MUIC_SM5502_SUPPORT_LANHUB_TA is not set
CONFIG_MUIC_SUPPORT_RUSTPROOF=y

#HALL IC
CONFIG_SENSORS_HALL=y

#LCD
CONFIG_FB_MSM_MDSS_PANEL_COMMON=y
CONFIG_BL_ISL98611=y
CONFIG_FB_MSM_MIPI_HX8394C_PANEL=y

#Touch Screen
CONFIG_TOUCHSCREEN_ZINITIX_BT532=y

#SVC LEDS
CONFIG_LEDS_KTD2026=y
CONFIG_LEDS_GPIO=y

CONFIG_MFD_RT5033=y
CONFIG_BATTERY_SAMSUNG=y
CONFIG_BATTERY_SAMSUNG_DATA_FILE="vasta_battery_data.h"
CONFIG_SAMSUNG_LPM_MODE=y
CONFIG_CHARGER_RT5033=y
CONFIG_FUELGAUGE_RT5033=y
CONFIG_REGULATOR_RT5033=y

#SENSORS
CONFIG_SENSORS=y
CONFIG_SENSORS_CORE=y
CONFIG_SENSOR_USE_SYMLINK=y
CONFIG_SYSFS=y
CONFIG_INPUT=y
CONFIG_INPUT_GPIO=y
CONFIG_INPUT_POLLDEV=y
# CONFIG_INPUT_MPU6515 is not set
# CONFIG_INPUT_MPU6500_SELFTEST is not set
# CONFIG_INPUT_MPU6500_POLLING is not set
# CONFIG_SENSORS_HSCDTD008A is not set
CONFIG_SENSORS_CM36686=y
CONFIG_SENSORS_CM36686_LEDA_EN_GPIO=y
CONFIG_SENSORS_K303C=y

CONFIG_NFC_PN547=y
CONFIG_NFC_PN547_8916_USE_BBCLK2=y

#Wifi
#
# Enable Qualcomm Wifi features
#
CONFIG_MSM_PIL_PRONTO=y
CONFIG_WCNSS_CORE=y
CONFIG_WCNSS_CORE_PRONTO=y
CONFIG_WCNSS_MEM_PRE_ALLOC=y

#
# Wifi features (Qualcomm)
#
CONFIG_NET_CORE=y
CONFIG_WIRELESS=y
CONFIG_WIRELESS_EXT_SYSFS=y
CONFIG_WEXT_CORE=y
CONFIG_WEXT_PROC=y
CONFIG_CFG80211=y
CONFIG_CFG80211_DEFAULT_PS=y
#CONFIG_CFG80211_ALLOW_RECONNECT is not set
CONFIG_WLAN=y
CONFIG_WIRELESS_EXT=y
CONFIG_WEXT_PRIV=y

CONFIG_MODULES=y
CONFIG_MODULE_UNLOAD=y
CONFIG_MODULE_FORCE_UNLOAD=y
CONFIG_WCNSS_REGISTER_DUMP_ON_BITE =y

#FLASH
CONFIG_FLASHLIGHT=y
CONFIG_RT_FLASH_LED=y
CONFIG_FLED_RT5033=y
CONFIG_FLED_RT5033_EXT_GPIO=y
#
# ID Chip
#
CONFIG_W1=y
CONFIG_W1_MASTER_GPIO_MSM=y
CONFIG_W1_SLAVE_DS28EL15=y
CONFIG_W1_WORKQUEUE=y
# CONFIG_W1_SN is not set
CONFIG_W1_FAST_CHECK=y

#Power off Alarm
CONFIG_RTC_AUTO_PWRON=y
CONFIG_RTC_AUTO_PWRON_PARAM=y

#optimize mmc block delay on resume
CONFIG_MMC_BLOCK_DEFERRED_RESUME=y

CONFIG_TRACE_MODEM_MEM_FAIL=y
```

## arch/arm/configs/msm8916_sec_xcover3_dcm_defconfig
```kconfig
CONFIG_SEC_XCOVER3_PROJECT=y
CONFIG_MACH_XCOVER3_DCM=y

# HARD RESET
CONFIG_RESTART_REASON_SEC_PARAM=y

# SS Pinctrl Driver
CONFIG_SEC_GPIO_SETTINGS=y

#SENSOR
CONFIG_SENSORS_CORE=y
CONFIG_SENSORS_K2HH=y
#CONFIG_SENSORS_K2HH_VDD is not set
CONFIG_SENSORS_GP2A002=y
CONFIG_SENSORS_GP2A_MODE_B1=y
# CONFIG_SENSORS_GP2A_VDD is not set
CONFIG_SENSORS_AK09911C=y

#Wifi
#
# Enable Qualcomm Wifi features
#
#CONFIG_MSM_PIL_PRONTO=y
#CONFIG_WCNSS_CORE=y
#CONFIG_WCNSS_CORE_PRONTO=y
#CONFIG_WCNSS_MEM_PRE_ALLOC=y
#
# Wifi features (Qualcomm)
#
#CONFIG_NET_CORE=y
#CONFIG_WIRELESS=y
#CONFIG_WIRELESS_EXT_SYSFS=y
#CONFIG_WEXT_CORE=y
#CONFIG_WEXT_PROC=y
#CONFIG_CFG80211=y
#CONFIG_CFG80211_DEFAULT_PS=y
#CONFIG_WLAN_REGION_CODE=300
#CONFIG_TARGET_LOCALE_CHN=y
#CONFIG_CFG80211_ALLOW_RECONNECT is not set
#CONFIG_WLAN=y
#CONFIG_WIRELESS_EXT=y
#CONFIG_WEXT_PRIV=y
#CONFIG_MODULES=y
#CONFIG_MODULE_UNLOAD=y
#CONFIG_MODULE_FORCE_UNLOAD=y
#CONFIG_WCNSS_REGISTER_DUMP_ON_BITE =y

# MUIC
CONFIG_SM5703_MUIC=y
CONFIG_USBID_STANDARD_VER_01=y
CONFIG_MUIC_SUPPORT_CHARGING_CABLE=y
CONFIG_MUIC_SUPPORT_RUSTPROOF=y

# PMIC/MISC
CONFIG_MFD_SM5703=y
CONFIG_REGULATOR_SM5703=y

# VIBRATOR
CONFIG_SM5703_VIBRATOR=y

#Touch Screen
CONFIG_TOUCHSCREEN_CYTTSP5_TMA445A=y
CONFIG_TOUCHSCREEN_MELFAS_MMS438=y

#############################################
# AUDIO&SOUND FEATURE
#############################################
#CONFIG_RADIO_IRIS=y
#CONFIG_RADIO_IRIS_TRANSPORT=m
CONFIG_SAMSUNG_JACK=n
#CONFIG_SW_100K_TO_GND is not set
#############################################

#LCD
CONFIG_PANEL_SC7798A_BV045WVM_WVGA=y

# Charging/Battery
CONFIG_CHARGER_SM5703=y
CONFIG_FUELGAUGE_SM5703=y
CONFIG_BATTERY_SAMSUNG=y
CONFIG_BATTERY_SAMSUNG_DATA_FILE="xcover3_battery_data.h"
CONFIG_SAMSUNG_LPM_MODE=y
CONFIG_BATTERY_SWELLING=y
CONFIG_PREVENT_SOC_JUMP=y
CONFIG_CHARGER_SM5703_DUALPATH=y

#USB Host
CONFIG_USB_HOST_NOTIFY=y

# Pre-power on alarm
#CONFIG_RTC_AUTO_PWRON=y
#CONFIG_RTC_AUTO_PWRON_PARAM=y

#optimize mmc block delay on resume
CONFIG_MMC_BLOCK_DEFERRED_RESUME=y

#CPRM enable
CONFIG_MMC_CPRM=y

#CAMERA
CONFIG_DB8221A=y
CONFIG_S5K4H5YB=y
CONFIG_SENSOR_8_BPP=y
CONFIG_CAMERA_SYSFS_V2=y

CONFIG_MSM_EEPROM=y
#CONFIG_MSM_OTP=y

#FLASH
CONFIG_FLASHLIGHT=y
CONFIG_SM_FLASH_LED=y
CONFIG_FLED_SM5703=y
CONFIG_FLED_SM5703_EXT_GPIO=y

#disable KSM for power consumption problem
#CONFIG_KSM=y
#CONFIG_ADAPTIVE_KSM=y
#CONFIG_KSM_MEMCMP=y



# MODEM SECURE CHECK
#CONFIG_SEC_PERIPHERAL_SECURE_CHK=y
#EPDG
CONFIG_NET_CORE=y
CONFIG_NET_SCH_PRIO=y
CONFIG_NET_SCHED=y   #depends on CONFIG_NET  which is enabled by default.. coz not seeing in the config file
CONFIG_NET_CLS_BASIC=y # required if basic is being used as a filter. depends on CONFIG_NET_CLS so enabling it by default
CONFIG_NET_CLS=y
CONFIG_NET_CLS_ACT=y # for enabling the action target.
CONFIG_NET_ACT_MIRRED=y  # for enabling the mirred target for redirecting the packet between the devices.
CONFIG_NET_EMATCH=y   #basic uses extended matches so this has to be present
CONFIG_NET_SCH_INGRESS=y # classifier for ingress packet

CONFIG_VPNCLIENT_SECURITY=y

# SSWAP
CONFIG_SWAP=y
CONFIG_FRONTSWAP=y
CONFIG_ZSMALLOC=y
CONFIG_PGTABLE_MAPPING=y
CONFIG_ZSWAP=y
CONFIG_ZPOOL=y
CONFIG_DIRECT_RECLAIM_FILE_PAGES_ONLY=y
CONFIG_INCREASE_MAXIMUM_SWAPPINESS=y
CONFIG_FIX_INACTIVE_RATIO=y
CONFIG_TIGHT_PGDAT_BALANCE=y
CONFIG_VNSWAP=y
CONFIG_SWAP_ENABLE_READAHEAD=n

#APC CPR QUOTIENT
CONFIG_APC_CPR_QUOT_BOOST=y

#ISDBT
CONFIG_ISDBT=y
CONFIG_ISDBT_FC8180_SPI=y

#NFC
CONFIG_NFC=y
CONFIG_SEC_NFC_SENN3AB=y

# SDP
CONFIG_SDP=y

# SEC THERMISTOR
CONFIG_SEC_USE_FLASH_THERMISTOR=y
```

## arch/arm/configs/msm8926-sec_afyonltecan_defconfig
```kconfig
#variant defconfig
CONFIG_MACH_AFYONLTE_CAN=y
CONFIG_SEC_AFYON_PROJECT=y
CONFIG_SEC_AFYONLTE_COMMON=y
CONFIG_ARCH_MSM8926_LTE=y

#Power Management
CONFIG_SEC_PM=y
CONFIG_SEC_PM_DEBUG=y

CONFIG_FB_MSM_MDSS_CPT_QHD_PANEL=y
CONFIG_FB_MSM8x26_MDSS_CHECK_LCD_CONNECTION=y
CONFIG_SAMSUNG_DEBUG_DISPLAY=y
#CONFIG_FB_MSM_MDSS_DSI_CTRL_STATUS=y
CONFIG_ESD_ERR_FG_RECOVERY=y
CONFIG_FB_MSM_MDSS=y
CONFIG_FB_MSM_MDSS_WRITEBACK=y
CONFIG_BACKLIGHT_LCD_SUPPORT=y
#CONFIG_MDNIE_TFT_MSM8X26=y

CONFIG_LCD_CLASS_DEVICE=y
CONFIG_BACKLIGHT_CLASS_DEVICE=y
# CONFIG_BACKLIGHT_GENERIC is not set
#CONFIG_TC358764_I2C_CONTROL=y

CONFIG_UID_STAT=y
#VIBRATOR
#CONFIG_QPNP_VIBRATOR is not set
CONFIG_MSM_VIBRATOR=y

#TKEY LEDS
CONFIG_LEDS_GPIO=y

#TSP
#CONFIG_TOUCHSCREEN_ATMEL_MXT1188S=y
#CONFIG_TOUCHSCREEN_MMS252=y
#CONFIG_TOUCHSCREEN_BCMTCH15XXX is not set
#CONFIG_KEYBOARD_CYPRESS_TOUCH is not set
CONFIG_TOUCHSCREEN_CYPRESS_CYTTSP4=y
CONFIG_TOUCHSCREEN_CYPRESS_CYTTSP4_DEVICETREE_SUPPORT=y
#KEYS
CONFIG_KEYBOARD_GPIO=y

#SENSOR
CONFIG_SENSORS=y
CONFIG_SENSORS_BMA255=y
CONFIG_SENSORS_HSCDTD008A=y
CONFIG_INPUT_POLLDEV=y
CONFIG_SENSORS_GP2A002=y
CONFIG_SENSORS_POWERCONTROL=y
CONFIG_SENSORS_GP2A_VDDCONTROL=y
#CONFIG_SENSORS_K3DH=y
#CONFIG_SENSOR_K3DH_INPUTDEV=y
#CONFIG_SENSORS_SX9500=y
#CONFIG_SENSORS_SX9500_INIT_TOUCH_THRESHOLD=3000
#CONFIG_SENSORS_SX9500_NORMAL_TOUCH_THRESHOLD=17

#CONFIG_PROXIMITY_SENSOR=y
#CONFIG_OPTICAL_TAOS_TMD2672X=y
#CONFIG_SENSORS_ASP01=y

CONFIG_INPUT=y
CONFIG_INPUT_GPIO=y
#CONFIG_SENSORS_HALL=y
CONFIG_SEC_NFC_I2C=y

#CAMERA
CONFIG_MSM_CPP=y
CONFIG_S5K4ECGX=y
CONFIG_SR030PC50=y

#USB
CONFIG_USB_ANDROID_SAMSUNG_COMPOSITE=y
CONFIG_USB_ANDROID_SAMSUNG_MTP=y
CONFIG_USB_DUN_SUPPORT=y
CONFIG_USB_HOST_NOTIFY=y
CONFIG_USB_STORAGE_DETECT=y
CONFIG_USB_ANDROID_SAMSUNG_SIDESYNC=y

#MUIC
#CONFIG_MFD_MAX77693=y
#CONFIG_USB_SWITCH_MAX77693=y
#CONFIG_REGULATOR_MAX77693=y
#CONFIG_DI_MUIC=n
#CONFIG_MUIC_INIT_DETECT_DELAY=3000
#CONFIG_MUIC_USB_DETECT_DELAY=17000
CONFIG_USB_SWITCH_TSU6721=y

CONFIG_MUIC_SUPPORT_CAR_DOCK=y
# IRDA support
#CONFIG_IR_REMOCON_MC96=y

#Battery charging & BMS
CONFIG_BATTERY_SAMSUNG=y
CONFIG_CHARGER_SMB358=y
CONFIG_FUELGAUGE_MAX17048=y
CONFIG_FUELGAUGE_MAX17048_COULOMB_COUNTING=y
CONFIG_SAMSUNG_LPM_MODE=y
#CONFIG_PM8926_BATTERY_CHECK_INTERRUPT=y


#BT
no need

#Sec Thermistor
CONFIG_SEC_THERMISTOR=y

#Wifi
#
# Enable Qualcomm Wifi features
#
CONFIG_MSM_PIL_PRONTO=y
CONFIG_WCNSS_CORE=y
CONFIG_WCNSS_CORE_PRONTO=y
CONFIG_WCNSS_MEM_PRE_ALLOC=y

CONFIG_MSM_WCNSS_SSR_8960=y

#
# Wifi features (Qualcomm)
#
CONFIG_NET_CORE=y
CONFIG_WIRELESS=y
CONFIG_WIRELESS_EXT_SYSFS=y
CONFIG_WEXT_CORE=y
CONFIG_WEXT_PROC=y
CONFIG_CFG80211=y
CONFIG_CFG80211_DEFAULT_PS=y
#CONFIG_CFG80211_ALLOW_RECONNECT is not set
CONFIG_WLAN=y
CONFIG_WIRELESS_EXT=y
CONFIG_WEXT_PRIV=y

CONFIG_MODULES=y
CONFIG_MODULE_UNLOAD=y
CONFIG_MODULE_FORCE_UNLOAD=y
CONFIG_WCNSS_REGISTER_DUMP_ON_BITE=y

# Earjack
CONFIG_SAMSUNG_JACK=y

# DHA Solution
CONFIG_SEC_DHA_SOL_MAL=y
CONFIG_CRYPTO_NULL=y
```
