## arch/arm/configs/msm8928-sec_hestialte_att_defconfig
```kconfig
#variant defconfig
CONFIG_MACH_HESTIALTE_ATT=y
CONFIG_SEC_HESTIALTE_COMMON=y
CONFIG_SEC_HESTIA_PROJECT=y
CONFIG_ARCH_MSM8926_LTE=y

CONFIG_FB_MSM_MIPI_SAMSUNG_OCTA_VIDEO_HD_PANEL=y
CONFIG_FB_MSM8x26_MDSS_CHECK_LCD_CONNECTION=y
CONFIG_ESD_ERR_FG_RECOVERY=y
CONFIG_FB_MSM_MDSS_MSM8X26=y
CONFIG_FB_MSM_MDSS=y
CONFIG_FB_MSM_MDSS_WRITEBACK=y
CONFIG_BACKLIGHT_LCD_SUPPORT=y
#CONFIG_MDNIE_TFT_MSM8X26=y
CONFIG_LCD_CLASS_DEVICE=y
CONFIG_BACKLIGHT_CLASS_DEVICE=y
CONFIG_SAMSUNG_DEBUG_DISPLAY=y
# CONFIG_BACKLIGHT_GENERIC is not set

#VIBRATOR
#CONFIG_QPNP_VIBRATOR is not set
#CONFIG_MSM_VIBRATOR is not set
#CONFIG_DRV2604_VIBRATOR is not set
CONFIG_VIBETONZ=y
CONFIG_MOTOR_ISA1000=y


#TKEY LEDS
#CONFIG_LEDS_GPIO=y

#SVC LEDS
#CONFIG_LEDS_KTD2026=y

#TSP
#CONFIG_TOUCHSCREEN_ATMEL_MXT1188S=y
#CONFIG_TOUCHSCREEN_MMS300=y
CONFIG_TOUCHSCREEN_SYNAPTICS_I2C_RMI_G=y
#CONFIG_TOUCHSCREEN_BCMTCH15XXX is not set
#CONFIG_KEYBOARD_CYPRESS_TOUCH is not set
#CONFIG_TOUCHSCREEN_CYTTSP4=y
#CONFIG_TOUCHSCREEN_CYTTSP5=y

#InputConfig
CONFIG_INPUT_ENABLED=y

#KEYS
#CONFIG_KEYBOARD_CYPRESS_TOUCHKEY_HE=y
CONFIG_KEYBOARD_GPIO=y
CONFIG_KEYBOARD_ABOV_TOUCH=y

# NFC
CONFIG_SEC_NFC=y
CONFIG_SEC_NFC_IF_I2C=y
CONFIG_SEC_NFC_PRODUCT_N5=y
CONFIG_SEC_NFC_USE_8226_BBCLK2=y
CONFIG_SEC_NFC_NO_POWER_CONTROL=y

#SENSOR
CONFIG_STAGING=y
CONFIG_IIO_SW_RING=y
# CONFIG_INV_TESTING is not set
CONFIG_INPUT_POLLDEV=y

CONFIG_AVERAGE=y
CONFIG_INPUT=y
CONFIG_INPUT_GPIO=y
#
# Finger print sensor
#
CONFIG_SENSORS_FINGERPRINT=y
CONFIG_SENSORS_FINGERPRINT_SYSFS=y
CONFIG_SENSORS_VFS61XX=y
CONFIG_SENSORS_VFS61XX_KO=y

#S-View(Hall Sensor)
CONFIG_SENSORS_HALL=y

#Audience
CONFIG_SERIAL_MSM_HS=y
CONFIG_SND_SOC_ES705=y
CONFIG_SND_SOC_ES705_SLIM=y
CONFIG_FW_LOADER=y
CONFIG_FIRMWARE_IN_KERNEL=y
CONFIG_EXTRA_FIRMWARE_DIR="firmware"

#CAMERA
#CONFIG_MSM_CPP=y
#CONFIG_S5K4ECGX=y
#CONFIG_SR030PC50=y

#USB
CONFIG_USB_ANDROID_SAMSUNG_COMPOSITE=y
CONFIG_USB_ANDROID_SAMSUNG_MTP=y
CONFIG_USB_DUN_SUPPORT=y
CONFIG_USB_HOST_NOTIFY=y
CONFIG_USB_STORAGE_DETECT=y
CONFIG_USB_ANDROID_SAMSUNG_SIDESYNC=y

#MUIC
#CONFIG_MFD_MAX77693=y
#CONFIG_USB_SWITCH_MAX77693=y
#CONFIG_REGULATOR_MAX77693=y
#CONFIG_DI_MUIC=n
#CONFIG_MUIC_INIT_DETECT_DELAY=3000
#CONFIG_MUIC_USB_DETECT_DELAY=17000
CONFIG_USB_SWITCH_TSU6721=y
#CONFIG_SM5502_MUIC=y

# IRDA support
CONFIG_IRDA_COMMON_LDO=y

#Battery charging & BMS
CONFIG_BATTERY_SAMSUNG=y
CONFIG_CHARGER_SMB358=y
CONFIG_FUELGAUGE_MAX17048=y
CONFIG_FUELGAUGE_MAX17048_COULOMB_COUNTING=y
CONFIG_SAMSUNG_LPM_MODE=y

#BT
no need

#Wifi
#
# Enable Qualcomm Wifi features
#
CONFIG_MSM_PIL_PRONTO=y
CONFIG_WCNSS_CORE=y
CONFIG_WCNSS_CORE_PRONTO=y
CONFIG_WCNSS_MEM_PRE_ALLOC=y

#
# Wifi features (Qualcomm)
#
CONFIG_NET_CORE=y
CONFIG_WIRELESS=y
CONFIG_WIRELESS_EXT_SYSFS=y
CONFIG_WEXT_CORE=y
CONFIG_WEXT_PROC=y
CONFIG_CFG80211=y
CONFIG_CFG80211_DEFAULT_PS=y
#CONFIG_CFG80211_ALLOW_RECONNECT is not set
CONFIG_WLAN=y
CONFIG_WIRELESS_EXT=y
CONFIG_WEXT_PRIV=y

CONFIG_CFG80211_INTERNAL_REGDB=y
CONFIG_MODULES=y
CONFIG_MODULE_UNLOAD=y
CONFIG_MODULE_FORCE_UNLOAD=y
CONFIG_WCNSS_REGISTER_DUMP_ON_BITE=y

#GPIO Expander IC
CONFIG_GPIO_PCAL6416A=y

# DHA Solution
CONFIG_SEC_DHA_SOL_MAL=y

# Earjack
CONFIG_SAMSUNG_JACK=y

# spi
CONFIG_SPI=y
CONFIG_SPI_MASTER=y
CONFIG_SPI_QUP=y
CONFIG_OF=y
CONFIG_OF_SPI=y

#
# Sensor hub
#
CONFIG_SENSORS_SSP=y
CONFIG_SENSORS_SYSFS=y
CONFIG_SENSORS_SSP_FACTORY=y
CONFIG_SENSORS_SSP_MPU6500=y
CONFIG_SENSORS_SSP_AK09911=y
# CONFIG_SENSORS_SSP_BMP182 is not set
CONFIG_SENSORS_SSP_ATUC128L5HAR=y
CONFIG_SENSORS_SSP_SENSORHUB=y
CONFIG_SENSORS_SSP_STM_HESTIA=y
CONFIG_SENSORS_SSP_UVIS25=y
CONFIG_SENSORS_SSP_SHTC1=y
# CONFIG_SENSORS_SSP_MOBEAM is not set
# CONFIG_SENSORS_SSP_TMG399X is not set
CONFIG_SENSORS_SSP_TMD37823=y
CONFIG_SENSORS_MAX86900=y
CONFIG_SENSORS_MLX90615=y
CONFIG_SENSORS_BIO=y
# CONFIG_SENSORS_CONTROL is not set
CONFIG_IIO_BUFFER=y
CONFIG_IIO=y
CONFIG_IIO_KFIFO_BUF=y
CONFIG_IIO_TRIGGER=y
CONFIG_IIO_ST_HWMON=y
```

## arch/arm/configs/msm8928-sec_mega2lte_defconfig
```kconfig
#variant defconfig
CONFIG_MACH_MEGA2LTE_KTT=y
CONFIG_SEC_MEGA2LTE_COMMON=y
CONFIG_SEC_MEGA2_PROJECT=y

#Power Management
CONFIG_SEC_PM=y
CONFIG_SEC_PM_DEBUG=y

CONFIG_FB_MSM_MDSS_HX8394C_TFT_VIDEO_720P_PANEL=y
CONFIG_FB_MSM8x26_MDSS_CHECK_LCD_CONNECTION=y
#CONFIG_ESD_ERR_FG_RECOVERY=y
CONFIG_FB_MSM_MDSS_MSM8X26=y
CONFIG_FB_MSM_MDSS=y
CONFIG_FB_MSM_MDSS_WRITEBACK=y
CONFIG_BACKLIGHT_LCD_SUPPORT=y
CONFIG_MDNIE_TFT_MSM8X26=y
CONFIG_CABC_TUNING_HX8394C=y
CONFIG_LCD_CLASS_DEVICE=y
CONFIG_BACKLIGHT_CLASS_DEVICE=y
CONFIG_SAMSUNG_DEBUG_DISPLAY=y
# CONFIG_BACKLIGHT_GENERIC is not set

#VIBRATOR
#CONFIG_QPNP_VIBRATOR is not set
CONFIG_MSM_VIBRATOR=y

#TKEY LEDS
#CONFIG_LEDS_GPIO=y

#SVC LEDS
CONFIG_LEDS_KTD2026=y

# TIMA LOG
CONFIG_ARCH_MSM8926_LTE=y

#TSP
#CONFIG_TOUCHSCREEN_ATMEL_MXT1188S=y
#CONFIG_TOUCHSCREEN_MMS252=y
#CONFIG_TOUCHSCREEN_BCMTCH15XXX is not set
#CONFIG_KEYBOARD_CYPRESS_TOUCH is not set
#CONFIG_TOUCHSCREEN_CYTTSP4=y
#CONFIG_TOUCHSCREEN_CYTTSP5=y
#CONFIG_TOUCHSCREEN_CYTTSP5_DEVICETREE_SUPPORT=y
CONFIG_TOUCHSCREEN_ZINITIX_BT532=y

#KEYS
CONFIG_KEYBOARD_GPIO=y
# CONFIG_KEYBOARD_ABOV_TOUCH is not set

#SENSOR
CONFIG_STAGING=y
CONFIG_IIO=y
CONFIG_IIO_BUFFER=y
CONFIG_IIO_SW_RING=y
CONFIG_IIO_KFIFO_BUF=y
# CONFIG_INV_MPU_IIO_PRIMARY is not set
# CONFIG_INV_TESTING is not set

#MPL Refactorying (2014)
CONFIG_INV_SENSORS_IIO=y
CONFIG_INV_SENSORS_MPU65XX=y
CONFIG_INV_SENSORS_DMP=y
CONFIG_INV_SENSORS_DBG=y
CONFIG_INV_SENSORS_DMP_K520S=y
CONFIG_INV_SENSORS_DTS_SUPPORT=y

CONFIG_SENSORS=y
CONFIG_SENSORS_HSCDTD008A=y
CONFIG_INPUT_POLLDEV=y
CONFIG_SENSORS_CM36686=y
CONFIG_SENSORS_CM36686_LEDA_EN_GPIO=y

CONFIG_INPUT=y
CONFIG_INPUT_GPIO=y

#S-View(Hall Sensor)
CONFIG_SENSORS_HALL=y
CONFIG_W1=y
CONFIG_W1_MASTER_GPIO_MSM=y
CONFIG_W1_SLAVE_DS28EL15=y
CONFIG_OF_SUBCMDLINE_PARSE=y
CONFIG_W1_WORKQUEUE=y
CONFIG_W1_FAST_CHECK=y

#CONFIG_SEC_NFC_I2C=y
CONFIG_NFC_PN547=y
CONFIG_NFC_PN547_8226_USE_BBCLK2 = y

#Audience
#CONFIG_SND_SOC_ES325=y
#CONFIG_SND_SOC_ES325_SLIM=y
#CONFIG_FW_LOADER=y
#CONFIG_FIRMWARE_IN_KERNEL=y
#CONFIG_EXTRA_FIRMWARE="audience-es325-fw-h-eur.bin"
#CONFIG_EXTRA_FIRMWARE_DIR="firmware/es325"

#CAMERA
#CONFIG_MSM_CPP=y
#CONFIG_S5K4ECGX=y
#CONFIG_SR030PC50=y

#USB
CONFIG_USB_ANDROID_SAMSUNG_COMPOSITE=y
CONFIG_USB_ANDROID_SAMSUNG_MTP=y
CONFIG_USB_DUN_SUPPORT=y
CONFIG_USB_HOST_NOTIFY=y
CONFIG_USB_STORAGE_DETECT=y
CONFIG_USB_ANDROID_SAMSUNG_SIDESYNC=y

#MUIC
#CONFIG_MFD_MAX77693=y
#CONFIG_USB_SWITCH_MAX77693=y
#CONFIG_REGULATOR_MAX77693=y
#CONFIG_DI_MUIC=n
#CONFIG_MUIC_INIT_DETECT_DELAY=3000
#CONFIG_MUIC_USB_DETECT_DELAY=17000
#CONFIG_USB_SWITCH_TSU6721=y
#CONFIG_SM5502_MUIC=y
CONFIG_USB_SWITCH_RT8973=y

# IRDA support
#CONFIG_IR_REMOCON_MC96=y
#CONFIG_IR_REMOCON_KMINI=y

#Battery charging & BMS
CONFIG_BATTERY_SAMSUNG=y
CONFIG_CHARGER_SM5414=y
CONFIG_BATTERY_BCL=y
CONFIG_QPNP_BMS=y
CONFIG_SAMSUNG_LPM_MODE=y
#BT
no need

#Sec Thermistor
CONFIG_SEC_THERMISTOR=y

#Wifi
#
# Enable Qualcomm Wifi features
#
CONFIG_MSM_PIL_PRONTO=y
CONFIG_WCNSS_CORE=y
CONFIG_WCNSS_CORE_PRONTO=y
CONFIG_WCNSS_MEM_PRE_ALLOC=y

#
# Wifi features (Qualcomm)
#
CONFIG_NET_CORE=y
CONFIG_WIRELESS=y
CONFIG_WIRELESS_EXT_SYSFS=y
CONFIG_WEXT_CORE=y
CONFIG_WEXT_PROC=y
CONFIG_CFG80211=y
CONFIG_CFG80211_DEFAULT_PS=y
#CONFIG_CFG80211_ALLOW_RECONNECT is not set
CONFIG_WLAN=y
CONFIG_WIRELESS_EXT=y
CONFIG_WEXT_PRIV=y

CONFIG_MODULES=y
CONFIG_MODULE_UNLOAD=y
CONFIG_MODULE_FORCE_UNLOAD=y
CONFIG_WCNSS_REGISTER_DUMP_ON_BITE =y

# Earjack
CONFIG_SAMSUNG_JACK=y
CONFIG_SEC_DHA_SOL_MAL=y
#CONFIG_EXTRA_FIRMWARE="audience-es325-fw-h-eur.bin"

# SSWAP
CONFIG_SWAP=y
CONFIG_FRONTSWAP=y
CONFIG_ZSMALLOC_NEW=y
CONFIG_PGTABLE_MAPPING=y
CONFIG_ZSWAP=y
CONFIG_DIRECT_RECLAIM_FILE_PAGES_ONLY=n
CONFIG_INCREASE_MAXIMUM_SWAPPINESS=y
CONFIG_FIX_INACTIVE_RATIO=y
CONFIG_TIGHT_PGDAT_BALANCE=y
CONFIG_VNSWAP=y
CONFIG_SWAP_ENABLE_READAHEAD=n

# DMB
CONFIG_TDMB=y
CONFIG_TDMB_VENDOR_FCI=y
CONFIG_TDMB_FC8080=y
CONFIG_TDMB_SPI=y
CONFIG_TDMB_QUALCOMM=y
```

## arch/arm/configs/msm8929_sec_eng_defconfig
```kconfig
# GPIO DVS feature
CONFIG_SEC_GPIO_DVS=y

# Display Clock Tunning (DCT)
CONFIG_SEC_DISP_CLK_TUNNING=y
#EARJACK SYSFS
CONFIG_EARJACK_ADC_SYSFS=y

CONFIG_CORESIGHT=y
CONFIG_CORESIGHT_FUSE=y
CONFIG_CORESIGHT_EVENT=y
CONFIG_CORESIGHT_TMC=y
CONFIG_CORESIGHT_TPIU=y
CONFIG_CORESIGHT_FUNNEL=y
CONFIG_CORESIGHT_REPLICATOR=y
CONFIG_CORESIGHT_STM=y
CONFIG_CORESIGHT_HWEVENT=y
CONFIG_CORESIGHT_MODEM_ETM=y
CONFIG_CORESIGHT_WCN_ETM=y
CONFIG_CORESIGHT_RPM_ETM=y
CONFIG_CORESIGHT_QPDI=y
CONFIG_CORESIGHT_ETMV4=y

CONFIG_SLUB_DEBUG=y
CONFIG_DEBUG_KMEMLEAK=y
CONFIG_DEBUG_KMEMLEAK_EARLY_LOG_SIZE=4000
CONFIG_DEBUG_KMEMLEAK_DEFAULT_OFF=y
CONFIG_DEBUG_SPINLOCK=y
CONFIG_DEBUG_MUTEXES=y
CONFIG_DEBUG_ATOMIC_SLEEP=y
CONFIG_DEBUG_STACK_USAGE=y
CONFIG_DEBUG_LIST=y
CONFIG_FAULT_INJECTION=y
CONFIG_FAIL_PAGE_ALLOC=y
CONFIG_FAULT_INJECTION_DEBUG_FS=y
CONFIG_FAULT_INJECTION_STACKTRACE_FILTER=y
CONFIG_DEBUG_PAGEALLOC=y
CONFIG_PANIC_ON_DATA_CORRUPTION=y
CONFIG_DEBUG_LL=y
CONFIG_EARLY_PRINTK=y

CONFIG_MSM_BUSPM_DEV=y

#
# RP
#
# CONFIG_SEC_RESTRICT_ROOTING is not set
# CONFIG_SEC_RESTRICT_SETUID is not set
# CONFIG_SEC_RESTRICT_FORK is not set
# CONFIG_SEC_RESTRICT_ROOTING_LOG is not set

CONFIG_SEC_FILE_LEAK_DEBUG=y

# Post CS Patch
CONFIG_MODULE_SIG=y
CONFIG_MODULE_SIG_FORCE=y
CONFIG_MODULE_SIG_SHA512=y
# CONFIG_SLUB_DEBUG_ON is not on
CONFIG_DEBUG_HIGHMEM=y
CONFIG_HAVE_ARCH_SECCOMP_FILTER=y
CONFIG_SECCOMP=y
CONFIG_SECCOMP_FILTER=y
```

## arch/arm/configs/msm8930_golden_att_defconfig
```kconfig
#variant defconfig
CONFIG_MACH_GOLDEN_ATT=y
CONFIG_2MIC_QUP_I2C_GSBI11=y
CONFIG_ESD_ERR_FG_RECOVERY=y
# Battery charging and BMS
# CONFIG_BATTERY_MSM is not set
# CONFIG_PM8921_BMS is not set
# CONFIG_PM8921_SEC_CHARGER is not set
# CONFIG_WIRELESS_CHARGER is not set
CONFIG_PM8921_CHARGER=y
CONFIG_BATTERY_SAMSUNG=y
CONFIG_CHARGER_SMB358=y
CONFIG_FUELGAUGE_MAX17048=y
CONFIG_SAMSUNG_LPM_MODE=y

# RTCC
CONFIG_SWAP=y
CONFIG_ZRAM=y
CONFIG_ZRAM_DEBUG=y
CONFIG_ZRAM_FOR_ANDROID=y
CONFIG_INSIDESECURE_VPNCLIENT=y
```
