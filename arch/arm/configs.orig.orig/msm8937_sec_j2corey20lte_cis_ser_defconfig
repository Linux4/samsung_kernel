## arch/arm/configs/msm8228-sec_atlantic3geur_defconfig
```kconfig
#variant defconfig
CONFIG_MACH_ATLANTIC3GEUR_OPEN=y
CONFIG_SEC_ATLANTIC3G_COMMON=y
CONFIG_SEC_ATLANTIC_PROJECT=y

#Power Management
CONFIG_SEC_PM=y
CONFIG_SEC_PM_DEBUG=y

CONFIG_FB_MSM_MDSS_MAGNA_OCTA_VIDEO_720P_PANEL=y
CONFIG_FB_MSM8x26_MDSS_CHECK_LCD_CONNECTION=y
#CONFIG_ESD_ERR_FG_RECOVERY=y
CONFIG_FB_MSM_MDSS_MSM8X26=y
CONFIG_FB_MSM_MDSS=y
CONFIG_FB_MSM_MDSS_WRITEBACK=y
CONFIG_BACKLIGHT_LCD_SUPPORT=y
#CONFIG_MDNIE_TFT_MSM8X26=y
CONFIG_MDNIE_LITE_TUNING=y
CONFIG_LCD_CLASS_DEVICE=y
CONFIG_BACKLIGHT_CLASS_DEVICE=y
CONFIG_SAMSUNG_DEBUG_DISPLAY=y
# CONFIG_BACKLIGHT_GENERIC is not set
CONFIG_LCD_CRACK_RECOVERY=y

#VIBRATOR
#CONFIG_QPNP_VIBRATOR is not set
CONFIG_MSM_VIBRATOR=y

#TKEY LEDS
#CONFIG_LEDS_GPIO=y

#SVC LEDS
CONFIG_LEDS_KTD2026=y

# TIMA LOG
CONFIG_ARCH_MSM8226_3G_WIFI=y

#TSP
#CONFIG_TOUCHSCREEN_ATMEL_MXT1188S=y
#CONFIG_TOUCHSCREEN_MMS252=y
#CONFIG_TOUCHSCREEN_BCMTCH15XXX is not set
#CONFIG_KEYBOARD_CYPRESS_TOUCH is not set
#CONFIG_TOUCHSCREEN_CYTTSP4=y
CONFIG_TOUCHSCREEN_CYTTSP5=y
CONFIG_TOUCHSCREEN_CYTTSP5_DEVICETREE_SUPPORT=y

#KEYS
CONFIG_KEYBOARD_GPIO=y
CONFIG_KEYBOARD_ABOV_TOUCH=y
CONFIG_INPUT_ENABLED=y

#SENSOR
CONFIG_STAGING=y
CONFIG_IIO=y
CONFIG_IIO_BUFFER=y
CONFIG_IIO_SW_RING=y
CONFIG_IIO_KFIFO_BUF=y
CONFIG_INV_MPU_IIO_PRIMARY=y
# CONFIG_INV_TESTING is not set
CONFIG_SENSORS=y
CONFIG_SENSORS_HSCDTD008A=y
CONFIG_INPUT_POLLDEV=y

#CONFIG_SENSORS_TMD27723 is not set
CONFIG_SENSORS_CM36686=y
CONFIG_AVERAGE=y
CONFIG_SENSORS_ADPD142=y
CONFIG_INPUT=y
CONFIG_INPUT_GPIO=y
#
# Finger print sensor
#
CONFIG_SENSORS_FINGERPRINT=y
CONFIG_SENSORS_FINGERPRINT_SYSFS=y
CONFIG_SENSORS_VFS61XX=y
CONFIG_SENSORS_VFS61XX_KO=y

#S-View(Hall Sensor)
CONFIG_SENSORS_HALL=y
CONFIG_W1=y
CONFIG_W1_MASTER_GPIO_MSM=y
CONFIG_W1_SLAVE_DS28EL15=y
#CONFIG_W1_WORKQUEUE=y
CONFIG_W1_SN=y
CONFIG_W1_FAST_CHECK=y
CONFIG_OF_SUBCMDLINE_PARSE=y
#Audience
#CONFIG_SND_SOC_ES325_ATLANTIC=y
#CONFIG_SND_SOC_ES325_SLIM=y
#CONFIG_FW_LOADER=y
#CONFIG_FIRMWARE_IN_KERNEL=y
#CONFIG_EXTRA_FIRMWARE="audience-es325-fw-h-eur.bin"
#CONFIG_EXTRA_FIRMWARE_DIR="firmware/es325"

#CAMERA
#CONFIG_MSM_CPP=y
#CONFIG_S5K4ECGX=y
#CONFIG_SR030PC50=y

#USB
CONFIG_USB_ANDROID_SAMSUNG_COMPOSITE=y
CONFIG_USB_ANDROID_SAMSUNG_MTP=y
CONFIG_USB_DUN_SUPPORT=y
# CONFIG_USB_HOST_NOTIFY=y is not set
CONFIG_USB_STORAGE_DETECT=y
CONFIG_USB_ANDROID_SAMSUNG_SIDESYNC=y

#MUIC
#CONFIG_USB_SWITCH_TSU6721=y
CONFIG_SM5502_MUIC=y
CONFIG_MUIC_SUPPORT_RUSTPROOF=y
# CONFIG_MUIC_SUPPORT_CHARGING_CABLE is not set

# IRDA support
CONFIG_IRDA_COMMON_LDO=y

#Battery charging Charger & BMS
CONFIG_BATTERY_SAMSUNG=y
CONFIG_QPNP_CHARGER=y
CONFIG_BATTERY_BCL=y
CONFIG_QPNP_BMS=y
CONFIG_BATTERY_SWELLING=y

#BT
no need

#Sec Thermistor
CONFIG_SEC_THERMISTOR=y

#Wifi
#
# Enable Qualcomm Wifi features
#
CONFIG_MSM_PIL_PRONTO=y
CONFIG_WCNSS_CORE=y
CONFIG_WCNSS_CORE_PRONTO=y
CONFIG_WCNSS_MEM_PRE_ALLOC=y

#
# Wifi features (Qualcomm)
#
CONFIG_NET_CORE=y
CONFIG_WIRELESS=y
CONFIG_WIRELESS_EXT_SYSFS=y
CONFIG_WEXT_CORE=y
CONFIG_WEXT_PROC=y
CONFIG_CFG80211=y
CONFIG_CFG80211_DEFAULT_PS=y
#CONFIG_CFG80211_ALLOW_RECONNECT is not set
CONFIG_WLAN=y
CONFIG_WIRELESS_EXT=y
CONFIG_WEXT_PRIV=y

CONFIG_MODULES=y
CONFIG_MODULE_UNLOAD=y
CONFIG_MODULE_FORCE_UNLOAD=y
CONFIG_WCNSS_REGISTER_DUMP_ON_BITE=y
CONFIG_WCNSS_IRIS_REGISTER_DUMP=y
CONFIG_CFG80211_INTERNAL_REGDB=y

# Earjack
CONFIG_SAMSUNG_JACK=y

# DHA Solution
CONFIG_SEC_DHA_SOL_MAL=y

# DUAL CP Flag
CONFIG_AUDIO_DUAL_CP=y

# SSWAP
CONFIG_SWAP=y
CONFIG_FRONTSWAP=y
CONFIG_ZSMALLOC_NEW=y
CONFIG_PGTABLE_MAPPING=y
CONFIG_ZSWAP=y
CONFIG_DIRECT_RECLAIM_FILE_PAGES_ONLY=y
CONFIG_INCREASE_MAXIMUM_SWAPPINESS=y
CONFIG_FIX_INACTIVE_RATIO=y
CONFIG_TIGHT_PGDAT_BALANCE=y
CONFIG_VNSWAP=y
CONFIG_SWAP_ENABLE_READAHEAD=n

# MMAP READAROUND
CONFIG_MMAP_READAROUND_LIMIT=32
```

## arch/arm/configs/msm8610_sec_eng_defconfig
```kconfig
##eng

CONFIG_MSM_XPU_ERR_FATAL=y

# CONFIG_CFG80211_INTERNAL_REGDB is not set

CONFIG_CORESIGHT=y
CONFIG_CORESIGHT_FUSE=y
CONFIG_CORESIGHT_TMC=y
CONFIG_CORESIGHT_TPIU=y
CONFIG_CORESIGHT_FUNNEL=y
CONFIG_CORESIGHT_REPLICATOR=y
CONFIG_CORESIGHT_STM=y
CONFIG_CORESIGHT_HWEVENT=y
CONFIG_CORESIGHT_ETM=y
CONFIG_CORESIGHT_ETM_DEFAULT_ENABLE=y
CONFIG_CORESIGHT_ETM_PCSAVE_DEFAULT_ENABLE=y
CONFIG_CORESIGHT_EVENT=y

# CONFIG_DETECT_HUNG_TASK is not set

CONFIG_DEBUG_KMEMLEAK=y
CONFIG_DEBUG_KMEMLEAK_DEFAULT_OFF=y
CONFIG_DEBUG_SPINLOCK=y
CONFIG_DEBUG_MUTEXES=y
CONFIG_DEBUG_ATOMIC_SLEEP=y
CONFIG_DEBUG_STACK_USAGE=y

CONFIG_FAULT_INJECTION=y
CONFIG_FAIL_PAGE_ALLOC=y
CONFIG_FAULT_INJECTION_DEBUG_FS=y
CONFIG_FAULT_INJECTION_STACKTRACE_FILTER=y
# CONFIG_DEBUG_PAGEALLOC is not set

CONFIG_PANIC_ON_DATA_CORRUPTION=y

#enable DVS for iora test
CONFIG_SEC_GPIO_DVS=y

# CONFIG_SEC_RESTRICT_ROOTING is not set
# CONFIG_SEC_RESTRICT_SETUID is not set
# CONFIG_SEC_RESTRICT_FORK is not set
# CONFIG_SEC_RESTRICT_ROOTING_LOG is not set

#enable block trace
CONFIG_BLOCK=y
CONFIG_BLK_DEV_IO_TRACE=y

CONFIG_SEC_FILE_LEAK_DEBUG=y
```

## arch/arm/configs/msm8610_sec_heat_usa_dyn_defconfig
```kconfig
CONFIG_SEC_HEAT_PROJECT=y
CONFIG_MACH_HEAT_DYN=y
# CONFIG_EXT_MAINMIC_BIAS is not set
CONFIG_EXT_SUBMIC_BIAS=y

CONFIG_SENSORS=y
CONFIG_SENSORS_GP2A002=y
CONFIG_SENSORS_BMA254=y
CONFIG_SENSORS_POWER_EN=y
CONFIG_SENSORS_POWERCONTROL=y

CONFIG_FB_MSM_MIPI_CMD_WVGA_ILI9806B_PT_PANEL=y

CONFIG_BACKLIGHT_KTD2801=y
CONFIG_LEDS_SEC_BACKLIGHT=y
CONFIG_MSM_VIBRATOR=y

#
# Enable Qualcomm Wifi features
#
CONFIG_MSM_PIL_PRONTO=y
CONFIG_WCNSS_CORE=y
CONFIG_WCNSS_CORE_PRONTO=y
CONFIG_WCNSS_MEM_PRE_ALLOC=y

#
# Wifi features (Qualcomm)
#
CONFIG_NET_CORE=y
CONFIG_WIRELESS=y
CONFIG_WIRELESS_EXT_SYSFS=y
CONFIG_WEXT_CORE=y
CONFIG_WEXT_PROC=y
CONFIG_CFG80211=y
CONFIG_CFG80211_WEXT=y
CONFIG_CFG80211_DEFAULT_PS=y
CONFIG_CFG80211_ALLOW_RECONNECT=y
CONFIG_WLAN=y
CONFIG_WIRELESS_EXT=y
CONFIG_WEXT_PRIV=y

CONFIG_MODULES=y
CONFIG_MODULE_UNLOAD=y
CONFIG_MODULE_FORCE_UNLOAD=y

#
# Wifi features (Broadcomm)
# CONFIG_BCM4339 is not set
# CONFIG_BCMDHD_FW_PATH is not set
# CONFIG_BCMDHD_NVRAM_PATH is not set
# CONFIG_BROADCOM_WIFI_RESERVED_MEM is not set
# CONFIG_WLAN_REGION_CODE is not set
# CONFIG_MMC_MSM_SDC2_SUPPORT is not set
# CONFIG_H_EUR_WIFI is not set
#TSP
CONFIG_TOUCHSCREEN_IST30XX=y

# Charger
CONFIG_BATTERY_SAMSUNG=y
CONFIG_SAMSUNG_LPM_MODE=y
CONFIG_FUELGAUGE_MAX17048=y
CONFIG_CHARGER_SMB358=y

#LED
CONFIG_LEDS_QPNP=y
CONFIG_LEDS_MSM_GPIO_FLASH=y
CONFIG_LEDS_TRIGGERS=y
# CONFIG_LEDS_AN30259A is not set

#Camera
CONFIG_SR030PC50=y
CONFIG_S5K4ECGX=y
```

## arch/arm/configs/msm8610_sec_kanas3g_chn_ctc_defconfig
```kconfig
CONFIG_MACH_KANAS3G_CTC=y
CONFIG_SEC_KANAS_PROJECT=y
# CONFIG_EXT_MAINMIC_BIAS is not set
CONFIG_EXT_SUBMIC_BIAS=y

CONFIG_SENSORS=y
#CONFIG_PROXIMITY_SENSOR=y
#CONFIG_SENSORS_GP2A002=y
CONFIG_SENSORS_BMA254=y
#CONFIG_SENSORS_POWER_EN=y
#CONFIG_SENSORS_POWERCONTROL=y
CONFIG_BMA254_SMART_ALERT=y

CONFIG_FB_MSM_MIPI_VIDEO_WVGA_NT35502_PT_PANEL=y

# CONFIG_BACKLIGHT_KTD2801 is not set
CONFIG_LEDS_SEC_BACKLIGHT=y
CONFIG_MSM_VIBRATOR=y

#
# Enable Qualcomm Wifi features
#
CONFIG_MSM_PIL_PRONTO=y
CONFIG_WCNSS_CORE=y
CONFIG_WCNSS_CORE_PRONTO=y
CONFIG_WCNSS_MEM_PRE_ALLOC=y

# LCD feature
CONFIG_FB_MSM_MDSS_DSI_CTRL_STATUS=y

#
# Wifi features (Qualcomm)
#
CONFIG_NET_CORE=y
CONFIG_WIRELESS=y
CONFIG_WIRELESS_EXT_SYSFS=y
CONFIG_WEXT_CORE=y
CONFIG_WEXT_PROC=y
CONFIG_CFG80211=y
CONFIG_CFG80211_WEXT=y
CONFIG_CFG80211_DEFAULT_PS=y
# CONFIG_CFG80211_ALLOW_RECONNECT is not set
CONFIG_WLAN=y
CONFIG_WIRELESS_EXT=y
CONFIG_WEXT_PRIV=y

CONFIG_MODULES=y
CONFIG_MODULE_UNLOAD=y
CONFIG_MODULE_FORCE_UNLOAD=y
CONFIG_WCNSS_IRIS_REGISTER_DUMP=y
CONFIG_PPP_FILTER=y
CONFIG_PPP_ASYNC=y
CONFIG_PPP_SYNC_TTY=y

#
# Wifi features (Broadcomm)
# CONFIG_BCM4339 is not set
# CONFIG_BCMDHD_FW_PATH is not set
# CONFIG_BCMDHD_NVRAM_PATH is not set
# CONFIG_BROADCOM_WIFI_RESERVED_MEM is not set
# CONFIG_WLAN_REGION_CODE is not set
# CONFIG_MMC_MSM_SDC2_SUPPORT is not set
# CONFIG_H_EUR_WIFI is not set


#TSP
CONFIG_TOUCHSCREEN_MMS134S=y
CONFIG_TOUCHSCREEN_IST30XX=y

# Charger
CONFIG_SAMSUNG_LPM_MODE=y
CONFIG_QPNP_SEC_CHARGER=y
CONFIG_BATTERY_BCL=y
CONFIG_QPNP_BMS=y
CONFIG_NOT_USE_EXT_OVP=y

#CAM
CONFIG_SR352=y

#LED
# CONFIG_LEDS_QPNP is not set
# CONFIG_LEDS_MSM_GPIO_FLASH is not set
CONFIG_LEDS_TRIGGERS=y
#AUDIO
CONFIG_RADIO_IRIS=y
CONFIG_RADIO_IRIS_TRANSPORT=m
# CONFIG_LEDS_AN30259A is not set

#SAPA
CONFIG_RTC_AUTO_PWRON=y
CONFIG_RTC_AUTO_PWRON_PARAM=y

#SSRM
CONFIG_SEC_THERMISTOR=y

# RTCC v3
CONFIG_SWAP=y
CONFIG_ZSMALLOC=y
CONFIG_ZRAM=y
CONFIG_RUNTIME_COMPCACHE=y
CONFIG_KSWAPD_NOSWAP=y
```

## arch/arm/configs/msm8610_sec_kanas3g_chn_cu_defconfig
```kconfig
#variant defconfig
CONFIG_MACH_KANAS3G_CU=y
CONFIG_SEC_KANAS_PROJECT=y

# CONFIG_EXT_MAINMIC_BIAS is not set
CONFIG_EXT_SUBMIC_BIAS=y

CONFIG_SENSORS=y
CONFIG_SENSORS_BMA254=y
CONFIG_SENSORS_POWERCONTROL=y
CONFIG_BMA254_SMART_ALERT=y

# LCD
CONFIG_FB_MSM_MIPI_VIDEO_WVGA_NT35502_PT_PANEL=y
CONFIG_LEDS_SEC_BACKLIGHT=y

CONFIG_MSM_VIBRATOR=y

#
# Enable Qualcomm Wifi features
#
CONFIG_MSM_PIL_PRONTO=y
CONFIG_WCNSS_CORE=y
CONFIG_WCNSS_CORE_PRONTO=y
CONFIG_WCNSS_MEM_PRE_ALLOC=y

#
# Wifi features (Qualcomm)
#
CONFIG_NET_CORE=y
CONFIG_WIRELESS=y
CONFIG_WIRELESS_EXT_SYSFS=y
CONFIG_WEXT_CORE=y
CONFIG_WEXT_PROC=y
CONFIG_CFG80211=y
CONFIG_CFG80211_WEXT=y
CONFIG_CFG80211_DEFAULT_PS=y
#CONFIG_CFG80211_ALLOW_RECONNECT=y
CONFIG_WLAN=y
CONFIG_WIRELESS_EXT=y
CONFIG_WEXT_PRIV=y

CONFIG_MODULES=y
CONFIG_MODULE_UNLOAD=y
CONFIG_MODULE_FORCE_UNLOAD=y

#
# Wifi features (Broadcomm)
# CONFIG_BCM4339 is not set
# CONFIG_BCMDHD_FW_PATH is not set
# CONFIG_BCMDHD_NVRAM_PATH is not set
# CONFIG_BROADCOM_WIFI_RESERVED_MEM is not set
# CONFIG_WLAN_REGION_CODE is not set
# CONFIG_MMC_MSM_SDC2_SUPPORT is not set
# CONFIG_H_EUR_WIFI is not set

#TSP
CONFIG_TOUCHSCREEN_MMS134S=y
CONFIG_TOUCHSCREEN_IST30XX=y

# Charger
CONFIG_QPNP_SEC_CHARGER=y
CONFIG_BATTERY_BCL=y
CONFIG_QPNP_BMS=y
CONFIG_NOT_USE_EXT_OVP=y

#LED
CONFIG_LEDS_QPNP=y
CONFIG_LEDS_MSM_GPIO_FLASH=y
CONFIG_LEDS_TRIGGERS=y

#AUDIO
CONFIG_RADIO_IRIS=y
CONFIG_RADIO_IRIS_TRANSPORT=m
# CONFIG_LEDS_AN30259A is not set

# RTCC v3
CONFIG_SWAP=y
CONFIG_ZSMALLOC=y
CONFIG_ZRAM=y
CONFIG_RUNTIME_COMPCACHE=y
CONFIG_KSWAPD_NOSWAP=y

#SAPA
CONFIG_RTC_AUTO_PWRON=y
CONFIG_RTC_AUTO_PWRON_PARAM=y

# CAMERA
CONFIG_S5K4ECGX=y
CONFIG_SR030PC50=n
CONFIG_SR352=n

#SSRM
CONFIG_SEC_THERMISTOR=y
```
