## arch/arm/configs.orig.orig/msm8937_sec_j2corey20lte_cis_ser_defconfig
```kconfig
CONFIG_SEC_MSM8917_PROJECT=y
CONFIG_SEC_J2COREY20LTE_PROJECT=y
CONFIG_MACH_J2COREY20LTE_CIS_SER=y

CONFIG_DRV_SAMSUNG=y

#INPUT MODULES
CONFIG_SEC_DEBUG_TSP_LOG=y
CONFIG_TOUCHSCREEN_DUMP_MODE=y
CONFIG_TOUCHSCREEN_SYNAPTICS_I2C_TD4X00_J2CORELTE=y
CONFIG_SEC_INCELL=y
CONFIG_TOUCHSCREEN_SYNAPTICS_FB_OPEN_CLOSE=y

#MUIC
CONFIG_USE_MUIC=y
CONFIG_MUIC_NOTIFIER=y
CONFIG_MUIC_S2MU005=y
CONFIG_MFD_S2MU005=y
CONFIG_MUIC_SUPPORT_RUSTPROOF=y
CONFIG_MUIC_UART_SWITCH=y
CONFIG_MUIC_S2MU005_JIGB_CONTROL=y
CONFIG_MUIC_S2MU005_WATER_WA_DISABLE=y
CONFIG_MUIC_S2MU005_LANHUB_DISABLE=y
CONFIG_MUIC_S2MU005_619K_DISCHARGING=y
CONFIG_MUIC_DOCK_NOTIFIER=n

#USB Host
CONFIG_USB_HOST_NOTIFY=y
CONFIG_VBUS_NOTIFIER=y

# BATTERY & CHARGER
CONFIG_SAMSUNG_LPM_MODE=y
CONFIG_BATTERY_SAMSUNG=y
CONFIG_BATTERY_SAMSUNG_V2=y
CONFIG_BATTERY_NOTIFIER=y
CONFIG_PREVENT_SOC_JUMP=y
CONFIG_CHARGER_S2MU005=y
CONFIG_FUELGAUGE_S2MU005=y
#CONFIG_S2MU005_INNER_BATTERY=y
CONFIG_BATTERY_SWELLING=y
CONFIG_SEC_MPP_SHARE=y
CONFIG_BATTERY_AGE_FORECAST=y
CONFIG_BATTERY_AGE_FORECAST_DETACHABLE=y
CONFIG_S2MU005_DISABLE_BUCK_MODE=y
CONFIG_S2MU005_MODE_CHANGE_BY_TOPOFF=y

CONFIG_SYSFS=y
CONFIG_INPUT=y
CONFIG_INPUT_MISC=y
CONFIG_INPUT_GPIO=y
CONFIG_INPUT_POLLDEV=y

#SENSORS
CONFIG_SENSORS=y
CONFIG_SENSORS_CORE=y
CONFIG_SENSORS_LIS2DS=y
CONFIG_SENSORS_LIS2DS_I2C=y
CONFIG_SENSORS_STK3013=y
#NFC

#HALL IC
# CONFIG_SENSORS_HALL is not set

#CAMERA
CONFIG_S5K5E3YX=y
CONFIG_MSM_FRONT_OTP=y
CONFIG_GET_REAR_SENSOR_ID=y

#EEPROM
CONFIG_GET_REAR_MODULE_ID=y

#AUDIO
CONFIG_SAMSUNG_JACK=y
# CONFIG_SLIMBUS is not set
# CONFIG_SLIMBUS_MSM_NGD is not set
# CONFIG_SOUNDWIRE is not set

#FLASH
#CONFIG_FLASHLIGHT=y
CONFIG_LEDS_S2MU005=y
CONFIG_LEDS_S2MU005_FLASH=y

#DISPLAY
CONFIG_PANEL_TD4101_BV050SQM_QHD=y
CONFIG_BLIC_LM3632A=y

# MOTOR
CONFIG_MSM_VIBRATOR=y

#SVC LEDS
CONFIG_LEDS_KTD2026=y

#Power off Alarm
# CONFIG_RTC_AUTO_PWRON is not set

# Legacy alarm dev
# CONFIG_ANDROID_INTF_ALARM_DEV is not set

CONFIG_NR_CPUS=4

# SSWAP
CONFIG_SWAP=y
CONFIG_FRONTSWAP=y
CONFIG_ZSMALLOC=y
CONFIG_ZSMALLOC_STAT=y
CONFIG_ZSMALLOC_OBJ_SEQ=n
CONFIG_PGTABLE_MAPPING=y
CONFIG_ZSWAP=y
CONFIG_ZSWAP_COMPACTION=y
CONFIG_ZSWAP_ENABLE_WRITEBACK=n
CONFIG_ZSWAP_SAME_PAGE_SHARING=y
CONFIG_ZPOOL=y
CONFIG_DIRECT_RECLAIM_FILE_PAGES_ONLY=y
CONFIG_INCREASE_MAXIMUM_SWAPPINESS=y
CONFIG_FIX_INACTIVE_RATIO=y
CONFIG_TIGHT_PGDAT_BALANCE=y
CONFIG_VNSWAP=y
CONFIG_SWAP_ENABLE_READAHEAD=n
CONFIG_MMAP_READAROUND_LIMIT=16
CONFIG_BALANCE_ANON_FILE_RECLAIM=y

#SDCARD
# CONFIG_SEC_HYBRID_TRAY is not set

# Only for VTS issue ( for swaping : Using SSWAP Android GO instead of ZRAM, for vts Just enable zram flags , ZRAM partition is not created. )
CONFIG_ZRAM=y
CONFIG_ZRAM_LZ4_COMPRESS=y
CONFIG_SLUB_DEBUG=n

# MEMCG for Android GO ( Enable LMKD )
CONFIG_MEMCG=y
CONFIG_MEMCG_SWAP=y
 
# KNOX SDP and DLP
CONFIG_SDP=y
CONFIG_DLP=y

# EPDG
CONFIG_NET_CORE=y
CONFIG_NET_SCH_PRIO=y
CONFIG_NET_SCHED=y   #depends on CONFIG_NET  which is enabled by default.. coz not seeing in the config file
CONFIG_NET_CLS_BASIC=y # required if basic is being used as a filter. depends on CONFIG_NET_CLS so enabling it by default
CONFIG_NET_CLS=y
CONFIG_NET_CLS_ACT=y # for enabling the action target.
CONFIG_NET_ACT_MIRRED=y  # for enabling the mirred target for redirecting the packet between the devices.
CONFIG_NET_EMATCH=y   #basic uses extended matches so this has to be present
CONFIG_NET_SCH_INGRESS=y # classifier for ingress packet

# CONFIG_HZ for Android GO
CONFIG_HZ_300=y 

#Changing fault around from 64kb to 4kb for android GO models
CONFIG_FAULT_AROUND_4KB=y

# Enable F2FS for Android GO
CONFIG_F2FS_FS=y
CONFIG_F2FS_FS_SECURITY=y
CONFIG_F2FS_FS_ENCRYPTION=y 
```

## arch/arm/configs.orig.orig/msm8937_sec_j4corelte_mea_open_defconfig
```kconfig
CONFIG_SEC_MSM8917_PROJECT=y
CONFIG_SEC_J4CORELTE_PROJECT=y
CONFIG_MACH_J4CORELTE_MEA_OPEN=y

CONFIG_DRV_SAMSUNG=y

#INPUT MODULES
CONFIG_SEC_DEBUG_TSP_LOG=y
CONFIG_TOUCHSCREEN_DUMP_MODE=y
CONFIG_TOUCHSCREEN_SEC_INCELL_TS=y
CONFIG_INPUT_TOUCHSCREEN_TCLMV2=y
CONFIG_INPUT_TOUCHSCREEN_TCLM=n

#MUIC
CONFIG_USE_MUIC=y
CONFIG_MUIC_NOTIFIER=y
CONFIG_MUIC_S2MU005=y
CONFIG_MFD_S2MU005=y
CONFIG_MUIC_S2MU005_DISCHARGING_WA=y 
CONFIG_MUIC_SUPPORT_RUSTPROOF=y
CONFIG_MUIC_S2MU005_INNER_BATTERY=y
CONFIG_MUIC_UART_SWITCH=y
CONFIG_MUIC_S2MU005_JIGB_CONTROL=y
CONFIG_MUIC_S2MU005_WATER_WA_DISABLE=y

#USB Host
CONFIG_USB_HOST_NOTIFY=y
CONFIG_VBUS_NOTIFIER=y

# BATTERY & CHARGER
CONFIG_SAMSUNG_LPM_MODE=y
CONFIG_BATTERY_SAMSUNG=y
CONFIG_BATTERY_SAMSUNG_V2=y
CONFIG_BATTERY_NOTIFIER=y
CONFIG_PREVENT_SOC_JUMP=y
CONFIG_CHARGER_S2MU005=y
CONFIG_FUELGAUGE_S2MU005=y
CONFIG_S2MU005_INNER_BATTERY=y
CONFIG_BATTERY_SWELLING=y
CONFIG_SEC_MPP_SHARE=y
CONFIG_BATTERY_AGE_FORECAST=y
#CONFIG_BATTERY_AGE_FORECAST_DETACHABLE=y
CONFIG_S2MU005_DISABLE_BUCK_MODE=y

CONFIG_SYSFS=y
CONFIG_INPUT=y
CONFIG_INPUT_MISC=y
CONFIG_INPUT_GPIO=y
CONFIG_INPUT_POLLDEV=y

#SENSORS
CONFIG_SENSORS=y
CONFIG_SENSORS_CORE=y
CONFIG_SENSORS_LIS2DS=y
CONFIG_SENSORS_LIS2DS_I2C=y
CONFIG_SENSORS_CM36686=y
#NFC

#HALL IC
# CONFIG_SENSORS_HALL is not set

#CAMERA
CONFIG_S5K5E9YX=y
CONFIG_MSM_FRONT_OTP=y
CONFIG_GET_REAR_SENSOR_ID=y
CONFIG_GET_FRONT_SENSOR_ID=y
CONFIG_GET_FRONT_MODULE_ID=y
CONFIG_GET_FRONT_MODULE_ID_OTP=y

#EEPROM
CONFIG_GET_REAR_MODULE_ID=y

#AUDIO
CONFIG_SAMSUNG_JACK=y
# CONFIG_SLIMBUS is not set
# CONFIG_SLIMBUS_MSM_NGD is not set
# CONFIG_SOUNDWIRE is not set

#FLASH
#CONFIG_FLASHLIGHT=y
CONFIG_LEDS_S2MU005=y
CONFIG_LEDS_S2MU005_FLASH=y

#DISPLAY
CONFIG_PANEL_S6D7AT0B01_PM6003XB1_HDP=y
CONFIG_PANEL_S6D7AT0B01_BS060WKM_HDP=y
CONFIG_PANEL_HX83102D_BS060WKM_HDP=y
CONFIG_BLIC_LM3632A=y

# MOTOR
CONFIG_MSM_VIBRATOR=y

#SVC LEDS
CONFIG_LEDS_KTD2026=y

#Power off Alarm
# CONFIG_RTC_AUTO_PWRON is not set

# Legacy alarm dev
# CONFIG_ANDROID_INTF_ALARM_DEV is not set

CONFIG_NR_CPUS=4

# SSWAP
CONFIG_SWAP=y
CONFIG_FRONTSWAP=y
CONFIG_ZSMALLOC=y
CONFIG_ZSMALLOC_STAT=y
CONFIG_ZSMALLOC_OBJ_SEQ=n
CONFIG_PGTABLE_MAPPING=y
CONFIG_ZSWAP=y
CONFIG_ZSWAP_COMPACTION=y
CONFIG_ZSWAP_ENABLE_WRITEBACK=n
CONFIG_ZSWAP_SAME_PAGE_SHARING=y
CONFIG_ZPOOL=y
CONFIG_DIRECT_RECLAIM_FILE_PAGES_ONLY=y
CONFIG_INCREASE_MAXIMUM_SWAPPINESS=y
CONFIG_FIX_INACTIVE_RATIO=y
CONFIG_TIGHT_PGDAT_BALANCE=y
CONFIG_VNSWAP=y
CONFIG_SWAP_ENABLE_READAHEAD=n
CONFIG_MMAP_READAROUND_LIMIT=16
CONFIG_BALANCE_ANON_FILE_RECLAIM=y

# MMC
CONFIG_SEC_HYBRID_TRAY=y

# Only for VTS issue ( for swaping : Using SSWAP Android GO instead of ZRAM, for vts Just enable zram flags , ZRAM partition is not created. )
CONFIG_ZRAM=y
CONFIG_ZRAM_LZ4_COMPRESS=y
CONFIG_SLUB_DEBUG=n

# MEMCG for Android GO ( Enable LMKD )
CONFIG_MEMCG=y
CONFIG_MEMCG_SWAP=y
 
# KNOX SDP and DLP
CONFIG_SDP=y
CONFIG_DLP=y

# EPDG
CONFIG_NET_CORE=y
CONFIG_NET_SCH_PRIO=y
CONFIG_NET_SCHED=y   #depends on CONFIG_NET  which is enabled by default.. coz not seeing in the config file
CONFIG_NET_CLS_BASIC=y # required if basic is being used as a filter. depends on CONFIG_NET_CLS so enabling it by default
CONFIG_NET_CLS=y
CONFIG_NET_CLS_ACT=y # for enabling the action target.
CONFIG_NET_ACT_MIRRED=y  # for enabling the mirred target for redirecting the packet between the devices.
CONFIG_NET_EMATCH=y   #basic uses extended matches so this has to be present
CONFIG_NET_SCH_INGRESS=y # classifier for ingress packet

# CONFIG_HZ for Android GO
CONFIG_HZ_300=y 

#Changing fault around from 64kb to 4kb for android GO models
CONFIG_FAULT_AROUND_4KB=y
```

## arch/arm/configs/apq8084_sec_eng_defconfig
```kconfig
CONFIG_DEVMEM=y
CONFIG_DEVKMEM=y
CONFIG_MSM_CACHE_DUMP=y
CONFIG_MSM_CACHE_DUMP_ON_PANIC=y
CONFIG_MSM_L1_RECOV_ERR_PANIC=y
CONFIG_NET_VENDOR_ATHEROS=y
CONFIG_ATL1C=m
CONFIG_DM_REQ_CRYPT=y
CONFIG_MSM_IOMMU_PMON=y
CONFIG_CORESIGHT=y
CONFIG_CORESIGHT_FUSE=y
CONFIG_CORESIGHT_TMC=y
CONFIG_CORESIGHT_TPIU=y
CONFIG_CORESIGHT_FUNNEL=y
CONFIG_CORESIGHT_REPLICATOR=y
CONFIG_CORESIGHT_STM=y
CONFIG_CORESIGHT_HWEVENT=y
CONFIG_CORESIGHT_ETM=y
CONFIG_CORESIGHT_ETM_PCSAVE_DEFAULT_ENABLE=y
CONFIG_CORESIGHT_AUDIO_ETM=y
CONFIG_CORESIGHT_RPM_ETM=y
CONFIG_CORESIGHT_EVENT=y
CONFIG_LOCKUP_DETECTOR=y
# CONFIG_DETECT_HUNG_TASK is not set
CONFIG_DEBUG_KMEMLEAK=y
CONFIG_DEBUG_KMEMLEAK_EARLY_LOG_SIZE=4000
CONFIG_DEBUG_KMEMLEAK_DEFAULT_OFF=y
CONFIG_DEBUG_SPINLOCK=y
CONFIG_DEBUG_MUTEXES=y
CONFIG_DEBUG_ATOMIC_SLEEP=y
CONFIG_DEBUG_STACK_USAGE=y
CONFIG_DEBUG_LIST=y
CONFIG_SLUB_DEBUG=y
CONFIG_SLUB_DEBUG_ON=y
CONFIG_SLABINFO=y
CONFIG_FAULT_INJECTION=y
CONFIG_FAIL_PAGE_ALLOC=y
CONFIG_UFS_FAULT_INJECTION=y
CONFIG_FAULT_INJECTION_DEBUG_FS=y
CONFIG_FAULT_INJECTION_STACKTRACE_FILTER=y
CONFIG_DEBUG_PAGEALLOC=y
CONFIG_MSM_RTB=y
CONFIG_MSM_RTB_SEPARATE_CPUS=y
CONFIG_PANIC_ON_DATA_CORRUPTION=y
CONFIG_DEBUG_LL=y
CONFIG_EARLY_PRINTK=y
CONFIG_DEBUG_SET_MODULE_RONX=y
CONFIG_CRYPTO_XTS=y
# CONFIG_CRYPTO_DEV_QCRYPTO is not set
CONFIG_PRINTK_PROCESS=y
CONFIG_MSMB_CAMERA_DEBUG is not set
CONFIG_MSM_SENSOR_DRIVER_DEBUG is not set
CONFIG_MSM_EEPROM_DEBUG is not set
CONFIG_MSM_CPP_DEBUG is not set
CONFIG_MSM_CAMERA_DT_DEBUG is not set
CONFIG_MSM_ISP_DEBUG is not set
CONFIG_MSM_CC_SPI_TRANS_DEBUG is not set
CONFIG_MSM_CC_DEBUG is not set
CONFIG_BLOCK=y
CONFIG_BLK_DEV_IO_TRACE=y
CONFIG_MMC_QC_CMD_LOGGING=y
CONFIG_DEBUG_SG=y
CONFIG_IKCONFIG=y

CONFIG_MDP_UPSCALE_TUNNING=y
CONFIG_DYNAMIC_MDP_CAP=y

CONFIG_SAMSUNG_BATTERY_ENG_TEST=y

CONFIG_SENSORS_SSP_ENG=y

# GPIO DVS feature
CONFIG_SEC_GPIO_DVS=y

# Display Clock Tunning (DCT)
CONFIG_SEC_DISP_CLK_TUNNING=y

# NOC Debug
CONFIG_MSM_BUSPM_DEV=y

# CONFIG_SEC_RESTRICT_ROOTING is not set
# CONFIG_SEC_RESTRICT_SETUID is not set
# CONFIG_SEC_RESTRICT_FORK is not set
# CONFIG_SEC_RESTRICT_ROOTING_LOG is not set

#QCA6174 fw log
CONFIG_FW_LOGS_BASED_ON_INI=y

# Disable rustproof
# CONFIG_MUIC_SUPPORT_RUSTPROOF is not set

# Disable TIMA Cred for eng build
# CONFIG_TIMA_RKP_KDATA_PROT is not set
# CONFIG_TIMA_RKP_RO_CRED is not set

# Debug for List Curruption
CONFIG_SLUB_DEBUG=y
CONFIG_SLUB_DEBUG_ON=y
CONFIG_PAGE_POISONING=y
CONFIG_DEBUG_LIST=y
CONFIG_PANIC_ON_DATA_CORRUPTION=y
```

## arch/arm/configs/apq8084_sec_lentislte_ktt_defconfig
```kconfig
CONFIG_SEC_LENTIS_PROJECT=y
CONFIG_MACH_LENTISLTE_KTT=y
#
#Debug
#
CONFIG_SEC_DEBUG_NOCACHE_LOG_IN_LEVEL_LOW=y
#
# MAX77828 IC
#
CONFIG_EXTCON=y
CONFIG_EXTCON_MAX77828=y
CONFIG_MFD_MAX77828=y
CONFIG_MOTOR_DRV_MAX77828=y
CONFIG_SS_VIBRATOR=y
CONFIG_LEDS_MAX77828=y
CONFIG_MUIC_SUPPORT_WATERRESISTANCE=y
#
# MAX77804K IC
#
CONFIG_MFD_MAX77804K=y
CONFIG_EXTCON_MAX77804K=y
CONFIG_MOTOR_DRV_MAX77804K=y
#
#
# Supprot MDM(SDS)
#
CONFIG_USB_LOCK_SUPPORT_FOR_MDM=y
#
# IDCHIP
#
#CONFIG_INPUT_HALLIC=y
CONFIG_SENSORS_HALL=y
CONFIG_W1=y
CONFIG_W1_MASTER_GPIO_MSM=y
CONFIG_W1_SLAVE_DS28E15=y
CONFIG_W1_WORKQUEUE=y
CONFIG_W1_FAST_CHECK=y
CONFIG_W1_SN=y
#
# Battery & Charger
#
# CONFIG_SMB350_CHARGER is not set
# CONFIG_BATTERY_BQ28400 is not set
# CONFIG_BATTERY_MSM is not set
# CONFIG_FUELGAUGE_DUMMY is not set
#
# MAX77823 Charger
#
# CONFIG_QPNP_CHARGER is not set
# CONFIG_QPNP_BMS is not set
CONFIG_MFD_MAX77823=y
CONFIG_FUELGAUGE_MAX77823=y
CONFIG_FUELGAUGE_MAX77823_COULOMB_COUNTING=y
CONFIG_CHARGER_MAX77823=y
CONFIG_CHARGER_MAX77804K=y
CONFIG_FUELGAUGE_MAX17048=y
CONFIG_SAMSUNG_LPM_MODE=y
CONFIG_BATTERY_SAMSUNG=y
CONFIG_BATTERY_SAMSUNG_DATA_FILE="lentis_battery_data.h"
CONFIG_SAMSUNG_BATTERY_DISALLOW_DEEP_SLEEP=y
#
# NFC
#
CONFIG_NFC_PN547=y
CONFIG_NFC_PN547_8084_USE_BBCLK2=y

#
#TSP, TKEY, Booster
#
CONFIG_TOUCHSCREEN_SYNAPTICS_I2C_RMI_G=y
CONFIG_KEYBOARD_CYPRESS_TOUCHKEY=y
CONFIG_INPUT_BOOSTER=y

#
# LCD PANEL INFO
#
CONFIG_PANEL_S6E3HA0_AMS510CW01_WQHD=y

#
# Finger print sensor
#
CONFIG_SENSORS_FINGERPRINT=y
CONFIG_SENSORS_FINGERPRINT_SYSFS=y
CONFIG_SENSORS_VFS61XX=y
CONFIG_SENSORS_VFS61XX_KO=y

# SensorHub
CONFIG_SENSORS_SSP=y
CONFIG_SENSORS_SYSFS=y
CONFIG_SENSORS_SSP_ATMEL=y
CONFIG_SENSORS_SSP_SENSORHUB=y
CONFIG_SENSORS_SSP_FACTORY=y
CONFIG_SENSORS_SSP_MPU6500=y
CONFIG_SENSORS_SSP_LPS25H=y
CONFIG_SENSORS_SSP_YAS532=y
CONFIG_SENSORS_SSP_TMG399X=y
CONFIG_SENSORS_SSP_MOBEAM=y
CONFIG_SENSORS_SSP_ATUC128L5HAR=y
CONFIG_IIO=y
CONFIG_IIO_BUFFER=y
CONFIG_IIO_KFIFO_BUF=y
CONFIG_IIO_TRIGGER=y
CONFIG_SENSORS_SSP_ACC_CHECK=y

# Hrm Sensor
CONFIG_SENSORS_MAX86900=y

#B10
CONFIG_USER_RESET_DEBUG=y

#
# CAMERA
#
CONFIG_S5K2P2XX=y
CONFIG_COMPANION=y
CONFIG_LEDS_MAX77828=y
CONFIG_LEDS_MAX77804K=y
CONFIG_DEBUG_FLASH is not set

CONFIG_LEDS_MAX77828_RGB=y
#CONFIG IR LED
CONFIG_SEC_FPGA_ICE40XX=y
# DMB
CONFIG_TDMB=y
CONFIG_TDMB_VENDOR_FCI=y
CONFIG_TDMB_FC8080=y
CONFIG_TDMB_SPI=y
CONFIG_TDMB_QUALCOMM=y

#HDMI
CONFIG_SEC_MHL_SII8240=y
CONFIG_MHL_VERSION=0x21

#SSR
# CONFIG_SEC_SSR_DEBUG_LEVEL_CHK is not set

CONFIG_LEDS_AN30259A=y

# SSWAP
CONFIG_SWAP=y
CONFIG_FRONTSWAP=y
CONFIG_ZSMALLOC_NEW=y
CONFIG_PGTABLE_MAPPING=y
CONFIG_ZSWAP=y
CONFIG_DIRECT_RECLAIM_FILE_PAGES_ONLY=y
CONFIG_INCREASE_MAXIMUM_SWAPPINESS=y
CONFIG_FIX_INACTIVE_RATIO=y
CONFIG_TIGHT_PGDAT_BALANCE=y
CONFIG_VNSWAP=y
CONFIG_SWAP_ENABLE_READAHEAD=n

#QCOM BLUETOOTH
CONFIG_MSM_BT_POWER=y
# CONFIG_SERIAL_MSM_HS is not set
CONFIG_SERIAL_MSM_HS_LENTIS=y
# CONFIG_BT_BCM4358 is not set

#QCOM WLAN
CONFIG_CFG80211=y
CONFIG_CFG80211_INTERNAL_REGDB=y
CONFIG_CNSS=y
CONFIG_CNSS_MAC_BUG=y
CONFIG_WCNSS_MEM_PRE_ALLOC=y
CONFIG_NET_CORE=y
CONFIG_WIRELESS=y
CONFIG_WIRELESS_EXT_SYSFS=y
CONFIG_WEXT_CORE=y
CONFIG_WEXT_PROC=y
CONFIG_CFG80211=y
CONFIG_CFG80211_DEFAULT_PS=y
CONFIG_CFG80211_WEXT=y
CONFIG_CFG80211_DEFAULT_PS=y
# CONFIG_CFG80211_ALLOW_RECONNECT is not set
CONFIG_WLAN=y
# CONFIG_WIFI_CONTROL_FUNC is not set
# CONFIG_BCM4358 is not set
# CONFIG_BCMDHD_FW_PATH is not set
# CONFIG_BCMDHD_NVRAM_PATH is not set
# CONFIG_BROADCOM_WIFI_RESERVED_MEM is not set
# CONFIG_WLAN_REGION_CODE is not set
# CONFIG_CFG80211_REG_NOT_UPDATED is not set
# CONFIG_WIFI_MULTICAST_LOG is not set
# CONFIG_BCMDHD_PCIE is not set

# Samsung ODE
CONFIG_FORCE_DISABLE_FIPS=y

# CONFIG_TIMA_RKP is not set
# CONFIG_TIMA_RKP_KDATA_PROT is not set
# CONFIG_TIMA_RKP_RO_CRED is not set
# CONFIG_KNOX_KAP is not set
```

## arch/arm/configs/apq8084_sec_lentisqlte_eur_defconfig
```kconfig
# Lentisq PROJECT config
CONFIG_SEC_LENTISQ_PROJECT=y
CONFIG_MACH_LENTISQLTE_EUR=y
#
# MAX77803 IC
#
CONFIG_EXTCON=y
CONFIG_EXTCON_MAX77803=y
CONFIG_MFD_MAX77803=y
CONFIG_MOTOR_DRV_MAX77803=y
CONFIG_SS_VIBRATOR=y
CONFIG_LEDS_MAX77803=y
#
# Battery & Charger
#
# CONFIG_SMB350_CHARGER is not set
# CONFIG_BATTERY_BQ28400 is not set
# CONFIG_BATTERY_MSM is not set
# CONFIG_FUELGAUGE_DUMMY is not set
#
# MAX77803 Charger
#
# CONFIG_QPNP_CHARGER is not set
# CONFIG_QPNP_BMS is not set
CONFIG_FUELGAUGE_MAX17048=y
CONFIG_CHARGER_MAX77803=y
CONFIG_BATTERY_SAMSUNG=y
CONFIG_SAMSUNG_LPM_MODE=y
#
#TSP
#
CONFIG_TOUCHSCREEN_SYNAPTICS_I2C_RMI=y
#
#TOUCHKEY
#
CONFIG_KEYBOARD_CYPRESS_TOUCHKEY_H=y
CONFIG_FB_MSM_MIPI_SAMSUNG_OCTA_CMD_FULL_HD_PT_PANEL=y

#QCOM WLAN
CONFIG_CFG80211=y
CONFIG_CFG80211_INTERNAL_REGDB=y
CONFIG_CNSS=y
CONFIG_CNSS_MAC_BUG=y
CONFIG_WCNSS_MEM_PRE_ALLOC=y
CONFIG_NET_CORE=y
CONFIG_WIRELESS=y
CONFIG_WIRELESS_EXT_SYSFS=y
CONFIG_WEXT_CORE=y
CONFIG_WEXT_PROC=y
CONFIG_CFG80211=y
CONFIG_CFG80211_DEFAULT_PS=y
CONFIG_CFG80211_WEXT=y
CONFIG_CFG80211_DEFAULT_PS=y
# CONFIG_CFG80211_ALLOW_RECONNECT is not set
CONFIG_WLAN=y
# CONFIG_WIFI_CONTROL_FUNC is not set
# CONFIG_BCM4358 is not set
# CONFIG_BCMDHD_FW_PATH is not set
# CONFIG_BCMDHD_NVRAM_PATH is not set
# CONFIG_BROADCOM_WIFI_RESERVED_MEM is not set
# CONFIG_WLAN_REGION_CODE is not set
# CONFIG_CFG80211_REG_NOT_UPDATED is not set
# CONFIG_WIFI_MULTICAST_LOG is not set
# CONFIG_BCMDHD_PCIE is not set
```
