## arch/arm/configs/apq8084_sec_trlte_vzw_defconfig
```kconfig
CONFIG_SEC_TRLTE_PROJECT=y
CONFIG_MACH_TRLTE_VZW=y
#
# MAX77828 IC
#
CONFIG_EXTCON=y
CONFIG_EXTCON_MAX77828=y
CONFIG_MFD_MAX77828=y
CONFIG_EXTCON_MAX77843=y
CONFIG_MFD_MAX77843=y
CONFIG_MUIC_SUPPORT_HMT_DETECTION=y
CONFIG_MUIC_SUPPORT_DESK_DOCK=y
CONFIG_MUIC_SUPPORT_SMART_DOCK=y
CONFIG_MUIC_SUPPORT_QC_CHARGER=y
CONFIG_MUIC_SUPPORT_INCOMPATIBLE_CHARGER=y
CONFIG_MOTOR_DRV_MAX77828=y
CONFIG_MOTOR_DRV_MAX77843=y
CONFIG_SS_VIBRATOR=y
CONFIG_LEDS_MAX77828=y
#
# GPIO EXPANDER
#
CONFIG_GPIO_PCAL6416A=y
#
# Project using Maintenance mode
#
CONFIG_MAINTENANCE_MODE=y
#
# IDCHIP
#
#CONFIG_INPUT_HALLIC=y
CONFIG_SENSORS_HALL=y
CONFIG_W1=y
CONFIG_W1_MASTER_GPIO_MSM=y
CONFIG_W1_SLAVE_DS28EL35=y
CONFIG_W1_WORKQUEUE=y
CONFIG_W1_FAST_CHECK=y
CONFIG_W1_SN=y
#
# Battery & Charger
#
# CONFIG_SMB350_CHARGER is not set
# CONFIG_BATTERY_BQ28400 is not set
# CONFIG_BATTERY_MSM is not set
# CONFIG_FUELGAUGE_DUMMY is not set
#
# MAX77823 Charger
#
# CONFIG_QPNP_CHARGER is not set
# CONFIG_QPNP_BMS is not set
CONFIG_FUELGAUGE_MAX77843=y
CONFIG_FUELGAUGE_MAX77843_COULOMB_COUNTING=y
CONFIG_CHARGER_MAX77843=y
CONFIG_SAMSUNG_LPM_MODE=y
CONFIG_CHARGING_VZWCONCEPT=y
CONFIG_BATTERY_SAMSUNG=y
CONFIG_BATTERY_SAMSUNG_DATA_FILE="tr_battery_data.h"
CONFIG_AFC_CHARGER_MODE=y
#
# NFC
#
CONFIG_NFC_DUAL=y
CONFIG_SEC_NFC_I2C=y
CONFIG_SEC_NFC=y
CONFIG_SEC_NFC_PRODUCT_N5=y
CONFIG_NFC_N5_8084_USE_BBCLK2=y
CONFIG_SEC_NFC_MARGINTIME=y
CONFIG_NFC_PN547=y
CONFIG_NFC_PN547_8084_USE_BBCLK2=y
#
# LCD PANEL INFO
#
CONFIG_PANEL_S6E3HA2_AMS567DJ01_WQHD=y
#
# TSP,Tkey,Wacom
#
# CONFIG_TOUCHSCREEN_SYNAPTICS_I2C_RMI_G is not set
CONFIG_TOUCHSCREEN_STM=y
CONFIG_KEYBOARD_CYPRESS_TOUCHKEY_T=y
CONFIG_INPUT_WACOM=y
CONFIG_INPUT_BOOSTER=y
CONFIG_WACOM_LCD_FREQ_COMPENSATE=y
#
# Finger print sensor
#
CONFIG_SENSORS_FINGERPRINT=y
CONFIG_SENSORS_FINGERPRINT_SYSFS=y
CONFIG_SENSORS_VFS61XX=y
CONFIG_SENSORS_VFS61XX_KO=y

# SensorHub
CONFIG_SENSORS_SSP=y
CONFIG_SENSORS_SYSFS=y
CONFIG_SENSORS_SSP_ATMEL=y
CONFIG_SENSORS_SSP_SENSORHUB=y
CONFIG_SENSORS_SSP_FACTORY=y
CONFIG_SENSORS_SSP_ICM20610=y
CONFIG_SENSORS_SSP_LPS25H=y
CONFIG_SENSORS_SSP_AK09911C=y
CONFIG_SENSORS_SSP_TMG399X=y
CONFIG_SENSORS_SSP_MOBEAM=y
CONFIG_SENSORS_SSP_ATUC128L5HAR=y
CONFIG_IIO=y
CONFIG_IIO_BUFFER=y
CONFIG_IIO_KFIFO_BUF=y
CONFIG_IIO_TRIGGER=y

# Hrm Sensor + UV sensor
CONFIG_SENSORS_MAX86902=y
CONFIG_SENSORS_MAX_NOTCHFILTER=y
CONFIG_SENSORS_ADPD142=y
CONFIG_AVERAGE=y

# Grip sensor
CONFIG_SENSORS_SX9306=y
CONFIG_SENSORS_GRIP_SIMDET=y
CONFIG_SENSORS_SX9306_NORMAL_TOUCH_THRESHOLD=2
CONFIG_SENSORS_SX9306_INIT_TOUCH_THRESHOLD=120
CONFIG_SENSORS_SX9306_TEMPERATURE_COMPENSATION=y

#
# CAMERA
#
CONFIG_S5K2P2XX=y
CONFIG_COMPANION=y
CONFIG_OIS=y
CONFIG_LEDS_MAX77828=y
CONFIG_LEDS_MIC2873=y
CONFIG_DEBUG_FLASH is not set

CONFIG_LEDS_MAX77828_RGB=y
CONFIG_LEDS_MAX77843_RGB=y
#CONFIG IR LED
CONFIG_SEC_FPGA_ICE40XX=y

# Earjack
CONFIG_SAMSUNG_JACK=y
CONFIG_INPUT_GPIO=y

# MHL
CONFIG_SEC_MHL_SII8620=y

# SUB PMIC
CONFIG_REGULATOR_MAX77826=y
CONFIG_REGULATOR_S2MPB01=y

# SSWAP
CONFIG_SWAP=y
CONFIG_FRONTSWAP=y
CONFIG_ZSMALLOC_NEW=y
CONFIG_PGTABLE_MAPPING=y
CONFIG_ZSWAP=y
CONFIG_DIRECT_RECLAIM_FILE_PAGES_ONLY=n
CONFIG_INCREASE_MAXIMUM_SWAPPINESS=y
CONFIG_FIX_INACTIVE_RATIO=y
CONFIG_TIGHT_PGDAT_BALANCE=y
CONFIG_VNSWAP=y
CONFIG_SWAP_ENABLE_READAHEAD=n
# DSM Solution
CONFIG_SND_SOC_MAX98504=y
CONFIG_SND_SOC_MAXIM_DSM=y
#3MIC
CONFIG_SND_SOC_3MIC_SUPPORT=y
# VEQ
CONFIG_SND_SOC_VEQ_SUPPORT=y

#inside secure vpn
CONFIG_VPNCLIENT_SECURITY=y

#EPDG
CONFIG_NET_CORE=y
CONFIG_NET_SCH_PRIO=y
CONFIG_NET_SCHED=y   #depends on CONFIG_NET  which is enabled by default.. coz not seeing in the config file
CONFIG_NET_CLS_BASIC=y # required if basic is being used as a filter. depends on CONFIG_NET_CLS so enabling it by default
CONFIG_NET_CLS=y
CONFIG_NET_CLS_ACT=y # for enabling the action target.
CONFIG_NET_ACT_MIRRED=y  # for enabling the mirred target for redirecting the packet between the devices.
CONFIG_NET_EMATCH=y   #basic uses extended matches so this has to be present
CONFIG_NET_SCH_INGRESS=y # classifier for ingress packet

# Wifi features
CONFIG_WLAN_REGION_CODE=403

# USB
CONFIG_USB_RNDIS_VZW_REQ=y
#MODEM SECURE CHECK
CONFIG_SEC_PERIPHERAL_SECURE_CHK=y
```

## arch/arm/configs/apq8084_sec_userdebug_defconfig
```kconfig
# Overriding the rooting prevention feature as disable on ENG build
# CONFIG_SEC_RESTRICT_ROOTING is not set
# CONFIG_SEC_RESTRICT_SETUID is not set
# CONFIG_SEC_RESTRICT_FORK is not set
# CONFIG_SEC_RESTRICT_ROOTING_LOG is not set

# Disable TIMA Cred for userdebug build
# CONFIG_TIMA_RKP_KDATA_PROT is not set
# CONFIG_TIMA_RKP_RO_CRED is not set

CONFIG_IKCONFIG=y
CONFIG_IKCONFIG_PROC=y
```
