## arch/arm/configs/msm8226-sec_berluti3g_defconfig
```kconfig
#variant defconfig
CONFIG_MACH_BERLUTI3G_EUR=y
CONFIG_MACH_BERLUTI3G_COMMON=y
CONFIG_SEC_BERLUTI_PROJECT=y

#Power Management
CONFIG_SEC_PM=y
CONFIG_SEC_PM_DEBUG=y
#CONFIG_FB_MSM_MDSS_SHARP_HD_PANEL=y
CONFIG_FB_MSM_MIPI_MAGNA_OCTA_VIDEO_720P_PT_PANEL=y
#CONFIG_ESD_ERR_FG_RECOVERY=y
CONFIG_FB_MSM_MDSS=y
CONFIG_FB_MSM_MDSS_WRITEBACK=y
CONFIG_BACKLIGHT_LCD_SUPPORT=y
#CONFIG_MDNIE_TFT_MSM8X26 is not set
CONFIG_LCD_CLASS_DEVICE=y
CONFIG_BACKLIGHT_CLASS_DEVICE=y
#CONFIG_BACKLIGHT_GENERIC is not set

#VIBRATOR
#CONFIG_QPNP_VIBRATOR is not set
#CONFIG_MSM_VIBRATOR is not set
CONFIG_VIBETONZ=y
CONFIG_MOTOR_DRV_DRV2603=y

#TSP
#CONFIG_TOUCHSCREEN_MMS252 is not set
#CONFIG_TOUCHSCREEN_BCMTCH15XXX is not set
#CONFIG_KEYBOARD_CYPRESS_TOUCH is not set
CONFIG_KEYBOARD_CYPRESS_TOUCHKEY_C=y
CONFIG_TOUCHSCREEN_CYTTSP5=y
CONFIG_TOUCHSCREEN_CYTTSP5_DEVICETREE_SUPPORT=y

#SENSOR
CONFIG_STAGING=y
CONFIG_IIO=y
CONFIG_IIO_BUFFER=y
CONFIG_IIO_SW_RING=y
CONFIG_IIO_KFIFO_BUF=y
CONFIG_INV_MPU_IIO_PRIMARY=y
# CONFIG_INV_TESTING is not set
CONFIG_SENSORS=y
CONFIG_SENSORS_AK09911C=y
CONFIG_SENSORS_GP2A030A=y
CONFIG_SENSORS_GP2A030A_PROX=y

CONFIG_INPUT_POLLDEV=y
CONFIG_INPUT=y
CONFIG_INPUT_GPIO=y
CONFIG_SENSORS_HALL=y

#CAMERA
CONFIG_MSM_CPP=y
CONFIG_S5K4H5YB=y
CONFIG_S5K8B1YX=y

#USB
CONFIG_USB_ANDROID_SAMSUNG_COMPOSITE=y
CONFIG_USB_ANDROID_SAMSUNG_MTP=y
CONFIG_USB_DUN_SUPPORT=y
CONFIG_USB_ANDROID_SAMSUNG_SIDESYNC=y

#USB Host
CONFIG_USB_HOST_NOTIFY=y
CONFIG_USB_STORAGE_DETECT=y
CONFIG_USB_NET_SMSC75XX=y
CONFIG_USB_NET_SMSC95XX=y

#MUIC
#CONFIG_MFD_MAX77693=y
#CONFIG_USB_SWITCH_MAX77693=y
#CONFIG_REGULATOR_MAX77693=y
#CONFIG_DI_MUIC=n
#CONFIG_MUIC_INIT_DETECT_DELAY=3000
#CONFIG_MUIC_USB_DETECT_DELAY=17000
#CONFIG_USB_SWITCH_TSU6721=y
#CONFIG_SM5502_MUIC=y
CONFIG_USB_SWITCH_FSA9485=y

# IRDA support
CONFIG_IR_REMOCON_MC96=y

#Battery charging & BMS
CONFIG_QPNP_SEC_CHARGER=y
CONFIG_BATTERY_BCL=y
CONFIG_QPNP_BMS=y

#BT
no need

#Sec Thermistor
CONFIG_SEC_THERMISTOR=y

#Wifi
no need


# Earjack
CONFIG_SAMSUNG_JACK=y

# CODEC
#CONFIG_SND_SOC_MAX98504 is not set

# GPIO DVS
#CONFIG_SEC_GPIO_DVS is not set
# DHA Solution
#CONFIG_SEC_DHA_SOL_MAL is not set

# NFC
#CONFIG_NFC_DEVICES=y
CONFIG_SEC_NFC=y
CONFIG_SEC_NFC_IF_I2C=y
CONFIG_SEC_NFC_PRODUCT_N5=y
CONFIG_SEC_NFC_CLK_REQ=y
CONFIG_SEC_NFC_USE_8226_RFCLK2=y
```
