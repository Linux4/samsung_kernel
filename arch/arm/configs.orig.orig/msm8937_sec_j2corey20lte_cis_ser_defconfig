## arch/arm/configs/k39tv1_bsp_titan_hamster_debug_defconfig
```kconfig
CONFIG_CROSS_COMPILE="arm-eabi-"
# CONFIG_FHANDLE is not set
CONFIG_IKHEADERS=m
CONFIG_LOG_BUF_SHIFT=19
CONFIG_UCLAMP_TASK=y
CONFIG_UCLAMP_GROUPS_COUNT=16
CONFIG_UCLAMP_MAP_OPP=y
CONFIG_UCLAMP_TASK_GROUP=y
CONFIG_CPUSETS=y
CONFIG_SCHED_TUNE=y
CONFIG_PELT_UTIL_HALFLIFE_16=y
CONFIG_DEFAULT_USE_ENERGY_AWARE=y
# CONFIG_RD_BZIP2 is not set
# CONFIG_RD_LZMA is not set
# CONFIG_RD_XZ is not set
# CONFIG_RD_LZO is not set
# CONFIG_RD_LZ4 is not set
CONFIG_CC_OPTIMIZE_FOR_SIZE=y
CONFIG_SYSCTL_SYSCALL=y
CONFIG_CC_STACKPROTECTOR_STRONG=y
# CONFIG_BLK_DEV_BSG is not set
CONFIG_BLK_INLINE_ENCRYPTION=y
CONFIG_BLK_INLINE_ENCRYPTION_FALLBACK=y
CONFIG_MACH_MT6739=y
CONFIG_SMP=y
CONFIG_SCHED_MC=y
CONFIG_HAVE_ARM_ARCH_TIMER=y
CONFIG_ARM_PSCI=y
CONFIG_PREEMPT=y
CONFIG_HIGHMEM=y
# CONFIG_HIGHPTE is not set
CONFIG_ARM_MODULE_PLTS=y
CONFIG_KSM=y
CONFIG_ZSMALLOC=y
# CONFIG_BUILD_ARM_APPENDED_DTB_IMAGE is not set
# CONFIG_BUILD_ARM_APPENDED_DTB_IMAGE_NAMES is not set
# CONFIG_BUILD_ARM_DTB_OVERLAY_IMAGE is not set
# CONFIG_BUILD_ARM_DTB_OVERLAY_IMAGE_NAMES is not set
CONFIG_CMDLINE="console=tty0 console=ttyMT3,921600n1 root=/dev/ram vmalloc=496M slub_max_order=0 slub_debug=O "
CONFIG_CPU_FREQ=y
CONFIG_CPU_FREQ_DEFAULT_GOV_SCHEDUTIL=y
CONFIG_CPU_FREQ_GOV_POWERSAVE=y
CONFIG_CPU_FREQ_GOV_USERSPACE=y
CONFIG_CPU_FREQ_GOV_ONDEMAND=y
CONFIG_CPU_FREQ_LIMIT=y
CONFIG_VFP=y
CONFIG_NEON=y
# CONFIG_CORE_DUMP_DEFAULT_ELF_HEADERS is not set
CONFIG_WQ_POWER_EFFICIENT_DEFAULT=y
CONFIG_XFRM_MIGRATE=y
CONFIG_IP_PNP=y
CONFIG_IP_PNP_DHCP=y
CONFIG_IP_PNP_BOOTP=y
CONFIG_NET_IPIP=y
CONFIG_IP_MROUTE=y
CONFIG_IP_MROUTE_MULTIPLE_TABLES=y
CONFIG_IP_PIMSM_V1=y
CONFIG_IP_PIMSM_V2=y
CONFIG_SYN_COOKIES=y
CONFIG_INET_AH=y
CONFIG_INET_IPCOMP=y
CONFIG_INET6_AH=y
CONFIG_INET6_XFRM_MODE_ROUTEOPTIMIZATION=y
CONFIG_IPV6_SIT_6RD=y
CONFIG_IPV6_SUBTREES=y
CONFIG_IPV6_MROUTE=y
CONFIG_IPV6_PIMSM_V2=y
CONFIG_BRIDGE_NETFILTER=y
CONFIG_NETFILTER_XT_MATCH_CONNBYTES=y
CONFIG_NETFILTER_XT_MATCH_MULTIPORT=y
CONFIG_NETFILTER_XT_MATCH_PHYSDEV=y
CONFIG_NETFILTER_XT_MATCH_REALM=y
CONFIG_NETFILTER_XT_MATCH_RECENT=y
CONFIG_NETFILTER_XT_MATCH_TCPMSS=y
CONFIG_IP_NF_MATCH_AH=y
CONFIG_IP6_NF_MATCH_FRAG=y
CONFIG_IP6_NF_MATCH_IPV6HEADER=y
CONFIG_IP6_NF_TARGET_HL=y
CONFIG_BRIDGE=y
CONFIG_VLAN_8021Q=y
CONFIG_NET_CLS_FW=y
CONFIG_CLS_U32_PERF=y
CONFIG_CLS_U32_MARK=y
CONFIG_NET_CLS_FLOW=y
CONFIG_NET_ACT_POLICE=y
CONFIG_NET_ACT_MIRRED=y
CONFIG_NET_ACT_IPT=y
CONFIG_NET_CLS_IND=y
CONFIG_CFG80211=y
CONFIG_NL80211_TESTMODE=y
CONFIG_CFG80211_DEVELOPER_WARNINGS=y
# CONFIG_CFG80211_DEFAULT_PS is not set
CONFIG_CFG80211_DEBUGFS=y
CONFIG_CFG80211_INTERNAL_REGDB=y
CONFIG_MTK_NET_LOGGING=y
# CONFIG_UEVENT_HELPER is not set
CONFIG_EXTRA_FIRMWARE="tsp_novatek/nt36525_a02_csot.bin"
CONFIG_EXTRA_FIRMWARE_DIR="firmware"
CONFIG_ZRAM=y
CONFIG_BLK_DEV_LOOP_MIN_COUNT=16
CONFIG_MEDIATEK_SOLUTION=y
CONFIG_MTK_PLATFORM="mt6739"
CONFIG_ARCH_MTK_PROJECT="k39tv1_bsp_titan_hamster"
CONFIG_MTK_ENG_BUILD=y
CONFIG_MTK_GPT_SCHEME_SUPPORT=y
CONFIG_MTK_PMIC_NEW_ARCH=y
CONFIG_MTK_PMIC_COMMON=y
CONFIG_MTK_PMIC_CHIP_MT6357=y
CONFIG_MTK_AUXADC_INTF=y
CONFIG_MTK_PMIC_WRAP_HAL=y
CONFIG_MTK_STATIC_POWER=y
CONFIG_MTK_UNIFY_POWER=y
CONFIG_MTK_THERMAL_PA_VIA_ATCMD=y
CONFIG_MTK_THERMAL_FIX_VALUE=y
CONFIG_CUSTOM_KERNEL_IMGSENSOR="gc5035_mipi_raw imx258_mipi_raw gc02m1_mipi_raw"
CONFIG_CUSTOM_KERNEL_CAM_CAL_DRV="BRCB032GWZ_3 GT24c32a cat24c16"
CONFIG_MTK_S2MU005_FLASHLIGHT=y
# CONFIG_MTK_CAMERA_ISP is not set
CONFIG_MTK_CAM_CAL=y
CONFIG_MTK_CMDQ_V3=y
CONFIG_MTK_CMDQ=y
CONFIG_MTK_IMGSENSOR=y
CONFIG_IMGSENSOR_SYSFS=y
CONFIG_MTK_JPEG=y
CONFIG_MTK_SMI_EXT=y
CONFIG_MTK_LCM=y
CONFIG_CUSTOM_KERNEL_LCM="nt36525b_hdp_dsi_vdo_lm36274"
CONFIG_MTK_FB=y
CONFIG_MTK_LCM_PHYSICAL_ROTATION="0"
CONFIG_LCM_HEIGHT="1600"
CONFIG_LCM_WIDTH="720"
# CONFIG_MMPROFILE is not set
CONFIG_MTK_SENSOR_SUPPORT=y
CONFIG_MTK_SENSOR_ARCHITECTURE="1.0"
CONFIG_CUSTOM_KERNEL_ACCELEROMETER=y
CONFIG_MTK_MC3410_I2C=y
CONFIG_CUSTOM_KERNEL_ALSPS=y
CONFIG_MTK_CM36558=y
CONFIG_CUSTOM_KERNEL_GYROSCOPE=y
CONFIG_MTK_ITG1010=y
CONFIG_CUSTOM_KERNEL_MAGNETOMETER=y
CONFIG_MTK_AKM09918=y
CONFIG_MTK_HWMON=y
CONFIG_CUSTOM_KERNEL_BAROMETER=y
CONFIG_MTK_BMP280_NEW=y
CONFIG_MTK_COMBO=y
CONFIG_MTK_COMBO_CHIP_CONSYS_6739=y
CONFIG_MTK_COMBO_BT=y
CONFIG_MTK_COMBO_GPS=y
CONFIG_MTK_COMBO_WIFI=y
CONFIG_MTK_DHCPV6C_WIFI=y
CONFIG_MTK_GPS_SUPPORT=y
CONFIG_MTK_FMRADIO=y
CONFIG_MTK_FM_CHIP="MT6625_FM"
CONFIG_MTK_MD1_SUPPORT=9
CONFIG_MTK_ECCCI_DRIVER=y
CONFIG_MTK_ECCCI_C2K=y
CONFIG_MTK_SRIL_SUPPORT=y 
CONFIG_DEV_RIL_BRIDGE=y 
CONFIG_MTK_BTIF=y
CONFIG_MTK_ACCDET=y
CONFIG_ACCDET_EINT_IRQ=y
CONFIG_ACCDET_SUPPORT_EINT0=y
CONFIG_MTK_DRAMC=y
CONFIG_MTK_EMI_BWL=y
CONFIG_MTK_EMI_MPU=y
CONFIG_MTK_AUXADC=y
CONFIG_MTK_LENS=y
CONFIG_MTK_FLASHLIGHT=y
CONFIG_MTK_FLASHLIGHT_RT4505=y
CONFIG_MTK_FLASHLIGHT_PT=y
CONFIG_MTK_FLASHLIGHT_PT_STRICT=y
CONFIG_MTK_FLASHLIGHT_DLPT=y
CONFIG_MTK_LEDS=y
CONFIG_MTK_PWM=y
CONFIG_MTK_CHIP=y
CONFIG_MTK_IDLE_BALANCE_ENHANCEMENT=y
CONFIG_MTK_SCHED_EAS_POWER_SUPPORT=y
CONFIG_SCHED_HMP=y
CONFIG_MTK_SCHED_RQAVG_KS=y
CONFIG_MTK_SCHED_RQAVG_US=y
CONFIG_MTK_SCHED_CPULOAD=y
CONFIG_MTK_RT_THROTTLE_MON=y
CONFIG_MTK_SERIAL=y
CONFIG_USB_MTK_HDRC=y
CONFIG_MTK_MUSB_QMU_SUPPORT=y
CONFIG_MTK_MUSB_QMU_PURE_ZLP_SUPPORT=y
CONFIG_USB_MTK_OTG=y
CONFIG_MTK_RAM_CONSOLE=y
CONFIG_MTK_AEE_FEATURE=y
CONFIG_MTK_AEE_MRDUMP=y
CONFIG_MTK_RTC=y
CONFIG_RT_REGMAP=y
# CONFIG_MTK_LOAD_TRACKER=y
# CONFIG_MTK_CPU_CTRL_CFP=y
CONFIG_MTK_LOWMEM_HINT=y
CONFIG_MTPROF=y
CONFIG_MTK_SCHED_MONITOR=y
CONFIG_MTK_WQ_DEBUG=y
CONFIG_MTK_IRQ_COUNT_TRACER=y
CONFIG_MTK_IRQ_OFF_TRACER=y
CONFIG_MTK_PREEMPT_TRACER=y
CONFIG_ANDROID_DEFAULT_SETTING=y
CONFIG_MTK_ANDROID_DEFAULT_SETTING=y
CONFIG_MTK_TIMER_TIMESYNC=y
CONFIG_MTK_TC10_FEATURE=y
CONFIG_MTK_FREQ_HOPPING=y
CONFIG_MTK_GPU_SUPPORT=y
CONFIG_MTK_GPU_VERSION="rgx auckland 1.8ED"
CONFIG_MTK_GPU_COMMON_DVFS_SUPPORT=y
CONFIG_MTK_VIBRATOR=y
CONFIG_MTK_SYNC=y
CONFIG_MTK_VIDEOCODEC_DRIVER=y
CONFIG_MTK_DRAM_LOG_STORE=y
CONFIG_MTK_DRAM_LOG_STORE_ADDR=0x0010E900
CONFIG_MTK_DRAM_LOG_STORE_SIZE=0x100
CONFIG_BATTERY_SAMSUNG=y
CONFIG_BATTERY_SAMSUNG_V2=y
CONFIG_SCSI=y
CONFIG_BLK_DEV_SD=y
CONFIG_SCSI_SCAN_ASYNC=y
# CONFIG_SCSI_LOWLEVEL is not set
CONFIG_BLK_DEV_DM=y
# CONFIG_DM_DEBUG is not set
CONFIG_DM_CRYPT=y
CONFIG_DM_DEFAULT_KEY=y
CONFIG_DM_UEVENT=y
CONFIG_DM_VERITY_FEC=y
CONFIG_DM_ANDROID_VERITY_AT_MOST_ONCE_DEFAULT_ENABLED=y
CONFIG_DM_BOW=y
CONFIG_IFB=y
# CONFIG_ETHERNET is not set
CONFIG_PPP_FILTER=y
CONFIG_PPP_MULTILINK=y
CONFIG_PPPOE=y
CONFIG_PPP_ASYNC=y
CONFIG_PPP_SYNC_TTY=y
CONFIG_KEYBOARD_MTK=y
CONFIG_TWOKEY_REBOOT_NORMAL_MODE=y
CONFIG_TWOKEY_REBOOT_OTHER_MODE=y
CONFIG_KPD_PWRKEY_USE_PMIC=y
# CONFIG_INPUT_MOUSE is not set
CONFIG_INPUT_TOUCHSCREEN=y
CONFIG_SEC_DEBUG_TSP_LOG=y
# CONFIG_TOUCHSCREEN_PHYSICAL_ROTATION_WITH_LCM is not set
CONFIG_TOUCHSCREEN_NT36xxx_HOSTDL_SPI_A02C=y
CONFIG_INPUT_MISC=y
CONFIG_INPUT_UINPUT=y
# CONFIG_VT is not set
CONFIG_LEGACY_PTY_COUNT=16
# CONFIG_DEVMEM is not set
CONFIG_I2C_MTK=y
CONFIG_SPI=y
CONFIG_SPI_MT65XX=y
CONFIG_HWMON=y
CONFIG_THERMAL=y
CONFIG_THERMAL_DEFAULT_GOV_BACKWARD_COMPATIBLE=y
CONFIG_WATCHDOG=y
CONFIG_WATCHDOG_CORE=y
CONFIG_SOFT_WATCHDOG=y
CONFIG_SEC_DEBUG_SOFTDOG_PWDT=y
CONFIG_MTK_WATCHDOG_COMMON=y
CONFIG_MTK_WATCHDOG_COMMON_V2=y
CONFIG_MFD_MT6358=y
CONFIG_REGULATOR=y
CONFIG_MEDIA_SUPPORT=y
CONFIG_MEDIA_CAMERA_SUPPORT=y
CONFIG_MEDIA_USB_SUPPORT=y
CONFIG_USB_VIDEO_CLASS=y
CONFIG_DRM=y
CONFIG_FB_MODE_HELPERS=y
CONFIG_FB_TILEBLITTING=y
CONFIG_SOUND=y
CONFIG_SND=y
CONFIG_SND_HRTIMER=y
CONFIG_SND_DYNAMIC_MINORS=y
CONFIG_SND_SEQUENCER=y
CONFIG_SND_SEQ_DUMMY=y
# CONFIG_SND_SPI is not set
CONFIG_SND_USB_AUDIO=y
CONFIG_SND_SOC=y
CONFIG_MTK_SND_SOC_CODEC="mt6357"
CONFIG_SND_SOC_MTK_BTCVSD=y
CONFIG_MTK_SND_SOC_NEW_ARCH=y
CONFIG_HIDRAW=y
CONFIG_HID_A4TECH=y
CONFIG_HID_APPLE=y
CONFIG_HID_BELKIN=y
CONFIG_HID_CHERRY=y
CONFIG_HID_CHICONY=y
CONFIG_HID_CYPRESS=y
CONFIG_HID_DRAGONRISE=y
CONFIG_HID_EZKEY=y
CONFIG_HID_KYE=y
CONFIG_HID_GYRATION=y
CONFIG_HID_TWINHAN=y
CONFIG_HID_KENSINGTON=y
CONFIG_HID_LOGITECH=y
CONFIG_HID_MAGICMOUSE=y
CONFIG_HID_MICROSOFT=y
CONFIG_HID_MONTEREY=y
CONFIG_HID_PANTHERLORD=y
CONFIG_HID_PETALYNX=y
CONFIG_HID_SAMSUNG=y
CONFIG_HID_SUNPLUS=y
CONFIG_HID_GREENASIA=y
CONFIG_HID_SMARTJOYPLUS=y
CONFIG_HID_TOPSEED=y
CONFIG_HID_THRUSTMASTER=y
CONFIG_HID_ZEROPLUS=y
CONFIG_USB_HIDDEV=y
CONFIG_HID_ELECOM=y
CONFIG_HID_SPEEDLINK=y
CONFIG_HID_TIVO=y
CONFIG_HID_ORTEK=y
CONFIG_HID_PRIMAX=y
CONFIG_HID_SAITEK=y
CONFIG_HID_ROCCAT=y
CONFIG_HID_HOLTEK=y
CONFIG_HID_PRODIKEYS=y
CONFIG_HID_PICOLCD=y
CONFIG_HID_ZYDACRON=y
CONFIG_HID_ACRUX=y
CONFIG_HID_ACRUX_FF=y
CONFIG_HID_WIIMOTE=y
CONFIG_HID_WACOM=y
CONFIG_HID_NTRIG=y
CONFIG_HID_LCPOWER=y
CONFIG_HID_KEYTOUCH=y
CONFIG_HID_UCLOGIC=y
CONFIG_HID_WALTOP=y
CONFIG_HID_EMS_FF=y
CONFIG_HID_LOGITECH_DJ=y
CONFIG_TABLET_USB_GTCO=y
CONFIG_TABLET_USB_HANWANG=y
CONFIG_TABLET_USB_KBTAB=y
CONFIG_TABLET_USB_WACOM=y
CONFIG_TABLET_USB_AIPTEK=y
CONFIG_TABLET_USB_ACECAD=y
CONFIG_INPUT_TABLET=y
CONFIG_INPUT_JOYSTICK=y
CONFIG_JOYSTICK_XPAD=y
CONFIG_JOYSTICK_XPAD_FF=y
CONFIG_JOYSTICK_XPAD_LEDS=y
CONFIG_USB_BELKIN=y
CONFIG_SMARTJOYPLUS_FF=y
CONFIG_GREENASIA_FF=y
CONFIG_LOGITECH_FF=y
CONFIG_DRAGONRISE_FF=y
CONFIG_SONY_FF=y
CONFIG_LOGIRUMBLEPAD2_FF=y
CONFIG_USB_ARMLINUX=y
CONFIG_LOGIG940_FF=y
CONFIG_PANTHERLORD_FF=y
CONFIG_USB_PRINTER=y
CONFIG_USB_ACM=y
CONFIG_USB_USBNET=y
CONFIG_USB_NET_SMSC95XX=y
CONFIG_USB_NET_CDCETHER=y
CONFIG_USB_NET_CDC_NCM=y
CONFIG_USB_NET_CDC_EEM=y
CONFIG_USB_NET_CDC_MBIM=y
CONFIG_USB_NET_CDC_SUBSET=y
CONFIG_USB_NET_ZAURUS=y
CONFIG_USB_NET_AX88179_178A=y
CONFIG_USB_NET_SMSC75XX=y
CONFIG_USB_NET_NET1080=y
CONFIG_USB_RTL8150=y
CONFIG_USB_NET_AX8817X=y
CONFIG_USB=y
CONFIG_USB_STORAGE=y
CONFIG_USB_STORAGE_DATAFAB=y
CONFIG_USB_STORAGE_FREECOM=y
CONFIG_USB_STORAGE_ISD200=y
CONFIG_USB_STORAGE_USBAT=y
CONFIG_USB_STORAGE_SDDR09=y
CONFIG_USB_STORAGE_SDDR55=y
CONFIG_USB_STORAGE_JUMPSHOT=y
CONFIG_USB_STORAGE_ALAUDA=y
CONFIG_USB_STORAGE_ONETOUCH=y
CONFIG_USB_STORAGE_KARMA=y
CONFIG_USB_STORAGE_CYPRESS_ATACB=y
CONFIG_USB_SERIAL=y
CONFIG_USB_TRANCEVIBRATOR=y
CONFIG_NOP_USB_XCEIV=y
CONFIG_USB_GADGET_VBUS_DRAW=500
CONFIG_USB_CONFIGFS_SERIAL=y
CONFIG_USB_CONFIGFS_ACM=y
CONFIG_USB_CONFIGFS_RNDIS=y
CONFIG_USB_CONFIGFS_F_HID=y
CONFIG_USB_CONFIGFS_F_DM=y
CONFIG_USB_CONFIGFS_UEVENT=y
CONFIG_USB_CONFIGFS_F_FS=y
CONFIG_USB_CONFIGFS_F_CONN_GADGET=y
CONFIG_USB_CONFIGFS_F_MTP=y
CONFIG_USB_CONFIGFS_F_PTP=y
CONFIG_USB_CONFIGFS_F_ACC=y
CONFIG_USB_CONFIGFS_F_AUDIO_SRC=y
CONFIG_USB_CONFIGFS_F_MIDI=y
# CONFIG_USB_G_ANDROID is not set
CONFIG_USB_ANDROID_SAMSUNG_COMPOSITE=y
CONFIG_USB_NOTIFY_LAYER=y
CONFIG_USB_HOST_NOTIFY=y
CONFIG_USB_NOTIFIER=y
CONFIG_USB_DEBUG_DETAILED_LOG=y
CONFIG_USB_STORAGE_DETECT=y
CONFIG_USB_HW_PARAM=y
CONFIG_USB_ANNOUNCE_NEW_DEVICES=y
CONFIG_USB_NOTIFY_PROC_LOG=y
CONFIG_MMC=y
CONFIG_MMC_BLOCK_MINORS=32
CONFIG_MMC_BLOCK_DEFERRED_RESUME=y
CONFIG_MMC_MTK_PRO=y
CONFIG_MTK_EMMC_SUPPORT=y
CONFIG_MTK_EMMC_CACHE=y
CONFIG_NEW_LEDS=y
CONFIG_LEDS_CLASS=y
CONFIG_LEDS_TRIGGERS=y
CONFIG_LEDS_TRIGGER_TIMER=y
CONFIG_SW_SYNC=y
CONFIG_ANDROID_INTF_ALARM_DEV=y
CONFIG_ION=y
CONFIG_MTK_ION=y
CONFIG_MAILBOX=y
CONFIG_MTK_CMDQ_MBOX=y
CONFIG_MTK_PMIC_WRAP=y
CONFIG_IIO=y
CONFIG_MT635X_AUXADC=y
CONFIG_BATTERY_SWELLING=y
CONFIG_FUELGAUGE_S2MU005=y
CONFIG_CHARGER_S2MU005=y
CONFIG_QUOTA_NETLINK_INTERFACE=y
CONFIG_INCREMENTAL_FS=y
CONFIG_ISO9660_FS=y
CONFIG_JOLIET=y
CONFIG_ZISOFS=y
CONFIG_MSDOS_FS=y
CONFIG_VFAT_FS=y
CONFIG_TMPFS=y
CONFIG_SDCARD_FS=y
CONFIG_PSTORE=y
CONFIG_PSTORE_CONSOLE=y
CONFIG_PSTORE_PMSG=y
CONFIG_PSTORE_RAM=y
# CONFIG_NETWORK_FILESYSTEMS is not set
CONFIG_NLS_CODEPAGE_437=y
CONFIG_NLS_CODEPAGE_950=y
CONFIG_NLS_ASCII=y
CONFIG_NLS_ISO8859_1=y
CONFIG_NLS_UTF8=y
CONFIG_PRINTK_TIME=y
CONFIG_DYNAMIC_DEBUG=y
CONFIG_DEBUG_INFO=y
CONFIG_FRAME_WARN=1500
CONFIG_PAGE_OWNER=y
CONFIG_SLUB_DEBUG_ON=y
CONFIG_DEBUG_KMEMLEAK=y
CONFIG_DEBUG_KMEMLEAK_EARLY_LOG_SIZE=3200
CONFIG_DEBUG_KMEMLEAK_DEFAULT_OFF=y
# CONFIG_DEBUG_VIRTUAL is not set
CONFIG_PANIC_ON_OOPS=y
CONFIG_PANIC_TIMEOUT=5
CONFIG_SCHEDSTATS=y
# CONFIG_PROVE_LOCKING is not set
# CONFIG_DEBUG_LOCKDEP is not set
CONFIG_DEBUG_ATOMIC_SLEEP=y
CONFIG_RCU_CPU_STALL_TIMEOUT=60
# CONFIG_RCU_TRACE is not set
CONFIG_FAULT_INJECTION=y
# CONFIG_MTK_FTRACE_DEFAULT_ENABLE is not set
# CONFIG_DMA_API_DEBUG is not set
# CONFIG_KGDB is not set
# CONFIG_KGDB_KDB is not set
# CONFIG_ARM_UNWIND is not set
CONFIG_STATIC_USERMODEHELPER_PATH="/system_ext/bin/aee_core_forwarder"
CONFIG_CRYPTO_TWOFISH=y

# SEC_PARAM
CONFIG_CM_OFFSET=3146292
# FMM
CONFIG_FMM_LOCK_OFFSET=3146356

# LCD
CONFIG_SMCDSD_LCD_DEBUG=y

# BATTERY
CONFIG_ENG_BATTERY_CONCEPT=y

# CONFIG_CRYPTO_HW is not set
CONFIG_CRYPTO_SHA512_ARM=y
# TEEgris
CONFIG_TZDEV_USE_ARM_CALLING_CONVENTION=y
CONFIG_TZDEV=y
CONFIG_TZDEV_BOOST=y
CONFIG_TZDEV_IWI_EVENT=224
CONFIG_TZDEV_IWI_PANIC=225
CONFIG_TZDEV_KTHREADS_SMPBOOT=y
CONFIG_TZDEV_PAGE_MIGRATION=y
CONFIG_TZDEV_SK_MULTICORE=y
CONFIG_TZIRS=y
CONFIG_TZLOG=y
CONFIG_TZLOG_PG_CNT=8
CONFIG_TZ_BOOT_LOG=y
CONFIG_TZ_BOOT_LOG_PG_CNT=1
CONFIG_TZ_TRANSPORT=y
CONFIG_TZ_TRANSPORT_PG_CNT=2
CONFIG_TZDEV_SWD_PANIC_IS_CRITICAL=y
CONFIG_TEEGRIS_VERSION=4
CONFIG_TEEGRIS_TEE_SUPPORT=y

# Enable SEC_PM Feature
CONFIG_SEC_PM=y
CONFIG_SENSORS_SEC_THERMISTOR=y
CONFIG_SEC_GPIO_DVS=y
CONFIG_FOTA_LIMIT=y

# [ SEC_SELINUX_PORTING_COMMON
CONFIG_EXT4_FS_XATTR=y
CONFIG_EXT4_FS_SECURITY=y
CONFIG_JOURNAL_DATA_TAG=y
CONFIG_AUDIT=y
CONFIG_LSM_MMAP_MIN_ADDR=4096
CONFIG_SECURITY_SELINUX=y
CONFIG_SECURITY_SELINUX_DEVELOP=y
CONFIG_DEFAULT_SECURITY_SELINUX=y
CONFIG_NETFILTER_ADVANCED=y
CONFIG_NETFILTER_XT_TARGET_LOG=y
CONFIG_AUDITSYSCALL=y
CONFIG_PROC_AVC=y
CONFIG_SDCARD_FS_XATTR=y
CONFIG_ECRYPT_FS_VIRTUAL_FAT_XATTR=y
CONFIG_FAT_VIRTUAL_XATTR=y
CONFIG_EXFAT_VIRTUAL_XATTR=y
# ] SEC_SELINUX_PORTING_COMMON

# SPU SIGN VERIFY
CONFIG_CRYPTO_RSA=y
CONFIG_SPU_VERIFY=y
CONFIG_ASYMMETRIC_KEY_TYPE=y
CONFIG_ASYMMETRIC_PUBLIC_KEY_SUBTYPE=y

# Samsung ODE and Sd Card Encryption
CONFIG_KEYS=y
# CONFIG_KEYS_DEBUG_PROC_KEYS is not set
CONFIG_CRYPTO=y
CONFIG_CRYPTO_AES=y
CONFIG_CRYPTO_CBC=y
CONFIG_CRYPTO_SHA1=y
CONFIG_CRYPTO_SHA256=y
# CONFIG_FS_CRYPTO_SEC_EXTENSION is not set
CONFIG_ECRYPT_FS=y
CONFIG_WTL_ENCRYPTION_FILTER=y
CONFIG_KEYS_DEBUG_PROC_KEYS=y
CONFIG_ECRYPTFS_FEK_INTEGRITY=y

# CONFIG_SEC_DEBUG_EXTRA_INFO is not set
# CONFIG_SEC_DEBUG_HW_PARAM is not set
# CONFIG_SEC_DEBUG_INIT_LOG is not set
# EPDG
CONFIG_NET_SCH_PRIO=y
CONFIG_NET_CLS_BASIC=y
```

## arch/arm/configs/lego_defconfig
```kconfig
CONFIG_CHARGER_S2MU005=y
CONFIG_LSI_IFPMIC=y
CONFIG_S2MU005_INNER_BATTERY=y
CONFIG_S2MU005_DISABLE_BUCK_MODE=y
CONFIG_SEC_VIBRATOR=y
CONFIG_SEC_VIB_NOTIFIER=y
# CONFIG_SECURITY_DSMS is not set
CONFIG_SEC_ABC=y
CONFIG_SEC_ABC_HUB=y
CONFIG_SEC_ABC_COMMON=y
# CONFIG_SEC_ABC_MOTTO is not set
CONFIG_SEC_ABC_HUB_CORE=y
# CONFIG_SEC_ABC_HUB_COND is not set
CONFIG_SEC_ABC_HUB_BOOTC=y
CONFIG_SEC_STI=y
CONFIG_MUIC_S2MU005=y
CONFIG_SEC_INPUT_BOOSTER=y
CONFIG_SEC_INPUT_BOOSTER_MTK=y
CONFIG_USE_MUIC=y
CONFIG_MUIC_NOTIFIER=y
CONFIG_VBUS_NOTIFIER=y
CONFIG_MUIC_MANAGER=y
CONFIG_SEC_DETECT_CONN=y
CONFIG_QCOM_SEC_DETECT=m
CONFIG_SENSORS_SEC_THERMISTOR=y
CONFIG_MFD_S2MU005=y
CONFIG_FUELGAUGE_S2MU005=y
CONFIG_S2MU005_VOLT_MODE_TUNING=y
CONFIG_BATTERY_SAMSUNG=y
CONFIG_BATTERY_AGE_FORECAST=y
CONFIG_BATTERY_CISD=y
CONFIG_BATTERY_NOTIFIER=y
CONFIG_DC_VIBRATOR=y
# CONFIG_MTK_VIBRATOR is not set
```
