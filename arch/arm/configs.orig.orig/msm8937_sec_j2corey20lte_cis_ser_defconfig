## arch/arm/configs/msm8226-sec_millet3g_defconfig
```kconfig
#variant defconfig
CONFIG_MACH_MILLET3G_EUR=y
CONFIG_SEC_MILLET_PROJECT=y

#Power Management
CONFIG_SEC_PM=y
CONFIG_SEC_PM_DEBUG=y
CONFIG_SAMSUNG_DEBUG_DISPLAY=y
#CONFIG_FB_MSM_MDSS_SHARP_HD_PANEL=y
CONFIG_FB_MSM_MDSS_SDC_WXGA_PANEL=y
CONFIG_FB_MSM8x26_MDSS_CHECK_LCD_CONNECTION=y
CONFIG_ESD_ERR_FG_RECOVERY=y
CONFIG_FB_MSM_MDSS=y
CONFIG_FB_MSM_MDSS_WRITEBACK=y
CONFIG_BACKLIGHT_LCD_SUPPORT=y
CONFIG_MDNIE_TFT_MSM8X26=y
CONFIG_LCD_CLASS_DEVICE=y
CONFIG_BACKLIGHT_CLASS_DEVICE=y
# CONFIG_BACKLIGHT_GENERIC is not set

#VIBRATOR
#CONFIG_QPNP_VIBRATOR is not set
CONFIG_MSM_VIBRATOR=y

#TSP
CONFIG_TOUCHSCREEN_MMS252=y
#CONFIG_TOUCHSCREEN_BCMTCH15XXX is not set
#CONFIG_KEYBOARD_CYPRESS_TOUCH is not set

#SENSOR
CONFIG_SENSORS=y
CONFIG_SENSORS_K2HH=y
CONFIG_SENSORS_SX9500=y
CONFIG_SENSORS_SX9500_INIT_TOUCH_THRESHOLD=2000
CONFIG_SENSORS_SX9500_NORMAL_TOUCH_THRESHOLD=15

CONFIG_INPUT=y
CONFIG_INPUT_GPIO=y
CONFIG_SENSORS_HALL=y

#CAMERA
CONFIG_MSM_CPP=y
#CONFIG_S5K3H5XA=y
#CONFIG_S5K4H5YB=y
#CONFIG_S5K6A3YX=y
#CONFIG_ISX012=y
CONFIG_SR352=y
CONFIG_SR130PC20=y

#USB
CONFIG_USB_ANDROID_SAMSUNG_COMPOSITE=y
CONFIG_USB_ANDROID_SAMSUNG_MTP=y
CONFIG_USB_DUN_SUPPORT=y
CONFIG_USB_ANDROID_SAMSUNG_SIDESYNC=y

#USB Host
CONFIG_USB_HOST_NOTIFY=y
CONFIG_USB_STORAGE_DETECT=y
CONFIG_USB_NET_SMSC75XX=y
CONFIG_USB_NET_SMSC95XX=y

#MUIC
#CONFIG_MFD_MAX77693=y
#CONFIG_USB_SWITCH_MAX77693=y
#CONFIG_REGULATOR_MAX77693=y
#CONFIG_DI_MUIC=n
#CONFIG_MUIC_INIT_DETECT_DELAY=3000
#CONFIG_MUIC_USB_DETECT_DELAY=17000
#CONFIG_USB_SWITCH_TSU6721=y
CONFIG_SM5502_MUIC=y
CONFIG_MUIC_SM5502_SUPPORT_LANHUB_TA=y

# IRDA support
# CONFIG_IR_REMOCON_MC96 is not set

#Battery charging & BMS
CONFIG_BATTERY_SAMSUNG=y
CONFIG_CHARGER_SMB358=y
CONFIG_BATTERY_BCL=y
CONFIG_QPNP_BMS=y
CONFIG_SAMSUNG_LPM_MODE=y
#BT
no need

# TIMA LOG
CONFIG_ARCH_MSM8226_3G_WIFI=y

#Sec Thermistor
CONFIG_SEC_THERMISTOR=y

#Wifi
no need
#
# Enable Qualcomm Wifi features
#
CONFIG_MSM_PIL_PRONTO=y
CONFIG_WCNSS_CORE=y
CONFIG_WCNSS_CORE_PRONTO=y
CONFIG_WCNSS_MEM_PRE_ALLOC=y

#
# Wifi features (Qualcomm)
#
CONFIG_NET_CORE=y
CONFIG_WIRELESS=y
CONFIG_WIRELESS_EXT_SYSFS=y
CONFIG_WEXT_CORE=y
CONFIG_WEXT_PROC=y
CONFIG_CFG80211=y
CONFIG_CFG80211_DEFAULT_PS=y
# CONFIG_CFG80211_ALLOW_RECONNECT is not set
CONFIG_WLAN=y
CONFIG_WIRELESS_EXT=y
CONFIG_WEXT_PRIV=y

CONFIG_MODULES=y
CONFIG_MODULE_UNLOAD=y
CONFIG_MODULE_FORCE_UNLOAD=y
CONFIG_WCNSS_REGISTER_DUMP_ON_BITE=y
CONFIG_WCNSS_IRIS_REGISTER_DUMP=y

# Earjack
CONFIG_SAMSUNG_JACK=y

# CODEC
CONFIG_SND_SOC_MAX98504=y

# GPIO DVS
#CONFIG_SEC_GPIO_DVS is not set
# DHA Solution
#CONFIG_SEC_DHA_SOL_MAL is not set
```

## arch/arm/configs/msm8226-sec_ms013g_eur_defconfig
```kconfig
# SSWAP
#CONFIG_SWAP=y
#CONFIG_FRONTSWAP=y
#CONFIG_ZSMALLOC_NEW=y
#CONFIG_PGTABLE_MAPPING=y
#CONFIG_ZSWAP=y
#CONFIG_DIRECT_RECLAIM_FILE_PAGES_ONLY=n
#CONFIG_INCREASE_MAXIMUM_SWAPPINESS=y
#CONFIG_FIX_INACTIVE_RATIO=y
#CONFIG_TIGHT_PGDAT_BALANCE=y
#CONFIG_VNSWAP=y
#CONFIG_SWAP_ENABLE_READAHEAD=n

#variant defconfig
CONFIG_MACH_MS01_EUR_3G=y
CONFIG_SEC_MS01_PROJECT=y
CONFIG_MSM_VIDC_V4L2=y
CONFIG_SND_SOC_QDSP6V2=y

#NFC
CONFIG_SEC_NFC_I2C=n

#Power Management
#CONFIG_SEC_PM=n

#LCD
CONFIG_FB_MSM_MDSS_SHARP_HD_PANEL=y
#CONFIG_ESD_ERR_FG_RECOVERY is not set
CONFIG_FB_MSM_MDSS=y
CONFIG_FB_MSM_MDSS_WRITEBACK=y
CONFIG_BACKLIGHT_LCD_SUPPORT=y
#CONFIG_MDNIE_LITE_TUNING=y
CONFIG_MDNIE_TFT_MSM8X26=y
CONFIG_LCD_CLASS_DEVICE=y
CONFIG_BACKLIGHT_CLASS_DEVICE=y
CONFIG_LCD_CONNECTION_CHECK=y
# CONFIG_BACKLIGHT_GENERIC is not set


#SvcLED
#CONFIG_LEDS_AN30259A=y

#VIBRATOR
CONFIG_MSM_VIBRATOR=y
#CONFIG_VIBETONZ=y
#CONFIG_MOTOR_DRV_DRV2603=y

#TSP
CONFIG_TOUCHSCREEN_ZINITIX_BT531=y

#SENSORS
CONFIG_SENSORS=y
#CONFIG_INPUT_YAS_MAGNETOMETER_POSITION=3
#CONFIG_SENSORS_CM36651=y
#CONFIG_INPUT=y
CONFIG_INPUT_GPIO=y
CONFIG_INPUT_POLLDEV=y
#CONFIG_INPUT_MPU6500=y
#CONFIG_INPUT_MPU6500_POLLING=y
CONFIG_SENSORS_HALL=y
#CONFIG_SENSORS_YAS532=y
#CONFIG_MPU6500_ADJUST_SMART_ALERT=y
#CONFIG_YAS_MAG_DRIVER_YAS532=y
#CONFIG_INPUT_YAS_SENSORS=y
#CONFIG_YAS_MAG_MULTI_SUPPORT=y
#CONFIG_INPUT_YAS_ACCELEROMETER is not set
#CONFIG_INPUT_YAS_MAGNETOMETER=y
#CONFIG_YAS_ACC_DRIVER_BMA250 is not set
CONFIG_SENSORS_HSCDTD008A=y
CONFIG_SENSORS_BMA254=y
CONFIG_BMA254_SMART_ALERT=y
CONFIG_SENSORS_GP2A030A=y
CONFIG_SENSORS_GP2A030A_PROX=y
#CONFIG_INPUT_MPU6500_SELFTEST=y

#CAMERA

#USB
CONFIG_USB_ANDROID_SAMSUNG_COMPOSITE=y
CONFIG_USB_ANDROID_SAMSUNG_MTP=y
#CONFIG_USB_DUN_SUPPORT=y

#CONFIG_USB_ANDROID_SAMSUNG_SIDESYNC=y

#USB Host
#CONFIG_USB_HOST_NOTIFY=y
#CONFIG_USB_STORAGE_DETECT=y
#CONFIG_USB_NET_SMSC75XX=y
#CONFIG_USB_NET_SMSC95XX=y

#MUIC
#CONFIG_MFD_MAX77693=y
#CONFIG_USB_SWITCH_MAX77693=y
#CONFIG_REGULATOR_MAX77693=y
#CONFIG_DI_MUIC=n
#CONFIG_MUIC_INIT_DETECT_DELAY=3000
#CONFIG_MUIC_USB_DETECT_DELAY=17000
CONFIG_USB_SWITCH_TSU6721=y
#CONFIG_SM5502_MUIC=y
#CONFIG_TORCH_FIX=y
# IRDA support
# CONFIG_IR_REMOCON_MC96 is not set

#Battery charging & BMS
CONFIG_QPNP_SEC_CHARGER=y
CONFIG_BATTERY_BCL=y
CONFIG_QPNP_BMS=y

#Sec Thermistor
CONFIG_SEC_THERMISTOR=y

# Earjack
CONFIG_SAMSUNG_JACK=y

#NFC
#CONFIG_NFC_PN547=y
#CONFIG_NFC_PN547_8226_USE_BBCLK2=y

# CODEC
#CONFIG_SND_SOC_MAX98504 is not set

# GPIO DVS
#CONFIG_SEC_GPIO_DVS is not set
# DHA Solution
#CONFIG_SEC_DHA_SOL_MAL=y

# QCOM DEBUG
#CONFIG_MSM_RTB=y
#CONFIG_MSM_RTB_SEPARATE_CPUS=y

# DO NOT EXT OVP
CONFIG_NOT_USE_EXT_OVP=y
```

## arch/arm/configs/msm8226-sec_rubenswifi_defconfig
```kconfig
#variant defconfig
CONFIG_MACH_RUBENSWIFI_OPEN=y
CONFIG_SEC_RUBENS_PROJECT=y
CONFIG_SEC_RUBENSWIFI_COMMON=y

#Power Management
CONFIG_SEC_PM=y
CONFIG_SEC_PM_DEBUG=y
CONFIG_SAMSUNG_DEBUG_DISPLAY=y
#CONFIG_FB_MSM_MDSS_SHARP_HD_PANEL=y
CONFIG_FB_MSM_MDSS_SDC_WXGA_PANEL=y
CONFIG_FB_MSM8x26_MDSS_CHECK_LCD_CONNECTION=y
CONFIG_ESD_ERR_FG_RECOVERY=y
CONFIG_FB_MSM_MDSS=y
CONFIG_FB_MSM_MDSS_WRITEBACK=y
CONFIG_BACKLIGHT_LCD_SUPPORT=y
CONFIG_MDNIE_TFT_MSM8X26=y
CONFIG_LCD_CLASS_DEVICE=y
CONFIG_BACKLIGHT_CLASS_DEVICE=y
# CONFIG_BACKLIGHT_GENERIC is not set

#VIBRATOR
#CONFIG_QPNP_VIBRATOR is not set

#TSP
#CONFIG_TOUCHSCREEN_MMS252=y
#CONFIG_TOUCHSCREEN_BCMTCH15XXX is not set
#CONFIG_KEYBOARD_CYPRESS_TOUCH is not set
CONFIG_TOUCHSCREEN_SYNAPTICS_I2C_RMI=y

#SENSOR
CONFIG_SENSORS=y
CONFIG_SENSORS_K2HH=y
CONFIG_SENSORS_TMD3782S=y

#NFC
CONFIG_NFC_PN547=y


CONFIG_INPUT_POLLDEV=y
CONFIG_INPUT=y
CONFIG_INPUT_GPIO=y
#CONFIG_SENSORS_HALL is not set

#CAMERA
CONFIG_SR352=y
CONFIG_SR130PC20=y
CONFIG_LEDS_MAX77804K=y

#USB
CONFIG_USB_ANDROID_SAMSUNG_COMPOSITE=y
CONFIG_USB_ANDROID_SAMSUNG_MTP=y
CONFIG_USB_DUN_SUPPORT=y
CONFIG_USB_ANDROID_SAMSUNG_SIDESYNC=y

#USB Host
CONFIG_USB_HOST_NOTIFY=y
CONFIG_USB_STORAGE_DETECT=y
CONFIG_USB_NET_SMSC75XX=y
CONFIG_USB_NET_SMSC95XX=y

#EXTCON
CONFIG_EXTCON=y

#MUIC
#CONFIG_MFD_MAX77693=y
#CONFIG_USB_SWITCH_MAX77693=y
#CONFIG_REGULATOR_MAX77693=y
#CONFIG_DI_MUIC=n
#CONFIG_MUIC_INIT_DETECT_DELAY=3000
#CONFIG_MUIC_USB_DETECT_DELAY=17000
#CONFIG_USB_SWITCH_TSU6721=y
#CONFIG_SM5502_MUIC=y
#CONFIG_MAX77804K_MUIC is not set
#CONFIG_MUIC_SUPPORT_DESK_DOCK is not set
#CONFIG_MUIC_SM5502_SUPPORT_LANHUB_TA=y

CONFIG_MFD_MAX77804K=y
CONFIG_REGULATOR_MAX77804K=y
CONFIG_EXTCON_MAX77804K=y
CONFIG_ADC_ONESHOT=y
CONFIG_MUIC_SUPPORT_INCOMPATIBLE_CHARGER=y
CONFIG_MUIC_SUPPORT_RUSTPROOF=y

# IRDA support
#CONFIG_IR_REMOCON_MC96=y

#Battery charging & BMS
CONFIG_BATTERY_SAMSUNG=y
CONFIG_CHARGER_MAX77804K=y
CONFIG_FUELGAUGE_MAX17048=y
CONFIG_BATTERY_SAMSUNG_DATA_FILE="rubenslte_battery_data.h"
CONFIG_SAMSUNG_LPM_MODE=y

#BT
no need

# TIMA LOG
CONFIG_ARCH_MSM8226_3G_WIFI=y

#Sec Thermistor
CONFIG_SEC_THERMISTOR=y

#Wifi
no need
#
# Enable Qualcomm Wifi features
#
CONFIG_MSM_PIL_PRONTO=y
CONFIG_WCNSS_CORE=y
CONFIG_WCNSS_CORE_PRONTO=y
CONFIG_WCNSS_MEM_PRE_ALLOC=y

#
# Wifi features (Qualcomm)
#
CONFIG_NET_CORE=y
CONFIG_WIRELESS=y
CONFIG_WIRELESS_EXT_SYSFS=y
CONFIG_WEXT_CORE=y
CONFIG_WEXT_PROC=y
CONFIG_CFG80211=y
CONFIG_CFG80211_DEFAULT_PS=y
# CONFIG_CFG80211_ALLOW_RECONNECT is not set
CONFIG_WLAN=y
CONFIG_WIRELESS_EXT=y
CONFIG_WEXT_PRIV=y

CONFIG_MODULES=y
CONFIG_MODULE_UNLOAD=y
CONFIG_MODULE_FORCE_UNLOAD=y
CONFIG_WCNSS_REGISTER_DUMP_ON_BITE=y
CONFIG_WCNSS_IRIS_REGISTER_DUMP=y

# Earjack
CONFIG_SAMSUNG_JACK=y

# CODEC
#CONFIG_SND_SOC_MAX98504=y

# GPIO DVS
#CONFIG_SEC_GPIO_DVS is not set
# DHA Solution
#CONFIG_SEC_DHA_SOL_MAL is not set

# SSWAP
CONFIG_SWAP=y
CONFIG_FRONTSWAP=y
CONFIG_ZSMALLOC_NEW=y
CONFIG_PGTABLE_MAPPING=y
CONFIG_ZSWAP=y
CONFIG_DIRECT_RECLAIM_FILE_PAGES_ONLY=n
CONFIG_INCREASE_MAXIMUM_SWAPPINESS=y
CONFIG_FIX_INACTIVE_RATIO=y
CONFIG_TIGHT_PGDAT_BALANCE=y
CONFIG_VNSWAP=y
CONFIG_SWAP_ENABLE_READAHEAD=n

#Input Booster
CONFIG_INPUT_BOOSTER=y
```

## arch/arm/configs/msm8226-sec_s3ve3g_eur_defconfig
```kconfig
# SSWAP
CONFIG_SWAP=y
CONFIG_FRONTSWAP=y
CONFIG_ZSMALLOC_NEW=y
CONFIG_PGTABLE_MAPPING=y
CONFIG_ZSWAP=y
CONFIG_DIRECT_RECLAIM_FILE_PAGES_ONLY=n
CONFIG_INCREASE_MAXIMUM_SWAPPINESS=y
CONFIG_FIX_INACTIVE_RATIO=y
CONFIG_TIGHT_PGDAT_BALANCE=y
CONFIG_VNSWAP=y
CONFIG_SWAP_ENABLE_READAHEAD=n

#variant defconfig
CONFIG_MACH_S3VE3G_EUR=y
CONFIG_SEC_S3VE_PROJECT=y

#TIMA DEBUG LOG
CONFIG_ARCH_MSM8226_3G_WIFI=y

#Power Management
CONFIG_SEC_PM=n

#LCD
CONFIG_FB_MSM_MDSS_S6E8AA0A_HD_PANEL=y
CONFIG_ESD_ERR_FG_RECOVERY=y
CONFIG_FB_MSM_MDSS=y
CONFIG_FB_MSM_MDSS_WRITEBACK=y
CONFIG_BACKLIGHT_LCD_SUPPORT=y
CONFIG_MDNIE_LITE_TUNING=y
CONFIG_LCD_CLASS_DEVICE=y
CONFIG_LCD_CONNECTION_CHECK=y
CONFIG_BACKLIGHT_CLASS_DEVICE=y
#CONFIG_BACKLIGHT_GENERIC is not set

#SvcLED
CONFIG_LEDS_AN30259A=y

#VIBRATOR
#CONFIG_MSM_VIBRATOR=y
CONFIG_VIBETONZ=y
CONFIG_MOTOR_DRV_DRV2603=y

#TSP
#CONFIG_TOUCHSCREEN_MMS252 is not set
#CONFIG_TOUCHSCREEN_BCMTCH15XXX is not set
#CONFIG_KEYBOARD_CYPRESS_TOUCH is not set
CONFIG_KEYBOARD_CYPRESS_TOUCHKEY_S3=y
CONFIG_TOUCHSCREEN_MMS144=y

#SENSORS
CONFIG_SENSORS=y
CONFIG_INPUT_YAS_MAGNETOMETER_POSITION=3
CONFIG_SENSORS_CM36651=y
CONFIG_INPUT=y
CONFIG_INPUT_GPIO=y
CONFIG_INPUT_POLLDEV=y
CONFIG_INPUT_MPU6500=y
CONFIG_INPUT_MPU6500_POLLING=y
CONFIG_SENSORS_HALL=y
CONFIG_SENSORS_YAS532=y
CONFIG_MPU6500_ADJUST_SMART_ALERT=y
#CONFIG_YAS_MAG_DRIVER_YAS532=y
#CONFIG_INPUT_YAS_SENSORS=y
#CONFIG_YAS_MAG_MULTI_SUPPORT=y
#CONFIG_INPUT_YAS_ACCELEROMETER is not set
#CONFIG_INPUT_YAS_MAGNETOMETER=y
#CONFIG_YAS_ACC_DRIVER_BMA250 is not set
#CONFIG_SENSORS_HSCDTD008A is not set
#CONFIG_INPUT_MPU6500_SELFTEST=y

#CAMERA

#USB
CONFIG_USB_ANDROID_SAMSUNG_COMPOSITE=y
CONFIG_USB_ANDROID_SAMSUNG_MTP=y
CONFIG_USB_DUN_SUPPORT=y
CONFIG_USB_ANDROID_SAMSUNG_SIDESYNC=y

#USB Host
#CONFIG_USB_HOST_NOTIFY is not set
#CONFIG_USB_STORAGE_DETECT is not set
#CONFIG_USB_NET_SMSC75XX is not set
#CONFIG_USB_NET_SMSC95XX is not set

#MUIC
#CONFIG_MFD_MAX77693=y
#CONFIG_USB_SWITCH_MAX77693=y
#CONFIG_REGULATOR_MAX77693=y
#CONFIG_DI_MUIC=n
#CONFIG_MUIC_INIT_DETECT_DELAY=3000
#CONFIG_MUIC_USB_DETECT_DELAY=17000
#CONFIG_USB_SWITCH_TSU6721=y
CONFIG_SM5502_MUIC=y
CONFIG_TORCH_FIX=y
# IRDA support
# CONFIG_IR_REMOCON_MC96 is not set

#Battery charging & BMS
CONFIG_QPNP_SEC_CHARGER=y
CONFIG_BATTERY_BCL=y
CONFIG_QPNP_BMS=y

#Sec Thermistor
CONFIG_SEC_THERMISTOR=y

# Earjack
CONFIG_SAMSUNG_JACK=y

#NFC
CONFIG_NFC_PN547=y
CONFIG_NFC_PN547_8226_USE_BBCLK2=y

# CODEC
#CONFIG_SND_SOC_MAX98504 is not set

# GPIO DVS
#CONFIG_SEC_GPIO_DVS is not set
# DHA Solution
CONFIG_SEC_DHA_SOL_MAL=y

# QCOM DEBUG
CONFIG_MSM_RTB=y
CONFIG_MSM_RTB_SEPARATE_CPUS=y

# DO NOT EXT OVP
CONFIG_NOT_USE_EXT_OVP=y
```

## arch/arm/configs/msm8226-sec_victor3gdsdtv_ltn_defconfig
```kconfig
# SSWAP
CONFIG_SWAP=y
CONFIG_FRONTSWAP=y
CONFIG_ZSMALLOC_NEW=y
CONFIG_PGTABLE_MAPPING=y
CONFIG_ZSWAP=y
CONFIG_DIRECT_RECLAIM_FILE_PAGES_ONLY=n
CONFIG_INCREASE_MAXIMUM_SWAPPINESS=y
CONFIG_FIX_INACTIVE_RATIO=y
CONFIG_TIGHT_PGDAT_BALANCE=y
CONFIG_VNSWAP=y
CONFIG_SWAP_ENABLE_READAHEAD=n

#variant defconfig
#CONFIG_MACH_S3VE3G_EUR=y
#CONFIG_SEC_S3VE_PROJECT=y

#LTN VICTOR-variant defconfig
CONFIG_MACH_VICTOR3GDSDTV_LTN=y
CONFIG_SEC_VICTOR3GDSDTV_PROJECT=y

#Power Management
CONFIG_SEC_PM=n

#MDSS and LCD
#CONFIG_ESD_ERR_FG_RECOVERY=y
CONFIG_FB_MSM_MDSS=y
CONFIG_FB_MSM_MDSS_WRITEBACK=y
CONFIG_BACKLIGHT_LCD_SUPPORT=y
#CONFIG_MDNIE_TFT_MSM8X26=y
CONFIG_LCD_CLASS_DEVICE=y
CONFIG_BACKLIGHT_CLASS_DEVICE=y
# CONFIG_BACKLIGHT_GENERIC is not set
CONFIG_FB_MSM_MDSS_HX8369B_TFT_VIDEO_WVGA_PT_PANEL=y
CONFIG_FB_MSM8x26_MDSS_CHECK_LCD_CONNECTION=y
CONFIG_BACKLIGHT_IC_KTD2801=y
CONFIG_MDNIE_VIDEO_ENHANCED=y

#SvcLED
CONFIG_LEDS_AN30259A=y

#VIBRATOR
CONFIG_MSM_VIBRATOR=y
#CONFIG_VIBETONZ is not set
#CONFIG_MOTOR_DRV_DRV2603 is not set

#TSP
#CONFIG_TOUCHSCREEN_MMS252 is not set
#CONFIG_TOUCHSCREEN_BCMTCH15XXX is not set
#CONFIG_KEYBOARD_CYPRESS_TOUCH is not set
#CONFIG_KEYBOARD_CYPRESS_TOUCHKEY_S3 is not set
#CONFIG_TOUCHSCREEN_MMS144 is not set
CONFIG_TOUCHSCREEN_MMS136=y


#SENSORS
CONFIG_SENSORS=y
CONFIG_INPUT=y
CONFIG_INPUT_GPIO=y
CONFIG_INPUT_POLLDEV=y
CONFIG_SENSORS_BMA254=y
CONFIG_BMA254_SMART_ALERT=y
CONFIG_SENSORS_CM36686=y
CONFIG_SENSORS_CM36686_LEDA_EN_GPIO=y


#CAMERA
#CONFIG_MSM_CPP=y
#CONFIG_IMX219=y
CONFIG_SR130PC20=y
#CONFIG_S5K6A3YX=y

#USB
CONFIG_USB_ANDROID_SAMSUNG_COMPOSITE=y
CONFIG_USB_ANDROID_SAMSUNG_MTP=y
CONFIG_USB_DUN_SUPPORT=y
CONFIG_USB_ANDROID_SAMSUNG_SIDESYNC=y

#USB Host
CONFIG_USB_HOST_NOTIFY=y
CONFIG_USB_STORAGE_DETECT=y
CONFIG_USB_NET_SMSC75XX=y
CONFIG_USB_NET_SMSC95XX=y

#MUIC
#CONFIG_MFD_MAX77693=y
#CONFIG_USB_SWITCH_MAX77693=y
#CONFIG_REGULATOR_MAX77693=y
#CONFIG_DI_MUIC=n
#CONFIG_MUIC_INIT_DETECT_DELAY=3000
#CONFIG_MUIC_USB_DETECT_DELAY=17000
#CONFIG_USB_SWITCH_TSU6721=y
CONFIG_SM5502_MUIC=y

# IRDA support
# CONFIG_IR_REMOCON_MC96 is not set

#Battery charging & BMS
CONFIG_QPNP_SEC_CHARGER=y
CONFIG_BATTERY_BCL=y
CONFIG_QPNP_BMS=y

#Sec Thermistor
CONFIG_SEC_THERMISTOR=y

# Earjack
CONFIG_SAMSUNG_JACK=y

#NFC
CONFIG_NFC_PN547=y
CONFIG_NFC_PN547_8226_USE_BBCLK2=y

# CODEC
#CONFIG_SND_SOC_MAX98504 is not set

# GPIO DVS
#CONFIG_SEC_GPIO_DVS is not set
# DHA Solution
CONFIG_SEC_DHA_SOL_MAL=y

# QCOM DEBUG
CONFIG_MSM_RTB=y
CONFIG_MSM_RTB_SEPARATE_CPUS=y 

# For Latin Fullseg Mobile TV
CONFIG_MTV=y
CONFIG_MTV_FC8300=y
CONFIG_MTV_QUALCOMM=y
CONFIG_MTV_SPI=y
```
