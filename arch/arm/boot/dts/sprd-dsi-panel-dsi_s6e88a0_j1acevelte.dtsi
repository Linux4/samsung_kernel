&gen_panel {
	dsi_s6e88a0_vid: gen-panel-s6e88a0-video {
		gen-panel-manu = "SDC";			/* condensed manufacturer name */
		gen-panel-name = "s6e88a0";
		gen-panel-id = <0x400102>;
		gen-panel-dev-id = <0>;			/* SPRDFB_MAINLCD_ID : MAIN 0, SUB 1 */
		gen-panel-type = <2>;			/* LCD_MODE_DSI: MCU 0, RGB 1, DSI 2 */
		gen-panel-refresh = <60>;
		gen-panel-xres = <480>;
		gen-panel-yres = <800>;
		gen-panel-width= <56>;			/* screen width in mm */
		gen-panel-height = <94>;		/* screen height in mm */
		gen-panel-work-mode = <1>;		/* SPRDFB_MIPI_MODE_VIDEO : CMD 0, VIDEO 1*/
		gen-panel-direction = <0>;		/* LCD_DIRECT_NORMAL : Normal 0, ROT90 1, ROT180 2, ROT270 3 */
		gen-panel-suspend-mode = <1>;	/* SEND_SLEEP_CMD : RST 0, SLEEP 1 */
		gen-panel-bus-width = <24>;
		gen-panel-lanes = <2>;
		gen-panel-phy-feq = <365000>;
		gen-panel-h-sync-pol = <0>;		/*SPRDFB_POLARITY_POS : POS 0, NEG 1 */
		gen-panel-v-sync-pol = <0>;		/*SPRDFB_POLARITY_POS : POS 0, NEG 1 */
		gen-panel-de-pol = <0>;			/*SPRDFB_POLARITY_POS : POS 0, NEG 1 */
		gen-panel-te-pol = <0>;			/*SPRDFB_POLARITY_POS : POS 0, NEG 1 */
		gen-panel-color-mode-pol = <1>;	/*SPRDFB_POLARITY_POS : POS 0, NEG 1 */
		gen-panel-shut-down-pol = <1>;	/*SPRDFB_POLARITY_POS : POS 0, NEG 1 */
		gen-panel-h-front-porch = <18>; /* hfp */
		gen-panel-h-back-porch = <18>;	/* hbp */
		gen-panel-h-sync-width = <2>;	/* hsync */
		gen-panel-v-front-porch = <13>;	/* vfp */
		gen-panel-v-back-porch = <2>;	/* vbp */
		gen-panel-v-sync-width = <1>;	/* vsync */
		//gen-panel-esd-mode = <1>;		/*ESD_DET_INTERRUPT : POLLING 0, INTERRUPT 1 */
		//gen-panel-esd-gpio = <102>;
		//gen-panel-esd-state = <0>;		/* ESD_DET_NOT_INITIALIZED : NOT_INT 0, OFF 1, ON 0 */
		//gen-panel-esd-level = <1>;		/* ESD_DET_HIGH : LOW 0, HIGH 1 */
		gen-panel-octa-tset-param-offset = <5>;
		gen-panel-octa-mps-param-offset = <0>;		
		gen-panel-octa-elvss-param-offset = <1>;
		gen-panel-octa-elvss-temp-param-offset = <16>;		
		gen-panel-octa-aid-param-offset = <3>;
		gen-panel-octa-hbm-gamma-param-offset = <0>;		
		gen-panel-octa-product-reg = [C8];	/* Product Date register */
		gen-panel-octa-product-gpara = <40>;		/* Global parameter should be 'count - 1' */
		gen-panel-octa-coordinate-reg = [D7];	/* Product Date register */
		gen-panel-octa-coordinate-gpara = <3>;		/* Global parameter should be 'count - 1' */
		gen-panel-acl-always-on;

		/*
		 * DSI PACKET HEADER INFO
		 * @ delay(msec) : 2byte
		 * @ size of data : 2byte
		 */
		gen-panel-pkt-dinfo-addr-offset = <0>;
		gen-panel-pkt-dinfo-addr-length = <1>;
		gen-panel-pkt-dinfo-data-offset = <1>;
		gen-panel-pkt-dinfo-data-length = <1>;
		gen-panel-post-enable-cmds = [
			39 00 00 00 00 03       F0 5A 5A
			39 00 00 10 00 06	B8 38 0B 40 00 A8
			39 00 00 00 00 03	F0 A5 A5
			05 00 00 20 00 01	11
		];
		gen-panel-post-enable-1-cmds = [
			05 00 00 10 00 01	29
		];
		gen-panel-disable-cmds = [
			05 00 00 20 00 01	28
			05 00 00 96 00 01	10
		];
		gen-panel-nv-read-enable-cmds = [
			39 00 00 00 00 03	F0 5A 5A
		];
		gen-panel-nv-read-disable-cmds = [
			39 00 00 00 00 03	F0 A5 A5
		];
		gen-panel-acl-on-cmds = [
			15 00 00 00 00 02	55 02
		];
		gen-panel-acl-off-cmds = [
			15 00 00 00 00 02	55 00
		];
		gen-panel-hbm-on-cmds = [
			39 00 00 00 00 22	CA 01 00 01 00 01 00 80 80 80 80 80 80 80 80 80
						80 80 80 80 80 80 80 80 80 80 80 80 80 80 80 00
						00 00
			39 00 00 00 00 06	B2 40 08 20 00 08
			39 00 00 00 00 12	B6 2C 0B 00 00 00 00 00 00 00 00 00 00 0A AA AF
						AF 09
			15 00 00 00 00 02	55 02
		];
		gen-panel-tset-cmds = [
			39 00 00 00 00 08	B8 38 0B 40 00 A8 19 12
		];
		gen-panel-elvss-cmds = [
			39 00 00 00 00 12	B6 2C 14 00 00 00 00 00 00 00 00 00 00 0A AA AF
						AF 14
		];
		gen-panel-aid-cmds = [
			39 00 00 00 00 06	B2 40 08 20 00 08
		];

		/* VREGOUT VOLTAGE 6.3 * 2^22 */
		gen-panel-octa-vregout = <26424115>;

		gen-panel-candela-table = <
			5	6	7	8	9	10	11	12	13	14
			15	16	17	19	20	21	22	24	25	27
			29	30	32	34	37	39	41	44	47	50
			53	56	60	64	68	72	77	82	87	93
			98	105	111	119	126	134	143	152	162	172
			183	195	207	220	234	249	265	282	300	316
			333	350
		>;

		gen-panel-acl-table = <
			0x02	0x02	0x02	0x02	0x02	0x02	0x02	0x02	0x02	0x02
			0x02	0x02	0x02	0x02	0x02	0x02	0x02	0x02	0x02	0x02
			0x02	0x02	0x02	0x02	0x02	0x02	0x02	0x02	0x02	0x02
			0x02	0x02	0x02	0x02	0x02	0x02	0x02	0x02	0x02	0x02
			0x02	0x02	0x02	0x02	0x02	0x02	0x02	0x02	0x02	0x02
			0x02	0x02	0x02	0x02	0x02	0x02	0x02	0x02	0x02	0x02
			0x02	0x00
		>;
		
		gen-panel-aid-table = <
			0x315	0x311	0x306	0x303	0x2F8	0x2F5	0x2F1	0x2E7	0x2E3	0x2E1
			0x2D5	0x2D3	0x2C7	0x2C1	0x2B6	0x2B2	0x2A9	0x2A1	0x297	0x287
			0x281	0x276	0x271	0x261	0x248	0x241	0x234	0x221	0x207	0x1F5
			0x1E5	0x1D2	0x1B5	0x198	0x175	0x155	0x155	0x155	0x155	0x155
			0x155	0x155	0x155	0x132	0x112	0x0E7	0x0C3	0x095	0x065	0x035
			0x008	0x008	0x008	0x008	0x008	0x008	0x008	0x008	0x008	0x008
			0x008	0x008
		>;

		gen-panel-mps-table = <
			0xAC	0xAC	0xAC	0xAC	0xAC	0xAC	0xAC	0xAC	0xAC	0xAC
			0xAC	0xAC	0xAC	0xAC	0xAC	0xAC	0xAC	0xAC	0xAC	0xAC
			0xAC	0xAC	0xAC	0xAC	0xAC	0xAC	0xBC	0xBC	0xBC	0xBC
			0xBC	0xBC	0xBC	0xBC	0xBC	0xBC	0xBC	0xBC	0xBC	0xBC
			0xBC	0xBC	0xBC	0xBC	0xBC	0xBC	0xBC	0xBC	0xBC	0xBC
			0xBC	0xBC	0xBC	0xBC	0xBC	0xBC	0xBC	0xBC	0xBC	0xBC
			0xBC	0xBC
		>;
		
		gen-panel-elvss-table = <
			0x0B	0x0B	0x0B	0x0B	0x0B	0x0B	0x0B	0x0B	0x0B	0x0B
			0x0B	0x0B	0x0B	0x0B	0x0B	0x0C	0x0D	0x0E	0x0F		0x11
			0x13	0x15	0x15	0x15	0x15	0x15	0x15	0x15	0x15	0x15
			0x15	0x15	0x15	0x15	0x15	0x15	0x15	0x15	0x15	0x15
			0x15	0x15	0x15	0x15	0x15	0x15	0x15	0x15	0x15	0x15
			0x15	0x13	0x13	0x12	0x12	0x11	0x10	0x0F		0x0E	0x0D
			0x0C	0x0B
		>;

		gen-panel-elvss-temperature-table = <
			/* T > 0 */
			0x14	0x14	0x14	0x14	0x14	0x14	0x14	0x14	0x14	0x14
			0x14	0x14	0x14	0x14	0x14	0x14	0x14	0x14	0x14	0x14
			0x14	0x00	0x00	0x00	0x00	0x00	0x00	0x00	0x00	0x00
			0x00	0x00	0x00	0x00	0x00	0x00	0x00	0x00	0x00	0x00
			0x00	0x00	0x00	0x00	0x00	0x00	0x00	0x00	0x00	0x00
			0x00	0x00	0x00	0x00	0x00	0x00	0x00	0x00	0x00	0x00
			0x00	0x00

			/* 0 >= T > -20 */
			0x1E	0x1E	0x1E	0x1E	0x1E	0x1E	0x1E	0x1E	0x1E	0x1E
			0x1E	0x1E	0x1E	0x1E	0x1E	0x1D	0x1C	0x1B	0x1A	0x18
			0x16	0x00	0x00	0x00	0x00	0x00	0x00	0x00	0x00	0x00
			0x00	0x00	0x00	0x00	0x00	0x00	0x00	0x00	0x00	0x00
			0x00	0x00	0x00	0x00	0x00	0x00	0x00	0x00	0x00	0x00
			0x00	0x00	0x00	0x00	0x00	0x00	0x00	0x00	0x00	0x00
			0x00	0x00

			/* -20 > T */
			0x1E	0x1E	0x1E	0x1E	0x1E	0x1E	0x1E	0x1E	0x1E	0x19
			0x1E	0x1E	0x1E	0x1E	0x1E	0x1D	0x1C	0x1B	0x1A	0x18
			0x16	0x00	0x00	0x00	0x00	0x00	0x00	0x00	0x00	0x00
			0x00	0x00	0x00	0x00	0x00	0x00	0x00	0x00	0x00	0x00
			0x00	0x00	0x00	0x00	0x00	0x00	0x00	0x00	0x00	0x00
			0x00	0x00	0x00	0x00	0x00	0x00	0x00	0x00	0x00	0x00
			0x00	0x00
		>;

		gen-panel-candela-compensation-table = <
			/* V255 V203 V151 V87 V51 V35 V23 V11 V3 */
			0	5	5	10	15	19	24	29	33
			0	4	5	9	13	16	21	25	28
			0	4	5	8	12	15	19	25	26
			0	4	5	7	10	12	17	21	24
			0	4	5	7	10	12	17	20	24
			0	3	4	6	8	11	15	19	23
			0	3	4	6	7	10	13	18	21
			0	3	4	6	7	9	13	18	21
			0	3	4	6	7	8	11	16	20
			0	3	4	5	6	8	11	16	19
			0	3	4	5	6	7	10	15	18
			0	3	4	5	6	7	10	14	17
			0	3	4	4	5	7	10	14	17
			0	3	4	4	5	7	9	14	16
			0	3	4	4	5	7	9	13	16
			0	3	3	4	4	6	8	12	15
			0	3	3	4	4	6	8	12	14
			0	3	3	3	3	5	7	11	14
			0	3	3	3	3	5	7	11	13
			0	3	3	3	3	4	6	11	12
			0	3	3	3	3	4	6	10	12
			0	3	3	3	2	4	6	10	12
			0	3	3	3	2	3	5	9	11
			0	3	3	3	2	3	5	9	11
			0	3	3	3	2	3	5	8	10
			0	3	3	2	2	3	5	8	10
			0	3	3	2	2	3	4	7	9
			0	2	3	2	2	2	4	7	9
			0	2	3	2	2	2	4	7	8
			0	2	3	2	2	2	4	6	8
			0	2	3	2	2	2	4	6	8
			0	2	3	2	2	2	4	6	8
			0	2	3	2	2	2	4	6	8
			0	2	3	2	2	2	4	6	8
			0	2	3	2	2	2	4	6	8
			0	2	3	2	2	2	3	6	8
			0	2	3	2	2	2	3	6	7
			0	2	3	2	2	2	3	5	7
			0	2	3	2	2	2	3	5	7
			0	2	3	2	2	2	3	5	7
			0	1	3	2	2	2	3	5	7
			0	1	2	2	1	2	3	5	7
			0	1	2	2	1	2	3	5	7
			0	1	2	2	1	2	3	4	7
			0	1	2	2	1	2	2	4	7
			0	1	2	2	1	2	2	3	6
			0	1	2	2	1	2	2	3	5
			0	1	2	2	0	2	2	3	5
			0	1	2	1	0	1	1	2	4
			0	1	2	1	0	1	1	2	4
			0	1	2	1	0	1	1	2	3
			0	1	2	1	1	0	1	2	2
			0	1	2	1	1	0	1	2	2
			0	1	2	1	1	0	1	2	2
			0	1	2	1	1	0	1	1	2
			0	1	2	1	1	1	1	1	2
			0	1	1	1	0	0	1	1	2
			0	0	1	1	0	0	0	0	1
			0	0	1	1	0	(-1)	0	0	1
			0	0	0	1	(-1)	(-1)	0	0	1
			0	0	0	1	0	(-1)	(-1)	0	1
			0	0	0	0	0	0	0	0	0
		>;

		gen-panel-rgb-compensation-table = <
			/* R255 G255 B255 R203 G203 B203 R151 G151 B151 R87 G87 B87 R51 G51 B51 R35 G35 B35 R23 G23 B23 R11 G11 B11 */
			0 0 3 0 0 (-1) (-1) 0 0 (-4) 0 (-2) (-5) 0 (-2) (-5) 0 (-2) (-4) 0 (-3) (-3) 0 (-5)
			0 0 3 0 0 (-1) 0 0 0 (-4) 0 (-2) (-5) 0 (-2) (-4) 0 (-4) (-2) 0 (-2) (-1) 0 (-3)
			0 0 3 0 0 (-1) 0 0 (-1) (-3) 0 (-2) (-5) 0 (-2) (-5) 0 (-4) (-5) 0 (-4) 1 0 (-2)
			0 0 3 0 0 (-1) 0 0 (-1) (-2) 0 0 (-6) 0 (-3) (-3) 0 (-3) (-3) 0 (-3) 1 0 (-2)
			0 0 3 0 0 (-1) 0 0 (-1) (-2) 0 (-1) (-5) 0 (-2) (-3) 0 (-2) (-3) 0 (-3) (-1) 0 (-5)
			0 0 3 0 0 (-1) (-1) 0 (-1) (-2) 0 (-1) (-5) 0 (-2) (-3) 0 (-3) (-3) 0 (-2) (-2) 0 (-5)
			0 0 3 1 0 (-1) (-1) 0 (-1) (-2) 0 (-1) (-5) 0 (-2) (-3) 0 (-3) (-3) 0 (-4) (-1) 0 (-2)
			0 0 3 1 0 (-1) (-1) 0 (-1) (-2) 0 (-1) (-4) 0 (-2) (-3) 0 (-3) (-3) 0 (-3) (-1) 0 (-3)
			0 0 3 1 0 (-1) (-1) 0 (-1) (-2) 0 (-1) (-3) 0 (-1) (-3) 0 (-4) (-3) 0 (-3) (-2) 0 (-3)
			0 0 3 1 0 (-1) (-1) 0 (-1) (-1) 0 0 (-3) 0 0 (-3) 0 (-4) (-4) 0 (-4) (-2) 0 (-2)
			0 0 3 1 0 (-1) (-1) 0 (-1) (-1) 0 0 (-3) 0 0 (-3) 0 (-4) (-2) 0 (-2) (-3) 0 (-2)
			0 0 3 1 0 (-1) (-1) 0 (-1) (-1) 0 0 (-3) 0 0 (-3) 0 (-4) (-2) 0 (-2) (-1) 0 (-3)
			0 0 3 1 0 (-1) (-1) 0 (-1) (-1) 0 (-1) (-4) 0 0 (-3) 0 (-4) (-4) 0 (-2) (-2) 0 (-4)
			0 0 2 1 0 0 (-1) 0 (-1) (-1) 0 (-1) (-4) 0 0 (-3) 0 (-4) (-5) 0 (-4) (-2) 0 (-4)
			0 0 2 1 0 0 (-1) 0 (-1) (-1) 0 0 (-3) 0 (-1) (-4) 0 (-4) (-4) 0 (-3) (-2) 0 (-5)
			0 0 2 1 0 0 (-1) 0 (-1) (-1) 0 (-1) (-1) 0 2 (-4) 0 (-5) (-3) 0 (-1) (-2) 0 (-5)
			0 0 2 1 0 0 (-1) 0 (-1) (-1) 0 (-1) (-1) 0 1 (-3) 0 (-3) (-3) 0 (-1) (-2) 0 (-5)
			0 0 2 1 0 0 0 0 (-1) (-1) 0 (-1) (-2) 0 1 (-3) 0 (-5) (-3) 0 (-2) (-2) 0 (-4)
			1 0 2 0 0 0 (-1) 0 (-1) (-1) 0 (-1) (-2) 0 1 (-1) 0 (-4) (-3) 0 (-2) (-2) 0 (-4)
			1 0 2 0 0 0 (-1) 0 (-1) 0 0 (-1) (-2) 0 1 (-1) 0 (-4) (-5) 0 (-4) (-2) 0 (-1)
			1 0 2 0 0 0 (-1) 0 (-1) 0 0 (-1) (-2) 0 1 (-1) 0 (-4) (-3) 0 (-3) (-3) 0 (-3)
			1 0 2 0 0 0 (-1) 0 (-1) 0 0 (-1) (-2) 0 1 (-1) 0 (-3) (-3) 0 (-3) (-2) 0 (-3)
			1 0 2 0 0 0 0 0 (-1) (-1) 0 (-1) (-1) 0 1 (-1) 0 (-3) (-4) 0 (-4) (-4) 0 (-5)
			1 0 2 0 0 0 0 0 (-1) (-1) 0 (-1) (-1) 0 1 (-1) 0 (-3) (-2) 0 (-3) (-4) 0 (-5)
			1 0 2 0 0 0 0 0 (-1) (-2) 0 (-1) (-1) 0 2 0 0 (-4) (-2) 0 (-3) (-4) 0 (-5)
			1 0 2 0 0 0 0 0 (-1) (-2) 0 (-1) (-1) 0 0 (-1) 0 (-3) (-2) 0 (-3) (-4) 0 (-4)
			1 0 2 0 0 0 0 0 (-1) (-2) 0 (-1) (-1) 0 0 (-1) 0 (-3) (-2) 0 (-3) (-3) 0 (-5)
			1 0 2 0 0 0 0 0 (-1) (-2) 0 (-1) 0 0 1 (-2) 0 (-5) (-2) 0 (-3) (-3) 0 (-4)
			1 0 2 0 0 0 0 0 (-1) (-2) 0 (-1) 0 0 1 (-2) 0 (-5) (-1) 0 (-2) (-2) 0 (-3)
			1 0 2 0 0 0 0 0 (-1) (-2) 0 (-1) 0 0 1 (-2) 0 (-5) (-1) 0 (-2) (-3) 0 (-4)
			1 0 2 0 0 0 0 0 (-1) (-2) 0 (-1) 0 0 1 (-2) 0 (-5) (-1) 0 (-2) (-3) 0 (-1)
			1 0 2 0 0 0 0 0 (-1) (-2) 0 (-1) 0 0 1 (-1) 0 (-5) (-2) 0 (-2) (-2) 0 (-2)
			1 0 2 0 0 0 0 0 (-1) (-2) 0 (-1) 0 0 1 (-1) 0 (-5) (-2) 0 (-2) (-2) 0 (-1)
			1 0 2 0 0 0 0 0 (-1) (-2) 0 (-1) 0 0 1 (-1) 0 (-4) (-1) 0 (-2) (-2) 0 (-1)
			1 0 1 0 0 0 0 0 0 (-1) 0 (-1) (-1) 0 0 (-2) 0 (-4) (-1) 0 (-4) (-3) 0 (-6)
			1 0 1 0 0 0 (-1) 0 (-1) (-1) 0 (-1) 0 0 1 (-1) 0 (-4) (-2) 0 (-5) (-3) 0 (-4)
			1 0 1 0 0 (-1) (-1) 0 (-1) (-1) 0 (-1) 0 0 1 0 0 (-4) (-2) 0 (-4) (-3) 0 (-4)
			0 0 1 1 0 (-1) (-1) 0 (-1) 0 0 0 0 0 1 0 0 (-4) (-1) 0 (-3) (-2) 0 (-4)
			0 0 1 0 0 (-1) (-1) 0 (-1) 0 0 0 0 0 0 0 0 (-4) (-2) 0 (-2) (-1) 0 (-3)
			0 0 1 0 0 (-1) (-1) 0 (-1) (-1) 0 0 0 0 0 (-1) 0 (-4) (-2) 0 (-3) (-3) 0 (-5)
			0 0 0 0 0 0 0 0 (-1) 0 0 0 (-1) 0 0 0 0 (-2) (-1) 0 (-2) (-3) 0 (-5)
			0 0 0 1 0 0 0 0 (-1) 0 0 0 (-1) 0 0 (-1) 0 (-3) (-1) 0 (-2) (-3) 0 (-3)
			0 0 0 1 0 (-1) (-1) 0 (-1) 0 0 0 (-1) 0 0 0 0 (-3) (-3) 0 (-2) (-1) 0 (-3)
			0 0 0 1 0 (-1) (-1) 0 (-1) 0 0 0 (-1) 0 0 0 0 (-3) (-3) 0 (-2) (-1) 0 (-4)
			0 0 0 1 0 (-1) (-1) 0 (-1) 0 0 0 (-1) 0 0 0 0 (-3) (-1) 0 (-2) (-3) 0 (-3)
			0 0 0 1 0 (-1) (-1) 0 (-1) 0 0 0 (-1) 0 0 0 0 (-3) (-1) 0 (-1) (-2) 0 (-3)
			0 0 0 1 0 (-1) (-1) 0 (-1) 0 0 0 (-1) 0 0 0 0 (-3) (-1) 0 (-1) (-2) 0 (-3)
			0 0 0 1 0 (-1) (-1) 0 (-1) 0 0 0 (-1) 0 1 0 0 (-3) (-1) 0 (-1) (-2) 0 (-3)
			0 0 0 1 0 (-1) (-1) 0 (-1) 1 0 0 0 0 1 0 0 (-3) (-1) 0 (-3) (-2) 0 (-3)
			0 0 0 1 0 (-1) (-1) 0 (-1) 1 0 0 0 0 1 0 0 (-3) 0 0 (-2) (-2) 0 (-3)
			0	0	0	0	0	0	0	0	0	0	0	0	0	0	0	0	0	0	0	0	0	0	0	0
			0	0	0	0	0	0	0	0	0	0	0	0	0	0	0	0	0	0	0	0	0	0	0	0
			0	0	0	0	0	0	0	0	0	0	0	0	0	0	0	0	0	0	0	0	0	0	0	0
			0	0	0	0	0	0	0	0	0	0	0	0	0	0	0	0	0	0	0	0	0	0	0	0
			0	0	0	0	0	0	0	0	0	0	0	0	0	0	0	0	0	0	0	0	0	0	0	0
			0	0	0	0	0	0	0	0	0	0	0	0	0	0	0	0	0	0	0	0	0	0	0	0
			0	0	0	0	0	0	0	0	0	0	0	0	0	0	0	0	0	0	0	0	0	0	0	0
			0	0	0	0	0	0	0	0	0	0	0	0	0	0	0	0	0	0	0	0	0	0	0	0
			0	0	0	0	0	0	0	0	0	0	0	0	0	0	0	0	0	0	0	0	0	0	0	0
			0	0	0	0	0	0	0	0	0	0	0	0	0	0	0	0	0	0	0	0	0	0	0	0
			0	0	0	0	0	0	0	0	0	0	0	0	0	0	0	0	0	0	0	0	0	0	0	0
			0	0	0	0	0	0	0	0	0	0	0	0	0	0	0	0	0	0	0	0	0	0	0	0
		>;
		gen-panel-base-lux-table = <
			122	122	122	122	122	122	122	122	122	122
			122	122	122	122	122	122	122	122	122	122
			122	122	122	122	122	122	122	122	122	122
			122	122	122	122	122	122	129	138	146	155
			164	175	186	186	186	186	186	186	186	186
			186	198	210	223	236	250	266	283	301	317
			334	350
		>;

		gen-panel-gamma-curve-table = <
			215	215	215	215	215	215	215	215	215	215
			215	215	215	215	215	215	215	215	215	215
			215	215	215	215	215	215	215	215	215	215
			215	215	215	215	215	215	215	215	215	215
			215	215	215	215	215	215	215	215	215	215
			215	215	215	215	215	215	215	215	215	215
			215	220
		>;

		gen-panel-mdnie-ui-mode-cmds = [
			39 00 00 00 00 6C	EC 00 00 00 00 00 00 00 00 00 00 00 00 00 00 00
						00 00 00 FF FF 14 FF 14 FF 00 00 FF FF 00 FF 00
						FF 00 00 FF FF 00 FF 00 FF 00 00 20 00 20 00 20
						00 20 00 20 00 20 00 20 00 20 00 20 00 20 00 20
						00 20 00 20 00 20 00 20 00 20 00 20 00 20 00 20
						00 20 00 20 00 20 00 20 00 FF 04 00 00 00 00 00
						00 00 04 00 00 00 00 00 00 00 04 00
			39 00 00 00 00 05	EB 01 00 30 00
		];

		gen-panel-gamma-cmds = [
			39 00 00 00 00 22	CA 01 00 01 00 01 00 80 80 80 80 80 80 80 80 80
						80 80 80 80 80 80 80 80 80 80 80 80 80 80 80 00
						00 00
		];
		gen-panel-gamma-update-cmds = [
			15 00 00 00 00 02	F7 03
		];
		gen-panel-read-hbm = [
			B5 0D 06
			B5 1A 03
			B6 18 0C
		];
		gen-panel-read-mtp = [C8 00 21];
		gen-panel-read-id = [
			DA 00 01
			DB 00 01
			DC 00 01
		];
		gen-panel-read-status-reg = [0A];
		gen-panel-read-status-ok = [9A];
		status = "okay";
	};
};