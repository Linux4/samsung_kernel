&gen_panel {
	dsi_s6d78a0x02_grandpplte_286108_vid: gen-panel-s6d78a0x02-grandpplte-286108-video {
		gen-panel-manu = "BOE";			/* condensed manufacturer name */
		gen-panel-name = "lcd_s6d78a0x02_286108_mipi";
		gen-panel-id = <0x286108>;
		gen-panel-dev-id = <0>;			/* SPRDFB_MAINLCD_ID : MAIN 0, SUB 1 */
		gen-panel-type = <2>;			/* LCD_MODE_DSI: MCU 0, RGB 1, DSI 2 */
		gen-panel-refresh = <60>;
		gen-panel-xres = <540>;
		gen-panel-yres = <960>;
		gen-panel-width = <64>;			/* screen width in mm */
		gen-panel-height = <110>;		/* screen height in mm */
		gen-panel-work-mode = <1>;		/* SPRDFB_MIPI_MODE_VIDEO : CMD 0, VIDEO 1*/
		gen-panel-direction = <0>;		/* LCD_DIRECT_NORMAL : Normal 0, ROT90 1, ROT180 2, ROT270 3 */
		gen-panel-suspend-mode = <1>;	/* SEND_SLEEP_CMD : RST 0, SLEEP 1 */
		gen-panel-bus-width = <24>;
		gen-panel-lanes = <2>;
		gen-panel-phy-feq = <230000>;	/*fre * 2 = mipi fequency*/
		gen-panel-h-sync-pol = <0>;		/*SPRDFB_POLARITY_POS : POS 0, NEG 1 */
		gen-panel-v-sync-pol = <0>;		/*SPRDFB_POLARITY_POS : POS 0, NEG 1 */
		gen-panel-de-pol = <0>;			/*SPRDFB_POLARITY_POS : POS 0, NEG 1 */
		gen-panel-te-pol = <0>;			/*SPRDFB_POLARITY_POS : POS 0, NEG 1 */
		gen-panel-color-mode-pol = <1>;	/*SPRDFB_POLARITY_POS : POS 0, NEG 1 */
		gen-panel-shut-down-pol = <1>;	/*SPRDFB_POLARITY_POS : POS 0, NEG 1 */
		gen-panel-h-front-porch = <35>;	/* hfp */
		gen-panel-h-back-porch = <35>;	/* hbp */
		gen-panel-h-sync-width = <28>;	/* hsync */
		gen-panel-v-front-porch = <8>;	/* vfp */
		gen-panel-v-back-porch = <6>;	/* vbp */
		gen-panel-v-sync-width = <2>;	/* vsync */
		gen-panel-rst-high-in-sleep;

		/*
		 * DSI PACKET HEADER INFO
		 * @ delay(msec) : 2byte
		 * @ size of data : 2byte
		 */
		gen-panel-pkt-dinfo-addr-offset = <0>;
		gen-panel-pkt-dinfo-addr-length = <1>;
		gen-panel-pkt-dinfo-data-offset = <1>;
		gen-panel-pkt-dinfo-data-length = <1>;
		gen-panel-init-cmds = [
			39 00 00 00 00 03		F0 5A 5A
			39 00 00 00 00 03		F1 5A 5A
			39 00 00 00 00 03		FC A5 A5
			05 00 00 78 00 01		11
			15 00 00 00 00 02		B1 93
			15 00 00 00 00 02		B5 10
			39 00 00 00 00 12		F4 01 10 32 00 24 26 28 27 27 27 B7 2B 2C 65
									6A 34 20
			39 00 00 00 00 15		EF 01 01 81 22 83 04 05 00 00 00 28 81 00 21 21
									03 03 40 00 10
			39 00 00 00 00 09		F2 19 04 08 08 08 3F 23 00
			39 00 00 00 00 07		F6 63 23 15 00 00 06
			39 00 00 00 00 07		E1 01 FF 01 1B 20 17
			39 00 00 00 00 04		E2 ED C7 23
			39 00 00 00 00 27		F7 01 01 01 0A 0B 00 1A 05 1B 01 01 01 01 01 01
									01 01 01 01 01 01 01 08 09 00 1A 04 1B 01 01 01
									01 01 01 01 01 01 01
			15 00 00 00 00 02		36 10
			39 00 00 00 00 28		FA 11 3B 33 2A 1A 09 08 04 03 07 05 06 17 12 3B
									33 2A 1D 0B 07 04 03 07 05 07 17 10 3B 33 2A 1A
									07 05 02 02 05 03 04 15
			39 00 00 00 00 28		FB 11 3B 33 2A 1A 0A 08 04 03 06 05 06 17 12 3B
									33 2A 1D 0B 07 04 03 07 05 07 17 10 3B 33 2A 1A
									08 05 02 02 05 03 04 14
			05 00 00 14 00 01		29
			39 00 00 00 00 03		F0 A5 A5
			39 00 00 00 00 03		F1 A5 A5
			39 00 00 00 00 03		FC 5A 5A
		];

		gen-panel-enable-cmds = [
		];
		gen-panel-disable-cmds = [
			05 00 00 32 00 01		28
			05 00 00 32 00 01		10
		];
		gen-panel-read-id = [
			DA 00 01
			DB 00 01
			DC 00 01
		];
		gen-panel-read-status-reg = [0A];
		gen-panel-read-status-ok = [9A];
		status = "okay";
	};
};
