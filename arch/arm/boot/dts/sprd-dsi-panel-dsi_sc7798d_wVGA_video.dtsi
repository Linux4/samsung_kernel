&gen_panel {
	dsi_sc7798d_wVGA_vid: gen-panel-sc7798d-wVGA-video {
		gen-panel-manu = "SDC";			/* condensed manufacturer name */
		gen-panel-name = "sc7798d";
		gen-panel-id = <0x55B8F0>;
		gen-panel-dev-id = <0>;			/* SPRDFB_MAINLCD_ID : MAIN 0, SUB 1 */
		gen-panel-type = <2>;			/* LCD_MODE_DSI: MCU 0, RGB 1, DSI 2 */
		gen-panel-refresh = <60>;
		gen-panel-xres = <480>;
		gen-panel-yres = <800>;
		gen-panel-width= <60>;			/* screen width in mm */
		gen-panel-height = <100>;		/* screen height in mm */
		gen-panel-work-mode = <1>;		/* SPRDFB_MIPI_MODE_VIDEO : CMD 0, VIDEO 1*/
		gen-panel-direction = <0>;		/* LCD_DIRECT_NORMAL : Normal 0, ROT90 1, ROT180 2, ROT270 3 */
		gen-panel-suspend-mode = <1>;	/* SEND_SLEEP_CMD : RST 0, SLEEP 1 */
		gen-panel-bus-width = <24>;
		gen-panel-lanes = <2>;
		gen-panel-phy-feq = <481000>;
		gen-panel-h-sync-pol = <0>;		/*SPRDFB_POLARITY_POS : POS 0, NEG 1 */
		gen-panel-v-sync-pol = <0>;		/*SPRDFB_POLARITY_POS : POS 0, NEG 1 */
		gen-panel-de-pol = <0>;			/*SPRDFB_POLARITY_POS : POS 0, NEG 1 */
		gen-panel-te-pol = <0>;			/*SPRDFB_POLARITY_POS : POS 0, NEG 1 */
		gen-panel-color-mode-pol = <1>;	/*SPRDFB_POLARITY_POS : POS 0, NEG 1 */
		gen-panel-shut-down-pol = <1>;	/*SPRDFB_POLARITY_POS : POS 0, NEG 1 */
		gen-panel-h-front-porch = <145>;/* hfp */
		gen-panel-h-back-porch = <90>;	/* hbp */
		gen-panel-h-sync-width = <70>;	/* hsync */
		gen-panel-v-front-porch = <10>;	/* vfp */
		gen-panel-v-back-porch = <12>;	/* vbp */
		gen-panel-v-sync-width = <4>;	/* vsync */

		/*
		 * DSI PACKET HEADER INFO
		 * @ delay(msec) : 2byte
		 * @ size of data : 2byte
		 */
		gen-panel-pkt-dinfo-addr-offset = <0>;
		gen-panel-pkt-dinfo-addr-length = <1>;
		gen-panel-pkt-dinfo-data-offset = <1>;
		gen-panel-pkt-dinfo-data-length = <1>;
		gen-panel-init-cmds = [
			39 00 00 00 00 04		B9 F1 08 00
			39 00 00 00 00 08		B1 31 0C 0C A7 33 01 B7
			39 00 00 00 00 04		C6 00 00 FD
			39 00 00 00 00 05		E3 03 03 03 03
			39 00 00 0A 00 03		B8 06 22
			39 00 00 00 00 13		BA 31 00 44 25 91 0A 00 00 C2 34 00 00 04 02 1D
									B9 EE 40
			39 00 00 00 00 09		B3 00 00 00 00 0C 0A 25 20
			15 00 00 00 00 02		B4 00
			15 00 00 00 00 02		CC 0E
			15 00 00 00 00 02		BC 67
			15 00 00 00 00 02		B2 03
			39 00 00 05 00 06		C0 73 50 00 08 70
			39 00 00 00 00 34		E9 00 00 06 00 00 6E 29 12 30 00 48 08 6E 29 47
									03 00 00 00 00 00 18 00 00 89 98 33 11 77 55 13
									00 00 89 98 22 00 66 44 02 00 00 00 00 00 00 00
									00 00 00 00
			39 00 00 00 00 25		EA 00 00 98 98 44 66 00 22 20 00 00 98 98 55 77
									11 33 31 30 00 00 FF 01 00 00 00 00 00 00 00 00
									00 00 00 00 00
			39 00 00 00 00 23		E0 01 09 0D 2E 36 3F 10 31 07 0D 11 15 13 16 15
									32 38 01 05 05 30 35 3F 0E 30 04 09 0A 0D 12 0D
									0F 2C 35
		];
		gen-panel-enable-cmds = [
			05 00 00 82 00 01		11
			05 00 00 14 00 01		29
		];
		gen-panel-disable-cmds = [
			05 00 00 14 00 01		28
			05 00 00 82 00 01		10
		];
		gen-panel-mdnie-ui-mode-cmds = [
			39 00 00 00 00 71		E6
								5A 00 00 23 00 00 00 00 00 00 00 00 00 00 00 00
								00 00 00 00 00 00 FF 00 FF 00 FF FF 00 00 FF 00
								FF 00 FF FF 00 00 FF 00 FF 00 FF FF 00 02 FF 00
								20 00 20 00 20 00 20 00 20 00 20 00 20 00 20 00
								20 00 20 00 20 00 20 00 20 00 20 00 20 00 20 00
								20 00 20 00 20 00 20 00 20 00 20 00 20 00 04 B5
								1F 88 1F C3 1F E9 04 54 1F C3 1F E9 1F 88 04 8F
		];
		gen-panel-mdnie-video-mode-cmds = [
			39 00 00 00 00 71		E6
								5A 00 00 23 00 00 00 00 00 00 00 00 00 00 00 00
								00 00 00 00 00 00 FF 00 FF 00 FF FF 00 00 FF 00
								FF 00 FF FF 00 00 FF 00 FF 00 FF FF 00 02 FF 00
								20 00 20 00 20 00 20 00 20 00 20 00 20 00 20 00
								20 00 20 00 20 00 20 00 20 00 20 00 20 00 20 00
								20 00 20 00 20 00 20 00 20 00 20 00 20 00 04 B5
								1F 88 1F C3 1F E9 04 54 1F C3 1F E9 1F 88 04 8F
		];
		gen-panel-mdnie-camera-mode-cmds = [
			39 00 00 00 00 71		E6
								5A 00 00 23 00 00 00 00 00 00 00 00 00 00 00 00
								00 00 00 00 00 00 FF 00 FF 00 FF FF 00 00 FF 00
								FF 00 FF FF 00 00 FF 00 FF 00 FF FF 00 02 FF 00
								20 00 20 00 20 00 20 00 20 00 20 00 20 00 20 00
								20 00 20 00 20 00 20 00 20 00 20 00 20 00 20 00
								20 00 20 00 20 00 20 00 20 00 20 00 20 00 04 B5
								1F 88 1F C3 1F E9 04 54 1F C3 1F E9 1F 88 04 8F
		];
		gen-panel-mdnie-gallery-mode-cmds = [
			39 00 00 00 00 71		E6
								5A 00 00 23 00 00 00 00 00 00 00 00 00 00 00 00
								00 00 00 00 00 00 FF 00 FF 00 FF FF 00 00 FF 00
								FF 00 FF FF 00 00 FF 00 FF 00 FF FF 00 02 FF 00
								20 00 20 00 20 00 20 00 20 00 20 00 20 00 20 00
								20 00 20 00 20 00 20 00 20 00 20 00 20 00 20 00
								20 00 20 00 20 00 20 00 20 00 20 00 20 00 04 B5
								1F 88 1F C3 1F E9 04 54 1F C3 1F E9 1F 88 04 8F
		];
		gen-panel-mdnie-negative-mode-cmds = [
			39 00 00 00 00 71		E6
								5A 00 00 32 00 00 00 00 00 00 00 00 00 00 00 00
								00 00 00 00 00 FF 00 FF 00 FF 00 00 FF FF 00 FF
								00 FF 00 00 FF FF 00 FF 00 FF 00 00 FF 00 FF 00
								20 00 20 00 20 00 20 00 20 00 20 00 20 00 20 00
								20 00 20 00 20 00 20 00 20 00 20 00 20 00 20 00
								20 00 20 00 20 00 20 00 20 00 20 00 20 00 04 00
								00 00 00 00 00 00 04 00 00 00 00 00 00 00 04 00
		];
		gen-panel-mdnie-vt-mode-cmds = [
			39 00 00 00 00 71		E6
								5A 00 00 23 00 00 00 00 00 00 00 00 00 00 00 00
								00 00 00 00 00 00 FF 00 FF 00 FF FF 00 00 FF 00
								FF 00 FF FF 00 00 FF 00 FF 00 FF FF 00 02 FF 00
								20 00 20 00 20 00 20 00 20 00 20 00 20 00 20 00
								20 00 20 00 20 00 20 00 20 00 20 00 20 00 20 00
								20 00 20 00 20 00 20 00 20 00 20 00 20 00 04 B5
								1F 88 1F C3 1F E9 04 54 1F C3 1F E9 1F 88 04 8F
		];
		gen-panel-mdnie-browser-mode-cmds = [
			39 00 00 00 00 71		E6
								5A 00 00 23 00 00 00 00 00 00 00 00 00 00 00 00
								00 00 00 00 00 00 FF 00 FF 00 FF FF 00 00 FF 00
								FF 00 FF FF 00 00 FF 00 FF 00 FF FF 00 02 FF 00
								20 00 20 00 20 00 20 00 20 00 20 00 20 00 20 00
								20 00 20 00 20 00 20 00 20 00 20 00 20 00 20 00
								20 00 20 00 20 00 20 00 20 00 20 00 20 00 04 B5
								1F 88 1F C3 1F E9 04 54 1F C3 1F E9 1F 88 04 8F
		];
		gen-panel-mdnie-ebook-mode-cmds = [
			39 00 00 00 00 71		E6
								5A 00 00 32 00 00 00 00 00 00 00 00 00 00 00 00
								00 00 00 00 00 00 A9 00 EA 00 FF FF 00 00 FF 00
								FF 00 FF FF 00 00 FF 00 FF 00 FF FF 00 00 FF 00
								20 00 20 00 20 00 20 00 20 00 20 00 20 00 20 00
								20 00 20 00 20 00 20 00 20 00 20 00 20 00 20 00
								20 00 20 00 20 00 20 00 20 00 20 00 20 00 04 00
								00 00 00 00 00 00 04 00 00 00 00 00 00 00 04 00
		];
		gen-panel-mdnie-email-mode-cmds = [
			39 00 00 00 00 71		E6
								5A 00 00 32 00 00 00 00 00 00 00 00 00 00 00 00
								00 00 00 00 00 00 B1 00 E5 00 FF FF 00 00 FF 00
								FF 00 FF FF 00 00 FF 00 FF 00 FF FF 00 00 FF 00
								20 00 20 00 20 00 20 00 20 00 20 00 20 00 20 00
								20 00 20 00 20 00 20 00 20 00 20 00 20 00 20 00
								20 00 20 00 20 00 20 00 20 00 20 00 20 00 04 00
								00 00 00 00 00 00 04 00 00 00 00 00 00 00 04 00
		];
		gen-panel-read-id = [
			DA 00 01
			DB 00 01
			DC 00 01
		];
		gen-panel-read-status-reg = [0A];
		gen-panel-read-status-ok = [9A];
		status = "okay";
	};
};
