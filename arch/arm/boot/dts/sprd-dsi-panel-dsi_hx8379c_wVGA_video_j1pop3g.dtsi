&gen_panel {
	dsi_hx8379c_wVGA_vid: gen-panel-hx8379c-wVGA-video {
		gen-panel-manu = "Truly";		/* condensed manufacturer name */
		gen-panel-name = "hx8379c";
		gen-panel-id = <0x68030>;
		gen-panel-dev-id = <0>;		/* SPRDFB_MAINLCD_ID : MAIN 0, SUB 1 */
		gen-panel-type = <2>;		/* LCD_MODE_DSI: MCU 0, RGB 1, DSI 2 */
		gen-panel-refresh = <60>;
		gen-panel-xres = <480>;
		gen-panel-yres = <800>;
		gen-panel-width= <60>;		/* screen width in mm */
		gen-panel-height = <100>;	/* screen height in mm */
		gen-panel-work-mode = <1>;	/* SPRDFB_MIPI_MODE_VIDEO : CMD 0, VIDEO 1*/
		gen-panel-direction = <0>;	/* LCD_DIRECT_NORMAL : Normal 0, ROT90 1, ROT180 2, ROT270 3 */
		gen-panel-suspend-mode = <1>;	/* SEND_SLEEP_CMD : RST 0, SLEEP 1 */
		gen-panel-bus-width = <24>;
		gen-panel-lanes = <2>;
		gen-panel-phy-feq = <400000>;
		gen-panel-h-sync-pol = <0>;	/*SPRDFB_POLARITY_POS : POS 0, NEG 1 */
		gen-panel-v-sync-pol = <0>;	/*SPRDFB_POLARITY_POS : POS 0, NEG 1 */
		gen-panel-de-pol = <0>;		/*SPRDFB_POLARITY_POS : POS 0, NEG 1 */
		gen-panel-te-pol = <0>;		/*SPRDFB_POLARITY_POS : POS 0, NEG 1 */
		gen-panel-color-mode-pol = <1>;	/*SPRDFB_POLARITY_POS : POS 0, NEG 1 */
		gen-panel-shut-down-pol = <1>;	/*SPRDFB_POLARITY_POS : POS 0, NEG 1 */
		gen-panel-h-front-porch = <35>;/* hfp */
		gen-panel-h-back-porch = <35>;	/* hbp */
		gen-panel-h-sync-width = <37>;	/* hsync */
		gen-panel-v-front-porch = <5>;	/* vfp */
		gen-panel-v-back-porch = <10>;	/* vbp */
		gen-panel-v-sync-width = <2>;	/* vsync */

		/*
		 * DSI PACKET HEADER INFO
		 * @ delay(msec) : 2byte
		 * @ size of data : 2byte
		 */
		gen-panel-pkt-dinfo-addr-offset = <0>;
		gen-panel-pkt-dinfo-addr-length = <1>;
		gen-panel-pkt-dinfo-data-offset = <1>;
		gen-panel-pkt-dinfo-data-length = <1>;
		gen-panel-init-cmds = [
			39 00 00 00 00 04		B9 FF 83 79
			39 00 00 00 00 11		B1 44 15 15 31 31 50 D0 EE 54 80 38 38 F8
							33 32 22
			39 00 00 00 00 0A		B2 80 3C 0C 03 20 50 11 42 1D
			39 00 00 00 00 0B		B4 08 6E 08 6E 08 6E 22 86 23 86
			39 00 00 00 00 05		C7 00 00 00 C0
			15 00 00 00 00 02		CC 02
			15 00 00 00 00 02		D2 00
			39 00 00 00 00 1E		D3 00 07 00 3C 14 08 08 32 10 01 00 01 03
							72 03 72 00 08 00 08 33 33 05 05 37 05 05 37 0A
			39 00 00 00 00 23		D5 19 19 18 18 1A 1A 1B 1B 02 03 00 01 06
							07 04 05 20 21 22 23 18 18 18 18 18 18 18 18 18
							18 18 18 00 00
			39 00 00 00 00 21		D6 18 18 19 19 1A 1A 1B 1B 05 04 07 06 01
							00 03 02 23 22 21 20 18 18 18 18 18 18 18 18 18
							18 18 18
			39 00 00 00 00 2B		E0 00 00 00 26 2E 3F 0A 30 06 09 0B 16 0E
							11 13 11 13 07 11 13 18 00 00 00 27 2D 3F 0A 2F
							05 08 0B 17 0D 11 13 12 13 07 12 13 17
			39 00 00 00 00 03		B6 89 89
			15 00 00 00 00 02		36 03
		];
		gen-panel-enable-cmds = [
			05 00 00 78 00 01		11
			05 00 00 0A 00 01		29
		];
		gen-panel-disable-cmds = [
			05 00 00 96 00 01		28
			05 00 00 96 00 01		10
		];
		gen-panel-backlight-on-cmds = [
			15 00 00 00 00 02		53 24
		];
		gen-panel-backlight-set-brightness-cmds = [
			15 00 00 00 00 02		51 00
		];
		gen-panel-backlight-set-brightness-reg = <0x51>;
		gen-panel-backlight-get-brightness-reg = <0x52>;
		gen-panel-read-id = [
			DA 00 01
			DB 00 01
			DC 00 01
		];
		gen-panel-read-status-reg = [0A];
		gen-panel-read-status-ok = [9A];
		status = "okay";
	};
};
