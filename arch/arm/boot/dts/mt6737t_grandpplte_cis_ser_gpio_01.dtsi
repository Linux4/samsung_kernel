/*
 * Generated by MTK SP Drv_CodeGen Version 03.13.6  for MT6735. Copyright MediaTek Inc. (C) 2013.
 * Thu Aug  4 19:51:34 2016
 * Do Not Modify the File.
 */

#include <dt-bindings/interrupt-controller/irq.h>
#include <dt-bindings/interrupt-controller/arm-gic.h>

/*************************
 * EINT DTSI File
*************************/

&accdet {
	interrupt-parent = <&eintc>;
	interrupts = <4 IRQ_TYPE_LEVEL_LOW>;
	debounce = <4 256000>;
	status = "okay";
};
&msdc1_ins {
	interrupt-parent = <&eintc>;
	interrupts = <5 IRQ_TYPE_LEVEL_LOW>;
	debounce = <5 1000>;
	status = "okay";
};
&touch {
	interrupt-parent = <&eintc>;
	interrupts = <62 IRQ_TYPE_EDGE_FALLING>;
	debounce = <62 0>;
	status = "okay";
};
&als {
	interrupt-parent = <&eintc>;
	interrupts = <65 IRQ_TYPE_LEVEL_LOW>;
	debounce = <65 0>;
	status = "okay";
};
&gse_1 {
	interrupt-parent = <&eintc>;
	interrupts = <66 IRQ_TYPE_LEVEL_LOW>;
	debounce = <66 0>;
	status = "okay";
};
&gyro {
	interrupt-parent = <&eintc>;
	interrupts = <67 IRQ_TYPE_LEVEL_LOW>;
	debounce = <67 0>;
	status = "okay";
};
&ext_buck_oc {
	interrupt-parent = <&eintc>;
	interrupts = <78 IRQ_TYPE_LEVEL_HIGH>;
	debounce = <78 0>;
	status = "okay";
};


/*************************
 * GPIO DTSI File
*************************/

&pio {
	gpio_pins_default: gpiodef{};
	gpio0: gpio@0 {};
	gpio1: gpio@1 {};
	gpio2: gpio@2 {};
	gpio3: gpio@3 {};
	gpio4: gpio@4 {};
	gpio5: gpio@5 {};
	gpio6: gpio@6 {};
	gpio7: gpio@7 {};
	gpio8: gpio@8 {};
	gpio9: gpio@9 {};
	gpio10: gpio@10 {};
	gpio11: gpio@11 {};
	gpio12: gpio@12 {};
	gpio13: gpio@13 {};
	gpio14: gpio@14 {};
	gpio15: gpio@15 {};
	gpio16: gpio@16 {};
	gpio17: gpio@17 {};
	gpio18: gpio@18 {};
	gpio19: gpio@19 {};
	gpio20: gpio@20 {};
	gpio21: gpio@21 {};
	gpio22: gpio@22 {};
	gpio23: gpio@23 {};
	gpio24: gpio@24 {};
	gpio25: gpio@25 {};
	gpio26: gpio@26 {};
	gpio27: gpio@27 {};
	gpio28: gpio@28 {};
	gpio29: gpio@29 {};
	gpio30: gpio@30 {};
	gpio31: gpio@31 {};
	gpio32: gpio@32 {};
	gpio33: gpio@33 {};
	gpio34: gpio@34 {};
	gpio35: gpio@35 {};
	gpio36: gpio@36 {};
	gpio37: gpio@37 {};
	gpio38: gpio@38 {};
	gpio39: gpio@39 {};
	gpio40: gpio@40 {};
	gpio41: gpio@41 {};
	gpio42: gpio@42 {};
	gpio43: gpio@43 {};
	gpio44: gpio@44 {};
	gpio45: gpio@45 {};
	gpio46: gpio@46 {};
	gpio47: gpio@47 {};
	gpio48: gpio@48 {};
	gpio49: gpio@49 {};
	gpio50: gpio@50 {};
	gpio51: gpio@51 {};
	gpio52: gpio@52 {};
	gpio53: gpio@53 {};
	gpio54: gpio@54 {};
	gpio55: gpio@55 {};
	gpio56: gpio@56 {};
	gpio57: gpio@57 {};
	gpio58: gpio@58 {};
	gpio59: gpio@59 {};
	gpio60: gpio@60 {
		pins_cmd_dat {
			pins = <PINMUX_GPIO60__FUNC_GPIO60>;
			slew-rate = <0>;
			bias-pull-down = <00>;
		};
	};
	gpio61: gpio@61 {};
	gpio62: gpio@62 {};
	gpio63: gpio@63 {};
	gpio64: gpio@64 {};
	gpio65: gpio@65 {};
	gpio66: gpio@66 {};
	gpio67: gpio@67 {};
	gpio68: gpio@68 {};
	gpio69: gpio@69 {};
	/* JTAG_TMS */
	gpio70: gpio@70 {
		pins_cmd_dat {
			pins = <PINMUX_GPIO70__FUNC_GPIO70>;
			slew-rate = <0>;
			bias-pull-down = <11>;
			output-low;
			input-schmitt-enable = <0>;
		};
	};
	/* JTAG_TCK */
	gpio71: gpio@71 {
		pins_cmd_dat {
			pins = <PINMUX_GPIO71__FUNC_GPIO71>;
			slew-rate = <0>;
			bias-pull-down = <11>;
			output-low;
			input-schmitt-enable = <0>;
		};
	};
	/* JTAG_TDI */
	gpio72: gpio@72 {
		pins_cmd_dat {
			pins = <PINMUX_GPIO72__FUNC_GPIO72>;
			slew-rate = <0>;
			bias-pull-down = <11>;
			output-low;
			input-schmitt-enable = <0>;
		};
	};
	/* JTAG_TDO */
	gpio73: gpio@73 {
		pins_cmd_dat {
			pins = <PINMUX_GPIO73__FUNC_GPIO73>;
			slew-rate = <0>;
			bias-pull-down = <11>;
			output-low;
			input-schmitt-enable = <0>;
		};
	};
	/* UART_RXD */
	gpio74: gpio@74 {};
	/* UART_TXD */
	gpio75: gpio@75 {};
	gpio76: gpio@76 {};
	gpio77: gpio@77 {};
	gpio78: gpio@78 {};
	gpio79: gpio@79 {};
	gpio80: gpio@80 {};
	gpio81: gpio@81 {};
	/* JIG_ON_ENB */
	gpio82: gpio@82 {
		pins_cmd_dat {
			pins = <PINMUX_GPIO82__FUNC_GPIO82>;
			slew-rate = <1>;
			bias-disable;
			output-high;
		};
	};
	gpio83: gpio@83 {};
	/* AP_USB_BOOT */
	gpio84: gpio@84 {
		pins_cmd_dat {
			pins = <PINMUX_GPIO84__FUNC_GPIO84>;
			slew-rate = <0>;
			bias-pull-down = <00>;
		};
	};
	gpio85: gpio@85 {};
	gpio86: gpio@86 {};
	gpio87: gpio@87 {};
	gpio88: gpio@88 {};
	gpio89: gpio@89 {};
	gpio90: gpio@90 {};
	gpio91: gpio@91 {};
	gpio92: gpio@92 {};
	gpio93: gpio@93 {};
	gpio94: gpio@94 {};
	gpio95: gpio@95 {};
	gpio96: gpio@96 {};
	gpio97: gpio@97 {};
	gpio98: gpio@98 {};
	gpio99: gpio@99 {};
	gpio100: gpio@100 {};
	gpio101: gpio@101 {};
	/* grip */
	gpio102: gpio@102 {
		pins_cmd_dat {
			pins = <PINMUX_GPIO102__FUNC_GPIO102>;
			slew-rate = <0>;
			bias-pull-down = <00>;
		};
	};
	gpio103: gpio@103 {};
	gpio104: gpio@104 {};
	gpio105: gpio@105 {};
	gpio106: gpio@106 {};
	gpio107: gpio@107 {};
	gpio108: gpio@108 {};
	gpio109: gpio@109 {};
	gpio110: gpio@110 {};
	gpio111: gpio@111 {};
	gpio112: gpio@112 {};
	gpio113: gpio@113 {};
	gpio114: gpio@114 {};
	gpio115: gpio@115 {};
	gpio116: gpio@116 {};
	gpio117: gpio@117 {};
	gpio118: gpio@118 {};
	gpio119: gpio@119 {};
	gpio120: gpio@120 {};
	gpio121: gpio@121 {};
	gpio122: gpio@122 {};
	gpio123: gpio@123 {};
	gpio124: gpio@124 {};
	gpio125: gpio@125 {};
	gpio126: gpio@126 {};
	gpio127: gpio@127 {};
	gpio128: gpio@128 {};
	gpio129: gpio@129 {};
	gpio130: gpio@130 {};
	gpio131: gpio@131 {};
	gpio132: gpio@132 {};
	gpio133: gpio@133 {};
	gpio134: gpio@134 {};
	gpio135: gpio@135 {};
	gpio136: gpio@136 {};
	gpio137: gpio@137 {};
	gpio138: gpio@138 {};
	gpio139: gpio@139 {};
	gpio140: gpio@140 {};
	gpio141: gpio@141 {};
	gpio142: gpio@142 {};
	gpio143: gpio@143 {};
	gpio144: gpio@144 {};
	gpio145: gpio@145 {};
	gpio146: gpio@146 {};
	gpio147: gpio@147 {};
	gpio148: gpio@148 {};
	gpio149: gpio@149 {};
	gpio150: gpio@150 {};
	gpio151: gpio@151 {};
	gpio152: gpio@152 {};
	gpio153: gpio@153 {};
	gpio154: gpio@154 {};
	gpio155: gpio@155 {};
	gpio156: gpio@156 {};
	gpio157: gpio@157 {};
	gpio158: gpio@158 {};
	gpio159: gpio@159 {};
	gpio160: gpio@160 {};
	gpio161: gpio@161 {};
	gpio162: gpio@162 {};
	gpio163: gpio@163 {};
	gpio164: gpio@164 {};
	gpio165: gpio@165 {};
	gpio166: gpio@166 {};
	gpio167: gpio@167 {};
	gpio168: gpio@168 {};
	gpio169: gpio@169 {};
	gpio170: gpio@170 {};
	gpio171: gpio@171 {};
	gpio172: gpio@172 {};
	gpio173: gpio@173 {};
	gpio174: gpio@174 {};
	gpio175: gpio@175 {};
	gpio176: gpio@176 {};
	gpio177: gpio@177 {};
	gpio178: gpio@178 {};
	gpio179: gpio@179 {};
	gpio180: gpio@180 {};
	gpio181: gpio@181 {};
	gpio182: gpio@182 {};
	gpio183: gpio@183 {};
	gpio184: gpio@184 {};
	gpio185: gpio@185 {};
	gpio186: gpio@186 {};
	gpio187: gpio@187 {};
	gpio188: gpio@188 {};
	gpio189: gpio@189 {};
	gpio190: gpio@190 {};
	gpio191: gpio@191 {};
	gpio192: gpio@192 {};
	gpio193: gpio@193 {};
	gpio194: gpio@194 {};
	gpio195: gpio@195 {};
	gpio196: gpio@196 {};
	gpio197: gpio@197 {};
	/* grip */
	gpio198: gpio@198 {
		pins_cmd_dat {
			pins = <PINMUX_GPIO198__FUNC_GPIO198>;
			slew_rate = <0>;
			bias-pull-down = <00>;
		};
	};
	/* grip */
	gpio199: gpio@199 {
		pins_cmd_dat {
			pins = <PINMUX_GPIO199__FUNC_GPIO199>;
			slew_rate = <0>;
			bias-pull-down = <00>;
		};
	};
	gpio200: gpio@200 {};
	gpio201: gpio@201 {};
	gpio202: gpio@202 {};
	gpio203: gpio@203 {};
};


&pio {
	pinctrl-names = "default","gpio0","gpio1","gpio2","gpio3","gpio4","gpio5","gpio6","gpio7","gpio8",
"gpio9","gpio10","gpio11","gpio12","gpio13","gpio14","gpio15","gpio16","gpio17","gpio18","gpio19","gpio20",
"gpio21","gpio22","gpio23","gpio24","gpio25","gpio26","gpio27","gpio28","gpio29","gpio30","gpio31","gpio32",
"gpio33","gpio34","gpio35","gpio36","gpio37","gpio38","gpio39","gpio40","gpio41","gpio42","gpio43","gpio44",
"gpio45","gpio46","gpio47","gpio48","gpio49","gpio50","gpio51","gpio52","gpio53","gpio54","gpio55","gpio56",
"gpio57","gpio58","gpio59","gpio60","gpio61","gpio62","gpio63","gpio64","gpio65","gpio66","gpio67","gpio68",
"gpio69","gpio70","gpio71","gpio72","gpio73","gpio74","gpio75","gpio76","gpio77","gpio78","gpio79","gpio80",
"gpio81","gpio82","gpio83","gpio84","gpio85","gpio86","gpio87","gpio88","gpio89","gpio90","gpio91","gpio92",
"gpio93","gpio94","gpio95","gpio96","gpio97","gpio98","gpio99","gpio100","gpio101","gpio102","gpio103",
"gpio104","gpio105","gpio106","gpio107","gpio108","gpio109","gpio110","gpio111","gpio112","gpio113","gpio114",
"gpio115","gpio116","gpio117","gpio118","gpio119","gpio120","gpio121","gpio122","gpio123","gpio124","gpio125",
"gpio126","gpio127","gpio128","gpio129","gpio130","gpio131","gpio132","gpio133","gpio134","gpio135","gpio136",
"gpio137","gpio138","gpio139","gpio140","gpio141","gpio142","gpio143","gpio144","gpio145","gpio146","gpio147",
"gpio148","gpio149","gpio150","gpio151","gpio152","gpio153","gpio154","gpio155","gpio156","gpio157","gpio158",
"gpio159","gpio160","gpio161","gpio162","gpio163","gpio164","gpio165","gpio166","gpio167","gpio168","gpio169",
"gpio170","gpio171","gpio172","gpio173","gpio174","gpio175","gpio176","gpio177","gpio178","gpio179","gpio180",
"gpio181","gpio182","gpio183","gpio184","gpio185","gpio186","gpio187","gpio188","gpio189","gpio190","gpio191",
"gpio192","gpio193","gpio194","gpio195","gpio196","gpio197","gpio198","gpio199","gpio200","gpio201","gpio202",
"gpio203";
	pinctrl-0 = <&gpio_pins_default>;
	pinctrl-1 = <&gpio0>;
	pinctrl-2 = <&gpio1>;
	pinctrl-3 = <&gpio2>;
	pinctrl-4 = <&gpio3>;
	pinctrl-5 = <&gpio4>;
	pinctrl-6 = <&gpio5>;
	pinctrl-7 = <&gpio6>;
	pinctrl-8 = <&gpio7>;
	pinctrl-9 = <&gpio8>;
	pinctrl-10 = <&gpio9>;
	pinctrl-11 = <&gpio10>;
	pinctrl-12 = <&gpio11>;
	pinctrl-13 = <&gpio12>;
	pinctrl-14 = <&gpio13>;
	pinctrl-15 = <&gpio14>;
	pinctrl-16 = <&gpio15>;
	pinctrl-17 = <&gpio16>;
	pinctrl-18 = <&gpio17>;
	pinctrl-19 = <&gpio18>;
	pinctrl-20 = <&gpio19>;
	pinctrl-21 = <&gpio20>;
	pinctrl-22 = <&gpio21>;
	pinctrl-23 = <&gpio22>;
	pinctrl-24 = <&gpio23>;
	pinctrl-25 = <&gpio24>;
	pinctrl-26 = <&gpio25>;
	pinctrl-27 = <&gpio26>;
	pinctrl-28 = <&gpio27>;
	pinctrl-29 = <&gpio28>;
	pinctrl-30 = <&gpio29>;
	pinctrl-31 = <&gpio30>;
	pinctrl-32 = <&gpio31>;
	pinctrl-33 = <&gpio32>;
	pinctrl-34 = <&gpio33>;
	pinctrl-35 = <&gpio34>;
	pinctrl-36 = <&gpio35>;
	pinctrl-37 = <&gpio36>;
	pinctrl-38 = <&gpio37>;
	pinctrl-39 = <&gpio38>;
	pinctrl-40 = <&gpio39>;
	pinctrl-41 = <&gpio40>;
	pinctrl-42 = <&gpio41>;
	pinctrl-43 = <&gpio42>;
	pinctrl-44 = <&gpio43>;
	pinctrl-45 = <&gpio44>;
	pinctrl-46 = <&gpio45>;
	pinctrl-47 = <&gpio46>;
	pinctrl-48 = <&gpio47>;
	pinctrl-49 = <&gpio48>;
	pinctrl-50 = <&gpio49>;
	pinctrl-51 = <&gpio50>;
	pinctrl-52 = <&gpio51>;
	pinctrl-53 = <&gpio52>;
	pinctrl-54 = <&gpio53>;
	pinctrl-55 = <&gpio54>;
	pinctrl-56 = <&gpio55>;
	pinctrl-57 = <&gpio56>;
	pinctrl-58 = <&gpio57>;
	pinctrl-59 = <&gpio58>;
	pinctrl-60 = <&gpio59>;
	pinctrl-61 = <&gpio60>;
	pinctrl-62 = <&gpio61>;
	pinctrl-63 = <&gpio62>;
	pinctrl-64 = <&gpio63>;
	pinctrl-65 = <&gpio64>;
	pinctrl-66 = <&gpio65>;
	pinctrl-67 = <&gpio66>;
	pinctrl-68 = <&gpio67>;
	pinctrl-69 = <&gpio68>;
	pinctrl-70 = <&gpio69>;
	pinctrl-71 = <&gpio70>;
	pinctrl-72 = <&gpio71>;
	pinctrl-73 = <&gpio72>;
	pinctrl-74 = <&gpio73>;
	pinctrl-75 = <&gpio74>;
	pinctrl-76 = <&gpio75>;
	pinctrl-77 = <&gpio76>;
	pinctrl-78 = <&gpio77>;
	pinctrl-79 = <&gpio78>;
	pinctrl-80 = <&gpio79>;
	pinctrl-81 = <&gpio80>;
	pinctrl-82 = <&gpio81>;
	pinctrl-83 = <&gpio82>;
	pinctrl-84 = <&gpio83>;
	pinctrl-85 = <&gpio84>;
	pinctrl-86 = <&gpio85>;
	pinctrl-87 = <&gpio86>;
	pinctrl-88 = <&gpio87>;
	pinctrl-89 = <&gpio88>;
	pinctrl-90 = <&gpio89>;
	pinctrl-91 = <&gpio90>;
	pinctrl-92 = <&gpio91>;
	pinctrl-93 = <&gpio92>;
	pinctrl-94 = <&gpio93>;
	pinctrl-95 = <&gpio94>;
	pinctrl-96 = <&gpio95>;
	pinctrl-97 = <&gpio96>;
	pinctrl-98 = <&gpio97>;
	pinctrl-99 = <&gpio98>;
	pinctrl-100 = <&gpio99>;
	pinctrl-101 = <&gpio100>;
	pinctrl-102 = <&gpio101>;
	pinctrl-103 = <&gpio102>;
	pinctrl-104 = <&gpio103>;
	pinctrl-105 = <&gpio104>;
	pinctrl-106 = <&gpio105>;
	pinctrl-107 = <&gpio106>;
	pinctrl-108 = <&gpio107>;
	pinctrl-109 = <&gpio108>;
	pinctrl-110 = <&gpio109>;
	pinctrl-111 = <&gpio110>;
	pinctrl-112 = <&gpio111>;
	pinctrl-113 = <&gpio112>;
	pinctrl-114 = <&gpio113>;
	pinctrl-115 = <&gpio114>;
	pinctrl-116 = <&gpio115>;
	pinctrl-117 = <&gpio116>;
	pinctrl-118 = <&gpio117>;
	pinctrl-119 = <&gpio118>;
	pinctrl-120 = <&gpio119>;
	pinctrl-121 = <&gpio120>;
	pinctrl-122 = <&gpio121>;
	pinctrl-123 = <&gpio122>;
	pinctrl-124 = <&gpio123>;
	pinctrl-125 = <&gpio124>;
	pinctrl-126 = <&gpio125>;
	pinctrl-127 = <&gpio126>;
	pinctrl-128 = <&gpio127>;
	pinctrl-129 = <&gpio128>;
	pinctrl-130 = <&gpio129>;
	pinctrl-131 = <&gpio130>;
	pinctrl-132 = <&gpio131>;
	pinctrl-133 = <&gpio132>;
	pinctrl-134 = <&gpio133>;
	pinctrl-135 = <&gpio134>;
	pinctrl-136 = <&gpio135>;
	pinctrl-137 = <&gpio136>;
	pinctrl-138 = <&gpio137>;
	pinctrl-139 = <&gpio138>;
	pinctrl-140 = <&gpio139>;
	pinctrl-141 = <&gpio140>;
	pinctrl-142 = <&gpio141>;
	pinctrl-143 = <&gpio142>;
	pinctrl-144 = <&gpio143>;
	pinctrl-145 = <&gpio144>;
	pinctrl-146 = <&gpio145>;
	pinctrl-147 = <&gpio146>;
	pinctrl-148 = <&gpio147>;
	pinctrl-149 = <&gpio148>;
	pinctrl-150 = <&gpio149>;
	pinctrl-151 = <&gpio150>;
	pinctrl-152 = <&gpio151>;
	pinctrl-153 = <&gpio152>;
	pinctrl-154 = <&gpio153>;
	pinctrl-155 = <&gpio154>;
	pinctrl-156 = <&gpio155>;
	pinctrl-157 = <&gpio156>;
	pinctrl-158 = <&gpio157>;
	pinctrl-159 = <&gpio158>;
	pinctrl-160 = <&gpio159>;
	pinctrl-161 = <&gpio160>;
	pinctrl-162 = <&gpio161>;
	pinctrl-163 = <&gpio162>;
	pinctrl-164 = <&gpio163>;
	pinctrl-165 = <&gpio164>;
	pinctrl-166 = <&gpio165>;
	pinctrl-167 = <&gpio166>;
	pinctrl-168 = <&gpio167>;
	pinctrl-169 = <&gpio168>;
	pinctrl-170 = <&gpio169>;
	pinctrl-171 = <&gpio170>;
	pinctrl-172 = <&gpio171>;
	pinctrl-173 = <&gpio172>;
	pinctrl-174 = <&gpio173>;
	pinctrl-175 = <&gpio174>;
	pinctrl-176 = <&gpio175>;
	pinctrl-177 = <&gpio176>;
	pinctrl-178 = <&gpio177>;
	pinctrl-179 = <&gpio178>;
	pinctrl-180 = <&gpio179>;
	pinctrl-181 = <&gpio180>;
	pinctrl-182 = <&gpio181>;
	pinctrl-183 = <&gpio182>;
	pinctrl-184 = <&gpio183>;
	pinctrl-185 = <&gpio184>;
	pinctrl-186 = <&gpio185>;
	pinctrl-187 = <&gpio186>;
	pinctrl-188 = <&gpio187>;
	pinctrl-189 = <&gpio188>;
	pinctrl-190 = <&gpio189>;
	pinctrl-191 = <&gpio190>;
	pinctrl-192 = <&gpio191>;
	pinctrl-193 = <&gpio192>;
	pinctrl-194 = <&gpio193>;
	pinctrl-195 = <&gpio194>;
	pinctrl-196 = <&gpio195>;
	pinctrl-197 = <&gpio196>;
	pinctrl-198 = <&gpio197>;
	pinctrl-199 = <&gpio198>;
	pinctrl-200 = <&gpio199>;
	pinctrl-201 = <&gpio200>;
	pinctrl-202 = <&gpio201>;
	pinctrl-203 = <&gpio202>;
	pinctrl-204 = <&gpio203>;

	status = "okay";

};


/********************
 * GPIO USAGE MAPPING DTSI File
****************/

&gpio_usage_mapping {
	GPIO_SIM1_HOT_PLUG = <8>;
	GPIO_SIM2_HOT_PLUG = <9>;
	GPIO_CMDAT1 = <43>;
	GPIO_SIM2_SCLK = <160>;
	GPIO_SIM2_SRST = <161>;
	GPIO_SIM2_SIO = <162>;
	GPIO_SIM1_SCLK = <163>;
	GPIO_SIM1_SRST = <164>;
	GPIO_SIM1_SIO = <165>;
};


&eintc {
	MD1_SIM1_HOT_PLUG_EINT@0 {
		compatible = "mediatek,MD1_SIM1_HOT_PLUG_EINT-eint";
		interrupts = <0 4>;
		debounce = <0 100000>;
		dedicated = <0 0>;
		src_pin = <0 1>;
		sockettype=<0 0>;
		status = "okay";
	};
	MD1_SIM2_HOT_PLUG_EINT@1 {
		compatible = "mediatek,MD1_SIM2_HOT_PLUG_EINT-eint";
		interrupts = <1 4>;
		debounce = <1 100000>;
		dedicated = <1 0>;
		src_pin = <1 2>;
		sockettype=<1 0>;
		status = "okay";
	};
};


/*************************
 * PMIC DTSI File
*************************/

&mt_pmic_vcama_ldo_reg {
	regulator-name = "vcama";
	regulator-default-on = <0>; /* 0:skip, 1: off, 2:on */
	status = "okay";
};
&mt_pmic_vsim1_ldo_reg {
	regulator-name = "vsim1";
	regulator-default-on = <0>; /* 0:skip, 1: off, 2:on */
	status = "okay";
};
&mt_pmic_vsim2_ldo_reg {
	regulator-name = "vsim2";
	regulator-default-on = <0>; /* 0:skip, 1: off, 2:on */
	status = "okay";
};
&mt_pmic_vcam_af_ldo_reg {
	regulator-name = "vcamaf";
	regulator-default-on = <0>; /* 0:skip, 1: off, 2:on */
	status = "okay";
};
&mt_pmic_vgp1_ldo_reg {
	regulator-name = "vgp1";
	regulator-default-on = <0>; /* 0:skip, 1: off, 2:on */
	status = "okay";
};
&mt_pmic_vibr_ldo_reg {
	regulator-name = "vibr";
	regulator-default-on = <0>; /* 0:skip, 1: off, 2:on */
	status = "okay";
};
&mt_pmic_vcamd_ldo_reg {
	regulator-name = "vcamd";
	regulator-default-on = <0>; /* 0:skip, 1: off, 2:on */
	status = "okay";
};
&mt_pmic_vcam_io_ldo_reg {
	regulator-name = "vcamio";
	regulator-default-on = <0>; /* 0:skip, 1: off, 2:on */
	status = "okay";
};

&kd_camera_hw1 {
	vcama-supply = <&mt_pmic_vcama_ldo_reg>;
	vcama_main2-supply = <&mt_pmic_vcama_ldo_reg>;
	vcama_sub-supply = <&mt_pmic_vcama_ldo_reg>;

	vcamaf-supply = <&mt_pmic_vcam_af_ldo_reg>;
	vcamaf_main2-supply = <&mt_pmic_vcam_af_ldo_reg>;
	vcamaf_sub-supply = <&mt_pmic_vcam_af_ldo_reg>;

	vcamd-supply = <&mt_pmic_vcamd_ldo_reg>;
	vcamd_main2-supply = <&mt_pmic_vcamd_ldo_reg>;
	vcamd_sub-supply = <&mt_pmic_vcamd_ldo_reg>;

	vcamio-supply = <&mt_pmic_vcam_io_ldo_reg>;
	vcamio_main2-supply = <&mt_pmic_vcam_io_ldo_reg>;
	vcamio_sub-supply = <&mt_pmic_vcam_io_ldo_reg>;

	status = "okay";
};

&touch {
	vtouch-supply = <&mt_pmic_vgp1_ldo_reg>;
	status = "okay";
};


/********************************************
 *ADC DTSI File
********************************************/

&auxadc {
	adc_channel@ {
		compatible = "mediatek,adc_channel";
		mediatek,temperature0 = <0>;
		mediatek,temperature1 = <1>;
		mediatek,adc_fdd_rf_params_dynamic_custom_ch = <12>;
		status = "okay";
	};
};


/**********************************************
 *CLK_BUF DTSI File
********************************************/

&rf_clock_buffer_ctrl {
	mediatek,clkbuf-quantity = <4>;
	mediatek,clkbuf-config = <2 1 1 1>;
	status = "okay";
};


/**********************************************
 *Keypad DTSI File
********************************************/
&keypad{
		mediatek,kpd-key-debounce = <1024>;
		mediatek,kpd-sw-pwrkey = <116>;
		mediatek,kpd-hw-pwrkey = <8>;
		mediatek,kpd-sw-rstkey  = <114>;
		mediatek,kpd-hw-rstkey = <17>;
		mediatek,kpd-use-extend-type = <0>;
		/*HW Keycode [0~71] -> Linux Keycode*/
		mediatek,kpd-hw-map-num = <72>;
		mediatek,kpd-hw-init-map = <0 115 102 0 0 0 0 0 0 0 0 0 0 0 0 0 0 0 0 0 0 0 0 0
								0 0 0 0 0 0 0 0 0 0 0 0 0 0 0 0 0 0 0 0 0 0 0 0
								0 0 0 0 0 0 0 0 0 0 0 0 0 0 0 0 0 0 0 0 0 0 0 0 >;
		mediatek,kpd-pwrkey-eint-gpio = <0>;
		mediatek,kpd-pwkey-gpio-din  = <0>;
		mediatek,kpd-hw-dl-key0 = <1>;
		mediatek,kpd-hw-dl-key1 = <17>;
		mediatek,kpd-hw-dl-key2 = <8>;
		mediatek,kpd-hw-recovery-key = <1>;
		mediatek,kpd-hw-factory-key = <17>;
		status = "okay";
};

/*************************
 * I2C DTSI File
*************************/

&i2c0 {
	#address-cells = <1>;
	#size-cells = <0>;
	camera_main@34 {
		compatible = "mediatek,camera_main";
		reg = <0x34>;
		status = "okay";
	};
	camera_main_af@18 {
		compatible = "mediatek,camera_main_af";
		reg = <0x18>;
		status = "okay";
	};
	camera_sub@20 {
		compatible = "mediatek,camera_sub";
		reg = <0x20>;
		status = "okay";
	};
};

&i2c1 {
	#address-cells = <1>;
	#size-cells = <0>;
	cap_touch@5d {
		compatible = "mediatek,cap_touch";
		reg = <0x5d>;
		status = "okay";
	};
	i2c_lcd_bias@3e {
		compatible = "mediatek,i2c_lcd_bias";
		reg = <0x3e>;
		status = "okay";
	};
};

&i2c2 {
	#address-cells = <1>;
	#size-cells = <0>;
	msensor@0d {
		compatible = "mediatek,msensor";
		reg = <0x0d>;
		status = "okay";
	};
	gyro@68 {
		compatible = "mediatek,gyro";
		reg = <0x68>;
		status = "okay";
	};
	gsensor@4c {
		compatible = "mediatek,gsensor";
		reg = <0x4c>;
		status = "okay";
	};
	alsps@60 {
		compatible = "mediatek,alsps";
		reg = <0x60>;
		status = "okay";
	};
	strobe_main@63 {
		compatible = "mediatek,strobe_main";
		reg = <0x63>;
		status = "okay";
	};
};

