/* Copyright (c) 2019, The Linux Foundation. All rights reserved.
 *
 * This program is free software; you can redistribute it and/or modify
 * it under the terms of the GNU General Public License version 2 and
 * only version 2 as published by the Free Software Foundation.
 *
 * This program is distributed in the hope that it will be useful,
 * but WITHOUT ANY WARRANTY; without even the implied warranty of
 * MERCHANTABILITY or FITNESS FOR A PARTICULAR PURPOSE.  See the
 * GNU General Public License for more details.
 */

/* AWINIC AW8896 Smart PA */
&i2c4 {
	status = "okay";
	/* id = <18>; */
	clock-frequency = <400000>;
	#address-cells = <1>;
	#size-cells = <0>;

	speaker_amp@34 {
		compatible = "mediatek,speaker_amp";
		reg = <0x34>;
		reset-gpio = <&pio 95 0>;
		status = "okay";
	};
}; /* AWINIC AW8896 Smart PA End */

&accdet {
	/*1:ACC mode, 2:low cost without in bias, 6:low cost with in bias*/
	accdet-mic-mode = <1>;
	/*min_3pole--max_3pole--min_4pole--max_4pole--vol_bias*/
	headset-vol-threshold = <0 600 601 2000 2600>;
	/*0--MD_MAX--VOICE_MAX--UP_MAX--DW_MAX*/
	headset-four-key-threshold = <0 160 190 270 500>;
};