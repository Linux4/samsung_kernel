/* 
 * Generated by Samsung 
 * If these files should be changed, then please make a sync with MTK
*/

#include "mt6739-a02_common.dtsi"
#include "mt6739_a02_camera_00.dtsi"
#include "mt6739_a02_eif_common.dtsi"
#include "mt6739_a02_audio_common.dtsi"
#include "mt6739_a02_sensor_r00.dtsi"
#include "mt6739_a02_input_common.dtsi"
#include "mt6739_a02_pm_common.dtsi"
#include "display_lcd_a02_common.dtsi"

/*End of this file, DO NOT ADD ANYTHING HERE*/
