/* Generated by MediaTek 
 * If these files should be chaned, then please make a sync with MTK
*/

/dts-v1/;
/plugin/;

#include "../k39tv1_bsp_1g_titan-bringup.dts"
#include "mt6739_a01core_camera_00.dtsi"
#include "mt6739_a01core_eif_common.dtsi"
#include "mt6739_a3core_audio_common.dtsi"
#include "mt6739_a3core_sensor_r00.dtsi"
#include "mt6739_a01_pm_common.dtsi"
#include "mt6739_a3core_input_common.dtsi"
#include "display_lcd_a01core_common.dtsi"

/* Add Samsung configuration over here */
/ {
	compatible = "Samsung,A3CORE CIS SER 00", "Mediatek,MT6739";
	dtbo-hw_rev = <0>;
	dtbo-hw_rev_end = <0>;

	fragment@model {
		target-path = "/";
		__overlay__ {
			usb_notifier {
				compatible = "samsung,usb-notifier";
			};
		};
	};
};

&msdc1 {
       cd-gpios = <&pio 23 0>;
};
/*End of this file, DO NOT ADD ANYTHING HERE*/
