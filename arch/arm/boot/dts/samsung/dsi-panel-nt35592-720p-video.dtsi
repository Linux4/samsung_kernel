/* Copyright (c) 2013, The Linux Foundation. All rights reserved.
 *
 * This program is free software; you can redistribute it and/or modify
 * it under the terms of the GNU General Public License version 2 and
 * only version 2 as published by the Free Software Foundation.
 *
 * This program is distributed in the hope that it will be useful,
 * but WITHOUT ANY WARRANTY; without even the implied warranty of
 * MERCHANTABILITY or FITNESS FOR A PARTICULAR PURPOSE.  See the
 * GNU General Public License for more details.
 */

/*---------------------------------------------------------------------------
 * This file is autogenerated file using gcdb parser. Please do not edit it.
 * Update input XML file to add a new entry or update variable in this file
 * VERSION = "1.0"
 *---------------------------------------------------------------------------*/
&mdss_mdp {
	dsi_nt35592_720_vid: qcom,mdss_dsi_nt35592_720p_video {
		qcom,mdss-dsi-panel-name = "nt35592 720p video mode dsi panel";
		qcom,mdss-dsi-panel-controller = <&mdss_dsi0>;
		qcom,mdss-dsi-panel-type = "dsi_video_mode";
		qcom,mdss-dsi-panel-destination = "display_1";
		qcom,mdss-dsi-panel-framerate = <60>;
		qcom,mdss-dsi-virtual-channel-id = <0>;
		qcom,mdss-dsi-stream = <0>;
		qcom,mdss-dsi-panel-width = <720>;
		qcom,mdss-dsi-panel-height = <1280>;
		qcom,mdss-dsi-h-front-porch = <72>;
		qcom,mdss-dsi-h-back-porch = <84>;
		qcom,mdss-dsi-h-pulse-width = <16>;
		qcom,mdss-dsi-h-sync-skew = <0>;
		qcom,mdss-dsi-v-back-porch = <20>;
		qcom,mdss-dsi-v-front-porch = <9>;
		qcom,mdss-dsi-v-pulse-width = <2>;
		qcom,mdss-dsi-h-left-border = <0>;
		qcom,mdss-dsi-h-right-border = <0>;
		qcom,mdss-dsi-v-top-border = <0>;
		qcom,mdss-dsi-v-bottom-border = <0>;
		qcom,mdss-dsi-bpp = <24>;
		qcom,mdss-dsi-underflow-color = <0xff>;
		qcom,mdss-dsi-border-color = <0>;
		qcom,mdss-dsi-on-command = [
			/* < Power Setting (1) > */
			15 00 00 00 00 00 02 FF 01
			15 00 00 00 00 00 02 FB 01
			15 00 00 00 00 00 02 00 3A
			15 00 00 00 00 00 02 08 66
			15 00 00 00 00 00 02 09 8F
			15 00 00 00 00 00 02 0B C2
			15 00 00 00 00 00 02 0C C2
			15 00 00 00 00 00 02 0D 25
			15 00 00 00 00 00 02 0E 33
			15 00 00 00 00 00 02 71 2C
			15 00 00 00 00 00 02 0F 0A
			15 01 00 00 00 00 02 36 73

			/* < Timing Setting(2) > */
			15 00 00 00 00 00 02 FF 05
			15 00 00 00 00 00 02 FB 01
			15 00 00 00 00 00 02 01 00
			15 00 00 00 00 00 02 02 8D
			15 00 00 00 00 00 02 03 8D
			15 00 00 00 00 00 02 04 8D
			15 00 00 00 00 00 02 05 30
			15 00 00 00 00 00 02 06 33
			15 00 00 00 00 00 02 07 77
			15 00 00 00 00 00 02 08 00
			15 00 00 00 00 00 02 09 00
			15 00 00 00 00 00 02 0A 00
			15 00 00 00 00 00 02 0B 80
			15 00 00 00 00 00 02 0C C8
			15 00 00 00 00 00 02 0D 0A
			15 00 00 00 00 00 02 0E 1B
			15 00 00 00 00 00 02 0F 06
			15 00 00 00 00 00 02 10 56
			15 00 00 00 00 00 02 11 00
			15 00 00 00 00 00 02 12 00
			15 00 00 00 00 00 02 13 1E
			15 00 00 00 00 00 02 14 00
			15 00 00 00 00 00 02 15 1A
			15 00 00 00 00 00 02 16 05
			15 00 00 00 00 00 02 17 00
			15 00 00 00 00 00 02 18 1E
			15 00 00 00 00 00 02 19 FF
			15 00 00 00 00 00 02 1A 00
			15 00 00 00 00 00 02 1B FC
			15 00 00 00 00 00 02 1C 80
			15 00 00 00 00 00 02 1D 00
			15 00 00 00 00 00 02 1E 10
			15 00 00 00 00 00 02 1F 77
			15 00 00 00 00 00 02 20 00
			15 00 00 00 00 00 02 21 00
			15 00 00 00 00 00 02 22 55
			15 00 00 00 00 00 02 23 0D
			15 00 00 00 00 00 02 31 A0
			15 00 00 00 00 00 02 32 00
			15 00 00 00 00 00 02 33 B8
			15 00 00 00 00 00 02 34 BB
			15 00 00 00 00 00 02 35 11
			15 00 00 00 00 00 02 36 02
			15 00 00 00 00 00 02 37 00
			15 00 00 00 00 00 02 38 01
			15 00 00 00 00 00 02 39 0B
			15 00 00 00 00 00 02 44 08
			15 00 00 00 00 00 02 45 80
			15 00 00 00 00 00 02 46 CC
			15 00 00 00 00 00 02 47 04
			15 00 00 00 00 00 02 48 00
			15 00 00 00 00 00 02 49 00
			15 00 00 00 00 00 02 4A 01
			15 00 00 00 00 00 02 6C 03
			15 00 00 00 00 00 02 6D 03
			15 00 00 00 00 00 02 6E 2F
			15 00 00 00 00 00 02 6F 25
			15 00 00 00 00 00 02 43 00
			15 00 00 00 00 00 02 4B 23
			15 00 00 00 00 00 02 4C 01
			15 00 00 00 00 00 02 50 23
			15 00 00 00 00 00 02 51 01
			15 00 00 00 00 00 02 58 23
			15 00 00 00 00 00 02 59 01
			15 00 00 00 00 00 02 5D 23
			15 00 00 00 00 00 02 5E 01
			15 00 00 00 00 00 02 89 01
			15 00 00 00 00 00 02 8D 01
			15 00 00 00 00 00 02 8E 64
			15 00 00 00 00 00 02 8F 20
			15 00 00 00 00 00 02 97 8E
			15 00 00 00 00 00 02 82 8C
			15 00 00 00 00 00 02 83 02
			15 00 00 00 00 00 02 BB 0A
			15 00 00 00 00 00 02 BC 0A
			15 00 00 00 00 00 02 24 25
			15 00 00 00 00 00 02 25 55
			15 00 00 00 00 00 02 26 05
			15 00 00 00 00 00 02 27 23
			15 00 00 00 00 00 02 28 01
			15 00 00 00 00 00 02 29 31
			15 00 00 00 00 00 02 2A 5D
			15 00 00 00 00 00 02 2B 01
			15 00 00 00 00 00 02 2F 00
			15 00 00 00 00 00 02 30 10
			15 00 00 00 00 00 02 A7 12
			15 01 00 00 00 00 02 2D 03

			/* 3. Gamma Setting(3) */
			15 00 00 00 00 00 02 FF 01
			15 00 00 00 00 00 02 FB 01
			15 00 00 00 00 00 02 75 00
			15 00 00 00 00 00 02 76 80
			15 00 00 00 00 00 02 77 00
			15 00 00 00 00 00 02 78 99
			15 00 00 00 00 00 02 79 00
			15 00 00 00 00 00 02 7A C3
			15 00 00 00 00 00 02 7B 00
			15 00 00 00 00 00 02 7C DC
			15 00 00 00 00 00 02 7D 00
			15 00 00 00 00 00 02 7E F2
			15 00 00 00 00 00 02 7F 01
			15 00 00 00 00 00 02 80 03
			15 00 00 00 00 00 02 81 01
			15 00 00 00 00 00 02 82 13
			15 00 00 00 00 00 02 83 01
			15 00 00 00 00 00 02 84 21
			15 00 00 00 00 00 02 85 01
			15 00 00 00 00 00 02 86 2E
			15 00 00 00 00 00 02 87 01
			15 00 00 00 00 00 02 88 57
			15 00 00 00 00 00 02 89 01
			15 00 00 00 00 00 02 8A 78
			15 00 00 00 00 00 02 8B 01
			15 00 00 00 00 00 02 8C AD
			15 00 00 00 00 00 02 8D 01
			15 00 00 00 00 00 02 8E D6
			15 00 00 00 00 00 02 8F 02
			15 00 00 00 00 00 02 90 17
			15 00 00 00 00 00 02 91 02
			15 00 00 00 00 00 02 92 4D
			15 00 00 00 00 00 02 93 02
			15 00 00 00 00 00 02 94 4E
			15 00 00 00 00 00 02 95 02
			15 00 00 00 00 00 02 96 80
			15 00 00 00 00 00 02 97 02
			15 00 00 00 00 00 02 98 B6
			15 00 00 00 00 00 02 99 02
			15 00 00 00 00 00 02 9A D8
			15 00 00 00 00 00 02 9B 03
			15 00 00 00 00 00 02 9C 05
			15 00 00 00 00 00 02 9D 03
			15 00 00 00 00 00 02 9E 23
			15 00 00 00 00 00 02 9F 03
			15 00 00 00 00 00 02 A0 4A
			15 00 00 00 00 00 02 A2 03
			15 00 00 00 00 00 02 A3 57
			15 00 00 00 00 00 02 A4 03
			15 00 00 00 00 00 02 A5 63
			15 00 00 00 00 00 02 A6 03
			15 00 00 00 00 00 02 A7 72
			15 00 00 00 00 00 02 A9 03
			15 00 00 00 00 00 02 AA 81
			15 00 00 00 00 00 02 AB 03
			15 00 00 00 00 00 02 AC 93
			15 00 00 00 00 00 02 AD 03
			15 00 00 00 00 00 02 AE A7
			15 00 00 00 00 00 02 AF 03
			15 00 00 00 00 00 02 B0 B6
			15 00 00 00 00 00 02 B1 03
			15 00 00 00 00 00 02 B2 B7
			15 00 00 00 00 00 02 B3 00
			15 00 00 00 00 00 02 B4 80
			15 00 00 00 00 00 02 B5 00
			15 00 00 00 00 00 02 B6 99
			15 00 00 00 00 00 02 B7 00
			15 00 00 00 00 00 02 B8 C3
			15 00 00 00 00 00 02 B9 00
			15 00 00 00 00 00 02 BA DC
			15 00 00 00 00 00 02 BB 00
			15 00 00 00 00 00 02 BC F2
			15 00 00 00 00 00 02 BD 01
			15 00 00 00 00 00 02 BE 03
			15 00 00 00 00 00 02 BF 01
			15 00 00 00 00 00 02 C0 13
			15 00 00 00 00 00 02 C1 01
			15 00 00 00 00 00 02 C2 21
			15 00 00 00 00 00 02 C3 01
			15 00 00 00 00 00 02 C4 2E
			15 00 00 00 00 00 02 C5 01
			15 00 00 00 00 00 02 C6 57
			15 00 00 00 00 00 02 C7 01
			15 00 00 00 00 00 02 C8 78
			15 00 00 00 00 00 02 C9 01
			15 00 00 00 00 00 02 CA AD
			15 00 00 00 00 00 02 CB 01
			15 00 00 00 00 00 02 CC D6
			15 00 00 00 00 00 02 CD 02
			15 00 00 00 00 00 02 CE 17
			15 00 00 00 00 00 02 CF 02
			15 00 00 00 00 00 02 D0 4D
			15 00 00 00 00 00 02 D1 02
			15 00 00 00 00 00 02 D2 4E
			15 00 00 00 00 00 02 D3 02
			15 00 00 00 00 00 02 D4 80
			15 00 00 00 00 00 02 D5 02
			15 00 00 00 00 00 02 D6 B6
			15 00 00 00 00 00 02 D7 02
			15 00 00 00 00 00 02 D8 D8
			15 00 00 00 00 00 02 D9 03
			15 00 00 00 00 00 02 DA 05
			15 00 00 00 00 00 02 DB 03
			15 00 00 00 00 00 02 DC 23
			15 00 00 00 00 00 02 DD 03
			15 00 00 00 00 00 02 DE 4A
			15 00 00 00 00 00 02 DF 03
			15 00 00 00 00 00 02 E0 57
			15 00 00 00 00 00 02 E1 03
			15 00 00 00 00 00 02 E2 63
			15 00 00 00 00 00 02 E3 03
			15 00 00 00 00 00 02 E4 72
			15 00 00 00 00 00 02 E5 03
			15 00 00 00 00 00 02 E6 81
			15 00 00 00 00 00 02 E7 03
			15 00 00 00 00 00 02 E8 93
			15 00 00 00 00 00 02 E9 03
			15 00 00 00 00 00 02 EA A7
			15 00 00 00 00 00 02 EB 03
			15 00 00 00 00 00 02 EC B6
			15 00 00 00 00 00 02 ED 03
			15 00 00 00 00 00 02 EE B7
			15 00 00 00 00 00 02 EF 00
			15 00 00 00 00 00 02 F0 80
			15 00 00 00 00 00 02 F1 00
			15 00 00 00 00 00 02 F2 99
			15 00 00 00 00 00 02 F3 00
			15 00 00 00 00 00 02 F4 C3
			15 00 00 00 00 00 02 F5 00
			15 00 00 00 00 00 02 F6 DC
			15 00 00 00 00 00 02 F7 00
			15 00 00 00 00 00 02 F8 F2
			15 00 00 00 00 00 02 F9 01
			15 01 00 00 00 00 02 FA 03

			15 00 00 00 00 00 02 FF 02
			15 00 00 00 00 00 02 FB 01
			15 00 00 00 00 00 02 00 01
			15 00 00 00 00 00 02 01 13
			15 00 00 00 00 00 02 02 01
			15 00 00 00 00 00 02 03 21
			15 00 00 00 00 00 02 04 01
			15 00 00 00 00 00 02 05 2E
			15 00 00 00 00 00 02 06 01
			15 00 00 00 00 00 02 07 57
			15 00 00 00 00 00 02 08 01
			15 00 00 00 00 00 02 09 78
			15 00 00 00 00 00 02 0A 01
			15 00 00 00 00 00 02 0B AD
			15 00 00 00 00 00 02 0C 01
			15 00 00 00 00 00 02 0D D6
			15 00 00 00 00 00 02 0E 02
			15 00 00 00 00 00 02 0F 17
			15 00 00 00 00 00 02 10 02
			15 00 00 00 00 00 02 11 4D
			15 00 00 00 00 00 02 12 02
			15 00 00 00 00 00 02 13 4E
			15 00 00 00 00 00 02 14 02
			15 00 00 00 00 00 02 15 80
			15 00 00 00 00 00 02 16 02
			15 00 00 00 00 00 02 17 B6
			15 00 00 00 00 00 02 18 02
			15 00 00 00 00 00 02 19 D8
			15 00 00 00 00 00 02 1A 03
			15 00 00 00 00 00 02 1B 05
			15 00 00 00 00 00 02 1C 03
			15 00 00 00 00 00 02 1D 23
			15 00 00 00 00 00 02 1E 03
			15 00 00 00 00 00 02 1F 4A
			15 00 00 00 00 00 02 20 03
			15 00 00 00 00 00 02 21 57
			15 00 00 00 00 00 02 22 03
			15 00 00 00 00 00 02 23 63
			15 00 00 00 00 00 02 24 03
			15 00 00 00 00 00 02 25 72
			15 00 00 00 00 00 02 26 03
			15 00 00 00 00 00 02 27 81
			15 00 00 00 00 00 02 28 03
			15 00 00 00 00 00 02 29 93
			15 00 00 00 00 00 02 2A 03
			15 00 00 00 00 00 02 2B A7
			15 00 00 00 00 00 02 2D 03
			15 00 00 00 00 00 02 2F B6
			15 00 00 00 00 00 02 30 03
			15 00 00 00 00 00 02 31 B7
			15 00 00 00 00 00 02 32 00
			15 00 00 00 00 00 02 33 80
			15 00 00 00 00 00 02 34 00
			15 00 00 00 00 00 02 35 99
			15 00 00 00 00 00 02 36 00
			15 00 00 00 00 00 02 37 C3
			15 00 00 00 00 00 02 38 00
			15 00 00 00 00 00 02 39 DC
			15 00 00 00 00 00 02 3A 00
			15 00 00 00 00 00 02 3B F2
			15 00 00 00 00 00 02 3D 01
			15 00 00 00 00 00 02 3F 03
			15 00 00 00 00 00 02 40 01
			15 00 00 00 00 00 02 41 13
			15 00 00 00 00 00 02 42 01
			15 00 00 00 00 00 02 43 21
			15 00 00 00 00 00 02 44 01
			15 00 00 00 00 00 02 45 2E
			15 00 00 00 00 00 02 46 01
			15 00 00 00 00 00 02 47 57
			15 00 00 00 00 00 02 48 01
			15 00 00 00 00 00 02 49 78
			15 00 00 00 00 00 02 4A 01
			15 00 00 00 00 00 02 4B AD
			15 00 00 00 00 00 02 4C 01
			15 00 00 00 00 00 02 4D D6
			15 00 00 00 00 00 02 4E 02
			15 00 00 00 00 00 02 4F 17
			15 00 00 00 00 00 02 50 02
			15 00 00 00 00 00 02 51 4D
			15 00 00 00 00 00 02 52 02
			15 00 00 00 00 00 02 53 4E
			15 00 00 00 00 00 02 54 02
			15 00 00 00 00 00 02 55 80
			15 00 00 00 00 00 02 56 02
			15 00 00 00 00 00 02 58 B6
			15 00 00 00 00 00 02 59 02
			15 00 00 00 00 00 02 5A D8
			15 00 00 00 00 00 02 5B 03
			15 00 00 00 00 00 02 5C 05
			15 00 00 00 00 00 02 5D 03
			15 00 00 00 00 00 02 5E 23
			15 00 00 00 00 00 02 5F 03
			15 00 00 00 00 00 02 60 4A
			15 00 00 00 00 00 02 61 03
			15 00 00 00 00 00 02 62 57
			15 00 00 00 00 00 02 63 03
			15 00 00 00 00 00 02 64 63
			15 00 00 00 00 00 02 65 03
			15 00 00 00 00 00 02 66 72
			15 00 00 00 00 00 02 67 03
			15 00 00 00 00 00 02 68 81
			15 00 00 00 00 00 02 69 03
			15 00 00 00 00 00 02 6A 93
			15 00 00 00 00 00 02 6B 03
			15 00 00 00 00 00 02 6C A7
			15 00 00 00 00 00 02 6D 03
			15 00 00 00 00 00 02 6E B6
			15 00 00 00 00 00 02 6F 03
			15 00 00 00 00 00 02 70 B7
			15 00 00 00 00 00 02 71 00
			15 00 00 00 00 00 02 72 80
			15 00 00 00 00 00 02 73 00
			15 00 00 00 00 00 02 74 99
			15 00 00 00 00 00 02 75 00
			15 00 00 00 00 00 02 76 C3
			15 00 00 00 00 00 02 77 00
			15 00 00 00 00 00 02 78 DC
			15 00 00 00 00 00 02 79 00
			15 00 00 00 00 00 02 7A F2
			15 00 00 00 00 00 02 7B 01
			15 00 00 00 00 00 02 7C 03
			15 00 00 00 00 00 02 7D 01
			15 00 00 00 00 00 02 7E 13
			15 00 00 00 00 00 02 7F 01
			15 00 00 00 00 00 02 80 21
			15 00 00 00 00 00 02 81 01
			15 00 00 00 00 00 02 82 2E
			15 00 00 00 00 00 02 83 01
			15 00 00 00 00 00 02 84 57
			15 00 00 00 00 00 02 85 01
			15 00 00 00 00 00 02 86 78
			15 00 00 00 00 00 02 87 01
			15 00 00 00 00 00 02 88 AD
			15 00 00 00 00 00 02 89 01
			15 00 00 00 00 00 02 8A D6
			15 00 00 00 00 00 02 8B 02
			15 00 00 00 00 00 02 8C 17
			15 00 00 00 00 00 02 8D 02
			15 00 00 00 00 00 02 8E 4D
			15 00 00 00 00 00 02 8F 02
			15 00 00 00 00 00 02 90 4E
			15 00 00 00 00 00 02 91 02
			15 00 00 00 00 00 02 92 80
			15 00 00 00 00 00 02 93 02
			15 00 00 00 00 00 02 94 B6
			15 00 00 00 00 00 02 95 02
			15 00 00 00 00 00 02 96 D8
			15 00 00 00 00 00 02 97 03
			15 00 00 00 00 00 02 98 05
			15 00 00 00 00 00 02 99 03
			15 00 00 00 00 00 02 9A 23
			15 00 00 00 00 00 02 9B 03
			15 00 00 00 00 00 02 9C 4A
			15 00 00 00 00 00 02 9D 03
			15 00 00 00 00 00 02 9E 57
			15 00 00 00 00 00 02 9F 03
			15 00 00 00 00 00 02 A0 63
			15 00 00 00 00 00 02 A2 03
			15 00 00 00 00 00 02 A3 72
			15 00 00 00 00 00 02 A4 03
			15 00 00 00 00 00 02 A5 81
			15 00 00 00 00 00 02 A6 03
			15 00 00 00 00 00 02 A7 93
			15 00 00 00 00 00 02 A9 03
			15 00 00 00 00 00 02 AA A7
			15 00 00 00 00 00 02 AB 03
			15 00 00 00 00 00 02 AC B6
			15 00 00 00 00 00 02 AD 03
			15 00 00 00 00 00 02 AE B7
			15 00 00 00 00 00 02 AF 00
			15 00 00 00 00 00 02 B0 80
			15 00 00 00 00 00 02 B1 00
			15 00 00 00 00 00 02 B2 99
			15 00 00 00 00 00 02 B3 00
			15 00 00 00 00 00 02 B4 C3
			15 00 00 00 00 00 02 B5 00
			15 00 00 00 00 00 02 B6 DC
			15 00 00 00 00 00 02 B7 00
			15 00 00 00 00 00 02 B8 F2
			15 00 00 00 00 00 02 B9 01
			15 00 00 00 00 00 02 BA 03
			15 00 00 00 00 00 02 BB 01
			15 00 00 00 00 00 02 BC 13
			15 00 00 00 00 00 02 BD 01
			15 00 00 00 00 00 02 BE 21
			15 00 00 00 00 00 02 BF 01
			15 00 00 00 00 00 02 C0 2E
			15 00 00 00 00 00 02 C1 01
			15 00 00 00 00 00 02 C2 57
			15 00 00 00 00 00 02 C3 01
			15 00 00 00 00 00 02 C4 78
			15 00 00 00 00 00 02 C5 01
			15 00 00 00 00 00 02 C6 AD
			15 00 00 00 00 00 02 C7 01
			15 00 00 00 00 00 02 C8 D6
			15 00 00 00 00 00 02 C9 02
			15 00 00 00 00 00 02 CA 17
			15 00 00 00 00 00 02 CB 02
			15 00 00 00 00 00 02 CC 4D
			15 00 00 00 00 00 02 CD 02
			15 00 00 00 00 00 02 CE 4E
			15 00 00 00 00 00 02 CF 02
			15 00 00 00 00 00 02 D0 80
			15 00 00 00 00 00 02 D1 02
			15 00 00 00 00 00 02 D2 B6
			15 00 00 00 00 00 02 D3 02
			15 00 00 00 00 00 02 D4 D8
			15 00 00 00 00 00 02 D5 03
			15 00 00 00 00 00 02 D6 05
			15 00 00 00 00 00 02 D7 03
			15 00 00 00 00 00 02 D8 23
			15 00 00 00 00 00 02 D9 03
			15 00 00 00 00 00 02 DA 4A
			15 00 00 00 00 00 02 DB 03
			15 00 00 00 00 00 02 DC 57
			15 00 00 00 00 00 02 DD 03
			15 00 00 00 00 00 02 DE 63
			15 00 00 00 00 00 02 DF 03
			15 00 00 00 00 00 02 E0 72
			15 00 00 00 00 00 02 E1 03
			15 00 00 00 00 00 02 E2 81
			15 00 00 00 00 00 02 E3 03
			15 00 00 00 00 00 02 E4 93
			15 00 00 00 00 00 02 E5 03
			15 00 00 00 00 00 02 E6 A7
			15 00 00 00 00 00 02 E7 03
			15 00 00 00 00 00 02 E8 B6
			15 00 00 00 00 00 02 E9 03
			15 01 00 00 00 00 02 EA B7

			/* <LED PWM Frequence Setting(4) - LED PWM: 21khz */
			15 00 00 00 00 00 02 FF 04
			15 00 00 00 00 00 02 FB 01
			15 00 00 00 00 00 02 07 20
			15 00 00 00 00 00 02 08 04
			15 00 00 00 00 00 02 46 06

			15 01 00 00 00 00 02 13 D3 /* CABC_PWM0[7 : 0]       82.05% */

			/* < CABC setting(5) > */
			15 00 00 00 00 00 02 FF 00
			15 00 00 00 00 00 02 36 C0
			15 01 00 00 00 00 02 53 24

			05 01 00 00 78 00 02 11 00
			05 01 00 00 0A 00 02 29 00
		];
		qcom,mdss-dsi-off-command = [
			05 01 00 00 32 00 02 28 00
			05 01 00 00 05 00 02 10 00
		];
		qcom,mdss-dsi-on-command-state = "dsi_lp_mode";
		qcom,mdss-dsi-off-command-state = "dsi_hs_mode";
		qcom,mdss-dsi-h-sync-pulse = <1>;
		qcom,mdss-dsi-traffic-mode = "burst_mode";
		qcom,mdss-dsi-bllp-eof-power-mode;
		qcom,mdss-dsi-bllp-power-mode;
		qcom,mdss-dsi-lane-0-state;
		qcom,mdss-dsi-lane-1-state;
		qcom,mdss-dsi-lane-2-state;
		qcom,mdss-dsi-lane-3-state;
		qcom,mdss-dsi-panel-timings = [73 1A 10 00 3E 40 16 1E 15 03 04 00];
		qcom,mdss-dsi-t-clk-post = <0x04>;
		qcom,mdss-dsi-t-clk-pre = <0x19>;
		qcom,mdss-dsi-bl-min-level = <1>;
		qcom,mdss-dsi-bl-max-level = <255>;
		qcom,mdss-dsi-dma-trigger = "trigger_sw";
		qcom,mdss-dsi-mdp-trigger = "none";
		qcom,mdss-dsi-bl-pmic-control-type = "bl_ctrl_dcs";
		qcom,mdss-dsi-reset-sequence = <0 10>, <1 50>;
		qcom,mdss-pan-physical-width-dimension = <74>;
		qcom,mdss-pan-physical-height-dimension = <132>;

		qcom,mdss-dsi-lp11-init;
		qcom,mdss-dsi-init-delay-us = <20000>;

		samsung,panel-brightness-cmds = [
			15 01 00 00 05 00 02 51 00
		];
		samsung,panel-cabc-on-cmds = [
			15 01 00 00 05 00 02 55 01
		];
		samsung,panel-cabc-off-cmds = [
			15 01 00 00 05 00 02 55 00
		];
		samsung,panel-cabc-cmds-state = "dsi_hs_mode";
	};
};
