/* Copyright (c) 2013, The Linux Foundation. All rights reserved.
 *
 * This program is free software; you can redistribute it and/or modify
 * it under the terms of the GNU General Public License version 2 and
 * only version 2 as published by the Free Software Foundation.
 *
 * This program is distributed in the hope that it will be useful,
 * but WITHOUT ANY WARRANTY; without even the implied warranty of
 * MERCHANTABILITY or FITNESS FOR A PARTICULAR PURPOSE.  See the
 * GNU General Public License for more details.
 */

/*---------------------------------------------------------------------------
 * This file is autogenerated file using gcdb parser. Please do not edit it.
 * Update input XML file to add a new entry or update variable in this file
 * VERSION = "1.0"
 *---------------------------------------------------------------------------*/
&mdss_mdp {
	dsi_sharp_jdi_720_vid: qcom,mdss_dsi_sharp_jdi_720p_video {
		qcom,mdss-dsi-panel-name = "sharp jdi 720p video mode dsi panel";
		qcom,mdss-dsi-panel-controller = <&mdss_dsi0>;
		qcom,mdss-dsi-panel-type = "dsi_video_mode";
		qcom,mdss-dsi-panel-destination = "display_1";
		qcom,mdss-dsi-panel-framerate = <60>;
		qcom,mdss-dsi-virtual-channel-id = <0>;
		qcom,mdss-dsi-stream = <0>;
		qcom,mdss-dsi-panel-width = <720>;
		qcom,mdss-dsi-panel-height = <1280>;
		qcom,mdss-dsi-h-front-porch = <192>;
		qcom,mdss-dsi-h-back-porch = <30>;
		qcom,mdss-dsi-h-pulse-width = <4>;
		qcom,mdss-dsi-h-sync-skew = <0>;
		qcom,mdss-dsi-v-back-porch = <6>;
		qcom,mdss-dsi-v-front-porch = <8>;
		qcom,mdss-dsi-v-pulse-width = <2>;
		qcom,mdss-dsi-h-left-border = <0>;
		qcom,mdss-dsi-h-right-border = <0>;
		qcom,mdss-dsi-v-top-border = <0>;
		qcom,mdss-dsi-v-bottom-border = <0>;
		qcom,mdss-dsi-bpp = <24>;
		qcom,mdss-dsi-underflow-color = <0xff>;
		qcom,mdss-dsi-border-color = <0>;
		qcom,mdss-dsi-on-command = [
			39 01 00 00 01 00 03 F0 5A 5A
			39 01 00 00 01 00 03 E0 00 04 /* Bus delay on */
			39 01 00 00 01 00 03 F0 A5 A5
			39 01 00 00 01 00 02 36 00
			39 01 00 00 01 00 02 53 26
			39 01 00 00 10 00 02 51 5f

			05 01 00 00 78 00 02 11 00 /* Sleep out */
			39 01 00 00 01 00 03 F0 5A 5A
			39 01 00 00 01 00 04 C3 BB 00 21 /* Set PWM frequency to higher than 22KHz */
			39 01 00 00 01 00 05 BA 04 02 02 EA

			39 01 00 00 01 00 46
				CA 21 EE 25 2D 34 3B 41
				4A 51 5D 65 75 83 90 9C
				A9 B0 BA C5 CC D3 EA F0
				2C EE 2E 34 39 3F 44 4B
				52 5D 65 74 82 8F 9C A9
				B1 BA C4 CB D2 E9 F0 26
				EE 29 2F 35 3C 41 49 50
				5C 64 74 82 8F 9C A9 B0
				B8 C3 CA D1 E1 E8

			39 01 00 00 01 00 46
				CB 19 F8 1D 25 2E 35 3B
				46 4F 5F 6B 7F 8C 98 A5
				AB BB C5 D0 D7 DE F4 FA
				24 F8 26 2C 33 39 3E 47 
				50 5F 6B 7E 8B 97 A5 AB 
				BC C5 CF D6 DD F3 FA 1E 
				F8 21 27 2F 36 3B 45 4E  
				5E 6A 7E 8B 97 A5 AB BB 
				C3 CE D5 DC EB F2

			39 01 00 00 01 00 03 F0 A5 A5
			05 01 00 00 0A 00 02 29 00
		];
		qcom,mdss-dsi-off-command = [
			05 01 00 00 32 00 02 28 00
			05 01 00 00 78 00 02 10 00
		];
		qcom,mdss-dsi-on-command-state = "dsi_lp_mode";
		qcom,mdss-dsi-off-command-state = "dsi_hs_mode";
		qcom,mdss-dsi-h-sync-pulse = <1>;
		qcom,mdss-dsi-traffic-mode = "burst_mode";
		qcom,mdss-dsi-bllp-eof-power-mode;
		qcom,mdss-dsi-bllp-power-mode;
		qcom,mdss-dsi-lane-0-state;
		qcom,mdss-dsi-lane-1-state;
		qcom,mdss-dsi-lane-2-state;
		qcom,mdss-dsi-lane-3-state;
		qcom,mdss-dsi-panel-timings = [82 1C 12 00 42 44 18 26 24 03 04 00];
		qcom,mdss-dsi-t-clk-post = <0x04>;
		qcom,mdss-dsi-t-clk-pre = <0x19>;
		qcom,mdss-dsi-bl-min-level = <1>;
		qcom,mdss-dsi-bl-max-level = <255>;
		qcom,mdss-dsi-dma-trigger = "trigger_sw";
		qcom,mdss-dsi-mdp-trigger = "none";
		qcom,mdss-dsi-bl-pmic-control-type = "bl_ctrl_dcs";
		qcom,mdss-dsi-reset-sequence = <0 10>, <1 50>;
		qcom,mdss-pan-physical-width-dimension = <69>;
		qcom,mdss-pan-physical-height-dimension = <124>;

		qcom,mdss-dsi-lp11-init;
		qcom,mdss-dsi-init-delay-us = <20000>;
		qcom,mdss-force-clk-lane-hs = <1>;

		samsung,panel-brightness-cmds = [
			15 01 00 00 05 00 02 51 00
		];
		samsung,panel-cabc-on-cmds = [
			15 01 00 00 05 00 02 55 01
			39 01 00 00 05 00 0A CA 27 27 27 27 27 27 27 27 27 /* CABC GAIN 82% */
		];
		samsung,panel-cabc-off-cmds = [
			15 01 00 00 05 00 02 55 00
			39 01 00 00 05 00 0A CA 20 20 20 20 20 20 20 20 20 /* CABC GAIN 100 % */
		];
		samsung,panel-cabc-cmds-state = "dsi_hs_mode";
	};
};
