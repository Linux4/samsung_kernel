/*
 * Copyright (c) 2015-2016, The Linux Foundation. All rights reserved.
 *
 * This program is free software; you can redistribute it and/or modify
 * it under the terms of the GNU General Public License version 2 and
 * only version 2 as published by the Free Software Foundation.
 *
 * This program is distributed in the hope that it will be useful,
 * but WITHOUT ANY WARRANTY; without even the implied warranty of
 * MERCHANTABILITY or FITNESS FOR A PARTICULAR PURPOSE.  See the
 * GNU General Public License for more details.
 */

#include "msm8917-sec-on5xllte-chn-r01.dtsi"
#include "msm8917-pinctrl-sec-on5xflte-chn-r01.dtsi"
#include "msm8917-sec-on5xllte-chn-fingerprint-sensor_00.dtsi"

/ {
	reserved-memory {
		/delete-node/ tzapp_region@0;
		tzapp_mem: tzapp_region@0 {
			compatible = "removed-dma-pool";
			no-map;
			reg = <0x0 0x90000000 0x0 0x1C00000>;
		};
		
		/delete-node/ secure_region@0;
		secure_mem: secure_region@0 {
			compatible = "shared-dma-pool";
			reusable;
			alignment = <0 0x400000>;
			size = <0 0x7000000>;
		};		
	};
};
