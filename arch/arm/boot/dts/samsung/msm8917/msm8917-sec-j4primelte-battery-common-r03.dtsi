/* Copyright (c) 2015, The Linux Foundation. All rights reserved.
 *
 * This program is free software; you can redistribute it and/or modify
 * it under the terms of the GNU General Public License version 2 and
 * only version 2 as published by the Free Software Foundation.
 *
 * This program is distributed in the hope that it will be useful,
 * but WITHOUT ANY WARRANTY; without even the implied warranty of
 * MERCHANTABILITY or FITNESS FOR A PARTICULAR PURPOSE.  See the
 * GNU General Public License for more details.
 */

 #include "msm8917-sec-j4primelte-battery-common.dtsi"
 
 / {
	i2c_11: i2c@11 {
		gpios = <&tlmm 0 0	/* sda */
			&tlmm 1 0	/* scl */
			>;
	};
};
