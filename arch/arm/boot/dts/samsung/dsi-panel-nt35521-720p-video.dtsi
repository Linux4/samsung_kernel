/* Copyright (c) 2013, The Linux Foundation. All rights reserved.
 *
 * This program is free software; you can redistribute it and/or modify
 * it under the terms of the GNU General Public License version 2 and
 * only version 2 as published by the Free Software Foundation.
 *
 * This program is distributed in the hope that it will be useful,
 * but WITHOUT ANY WARRANTY; without even the implied warranty of
 * MERCHANTABILITY or FITNESS FOR A PARTICULAR PURPOSE.  See the
 * GNU General Public License for more details.
 */

/*---------------------------------------------------------------------------
 * This file is autogenerated file using gcdb parser. Please do not edit it.
 * Update input XML file to add a new entry or update variable in this file
 * VERSION = "1.0"
 *---------------------------------------------------------------------------*/
&mdss_mdp {
	dsi_nt35521_720_vid: qcom,mdss_dsi_nt35521_720p_video {
		qcom,mdss-dsi-panel-name = "nt35521 720p video mode dsi panel";
		qcom,mdss-dsi-panel-controller = <&mdss_dsi0>;
		qcom,mdss-dsi-panel-type = "dsi_video_mode";
		qcom,mdss-dsi-panel-destination = "display_1";
		qcom,mdss-dsi-panel-framerate = <60>;
		qcom,mdss-dsi-virtual-channel-id = <0>;
		qcom,mdss-dsi-stream = <0>;
		qcom,mdss-dsi-panel-width = <720>;
		qcom,mdss-dsi-panel-height = <1280>;
		qcom,mdss-dsi-h-front-porch = <41>;
		qcom,mdss-dsi-h-back-porch = <41>;
		qcom,mdss-dsi-h-pulse-width = <2>;
		qcom,mdss-dsi-h-sync-skew = <0>;
		qcom,mdss-dsi-v-back-porch = <16>;
		qcom,mdss-dsi-v-front-porch = <16>;
		qcom,mdss-dsi-v-pulse-width = <2>;
		qcom,mdss-dsi-h-left-border = <0>;
		qcom,mdss-dsi-h-right-border = <0>;
		qcom,mdss-dsi-v-top-border = <0>;
		qcom,mdss-dsi-v-bottom-border = <0>;
		qcom,mdss-dsi-bpp = <24>;
		qcom,mdss-dsi-underflow-color = <0xff>;
		qcom,mdss-dsi-border-color = <0>;
		qcom,mdss-dsi-on-command = [
			39 01 00 00 00 00 05 FF AA 55 A5 80
			39 01 00 00 00 00 03 6F 11 00
			39 01 00 00 00 00 03 F7 20 00
			39 01 00 00 00 00 02 6F 06
			39 01 00 00 00 00 02 F7 A0
			39 01 00 00 00 00 02 6F 19
			39 01 00 00 00 00 02 F7 12
			39 01 00 00 00 00 02 6F 02
			39 01 00 00 00 00 02 F7 47
			39 01 00 00 00 00 02 6F 17
			39 01 00 00 00 00 02 F4 70
			39 01 00 00 00 00 02 6F 01
			39 01 00 00 00 00 02 F9 46
			39 01 00 00 00 00 06 F0 55 AA 52 08 00
			39 01 00 00 00 00 06 BD 01 A0 10 10 01
			39 01 00 00 00 00 05 B8 01 02 0C 02
			39 01 00 00 00 00 03 BB 11 11
			39 01 00 00 00 00 03 BC 00 00
			39 01 00 00 00 00 02 B6 01
			39 01 00 00 00 00 02 C8 80
			39 01 00 00 00 00 03 D9 01 01
			39 01 00 00 00 00 02 D4 C7
			39 01 00 00 0A 00 03 B1 60 27
			39 01 00 00 00 00 06 F0 55 AA 52 08 01
			39 01 00 00 00 00 03 B0 09 09
			39 01 00 00 00 00 03 B1 09 09
			39 01 00 00 00 00 03 BC 80 00
			39 01 00 00 00 00 03 BD 80 00
			39 01 00 00 00 00 02 CA 00
			39 01 00 00 00 00 02 C0 0C
			39 01 00 00 00 00 03 B5 03 03
			39 01 00 00 00 00 02 BE 48
			39 01 00 00 00 00 03 B3 19 19
			39 01 00 00 00 00 03 B4 19 19
			39 01 00 00 00 00 03 B9 26 26
			39 01 00 00 00 00 03 BA 24 24
			39 01 00 00 00 00 06 F0 55 AA 52 08 02
			39 01 00 00 00 00 02 EE 00
			39 01 00 00 00 00 11 B0 00 00 00 10 00 2B 00 44 00 59 00 7C 00 9C 00 CC
			39 01 00 00 00 00 11 B1 00 F5 01 39 01 6B 01 C2 02 06  02 07 02 3F 02 7E
			39 01 00 00 00 00 11 B2 02 A4 02 D9 02 FD 03 30 03 4F 03 6F 03 92 03 B0
			39 01 00 00 00 00 05 B3 03 DF 03 FF
			39 01 00 00 00 00 11 B4 00 00 00 10 00 2B 00 44 00 59 00 7C 00 9C 00 CC
			39 01 00 00 00 00 11 B5 00 F5 01 39 01 6B 01 C2 02 06  02 07 02 3F 02 7E
			39 01 00 00 00 00 11 B6 02 A4 02 D9 02 FD 03 30 03 4F 03 6F 03 92 03 B0
			39 01 00 00 00 00 05 B7 03 DF 03 FF
			39 01 00 00 00 00 11 B8 00 00 00 10 00 2B 00 44 00 59 00 7C 00 9C 00 CC
			39 01 00 00 00 00 11 B9 00 F5 01 39 01 6B 01 C2 02 06  02 07 02 3F 02 7E
			39 01 00 00 00 00 11 BA 02 A4 02 D9 02 FD 03 30 03 4F 03 6F 03 92 03 B0
			39 01 00 00 00 00 05 BB 03 DF 03 FF
			39 01 00 00 00 00 11 BC 00 00 00 10 00 2B 00 44 00 59 00 7C 00 9C 00 CC
			39 01 00 00 00 00 11 BD 00 F5 01 39 01 6B 01 C2 02 06  02 07 02 3F 02 7E
			39 01 00 00 00 00 11 BE 02 A4 02 D9 02 FD 03 30 03 4F 03 6F 03 92 03 B0
			39 01 00 00 00 00 05 BF 03 DF 03 FF
			39 01 00 00 00 00 11 C0 00 00 00 10 00 2B 00 44 00 59 00 7C 00 9C 00 CC
			39 01 00 00 00 00 11 C1 00 F5 01 39 01 6B 01 C2 02 06  02 07 02 3F 02 7E
			39 01 00 00 00 00 11 C2 02 A4 02 D9 02 FD 03 30 03 4F 03 6F 03 92 03 B0
			39 01 00 00 00 00 05 C3 03 DF 03 FF
			39 01 00 00 00 00 11 C4 00 00 00 10 00 2B 00 44 00 59 00 7C 00 9C 00 CC
			39 01 00 00 00 00 11 C5 00 F5 01 39 01 6B 01 C2 02 06  02 07 02 3F 02 7E
			39 01 00 00 00 00 11 C6 02 A4 02 D9 02 FD 03 30 03 4F 03 6F 03 92 03 B0
			39 01 00 00 00 00 05 C7 03 DF 03 FF
			39 01 00 00 00 00 06 F0 55 AA 52 08 06
			39 01 00 00 00 00 03 B0 10 12
			39 01 00 00 00 00 03 B1 14 16
			39 01 00 00 00 00 03 B2 00 02
			39 01 00 00 00 00 03 B3 31 31
			39 01 00 00 00 00 03 B4 31 34
			39 01 00 00 00 00 03 B5 34 34
			39 01 00 00 00 00 03 B6 34 31
			39 01 00 00 00 00 03 B7 31 31
			39 01 00 00 00 00 03 B8 31 31
			39 01 00 00 00 00 03 B9 2D 2E
			39 01 00 00 00 00 03 BA 2E 2D
			39 01 00 00 00 00 03 BB 31 31
			39 01 00 00 00 00 03 BC 31 31
			39 01 00 00 00 00 03 BD 31 34
			39 01 00 00 00 00 03 BE 34 34
			39 01 00 00 00 00 03 BF 34 31
			39 01 00 00 00 00 03 C0 31 31
			39 01 00 00 00 00 03 C1 03 01
			39 01 00 00 00 00 03 C2 17 15
			39 01 00 00 00 00 03 C3 13 11
			39 01 00 00 00 00 03 C4 17 15
			39 01 00 00 00 00 03 C5 13 11
			39 01 00 00 00 00 03 C6 03 01
			39 01 00 00 00 00 03 C7 31 31
			39 01 00 00 00 00 03 C8 31 34
			39 01 00 00 00 00 03 C9 34 34
			39 01 00 00 00 00 03 CA 34 31
			39 01 00 00 00 00 03 CB 31 31
			39 01 00 00 00 00 03 CC 31 31
			39 01 00 00 00 00 03 CD 2E 2D
			39 01 00 00 00 00 03 CE 2D 2E
			39 01 00 00 00 00 03 CF 31 31
			39 01 00 00 00 00 03 D0 31 31
			39 01 00 00 00 00 03 D1 31 34
			39 01 00 00 00 00 03 D2 34 34
			39 01 00 00 00 00 03 D3 34 31
			39 01 00 00 00 00 03 D4 31 31
			39 01 00 00 00 00 03 D5 00 02
			39 01 00 00 00 00 03 D6 10 12
			39 01 00 00 00 00 03 D7 14 16
			39 01 00 00 00 00 03 E6 32 32
			39 01 00 00 00 00 06 D8 00 00 00 00 00
			39 01 00 00 00 00 06 D9 00 00 00 00 00
			39 01 00 00 00 00 02 E7 00
			39 01 00 00 00 00 06 F0 55 AA 52 08 05
			39 01 00 00 00 00 02 ED 30
			39 01 00 00 00 00 03 B0 17 06
			39 01 00 00 00 00 02 B8 00
			39 01 00 00 00 00 02 C0 0E
			39 01 00 00 00 00 02 C1 0C
			39 01 00 00 00 00 02 C2 23
			39 01 00 00 00 00 02 C3 40
			39 01 00 00 00 00 02 C4 84
			39 01 00 00 00 00 02 C5 82
			39 01 00 00 00 00 02 C6 82
			39 01 00 00 00 00 02 C7 80
			39 01 00 00 00 00 03 C8 0C 30
			39 01 00 00 00 00 03 C9 06 10
			39 01 00 00 00 00 03 CA 01 10
			39 01 00 00 00 00 03 CB 01 10
			39 01 00 00 00 00 06 D1 03 05 05 07 00
			39 01 00 00 00 00 06 D2 03 05 09 03 00
			39 01 00 00 00 00 06 D3 00 00 6A 07 10
			39 01 00 00 00 00 06 D4 30 00 6A 07 00
			39 01 00 00 00 00 06 F0 55 AA 52 08 03
			39 01 00 00 00 00 03 B0 00 00
			39 01 00 00 00 00 03 B1 00 00
			39 01 00 00 00 00 06 B2 05 01 6B 01 6B
			39 01 00 00 00 00 06 B3 05 01 6B 01 6B
			39 01 00 00 00 00 06 B4 05 01 6B 01 6B
			39 01 00 00 00 00 06 B5 05 01 6B 01 6B
			39 01 00 00 00 00 06 B6 02 00 0A 00 00
			39 01 00 00 00 00 06 B7 02 00 0A 00 00
			39 01 00 00 00 00 06 B8 02 00 0A 00 00
			39 01 00 00 00 00 06 B9 02 00 0A 00 00
			39 01 00 00 00 00 06 BA 53 01 6B 01 6B
			39 01 00 00 00 00 06 BB 53 01 6B 01 6B
			39 01 00 00 00 00 06 BC 53 01 6B 01 6B
			39 01 00 00 00 00 06 BD 53 01 6B 01 6B
			39 01 00 00 00 00 02 C4 60
			39 01 00 00 00 00 02 C5 40
			39 01 00 00 00 00 02 C6 64
			39 01 00 00 00 00 02 C7 44
			39 01 00 00 00 00 02 6F 11
			39 01 00 00 00 00 02 F3 01
			/* displayon_01 ~ displayon_04*/
			05 01 00 00 B8 00 02 11 00
			05 01 00 00 B8 00 02 29 00
			/* brightness */
			39 01 00 00 02 00 02 53 24
			39 01 00 00 02 00 02 51 FF
		];
		qcom,mdss-dsi-off-command = [
			05 01 00 00 32 00 02 28 00
			05 01 00 00 78 00 02 10 00
		];
		qcom,mdss-dsi-on-command-state = "dsi_lp_mode";
		qcom,mdss-dsi-off-command-state = "dsi_hs_mode";
		qcom,mdss-dsi-h-sync-pulse = <1>;
		qcom,mdss-dsi-traffic-mode = "burst_mode";
		qcom,mdss-dsi-bllp-eof-power-mode;
		qcom,mdss-dsi-bllp-power-mode;
		qcom,mdss-dsi-lane-0-state;
		qcom,mdss-dsi-lane-1-state;
		qcom,mdss-dsi-lane-2-state;
		qcom,mdss-dsi-lane-3-state;
		qcom,mdss-dsi-panel-timings = [32 1A 12 00 3E 42 16 1E 14 03 04 00];
		qcom,mdss-dsi-t-clk-post = <0x04>;
		qcom,mdss-dsi-t-clk-pre = <0x12>;
		qcom,mdss-dsi-bl-min-level = <1>;
		qcom,mdss-dsi-bl-max-level = <255>;
		qcom,mdss-dsi-dma-trigger = "trigger_sw";
		qcom,mdss-dsi-mdp-trigger = "none";
		qcom,mdss-force-clk-lane-hs = <1>;
		qcom,mdss-dsi-bl-pmic-control-type = "bl_ctrl_dcs";
		qcom,mdss-dsi-reset-sequence = <1 10>, <0 10>, <1 120>;
		qcom,mdss-pan-physical-width-dimension = <68>;
		qcom,mdss-pan-physical-height-dimension = <121>;

		qcom,mdss-dsi-lp11-init;
		qcom,mdss-dsi-init-delay-us = <20000>;
	};
};
