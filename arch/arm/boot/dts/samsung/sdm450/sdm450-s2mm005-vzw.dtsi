/* Copyright (c) 2016, The Linux Foundation. All rights reserved.
 *
 * This program is free software; you can redistribute it and/or modify
 * it under the terms of the GNU General Public License version 2 and
 * only version 2 as published by the Free Software Foundation.
 *
 * This program is distributed in the hope that it will be useful,
 * but WITHOUT ANY WARRANTY; without even the implied warranty of
 * MERCHANTABILITY or FITNESS FOR A PARTICULAR PURPOSE.  See the
 * GNU General Public License for more details.
 */
/* 18.06.27 - FW product ID changed for PD comm authorization */
/* 18.07.20 - Updated product ID 0x10 for PD auth and old factory mode */

&i2c_8 { /* BLSP2 QUP4 */
	usbpd-s2mm005@33 {
		compatible = "sec-s2mm005,i2c";
		reg = <0x33>;
		interrupt-parent = <&tlmm>;
		interrupts = <0 141 0>;
		usbpd,usbpd_int = <&tlmm 141 0>;
		usbpd,s2mm005_sda = <&tlmm 98 0>;
		usbpd,s2mm005_scl = <&tlmm 99 0>;
		usbpd,s2mm005_fw_product_id = <0x10>;
	};
};
