/* Copyright (c) 2014, The Linux Foundation. All rights reserved.
 *
 * This program is free software; you can redistribute it and/or modify
 * it under the terms of the GNU General Public License version 2 and
 * only version 2 as published by the Free Software Foundation.
 *
 * This program is distributed in the hope that it will be useful,
 * but WITHOUT ANY WARRANTY; without even the implied warranty of
 * MERCHANTABILITY or FITNESS FOR A PARTICULAR PURPOSE.  See the
 * GNU General Public License for more details.
 */
#include "sdm450-sec-gta2xl-battery-r04.dtsi"
/{
	/delete-node/ i2c@12;

	battery {
		battery,charger_name = "s2mu004-charger";
		/delete-property/ battery,support_pogo;
	};

	i2c14: i2c@14 {
		s2mu004-fuelgauge@3B {
			pinctrl-names = "default";
			pinctrl-0 = <&jig_irq &fg_i2c &fg_int>;
		};
	};

	/delete-node/ sec-multi-charger;
};
