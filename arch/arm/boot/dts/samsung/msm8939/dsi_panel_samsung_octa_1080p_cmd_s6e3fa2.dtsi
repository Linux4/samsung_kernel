/* Copyright (c) 2013-2014, The Linux Foundation. All rights reserved.
 *
 * This program is free software; you can redistribute it and/or modify
 * it under the terms of the GNU General Public License version 2 and
 * only version 2 as published by the Free Software Foundation.
 *
 * This program is distributed in the hope that it will be useful,
 * but WITHOUT ANY WARRANTY; without even the implied warranty of
 * MERCHANTABILITY or FITNESS FOR A PARTICULAR PURPOSE.  See the
 * GNU General Public License for more details.
 */

/*---------------------------------------------------------------------------
 * This file is autogenerated file using gcdb parser. Please do not edit it.
 * Update input XML file to add a new entry or update variable in this file
 * VERSION = "1.0"
 *---------------------------------------------------------------------------*/
&mdss_mdp {
	dsi_samsung_fhd: mdss_dsi_samsung_1080p_cmd_fa2 {
		qcom,mdss-dsi-panel-name = "samsung,mdss-amoled-dsi-panel";
		qcom,mdss-dsi-panel-controller = <&mdss_dsi0>;
		qcom,mdss-dsi-panel-type = "dsi_cmd_mode";
		qcom,mdss-dsi-panel-destination = "display_1";
		qcom,mdss-dsi-panel-framerate = <60>;
		qcom,mdss-dsi-virtual-channel-id = <0>;
		qcom,mdss-dsi-stream = <0>;
		qcom,mdss-dsi-panel-width = <1080>;
		qcom,mdss-dsi-panel-height = <1920>;
		qcom,mdss-dsi-h-front-porch = <162>;
		qcom,mdss-dsi-h-back-porch = <36>;
		qcom,mdss-dsi-h-pulse-width = <10>;
		qcom,mdss-dsi-h-sync-skew = <0>;
		qcom,mdss-dsi-v-back-porch = <3>;
		qcom,mdss-dsi-v-front-porch = <13>;
		qcom,mdss-dsi-v-pulse-width = <2>;
		qcom,mdss-dsi-h-left-border = <0>;
		qcom,mdss-dsi-h-right-border = <0>;
		qcom,mdss-dsi-v-top-border = <0>;
		qcom,mdss-dsi-v-bottom-border = <0>;
		qcom,mdss-dsi-bpp = <24>;
		qcom,mdss-dsi-underflow-color = <0xff>;
		qcom,mdss-dsi-border-color = <0xff>;
		qcom,mdss-dsi-tx-eot-append;
/*		qcom,mdss-dsi-lp11-init;*/
		qcom,mdss-dsi-panel-lp11-reset;
		qcom,cont-splash-enabled;
		qcom,mdss-dsi-disp-on-seq = [
				29 01 00 00 00 00 03 F0 5A 5A		/* TEST KEY Enable */
				29 01 00 00 00 00 03 FC 5A 5A		/* TEST KEY Enable */

				/* MIPI Interface (Single DSI) */
				05 01 00 00 00 00 02 F2 07
				05 01 00 00 05 00 02 F9 09

				05 01 00 00 14 00 02 11 00			/* Sleep out, wait 20ms(0x14) */

				/* Brightness condition set */
				29 01 00 00 00 00 22				/* 1) Gamma 2.2 Setting */
					CA 01 00 01 00 01 00 80
					80 80 80 80 80 80 80 80
					80 80 80 80 80 80 80 80
					80 80 80 80 80 80 80 00
					00 00
				29 01 00 00 00 00 05 B2 00 0E 00 0E /* AID 0% */

				29 01 00 00 00 00 15				/* CAPS ELVSS Set */
					B6 98 04 00 00 00 00
					00 03 55 54 20
					00 0A AA AF 0F
					02 22 22 10
				29 01 00 00 00 00 02 B5 41			/* 16 frame Averaging (0x41) */

				23 01 00 00 00 00 02 F7 03			/* 2) Gamma, LTPS(AID) update */
				23 01 00 00 00 00 02 F7 00

				/* TE Vsync ON  */
				29 01 00 00 00 00 02 B0 02
				29 01 00 00 00 00 02 FD 0A
				29 01 00 00 00 00 02 FE 80
				29 01 00 00 00 00 02 FE 00
				29 01 00 00 00 00 02 35 00

				/* Touch Hsync */
				29 01 00 00 00 00 04 BD 05 02 02	/* Touch Hsync Enable */
													/* wait 120ms(0x78) */

				29 01 00 00 00 00 03 F0 A5 A5		/* TEST KEY Disable */
				29 01 00 00 00 00 03 FC A5 A5		/* TEST KEY Disable */
				05 01 00 00 00 00 02 29 00
				];
		qcom,mdss-dsi-disp-on-cmds = [05 01 00 00 00 00 02 29 00];

		qcom,mdss-dsi-disp-off-seq = [
				05 01 00 00 0A 00 02 28 00			/* wait 10ms(0x0A) */
				05 01 00 00 78 00 02 10 00			/* wait 120ms(0x78) */
			];

		qcom,mdss-dsi-disp-off-cmds = [05 01 00 00 00 00 02 28 00];

		/*used for only evt1 panel and over*/
		qcom,mdss-dsi-disp-hsync-on-seq = [
				29 01 00 00 00 00 03 F0 5A 5A		/* TEST KEY Enable */
				29 01 00 00 00 00 04 BD 85 02 0C	/* Touch Hsync Enable */
				29 01 00 00 00 00 03 F0 A5 A5		/* TEST KEY Disable */
				];

		qcom,mdss-dsi-disp-acl-off-cmds = [
				29 01 00 00 00 00 02 B5 41	/* ACL OFF - 41(16Frame Averaging) */
				29 01 00 00 00 00 02 55 00	/* OFF, b5<-0x41 */
				];
		qcom,mdss-dsi-disp-ldi-partial-disp-on = [
				29 01 00 00 00 00 05 30 00 C8 03 20
				29 01 00 00 00 00 02 12 00
				];
		qcom,mdss-dsi-disp-ldi-partial-disp-off = [29 01 00 00 00 00 02 13 00];

		qcom,mdss-dsi-disp-mtp-enable-cmds	=	[ 29 01 00 00 00 00 03 F0 5A 5A];
		qcom,mdss-dsi-disp-mtp-disable-cmds	 =	 [ 29 01 00 00 00 00 03 F0 A5 A5];



		qcom,mdss-dsi-panel-manufacture-id-command = [
							06 01 00 00 00 00 01 da 01 00
							06 01 00 00 00 00 01 db 01 00
							06 01 00 00 00 00 01 dc 01 00
							];

		qcom,mdss-dsi-panel-rddpm-read-cmds = [ 06 01 00 00 00 00 01 0A 01 00];	/* read 0A 1st */
		qcom,mdss-dsi-disp-on-seq-state = "dsi_lp_mode";
		qcom,mdss-dsi-disp-off-seq-state = "dsi_hs_mode";
		qcom,mdss-dsi-panel-manufacture-id-command-state = "dsi_hs_mode";
		qcom,mdss-dsi-panel-status-check-mode = "bta_check";
		qcom,mdss-dsi-h-sync-pulse = <0>;
		qcom,mdss-dsi-traffic-mode = "burst_mode";
		qcom,mdss-dsi-bllp-eof-power-mode;
		qcom,mdss-dsi-bllp-power-mode;
		qcom,mdss-dsi-lane-0-state;
		qcom,mdss-dsi-lane-1-state;
		qcom,mdss-dsi-lane-2-state;
		qcom,mdss-dsi-lane-3-state;
		qcom,mdss-dsi-te-pin-select = <1>;
		qcom,mdss-pan-wr-mem-continue=<0x3c>;
		qcom,mdss-dsi-wr-mem-start = <0x2c>;
		qcom,mdss-dsi-te-dcs-command = <1>;
		qcom,mdss-dsi-te-check-enable;
		qcom,mdss-dsi-te-using-te-pin;
		qcom,mdss-dsi-panel-timings = [2E 38 26 00 68 6E 2A 3C 2C 03 04 00];
		qcom,mdss-dsi-t-clk-post = <0x03>;
		qcom,mdss-dsi-t-clk-pre = <0x22>;
		qcom,mdss-dsi-panel-clockrate = <898000000>;
		qcom,mdss-dsi-bl-min-level = <1>;
		qcom,mdss-dsi-bl-max-level = <255>;
		qcom,mdss-dsi-dma-trigger = "trigger_sw";
		qcom,mdss-dsi-mdp-trigger = "none";
		qcom,mdss-dsi-bl-pmic-control-type = "bl_ctrl_dcs";
		qcom,mdss-dsi-reset-sequence = <1 20>, <0 20>, <1 20>;
		qcom,mdss-pan-physical-width-dimension = <65>;
		qcom,mdss-pan-physical-height-dimension = <115>;
		/*qcom,partial-update-enabled;*/
		qcom,panel-roi-alignment = <2 2 2 2 0 0>;
		samsung,panel-nv-mtp-read-cmds      = [ 06 01 00 00 00 00 01 c8 21 00];
		/*
		 * ************************************************************************************************************************
		 * candela to index mappings
		 * ************************************************************************************************************************
		 */
		samsung,panel-candella-mapping-table = <
		/*<idx><PMSL range> <candella> *//*linear map*/
			0	2	2	2
			1	3	3	4
			2	4	4	5
			3	5	5	6
			4	6	6	8
			5	7	7	9
			6	8	8	10
			7	9	9	12
			8	10	10	13
			9	11	11	15
			10	12	12	16
			11	13	13	17
			12	14	14	19
			13	15	15	20
			14	16	16	21
			15	17	17	24
			16	18	18	25
			17	19	19	27
			18	20	21	29
			19	22	23	30
			20	24	24	32
			21	25	26	34
			22	27	28	37
			23	29	29	39
			24	30	32	41
			25	33	34	44
			26	35	36	47
			27	37	38	50
			28	39	40	53
			29	41	43	56
			30	44	46	60
			31	47	49	64
			32	50	52	68
			33	53	56	72
			34	57	59	77
			35	60	63	82
			36	64	67	87
			37	68	71	93
			38	72	76	98
			39	77	80	105
			40	81	86	111
			41	87	91	119
			42	92	97	126
			43	98	104	134
			44	105	110	143
			45	111	118	152
			46	119	125	162
			47	126	133	172
			48	134	142	183
			49	143	150	195
			50	151	160	207
			51	161	170	220
			52	171	181	234
			53	182	193	249
			54	194	205	265
			55	206	218	282
			56	219	230	300
			57	231	242	316
			58	243	254	333
			59	255	255	350
			>;

		samsung,panel-aid-cmds-list = [
			29 01 00 00 00 00 05 B2 07 68 00 0E /* 0  samsung_brightness_aor_2cd_97.9 */
			29 01 00 00 00 00 05 B2 07 58 00 0E /* 1  samsung_brightness_aor_3cd_97.1 */
			29 01 00 00 00 00 05 B2 07 49 00 0E /* 2  samsung_brightness_aor_4cd_96.3 */
			29 01 00 00 00 00 05 B2 07 39 00 0E /* 3  samsung_brightness_aor_5cd_95.5 */
			29 01 00 00 00 00 05 B2 07 29 00 0E /* 4  samsung_brightness_aor_6cd_94.7 */
			29 01 00 00 00 00 05 B2 07 19 00 0E /* 5  samsung_brightness_aor_7cd_93.9 */
			29 01 00 00 00 00 05 B2 07 09 00 0E /* 6  samsung_brightness_aor_8cd_93.0 */
			29 01 00 00 00 00 05 B2 06 F8 00 0E /* 7  samsung_brightness_aor_9cd_92.1 */
			29 01 00 00 00 00 05 B2 06 E7 00 0E /* 8  samsung_brightness_aor_10cd_91.3 */
			29 01 00 00 00 00 05 B2 06 D7 00 0E /* 9  samsung_brightness_aor_11cd_90.4 */
			29 01 00 00 00 00 05 B2 06 C8 00 0E /* 10 samsung_brightness_aor_12cd_89.7 */
			29 01 00 00 00 00 05 B2 06 B7 00 0E /* 11 samsung_brightness_aor_13cd_88.8 */
			29 01 00 00 00 00 05 B2 06 A5 00 0E /* 12 samsung_brightness_aor_14cd_87.9 */
			29 01 00 00 00 00 05 B2 06 95 00 0E /* 13 samsung_brightness_aor_15cd_87.0 */
			29 01 00 00 00 00 05 B2 06 83 00 0E /* 14 samsung_brightness_aor_16cd_87.0 */
			29 01 00 00 00 00 05 B2 06 73 00 0E /* 15 samsung_brightness_aor_17cd_85.3 */
			29 01 00 00 00 00 05 B2 06 53 00 0E /* 16 samsung_brightness_aor_19cd_83.6 */
			29 01 00 00 00 00 05 B2 06 2F 00 0E /* 17 samsung_brightness_aor_20cd_81.8 */
			29 01 00 00 00 00 05 B2 06 27 00 0E /* 18 samsung_brightness_aor_21cd_81.4 */
			29 01 00 00 00 00 05 B2 06 17 00 0E /* 19 samsung_brightness_aor_22cd_80.5 */
			29 01 00 00 00 00 05 B2 05 FF 00 0E /* 20 samsung_brightness_aor_24cd_79.3 */
			29 01 00 00 00 00 05 B2 05 EF 00 0E /* 21 samsung_brightness_aor_25cd_78.5 */
			29 01 00 00 00 00 05 B2 05 CC 00 0E /* 22 samsung_brightness_aor_27cd_76.7*/
			29 01 00 00 00 00 05 B2 05 AB 00 0E /* 23 samsung_brightness_aor_29cd_74.9 */
			29 01 00 00 00 00 05 B2 05 98 00 0E /* 24 samsung_brightness_aor_30cd_74.0 */
			29 01 00 00 00 00 05 B2 05 76 00 0E /* 25 samsung_brightness_aor_32cd_72.2 */
			29 01 00 00 00 00 05 B2 05 53 00 0E /* 26 samsung_brightness_aor_34cd_70.4*/
			29 01 00 00 00 00 05 B2 05 1D 00 0E /* 27 samsung_brightness_aor_37cd_67.6*/
			29 01 00 00 00 00 05 B2 04 FB 00 0E /* 28 samsung_brightness_aor_39cd_65.9 */
			29 01 00 00 00 00 05 B2 04 D2 00 0E /* 29 samsung_brightness_aor_41cd_63.7 */
			29 01 00 00 00 00 05 B2 04 9E 00 0E /* 30 samsung_brightness_aor_44cd_61.1 */
			29 01 00 00 00 00 05 B2 04 62 00 0E /* 31 samsung_brightness_aor_47cd_58.0 */
			29 01 00 00 00 00 05 B2 04 2B 00 0E /* 32 samsung_brightness_aor_50cd_55.1*/
			29 01 00 00 00 00 05 B2 03 ED 00 0E /* 33 samsung_brightness_aor_53cd_51.9 */
			29 01 00 00 00 00 05 B2 03 AD 00 0E /* 34 samsung_brightness_aor_56cd_48.6 */
			29 01 00 00 00 00 05 B2 03 56 00 0E /* 35 samsung_brightness_aor_60cd_44.1 */
			29 01 00 00 00 00 05 B2 03 29 00 0E /* 36 samsung_brightness_aor_64_152cd_41.8 */
			29 01 00 00 00 00 05 B2 02 BE 00 0E /* 37 samsung_brightness_aor_162cd_36.6 */
			29 01 00 00 00 00 05 B2 02 67 00 0E /* 38 samsung_brightness_aor_172cd_31.8 */
			29 01 00 00 00 00 05 B2 02 1D 00 0E /* 39 samsung_brightness_aor_183cd_27.9  */
			29 01 00 00 00 00 05 B2 01 BD 00 0E /* 40 samsung_brightness_aor_195cd_23.0*/
			29 01 00 00 00 00 05 B2 01 4E 00 0E /* 41 samsung_brightness_aor_207cd_17.3 */
			29 01 00 00 00 00 05 B2 00 D6 00 0E /* 42 samsung_brightness_aor_220cd_11.1*/
			29 01 00 00 00 00 05 B2 00 53 00 0E /* 43 samsung_brightness_aor_234cd_4.3*/
			29 01 00 00 00 00 05 B2 00 0E 00 0E /* 44 samsung_brightness_aor_249_350.7 0cd_0.7 */
		];


		/* bl_level, Index in acl command list */
		samsung,panel-aid-map-table = <
			2	0
			4	2		5	3		6	4		8	6		9	7
			10	8		12	10		13	11		15	13		16	14
			17	15		19	16		20	17		21	18		24	20
			25	21		27	22		29	23		30	24		32	25
			34	26		37	27		39	28		41	29		44	30
			47	31		50	32		53	33		56	34		60	35
			64	36		68	36		72	36		77	36		82	36
			87	36		93	36		98	36		105	36		111	36
			119	36		126	36		134	36		143	36		152	36
			162	37		172	38		183	39		195	40		207	41
			220	42		234	43		249	44		265	44		282	44
			300	44		316	44		333	44		350	44
		>;
		/*
		 * ************************************************************************************************************************
		 * ACL command list and mappings
		 * ************************************************************************************************************************
		 */
		samsung,panel-aclcont-cmds-list = [
				29 01 00 00 00 00 02 B5 51]; /* ACL on, B5 <- 0x51 */

		samsung,panel-acl-cmds-list = [
				29 01 00 00 00 00 02 55 00
				29 01 00 00 00 00 02 55 01		/* ACL 30% */
				29 01 00 00 00 00 02 55 02		/* default ACL 15% */
				29 01 00 00 00 00 02 55 03];	/* ACL 50% */

		samsung,panel-acl-off-cmds = [
							29 01 00 00 00 00 02 B5 41   /* ACL OFF - 41 (16Frame Averaging) */
							29 01 00 00 00 00 02 55 00];/*off, b5<-0x41*/

		/* bl_level , Index in acl command list */
		samsung,panel-acl-map-table =  <
				2    2
				4    2	 	5    2         	 6   2           	8   2			9   2
				10   2             12   2   		13   2        	15   2		16   2
				17   2   		19   2     		20   2	 	21   2		24   2
				25   2      	27   2	 	29   2         	30   2		32   2
				34   2      	37   2	 	39   2         	41   2		44   2
				47   2      	50   2	 	53   2         	56   2		60   2
				64   2      	68   2	 	72   2         	77   2        	82   2
				87   2      	93   2  		98   2         	105  2        	111  2
				119  2      	126  2 		134  2         	143  2        	152  2
				162  2      	172  2	 	183  2         	195  2        	207  2
				220  2      	234  2	 	249  2         	265  2        	282  2
				300  2	  	316  2	 	333  2		350  2
			>;

		/*
		 * ************************************************************************************************************************
		 * ELVSS(ACL Off) command list and mappings
		 * ************************************************************************************************************************
		 */
		samsung,panel-elvss-cmds-list = [
			29 01 00 00 00 00 03 b6 88 0B /* 0 */
			29 01 00 00 00 00 03 b6 88 0C /* 1 */
			29 01 00 00 00 00 03 b6 88 0C /* 2 */
			29 01 00 00 00 00 03 b6 88 0D /* 3 */
			29 01 00 00 00 00 03 b6 88 0D /* 4 */
			29 01 00 00 00 00 03 b6 88 0E /* 5 */
			29 01 00 00 00 00 03 b6 88 0F /* 6 */
			29 01 00 00 00 00 03 b6 88 10 /* 7 */
			29 01 00 00 00 00 03 b6 88 0F /* 8 */
			29 01 00 00 00 00 03 b6 88 0E /* 9 */
			29 01 00 00 00 00 03 b6 88 0E /* 10 */
			29 01 00 00 00 00 03 b6 88 0D /* 11 */
			29 01 00 00 00 00 03 b6 88 0D /* 12 */
			29 01 00 00 00 00 03 b6 88 0C /* 13 */
			29 01 00 00 00 00 03 b6 88 0C /* 14 */
			29 01 00 00 00 00 03 b6 88 0B /* 15 */
			29 01 00 00 00 00 03 b6 88 0A /* 16 */
			29 01 00 00 00 00 03 b6 88 09 /* 17 */
			29 01 00 00 00 00 03 b6 88 09 /* 18 */
			29 01 00 00 00 00 03 b6 88 09 /* 19 */
			29 01 00 00 00 00 03 b6 88 09 /* 20 */
			29 01 00 00 00 00 03 b6 88 09 /* 21 */
			29 01 00 00 00 00 03 b6 88 09 /* 22 */
			29 01 00 00 00 00 03 b6 88 09 /* 23 */
			29 01 00 00 00 00 03 b6 88 09 /* 24 */
			29 01 00 00 00 00 03 b6 88 08 /* 25 */
			29 01 00 00 00 00 03 b6 88 07 /* 26 */
			29 01 00 00 00 00 03 b6 88 06 /* 27 */
			29 01 00 00 00 00 03 b6 88 06 /* 28 */
			29 01 00 00 00 00 03 b6 88 05 /* 29 */
			29 01 00 00 00 00 03 b6 88 04 /* 30 */
		];

		/*
		 * ************************************************************************************************************************
		 * SMART ACL(ACL On) ELVSS command list and mappings
		 * ************************************************************************************************************************
		 */

		samsung,panel-smart-acl-elvss-cmds-list = [
			29 01 00 00 00 00 03 b6 88 0B /* 0 */
			29 01 00 00 00 00 03 b6 88 0C /* 1 */
			29 01 00 00 00 00 03 b6 88 0C /* 2 */
			29 01 00 00 00 00 03 b6 88 0D /* 3 */
			29 01 00 00 00 00 03 b6 88 0D /* 4 */
			29 01 00 00 00 00 03 b6 88 0E /* 5 */
			29 01 00 00 00 00 03 b6 88 0F /* 6 */
			29 01 00 00 00 00 03 b6 88 10 /* 7 */
			29 01 00 00 00 00 03 b6 88 0F /* 8 */
			29 01 00 00 00 00 03 b6 88 0E /* 9 */
			29 01 00 00 00 00 03 b6 88 0E /* 10 */
			29 01 00 00 00 00 03 b6 88 0D /* 11 */
			29 01 00 00 00 00 03 b6 88 0D /* 12 */
			29 01 00 00 00 00 03 b6 88 0C /* 13 */
			29 01 00 00 00 00 03 b6 88 0C /* 14 */
			29 01 00 00 00 00 03 b6 88 0B /* 15 */
			29 01 00 00 00 00 03 b6 88 0A /* 16 */
			29 01 00 00 00 00 03 b6 88 09 /* 17 */
			29 01 00 00 00 00 03 b6 88 09 /* 18 */
			29 01 00 00 00 00 03 b6 88 09 /* 19 */
			29 01 00 00 00 00 03 b6 88 09 /* 20 */
			29 01 00 00 00 00 03 b6 88 09 /* 21 */
			29 01 00 00 00 00 03 b6 88 09 /* 22 */
			29 01 00 00 00 00 03 b6 88 09 /* 23 */
			29 01 00 00 00 00 03 b6 88 09 /* 24 */
			29 01 00 00 00 00 03 b6 88 08 /* 25 */
			29 01 00 00 00 00 03 b6 88 07 /* 26 */
			29 01 00 00 00 00 03 b6 88 06 /* 27 */
			29 01 00 00 00 00 03 b6 88 06 /* 28 */
			29 01 00 00 00 00 03 b6 88 05 /* 29 */
			29 01 00 00 00 00 03 b6 88 04 /* 30 */
		];

		/* bl_level, Index in elvss command list */
		samsung,panel-smart-acl-elvss-map-table = <
				2    0
				4    0	5    0       	  6   0            8   0       9   0
				10   0      12   0   		13   0      	15   0   	16   0
				17   0  	 19   0      	20   0 		21   0      24   0
				25   0      27   0 		29   0         	30   0	32   0
				34   0      37   0		39   0         	41   1	44   2
				47  3      50   4		53   5         	56   6	60   7
				64   7      68   7		72   7         	77   7	82   8
				87   8      93   8		98   9         	105  10	111  11
				119  12      126  13		134  14         	143  15	152  16
				162  17     172  18		183  19        	195  20 	207  21
				220  22     234  23		249  24        	265  25 	282  26
				300  27	  316  28		333	 29		350  30
				>;

		samsung,panel-gamma-cmds-list = [
				29 01 00 00 00 00 22            /* Brightness Condition Set - Gamma 2.2 Setting*/
					CA 01 00 01 00 01 00 80
					80 80 80 80 80 80 80 80
					80 80 80 80 80 80 80 80
					80 80 80 80 80 80 80 00
					00 00
				23 01 00 00 00 00 02 F7 03		/* Gamma, LTPS(AID) update */
				23 01 00 00 00 00 02 F7 00
			];


	};
};
