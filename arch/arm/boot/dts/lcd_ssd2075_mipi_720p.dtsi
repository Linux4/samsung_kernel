/ {
	lcd_ssd2075_mipi_720p: lcd2075 {
			hfp = <50>;
			hbp = <36>;
			hsync = <16>;
			vfp = <12>;
			vbp = <14>;
			vsync = <2>;

			work_mode = <1>;
			bpp = <24>;
			lan_number = <4>;
			phy_feq = <450000>;
			h_sync_pol = <0>;
			v_sync_pol = <0>;
			de_pol = <0>;
			te_pol = <0>;
			color_mode_pol = <1>;
			shut_down_pol = <1>;

			width = <720>;
			height = <1280>;
			fps = <60>;
			direction = <0>;
			dev_id = <0>;
			type=<2>;
			lcd_id = <0x2075>;
			esd_return_code = <28>;
			//low_res_simu;
			simu_width = <480>; 
			simu_height = <854>;
			panle_name = "lcd_ssd2075_mipi_720p";
			init_data = [
				15 00 00 02 E1 93
				15 00 00 02 B3 00
				39 00 00 05 B6 16 0F 00 77
				39 00 00 09 B8 00 06 08 00 07 09 23 04
				39 00 00 07 B9 04 08 22 FF FF 0F
				39 00 00 09 BA 0E 0E 10 10 0A 0A 0C 0C
				39 00 00 09 BB A1 A1 A1 A1 A1 A1 A1 A1
				39 00 00 09 BC 00 00 00 00 00 00 00 00
				39 00 00 09 BD 0F 0F 11 11 0B 0B 0D 0D
				39 00 00 09 BE A1 A1 A1 A1 A1 A1 A1 A1
				39 00 00 09 BF 00 00 00 00 00 00 00 00
				39 00 00 04 B1 06 44 10
				39 00 00 06 E0 11 02 04 00 01
				39 00 00 07 D0 00 00 0E 0F 14 20
				39 00 00 06 D1 1A 37 29 1B 08
				39 00 00 07 D2 00 00 0E 0F 14 20
				39 00 00 06 D3 1A 37 29 1B 08
				39 00 00 07 D4 00 00 0E 0F 14 20
				39 00 00 06 D5 1A 37 29 1B 08
				39 00 00 07 D6 00 00 0E 0F 14 20
				39 00 00 06 D7 1A 37 29 1B 08
				39 00 00 07 D8 00 00 0E 0F 14 20
				39 00 00 06 D9 1A 37 29 1B 08
				39 00 00 07 DA 00 00 0E 0F 14 20
				39 00 00 06 DB 1A 37 29 1B 08
				39 00 00 05 70 D8 00 FF 80
				15 00 00 02 FF 01
				39 00 00 03 C6 CC 33
				39 00 00 03 DE 9D 30
				15 00 00 02 14 00
				15 00 00 02 E9 07
				39 00 00 03 ED 60 10
				15 00 00 02 EC 12
				39 00 00 05 CD 77 7B 34 08
				39 00 00 08 C3 03 0D 34 05 01 44 54
				39 00 00 06 C4 02 03 3D 3D 5A
				39 00 00 04 CB DF 80 00
				39 00 00 04 EA 15 28 00
				39 00 00 05 F0 38 00 00 00
				39 00 00 04 C9 60 00 82
				39 00 00 09 B5 00 05 05 1E 04 40 20 FC
				15 00 00 02 36 0B
				15 00 00 02 3A 70
				15 78 00 01 11
				15 20 00 01 29
				];
			sleep_in =  [
			   39 00 00 02 28 00
			   39 78 00 02 10 00
			];
			sleep_out = [
				39 78 00 02 11 00
				39 00 00 02 29 00
			];
			esd_check = [
				37 00 00 02 01 00
			];
	};

};



