&gen_panel {
	dsi_s6e88a0_wVGA_vid: gen-panel-s6e88a0_w-video {
		gen-panel-manu = "SDC";			/* condensed manufacturer name */
		gen-panel-name = "s6e88a0";
		gen-panel-id = <0x520001>;
		gen-panel-dev-id = <0>;			/* SPRDFB_MAINLCD_ID : MAIN 0, SUB 1 */
		gen-panel-type = <2>;			/* LCD_MODE_DSI: MCU 0, RGB 1, DSI 2 */
		gen-panel-refresh = <60>;
		gen-panel-xres = <540>;
		gen-panel-yres = <960>;
		gen-panel-width= <56>;			/* screen width in mm */
		gen-panel-height = <94>;		/* screen height in mm */
		gen-panel-work-mode = <1>;		/* SPRDFB_MIPI_MODE_VIDEO : CMD 0, VIDEO 1*/
		gen-panel-direction = <0>;		/* LCD_DIRECT_NORMAL : Normal 0, ROT90 1, ROT180 2, ROT270 3 */
		gen-panel-suspend-mode = <1>;	/* SEND_SLEEP_CMD : RST 0, SLEEP 1 */
		gen-panel-bus-width = <24>;
		gen-panel-lanes = <2>;
		gen-panel-phy-feq = <461000>;
		gen-panel-h-sync-pol = <0>;		/*SPRDFB_POLARITY_POS : POS 0, NEG 1 */
		gen-panel-v-sync-pol = <0>;		/*SPRDFB_POLARITY_POS : POS 0, NEG 1 */
		gen-panel-de-pol = <0>;			/*SPRDFB_POLARITY_POS : POS 0, NEG 1 */
		gen-panel-te-pol = <0>;			/*SPRDFB_POLARITY_POS : POS 0, NEG 1 */
		gen-panel-color-mode-pol = <1>;	/*SPRDFB_POLARITY_POS : POS 0, NEG 1 */
		gen-panel-shut-down-pol = <1>;	/*SPRDFB_POLARITY_POS : POS 0, NEG 1 */
		gen-panel-h-front-porch = <59>; /* hfp */
		gen-panel-h-back-porch = <59>;	/* hbp */
		gen-panel-h-sync-width = <8>;	/* hsync */
		gen-panel-v-front-porch = <14>;	/* vfp */
		gen-panel-v-back-porch = <9>;	/* vbp */
		gen-panel-v-sync-width = <1>;	/* vsync */
		gen-panel-esd-mode = <1>;		/*ESD_DET_INTERRUPT : POLLING 0, INTERRUPT 1 */
		gen-panel-esd-gpio = <102>;
		gen-panel-esd-state = <0>;		/* ESD_DET_NOT_INITIALIZED : NOT_INT 0, OFF 1, ON 0 */
		gen-panel-esd-level = <1>;		/* ESD_DET_HIGH : LOW 0, HIGH 1 */

		/*
		 * DSI PACKET HEADER INFO
		 * @ delay(msec) : 2byte
		 * @ size of data : 2byte
		 */
		gen-panel-pkt-dinfo-addr-offset = <0>;
		gen-panel-pkt-dinfo-addr-length = <1>;
		gen-panel-pkt-dinfo-data-offset = <1>;
		gen-panel-pkt-dinfo-data-length = <1>;
		gen-panel-init-cmds = [
			39 00 00 00 00 03		F0 5A 5A
			05 00 00 78 00 01		11
			39 00 00 00 00 04		B8 38 0B 2D
			39 00 00 00 00 22		CA 01 00 01 00 01 00 80 80 80 80 80 80 80 80 80
									80 80 80 80 80 80 80 80 80 80 80 80 6B 68 71 00
									00 00
			39 00 00 00 00 06		B2 40 0A 17 00 0A
			39 00 00 00 00 03		B6 2C 0B
			15 00 00 00 00 02		55 00
			15 00 00 00 00 02		F7 03
			05 00 00 78 00 01		29
		];
		gen-panel-enable-cmds = [
			05 00 00 78 00 01		11
			05 00 00 14 00 01		29
		];
		gen-panel-disable-cmds = [
			05 00 00 22 00 01		28
			05 00 00 78 00 01		10
		];
		gen-panel-nv-read-enable-cmds = [
			39 00 00 00 00 03	F0 5A 5A
		];
		gen-panel-nv-read-disable-cmds = [
			39 00 00 00 00 03	F0 A5 A5
		];
		gen-panel-acl-on-cmds = [
			15 00 00 00 00 02	55 01
		];
		gen-panel-acl-off-cmds = [
			15 00 00 00 00 02	55 00
		];
		
		gen-panel-hbm-on-cmds = [
			39 00 00 00 00 22	CA 01 00 01 00 01 00 80 80 80 80 80 80 80 80 80
								80 80 80 80 80 80 80 80 80 80 80 80 6B 68 71 00
								00 00
			39 00 00 00 00 06	B2 40 0A 17 00 0A
			39 00 00 00 00 03	B6 2C 0B
			15 00 00 00 00 02	B0 10
			15 00 00 00 00 02	B6 09  /* need to check */
			15 00 00 00 00 02	55 01
		];
		gen-panel-hbm-off-cmds = [
			15 00 00 00 00 02	B0 10
			15 00 00 00 00 02	B6 00
		];

		/* VREGOUT VOLTAGE 5.6 * 2^22 */
		gen-panel-octa-vregout = <23488102>;

		gen-panel-candela-table = <
			5	6	7	8	9
			10	11	12	13	14
			15	16	17	19	20
			21	22	24	25	27
			29	30	32	34	37
			39	41	44	47	50
			53	56	60	64	68
			72	77	82	87	93
			98	105	111	119	126
			134	143	152	162	172
			183	195	207	220	234
			249	265	282	300	316
			333	360
		>;		
		
		gen-panel-aid-cmds = [
			39 00 00 00 00 06	B2 40 0A 17 03 AC
			39 00 00 00 00 06	B2 40 0A 17 03 A5
			39 00 00 00 00 06	B2 40 0A 17 03 9B
			39 00 00 00 00 06	B2 40 0A 17 03 93
			39 00 00 00 00 06	B2 40 0A 17 03 89
			39 00 00 00 00 06	B2 40 0A 17 03 80
			39 00 00 00 00 06	B2 40 0A 17 03 77
			39 00 00 00 00 06	B2 40 0A 17 03 6F
			39 00 00 00 00 06	B2 40 0A 17 03 65
			39 00 00 00 00 06	B2 40 0A 17 03 5C
			39 00 00 00 00 06	B2 40 0A 17 03 52
			39 00 00 00 00 06	B2 40 0A 17 03 4A
			39 00 00 00 00 06	B2 40 0A 17 03 41
			39 00 00 00 00 06	B2 40 0A 17 03 2F
			39 00 00 00 00 06	B2 40 0A 17 03 25
			39 00 00 00 00 06	B2 40 0A 17 03 1D
			39 00 00 00 00 06	B2 40 0A 17 03 12
			39 00 00 00 00 06	B2 40 0A 17 03 01
			39 00 00 00 00 06	B2 40 0A 17 02 F7
			39 00 00 00 00 06	B2 40 0A 17 02 E5
			39 00 00 00 00 06	B2 40 0A 17 02 D3
			39 00 00 00 00 06	B2 40 0A 17 02 C8
			39 00 00 00 00 06	B2 40 0A 17 02 B7
			39 00 00 00 00 06	B2 40 0A 17 02 A2
			39 00 00 00 00 06	B2 40 0A 17 02 87
			39 00 00 00 00 06	B2 40 0A 17 02 74
			39 00 00 00 00 06	B2 40 0A 17 02 5F
			39 00 00 00 00 06	B2 40 0A 17 02 42
			39 00 00 00 00 06	B2 40 0A 17 02 22
			39 00 00 00 00 06	B2 40 0A 17 02 05
			39 00 00 00 00 06	B2 40 0A 17 01 E5
			39 00 00 00 00 06	B2 40 0A 17 01 C7
			39 00 00 00 00 06	B2 40 0A 17 01 9E
			39 00 00 00 00 06	B2 40 0A 17 01 78
			39 00 00 00 00 06	B2 40 0A 17 01 4F
			39 00 00 00 00 06	B2 40 0A 17 01 22
			39 00 00 00 00 06	B2 40 0A 17 00 EF
			39 00 00 00 00 06	B2 40 0A 17 00 BD
			39 00 00 00 00 06	B2 40 0A 17 00 85
			39 00 00 00 00 06	B2 40 0A 17 00 49
			39 00 00 00 00 06	B2 40 0A 17 00 0A
		];

		gen-panel-aid-map-table = <
			5	0	6	1	7	2	8	3	9	4
			10	5	11	6	12	7	13	8	14	9
			15	10	16	11	17	12	19	13	20	14
			21	15	22	16	24	17	25	18	27	19
			29	20	30	21	32	22	34	23	37	24
			39	25	41	26	44	27	47	28	50	29
			53	30	56	31	60	32	64	33	68	33
			72	33	77	33	82	33	87	33	93	33
			98	33	105	33	111	33	119	33	126	33
			134	33	143	33	152	33	162	33	172	34
			183	35	195	36	207	37	220	38	234	39
			249	40	265	40	282	40	300	40	316	40
			333	40	360	40
		>;

		gen-panel-elvss-cmds = [
			39 00 00 00 00 03	B6 2C 17	/* 0 */
			39 00 00 00 00 03	B6 2C 16	/* 1 */
			39 00 00 00 00 03	B6 2C 15	/* 2 */
			39 00 00 00 00 03	B6 2C 14	/* 3 */
			39 00 00 00 00 03	B6 2C 13	/* 4 */
			39 00 00 00 00 03	B6 2C 12	/* 5 */
			39 00 00 00 00 03	B6 2C 11	/* 6 */
			39 00 00 00 00 03	B6 2C 10	/* 7 */
			39 00 00 00 00 03	B6 2C 0F	/* 8 */
			39 00 00 00 00 03	B6 2C 0E	/* 9 */
			39 00 00 00 00 03	B6 2C 0D	/* 10 */
			39 00 00 00 00 03	B6 2C 0C	/* 11 */
			39 00 00 00 00 03	B6 2C 0B	/* 12 */
		];

		gen-panel-elvss-map-table = <
			5	0	6	0	7	0	8	0	9	0
			10	0	11	0	12	0	13	0	14	0
			15	0	16	0	17	0	19	0	20	0
			21	0	22	0	24	0	25	0	27	0
			29	0	30	0	32	0	34	0	37	0
			39	0	41	0	44	0	47	0	50	0
			53	0	56	0	60	0	64	0	68	0
			72	0	77	0	82	1	87	1	93	2
			98	2	105	2	111	3	119	3	126	4
			134	4	143	5	152	5	162	6	172	6
			183	7	195	7	207	7	220	7	234	8
			249	8	265	8	282	9	300	10	316	11
			333	11	360	12
		>;
		
		gen-panel-base-lux-table = <
			111 111 111 111 111 111 111 111 111 111 111 
			111 111 111 111 111 111 111 111 111 111 111 
			111 111 111 111 111 111 111 111 111 111 111 
			111 117 123 131 140 148 157 165 176 184 196 
			204 217 229 243 255 255 255 255 255 255 255 
			255 272 283 300 318 333 360
		>;

		gen-panel-candela-compensation-table = <
			/* V255 V203    V151    V87     V51     V35     V23     V11     V3 */
			0	6	12	20 	27 	31 	36 	39 	40
			0	6	11	17 	24 	28 	31 	36 	39
			0	4	8	15 	20 	24 	28 	31 	32
			0	3	5	11 	16 	20 	24 	26 	29
			0	2	4	9 	15 	18 	22 	24 	26
			0	4	7	11 	14 	19 	22 	24 	25
			0	2	4	7 	12 	15 	19 	21 	23
			0	1	3	7 	11 	14 	17 	20 	21
			0	1	2	6 	10 	13 	16 	19 	20
			0	1	2	6 	10 	13 	16 	18 	19
			0	1	2	5 	9 	12 	14 	17 	18
			0	1	2	4 	8 	11 	14 	16 	17
			0	1	1	4 	8 	10 	13 	15 	16
			0	1	1	3 	7 	9 	12 	14 	15
			0	1	1	3 	6 	9 	11 	14 	14
			0	1	1	3 	6 	8 	10 	13 	14
			0	1	1	2 	6 	8 	10 	13 	13
			0	1	1	2 	5 	7 	9 	12 	13
			0	1	1	2 	5 	7 	9 	11 	12
			0	1	1	2 	4 	6 	8 	11 	11
			0	1	0	2 	4 	6 	8 	10 	11
			0	1	0	2 	4 	6 	8 	10 	10
			0	1	0	1 	4 	5 	7 	10 	10
			0	1	0	1 	4 	5 	7 	9 	10
			0	1	0	1 	3 	5 	6 	8 	9
			0	1	0	1 	3 	4 	6 	8 	8
			0	1	0	1 	3 	4 	6 	7 	8
			0	1	0	1 	3 	4 	5 	7 	7
			0	1	0	1 	3 	3 	5 	7 	7
			0	1	0	0 	2 	3 	4 	6 	7
			0	1	0	0 	2 	3 	4 	6 	6
			0	1	0	0 	2 	3 	4 	5 	6
			0	1	0	0 	2 	2 	3 	5 	5
			0	1	0	0 	2 	2 	3 	4 	5
			0	2	1	0 	1 	2 	3 	4 	4
			0	2	2	1 	2 	2 	3 	4 	4
			0	1	1	1 	2 	2 	3 	4 	4
			0	2	3	1 	2 	2 	3 	4 	4
			0	2	3	1 	2 	3 	3 	4 	4
			0	2	3	2 	2 	2 	3 	4 	4
			0	3	4	2 	2 	2 	3 	4 	4
			0	3	4	2 	2 	3 	2 	4 	4
			0	3	3	2 	2 	2 	3 	4 	4
			0	2	3	2 	2 	2 	3 	4 	4
			0	3	4	2 	2 	2 	2 	4 	4
			0	3	5	2 	2 	2 	3 	4 	4
			0	3	5	2 	2 	2 	2 	3 	3
			0	2	4	2 	2 	1 	2 	3 	3
			0	3	4	2 	1 	1 	1 	3 	3
			0	3	4	2 	1 	1 	1 	2 	3
			0	3	4	2 	1 	1 	1 	2 	2
			0	2	3	2 	1 	1 	1 	2 	2
			0	2	3	1 	1 	1 	1 	1 	2
			0	2	3	1 	1 	1 	1 	1 	1
			0	2	3	1 	1 	1 	0 	1 	1
			0	2	3	1 	1 	1 	1 	1 	1
			0	1	2	2 	0 	1 	1 	1 	1
			0	2	4	1 	1 	0 	0 	0 	1
			0	1	3	1 	0 	0 	1 	0 	1
			0	1	4	1 	0 	0 	0 	0 	1
			0	0	3	0 	0 	0 	0 	0 	1
			0	0	0	0 	0 	0 	0 	0 	0
		>;

		gen-panel-rgb-compensation-table = <
		/* R255 	G255 	B255 	R203 	G203 B203 	R151 	G151 	B151 	R87 	G87 	B87 	R51 	G51 	B51 	R35 	G35 	B35 	R23 	G23 B23 R11 G11 B11 */
			(-5)	0		(-4)	(-3)	0	 (-3)	(-6)	1	(-4)	(-16)	4	(-13)	(-19)	6	(-16)	(-13)	5	(-10)	(-4)	3	(-6)	(-6)	8	(-8)
			(-3)	0		(-3)	(-3)	0	 (-3)	(-5)	1	(-4)	(-13)	4	(-10)	(-15)	5	(-13)	(-15)	4	(-12)	(-10)	5	(-13)	(-6)	4	(-8)
			(-4)	(-1)	(-4)	(-3)	0	 (-2)	(-4)	1	(-3)	(-14)	4	(-10)	(-18)	5	(-15)	(-13)	3	(-11)	(-8)	4	(-10)	(-10)	5	(-11)
			(-2)	0		(-2)	(-3)	0	 (-3)	(-6)	0	(-4)	(-14)	3	(-11)	(-20)	6	(-16)	(-13)	6	(-15)	(-7)	4	(-8)	(-8)	6	(-13)
			(-2)	0		(-2)	(-2)	0	 (-2)	(-5)	0	(-5)	(-13)	3	(-9)	(-18)	6	(-14)	(-13)	6	(-14)	(-7)	4	(-11)	(-11)	6	(-14)
			(-2)	0		(-2)	(-2)	(-1) (-2)	(-5)	0	(-4)	(-10)	3	(-8)	(-20)	6	(-14)	(-8)	5	(-7)	(-9)	5	(-13)	(-11)	5	(-12)
			0		0		0		(-1)	0	 (-1)	(-4)	0	(-2)	(-9)	2	(-6)	(-10)	5	(-10)	(-12)	5	(-12)	(-7)	4	(-8)	(-8)	6	(-14)
			0		0		0		(-1)	0	 (-1)	(-3)	0	(-2)	(-8)	3	(-6)	(-10)	5	(-10)	(-9)	5	(-11)	(-6)	5	(-10)	(-8)	5	(-11)
			0		0		0		0		0	 0		(-4)	0	(-3)	(-7)	2	(-5)	(-12)	5	(-11)	(-9)	5	(-11)	(-9)	6	(-12)	(-6)	5	(-12)
			0		0		0		0		0	 0		(-4)	0	(-3)	(-7)	2	(-5)	(-11)	4	(-10)	(-8)	4	(-10)	(-10)	6	(-12)	(-7)	6	(-13)
			0		0		0		0		0	 0		(-3)	0	(-2)	(-7)	2	(-5)	(-9)	4	(-10)	(-8)	5	(-10)	(-10)	5	(-12)	(-10)	7	(-16)
			0		0		0		0		0	 0		(-2)	0	(-2)	(-7)	1	(-4)	(-9)	4	(-10)	(-10)	5	(-11)	(-8)	4	(-10)	(-7)	7	(-14)
			0		0		0		0		0	 0		(-2)	0	(-1)	(-6)	1	(-4)	(-8)	4	(-10)	(-12)	5	(-11)	(-7)	4	(-9)	(-6)	7	(-15)
			0		0		0		0		0	 0		(-1)	0	0		(-5)	1	(-4)	(-8)	4	(-9)	(-10)	4	(-9)	(-9)	5	(-12)	(-7)	7	(-15)
			0		0		0		0		0	 0		(-1)	0	0		(-5)	1	(-4)	(-7)	4	(-9)	(-9)	3	(-8)	(-9)	6	(-14)	(-6)	6	(-12)
			0		0		0		0		0	 0		(-1)	0	0		(-4)	1	(-3)	(-7)	4	(-9)	(-8)	4	(-9)	(-8)	6	(-12)	(-6)	6	(-13)
			0		0		0		0		0	 0		(-1)	0	0		(-4)	1	(-3)	(-5)	4	(-8)	(-9)	3	(-8)	(-8)	6	(-12)	(-6)	6	(-12)
			0		0		0		0		0	 0		(-1)	0	0		(-3)	1	(-2)	(-5)	4	(-8)	(-9)	3	(-7)	(-8)	5	(-12)	(-9)	6	(-14)
			0		0		0		0		0	 0		(-1)	0	0		(-3)	1	(-2)	(-5)	3	(-8)	(-8)	3	(-6)	(-7)	5	(-11)	(-8)	7	(-16)
			0		0		0		0		0	 0		(-1)	0	0		(-3)	1	(-2)	(-4)	4	(-8)	(-8)	2	(-6)	(-6)	5	(-11)	(-7)	6	(-12)
			0		0		0		0		0	 0		0		0	0		(-4)	1	(-2)	(-3)	4	(-8)	(-7)	2	(-5)	(-7)	4	(-10)	(-9)	8	(-16)
			0		0		0		0		0	 0		0		0	0		(-4)	1	(-2)	(-3)	3	(-8)	(-7)	2	(-5)	(-7)	4	(-10)	(-9)	7	(-16)
			0		0		0		0		0	 0		0		0	0		(-4)	0	(-2)	(-3)	3	(-8)	(-8)	3	(-6)	(-6)	5	(-10)	(-5)	6	(-12)
			0		0		0		0		0	 0		0		0	0		(-4)	0	(-2)	(-2)	3	(-7)	(-7)	2	(-5)	(-6)	4	(-10)	(-7)	7	(-14)
			0		0		0		0		0	 0		0		0	0		(-3)	0	(-2)	(-3)	2	(-6)	(-6)	2	(-4)	(-5)	5	(-10)	(-7)	7	(-14)
			0		0		0		0		0	 0		0		0	0		(-2)	0	(-1)	(-2)	2	(-6)	(-7)	2	(-5)	(-4)	4	(-8)	(-8)	6	(-14)
			0		0		0		0		0	 0		0		0	0		(-2)	0	(-1)	(-2)	2	(-6)	(-5)	2	(-4)	(-4)	3	(-8)	(-7)	8	(-16)
			0		0		0		0		0	 0		0		0	0		(-2)	0	(-1)	0		2	(-5)	(-6)	1	(-4)	(-5)	4	(-10)	(-7)	7	(-14)
			0		0		0		0		0	 0		0		0	0		(-2)	0	(-1)	0		2	(-5)	(-6)	2	(-4)	(-3)	3	(-7)	(-5)	6	(-12)
			0		0		0		0		0	 0		0		0	0		(-1)	0	(-1)	0		2	(-5)	(-6)	1	(-4)	(-4)	3	(-8)	(-5)	7	(-14)
			0		0		0		0		0	 0		0		0	0		(-1)	0	(-1)	0		2	(-5)	(-4)	1	(-3)	(-3)	3	(-7)	(-8)	6	(-14)
			0		0		0		0		0	 0		0		0	0		0		0	(-1)	0		2	(-4)	(-4)	1	(-3)	(-3)	2	(-6)	(-7)	7	(-16)
			0		0		0		0		0	 0		0		0	0		0		0	0		0		2	(-5)	(-2)	1	(-2)	(-3)	3	(-6)	(-6)	6	(-14)
			0		0		0		0		0	 0		0		0	0		0		0	0		1		2	(-4)	(-2)	1	(-2)	(-3)	2	(-6)	(-6)	6	(-14)
			1		0		0		0		0	 0		0		0	0		0		0	0		0		2	(-4)	(-2)	0	(-2)	(-2)	2	(-4)	(-6)	7	(-16)
			1		0		0		0		0	 (-1)	0		0	0		0		0	(-1)	0		2	(-4)	(-3)	1	(-2)	(-1)	2	(-4)	(-6)	6	(-13)
			0		0		0		0		0	 0		0		0	1		0		0	0		0		1	(-4)	(-2)	0	(-1)	(-3)	2	(-6)	(-4)	6	(-13)
			0		0		(-1)	1		0	 0		0		0	(-1)	0		0	0		0		2	(-4)	(-2)	0	(-1)	(-1)	2	(-5)	(-6)	6	(-14)
			0		0		0		0		0	 (-1)	0		0	0		0		0	0		0		1	(-4)	(-3)	0	(-1)	(-2)	2	(-6)	(-7)	6	(-14)
			0		0		0		0		0	 0		0		0	0		0		0	0		0		2	(-4)	(-1)	0	(-1)	(-1)	2	(-5)	(-6)	6	(-13)
			0		0		0		1		0	 0		0		0	(-1)	0		0	0		0		1	(-4)	(-2)	0	0		(-3)	2	(-6)	(-6)	5	(-12)
			0		0		0		0		0	 0		1		0	0		0		0	0		0		1	(-3)	(-1)	0	(-1)	(-3)	2	(-5)	(-5)	5	(-12)
			0		0		0		1		0	 0		0		0	(-1)	0		0	0		0		1	(-3)	(-2)	0	(-1)	(-2)	1	(-4)	(-5)	5	(-11)
			0		0		0		0		0	 0		0		0	0		(-1)	0	0		0		1	(-2)	0		0	0		(-2)	2	(-4)	(-4)	5	(-10)
			0		0		0		0		0	 0		1		0	0		0		0	0		0		1	(-3)	(-2)	0	(-2)	(-2)	1	(-4)	(-5)	4	(-10)
			0		0		0		0		0	 0		0		0	1		0		0	0		0		0	(-2)	0		0	(-2)	(-3)	1	(-4)	(-3)	5	(-11)
			0		0		1		0		0	 0		0		0	0		0		0	0		0		0	(-2)	0		0	(-2)	(-2)	1	(-3)	(-3)	4	(-10)
			0		0		1		0		0	 0		0		0	0		0		0	0		0		0	(-2)	0		1	(-2)	(-2)	1	(-2)	(-3)	4	(-9)
			0		0		1		0		0	 0		1		0	0		0		0	0		0		0	(-2)	0		0	(-2)	(-2)	1	(-2)	(-3)	3	(-8)
			0		0		1		0		0	 0		1		0	0		0		0	0		0		0	(-1)	1		1	(-2)	(-2)	0	(-2)	(-4)	4	(-9)
			0		0		1		0		0	 0		1		0	0		0		0	0		0		0	(-1)	1		1	(-2)	0		0	(-1)	(-4)	3	(-8)
			0		0		1		0		0	 0		1		0	0		0		0	0		0		0	(-1)	1		0	(-2)	0		0	(-1)	(-2)	3	(-6)
			0		0		1		0		0	 0		1		0	0		0		0	0		0		0	(-2)	1		0	(-1)	0		0	(-1)	(-1)	3	(-6)
			0		0		0		0		0	 0		0		0	0		0		0	0		1		0	(-1)	0		0	(-2)	0		0	0		0		2	(-6)
			0		0		0		0		0	 0		0		0	0		0		0	0		1		0	(-1)	2		0	(-1)	1		0	0		2		2	(-4)
			0		0		0		0		0	 0		0		0	0		0		0	0		0		0	0		0		0	0		0		0	0		0		0	0
			0		0		0		0		0	 0		0		0	0		0		0	0		0		0	0		0		0	0		0		0	0		0		0	0
			0		0		0		0		0	 0		0		0	0		0		0	0		0		0	0		0		0	0		0		0	0		0		0	0
			0		0		0		0		0	 0		0		0	0		0		0	0		0		0	0		0		0	0		0		0	0		0		0	0
			0		0		0		0		0	 0		0		0	0		0		0	0		0		0	0		0		0	0		0		0	0		0		0	0
			0		0		0		0		0	 0		0		0	0		0		0	0		0		0	0		0		0	0		0		0	0		0		0	0
			0		0		0		0		0	 0		0		0	0		0		0	0		0		0	0		0		0	0		0		0	0		0		0	0
			>;
			

		gen-panel-gamma-cmds = [
			39 00 00 00 00 22	CA 01 00 01 00 01 00 80 80 80 80 80 80 80 80 80
								80 80 80 80 80 80 80 80 80 80 80 80 6B 68 71 00
								00 00
		];
		
		gen-panel-gamma-update-cmds = [
			15 00 00 00 00 02	F7 03
		];
		
		gen-panel-read-mtp = [C8 00 21];

		gen-panel-read-id = [
			DA 00 01
			DB 00 01
			DC 00 01
		];
		gen-panel-read-status-reg = [0A];
		gen-panel-read-status-ok = [9A];
		status = "okay";
	};
};
