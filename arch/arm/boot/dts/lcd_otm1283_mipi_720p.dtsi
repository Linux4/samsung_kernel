/ { lcd_mipi_otm1283_720p: lcd1283 {
						hfp = <50>;
						hbp = <36>;
						hsync = <16>;
						vfp = <12>;
						vbp = <14>;
						vsync = <2>;

			work_mode = <0>;
			bpp = <24>;
			lan_number = <4>;
			phy_feq = <500000>;
			h_sync_pol = <0>;
			v_sync_pol = <0>;
			de_pol = <0>;
			te_pol = <0>;
			color_mode_pol = <0>;
			shut_down_pol = <0>;

			width = <720>;
			height = <1280>;
			fps = <60>;
			direction = <0>;
			dev_id = <0>;
			lcd_id = <0x8394>;
			low_res_simu;
			simu_width = <480>;
			simu_height = <854>;
			panle_name = "lcd_hx8394a_mipi";
			init_data = [
				39 00 00 00 04 B9 FF 83 94
				39 00 00 00 11 BA 63 82 00 16 C5
						00 10 FF 0F 24 03 21 24 25 20 08
				39 00 00 00 12 B1 01 00 04 C4 03
						12 F1 24 2C 3F 3F 57 02 00 E6 E2 A6
				39 00 00 00 07 B2 00 C8 0E 30 00 33
				39 00 00 00 20 B4 80 04 32 10 08 54 15 0F
						22 10 08 47 53 54 0A 4B 53 54 02 61 61
				39 00 00 02 B6 21
				39 00 00 00 39 D5 00 00 00 00 0A 00 01 22
					00 33 CC 00 AA BB 01 23 45 67 9A BC 45
					67 88 88 88 88 88 88 88 01 88 88 88 88
					88 88 88 88 88 88 88 88 88 88 88 88 88
					88 88 88 88 88 3C 01
				39 00 00 00 02 cc 09
				39 00 00 00 05 bf 06 02 10 04
				39 00 00 00 05 c7 00 10 00 10
				39 00 00 00 1A E0 00 04 08 28 2F 3F 15 34
						06 0C 0E 12 14 13 14 11 19 00 04 08
						29 2E 3F 15 35
				39 00 00 00 11 07 0C 0F 11 13 11 12 10 16
					0A 17 07 12 0A 17 06 11
				39 00 00 00 03 c0 0c 17
				39 00 00 00 03 c6 08 08
				39 00 00 00 02 D4 32
				15 78 00 00 02 11 00
				15 32 00 00 02 29 00

			];
			sleep_in =  [
			   15 00 00 00 02 28 00
			   15 78 00 00 02 10 00
			];
			sleep_out = [
			   15 78 00 00 02 11 00
			   15 00 00 00 02 29 00
			];
	};

};



