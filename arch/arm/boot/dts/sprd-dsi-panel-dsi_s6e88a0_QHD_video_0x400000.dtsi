&gen_panel {
	dsi_s6e88a0_QHD_400000_vid: gen-panel-s6e88a0_QHD_400000-video {
		gen-panel-manu = "SDC";			/* condensed manufacturer name */
		gen-panel-name = "s6e88a0";
		gen-panel-id = <0x400000>;
		gen-panel-dev-id = <0>;			/* SPRDFB_MAINLCD_ID : MAIN 0, SUB 1 */
		gen-panel-type = <2>;			/* LCD_MODE_DSI: MCU 0, RGB 1, DSI 2 */
		gen-panel-refresh = <60>;
		gen-panel-xres = <540>;
		gen-panel-yres = <960>;
		gen-panel-width= <56>;			/* screen width in mm */
		gen-panel-height = <94>;		/* screen height in mm */
		gen-panel-work-mode = <1>;		/* SPRDFB_MIPI_MODE_VIDEO : CMD 0, VIDEO 1*/
		gen-panel-direction = <0>;		/* LCD_DIRECT_NORMAL : Normal 0, ROT90 1, ROT180 2, ROT270 3 */
		gen-panel-suspend-mode = <1>;	/* SEND_SLEEP_CMD : RST 0, SLEEP 1 */
		gen-panel-bus-width = <24>;
		gen-panel-lanes = <2>;
		gen-panel-phy-feq = <461000>;
		gen-panel-h-sync-pol = <0>;		/*SPRDFB_POLARITY_POS : POS 0, NEG 1 */
		gen-panel-v-sync-pol = <0>;		/*SPRDFB_POLARITY_POS : POS 0, NEG 1 */
		gen-panel-de-pol = <0>;			/*SPRDFB_POLARITY_POS : POS 0, NEG 1 */
		gen-panel-te-pol = <0>;			/*SPRDFB_POLARITY_POS : POS 0, NEG 1 */
		gen-panel-color-mode-pol = <1>;	/*SPRDFB_POLARITY_POS : POS 0, NEG 1 */
		gen-panel-shut-down-pol = <1>;	/*SPRDFB_POLARITY_POS : POS 0, NEG 1 */
		gen-panel-h-front-porch = <59>; /* hfp */
		gen-panel-h-back-porch = <59>;	/* hbp */
		gen-panel-h-sync-width = <8>;	/* hsync */
		gen-panel-v-front-porch = <14>;	/* vfp */
		gen-panel-v-back-porch = <9>;	/* vbp */
		gen-panel-v-sync-width = <1>;	/* vsync */
		gen-panel-esd-mode = <1>;		/*ESD_DET_INTERRUPT : POLLING 0, INTERRUPT 1 */
		gen-panel-esd-gpio = <102>;
		gen-panel-esd-state = <0>;		/* ESD_DET_NOT_INITIALIZED : NOT_INT 0, OFF 1, ON 0 */
		gen-panel-esd-level = <1>;		/* ESD_DET_HIGH : LOW 0, HIGH 1 */
		gen-panel-octa-tset-param-offset = <5>;
		gen-panel-octa-elvss-param-offset = <16>;
		gen-panel-octa-aid-param-offset = <3>;

		/*
		 * DSI PACKET HEADER INFO
		 * @ delay(msec) : 2byte
		 * @ size of data : 2byte
		 */
		gen-panel-pkt-dinfo-addr-offset = <0>;
		gen-panel-pkt-dinfo-addr-length = <1>;
		gen-panel-pkt-dinfo-data-offset = <1>;
		gen-panel-pkt-dinfo-data-length = <1>;
		gen-panel-post-enable-cmds = [
			39 00 00 00 00 03	F0 5A 5A
			39 00 00 00 00 06	B8 38 0B 40 00 A8
			39 00 00 00 00 03	F0 A5 A5
			05 00 00 14 00 01	11
		];
		gen-panel-post-enable-1-cmds = [
			05 00 00 14 00 01	29
		];
		gen-panel-disable-cmds = [
			05 00 00 14 00 01	28
			05 00 00 78 00 01	10
		];
		gen-panel-nv-read-enable-cmds = [
			39 00 00 00 00 03	F0 5A 5A
		];
		gen-panel-nv-read-disable-cmds = [
			39 00 00 00 00 03	F0 A5 A5
		];
		gen-panel-acl-on-cmds = [
			15 00 00 00 00 02	B5 03	/* ACL MTP Rewrite */
			15 00 00 00 00 02	55 02
		];
		gen-panel-acl-off-cmds = [
			15 00 00 00 00 02	55 00
		];
		gen-panel-hbm-on-cmds = [
			39 00 00 00 00 22	CA 01 00 01 00 01 00 80 80 80 80 80 80 80 80 80
						80 80 80 80 80 80 80 80 80 80 80 80 80 80 80 00
						00 00
			39 00 00 00 00 06	B2 40 00 28 00 0A
			39 00 00 00 00 12	B6 2C 0B 00 00 00 00 00 00 00 00 00 00 0A AA AF 0F 04
			15 00 00 00 00 02	B5 03	/* ACL MTP Rewrite */
			15 00 00 00 00 02	55 02
		];
		gen-panel-hbm-off-cmds = [
			15 00 00 00 00 02	B0 10
			15 00 00 00 00 02	B6 00
		];
		gen-panel-tset-cmds = [
			39 00 00 00 00 07	B8 38 0B 40 00 A8 19
		];
		gen-panel-elvss-cmds = [
			39 00 00 00 00 12	B6 2C 00 00 00 00 00 00 00 00 00 00 00 0A AA AF
						0F 00
		];
		gen-panel-aid-cmds = [
			39 00 00 00 00 06	B2 40 00 28 00 0A
		];

		/* VREGOUT VOLTAGE 5.4 * 2^22 */
		gen-panel-octa-vregout = <22649241>;


		gen-panel-candela-table = <
			5	6	7	8	9	10	11	12	13	14
			15	16	17	19	20	21	22	24	25	27
			29	30	32	34	37	39	41	44	47	50
			53	56	60	64	68	72	77	82	87	93
			98	105	111	119	126	134	143	152	162	172
			183	195	207	220	234	249	265	282	300	316
			333	350
		>;

		gen-panel-aid-table = <
			0x3B8	0x3B1	0x3A9	0x3A3	0x39B	0x393	0x38D	0x384	0x37D	0x376
			0x36E	0x366	0x360	0x351	0x348	0x33E	0x335	0x323	0x319	0x307
			0x2F7	0x2ED	0x2DD	0x2CD	0x2B5	0x2A5	0x295	0x27B	0x263	0x24B
			0x231	0x218	0x1F6	0x1D5	0x1B5	0x18F	0x18F	0x18F	0x18F	0x18F
			0x18F	0x18F	0x18F	0x163	0x13B	0x113	0x0DF	0x0B1	0x078	0x045
			0x00A	0x00A	0x00A	0x00A	0x00A	0x00A	0x00A	0x00A	0x00A	0x00A
			0x00A	0x00A
		>;

		gen-panel-elvss-table = <
			0x0B	0x0B	0x0B	0x0B	0x0B	0x0B	0x0B	0x0B	0x0B	0x0B
			0x0B	0x0B	0x0B	0x0B	0x0B	0x0D	0x0F	0x11	0x13	0x15
			0x17	0x18	0x18	0x18	0x18	0x18	0x18	0x18	0x18	0x18
			0x18	0x18	0x18	0x18	0x18	0x18	0x18	0x18	0x18	0x18
			0x18	0x18	0x18	0x18	0x18	0x17	0x17	0x16	0x16	0x15
			0x15	0x14	0x13	0x12	0x12	0x11	0x10	0x0F	0x0E	0x0D
			0x0C	0x0B
		>;

		gen-panel-elvss-temperature-table = <
			/* T > 0 */
			0x11	0x11	0x11	0x11	0x11	0x11	0x11	0x11	0x11	0x11
			0x11	0x11	0x11	0x11	0x11	0x11	0x11	0x11	0x11	0x11
			0x11	0x00	0x00	0x00	0x00	0x00	0x00	0x00	0x00	0x00
			0x00	0x00	0x00	0x00	0x00	0x00	0x00	0x00	0x00	0x00
			0x00	0x00	0x00	0x00	0x00	0x00	0x00	0x00	0x00	0x00
			0x00	0x00	0x00	0x00	0x00	0x00	0x00	0x00	0x00	0x00
			0x00	0x00

			/* 0 >= T > -20 */
			0x1E	0x1E	0x1E	0x1E	0x1E	0x1E	0x1E	0x1E	0x1E	0x1E
			0x1E	0x1E	0x1E	0x1E	0x1E	0x1C	0x1A	0x18	0x16	0x14
			0x12	0x00	0x00	0x00	0x00	0x00	0x00	0x00	0x00	0x00
			0x00	0x00	0x00	0x00	0x00	0x00	0x00	0x00	0x00	0x00
			0x00	0x00	0x00	0x00	0x00	0x00	0x00	0x00	0x00	0x00
			0x00	0x00	0x00	0x00	0x00	0x00	0x00	0x00	0x00	0x00
			0x00	0x00

			/* -20 > T */
			0x1E	0x1E	0x1E	0x1E	0x1E	0x1E	0x1E	0x1E	0x1E	0x1E
			0x1E	0x1E	0x1E	0x1E	0x1E	0x1C	0x1A	0x18	0x16	0x14
			0x12	0x00	0x00	0x00	0x00	0x00	0x00	0x00	0x00	0x00
			0x00	0x00	0x00	0x00	0x00	0x00	0x00	0x00	0x00	0x00
			0x00	0x00	0x00	0x00	0x00	0x00	0x00	0x00	0x00	0x00
			0x00	0x00	0x00	0x00	0x00	0x00	0x00	0x00	0x00	0x00
			0x00	0x00
		>;
		gen-panel-base-lux-table = <
			129 129 129 129 129 129 129 129 129 129 129 129 129
			129 129 129 129 129 129 129 129 129 129 129 129 129
			129 129 129 129 129 129 129 129 129 129 136 146 153
			163 169 182 191 191 191 191 191 191 191 191 191 204
			216 229 243 258 273 289 305 320 336 350
		>;

		gen-panel-candela-compensation-table = <
			/* V255 V203 V151 V87 V51 V35 V23 V11 V3 */
			0	3	4	6	10	14	18	22	25
			0	1	3	4	8	12	15	20	23
			0	1	2	3	7	10	13	18	21
			0	1	2	3	6	9	12	17	19
			0	1	1	2	5	8	11	15	18
			0	1	1	2	4	7	10	14	18
			0	1	1	2	4	7	10	14	17
			0	1	1	1	4	6	9	13	16
			0	1	1	1	3	6	8	13	16
			0	1	1	1	3	6	8	12	15
			0	1	1	1	3	5	7	12	14
			0	1	1	1	2	5	7	11	14
			0	1	1	1	3	5	7	11	14
			0	1	1	1	2	4	6	10	13
			0	1	2	2	3	5	7	11	13
			0	1	2	2	3	5	7	11	13
			0	1	2	2	4	6	7	11	13
			0	1	2	2	4	6	7	11	13
			0	1	3	3	4	6	7	11	13
			0	2	3	3	4	6	7	11	13
			0	2	3	3	4	6	7	11	12
			0	2	3	3	4	6	7	11	12
			0	2	3	3	4	5	7	10	11
			0	2	3	3	3	5	7	10	11
			0	2	3	3	3	5	6	9	11
			0	2	3	3	3	5	6	9	11
			0	2	3	3	3	4	6	8	10
			0	1	2	2	3	4	5	8	10
			0	1	2	2	3	4	5	7	9
			0	1	2	2	3	4	5	7	9
			0	1	2	2	3	4	5	7	8
			0	1	2	2	3	3	4	6	8
			0	1	2	2	2	3	4	6	8
			0	1	2	2	2	3	4	6	7
			0	1	2	2	2	3	4	5	7
			0	1	2	2	2	3	4	5	6
			0	2	2	2	2	2	3	4	6
			0	2	2	2	2	2	3	4	6
			0	2	2	2	3	2	3	4	6
			0	2	2	2	3	2	3	4	6
			0	1	2	2	2	3	3	4	6
			0	1	2	2	2	2	3	4	6
			0	1	2	2	2	2	3	4	6
			0	1	2	1	2	2	3	3	6
			0	0	1	1	2	1	2	2	5
			0	0	1	1	1	1	2	2	5
			0	0	1	1	1	1	2	2	4
			0	0	1	1	1	1	2	2	4
			0	0	1	1	1	0	2	1	4
			0	0	1	1	1	0	2	1	3
			0	1	2	1	2	1	2	1	3
			0	1	1	1	2	1	1	1	2
			0	0	1	0	1	1	1	1	2
			0	0	1	0	0	1	1	1	2
			0	0	2	0	1	1	0	1	2
			0	0	1	0	1	1	1	1	1
			0	0	1	0	0	0	0	0	1
			0	0	1	0	0	0	0	0	1
			0	0	0	(-1)	(-1)	0	0	0	1
			0	(-1)	0	(-1)	(-1)	0	0	0	1
			0	(-1)	0	(-2)	(-1)	(-1)	(-1)	(-1)	0
			0	0	0	0	0	0	0	0	0
		>;

		gen-panel-rgb-compensation-table = <
			/* R255 G255 B255 R203 G203 B203 R151 G151 B151 R87 G87 B87 R51 G51 B51 R35 G35 B35 R23 G23 B23 R11 G11 B11 */
			(-1)	0	0	0	0	0	(-2)	0	0	(-6)	0	(-2)	(-11)	0	(-2)	(-7)	0	(-1)	(-6)	0	(-1)	(-2)	0	(-3)
			(-1)	0	0	0	0	0	(-1)	0	0	(-4)	0	(-1)	(-11)	0	(-2)	(-7)	0	(-1)	(-6)	0	(-5)	(-4)	0	(-2)
			0	0	0	(-1)	0	0	(-2)	0	0	(-4)	0	0	(-9)	0	(-1)	(-8)	0	(-3)	(-4)	0	(-4)	(-5)	0	(-3)
			0	0	0	(-1)	0	0	(-2)	0	0	(-4)	0	0	(-9)	0	(-1)	(-8)	0	(-4)	(-5)	0	(-2)	(-7)	0	(-5)
			0	0	0	(-1)	0	0	0	0	1	(-3)	0	(-1)	(-8)	0	(-1)	(-8)	0	(-4)	(-6)	0	(-2)	(-8)	0	(-8)
			0	0	0	(-1)	0	0	0	0	1	(-2)	0	0	(-8)	0	(-1)	(-7)	0	(-4)	(-9)	0	(-5)	(-9)	0	(-9)
			0	0	0	(-1)	0	0	(-1)	0	0	(-2)	0	0	(-7)	0	0	(-5)	0	(-3)	(-8)	0	(-2)	(-10)	0	(-9)
			0	0	0	0	0	0	(-1)	0	0	(-3)	0	0	(-7)	0	0	(-7)	0	(-4)	(-7)	0	(-2)	(-10)	0	(-9)
			0	0	0	0	0	0	(-1)	0	0	(-2)	0	0	(-7)	0	0	(-6)	0	(-3)	(-10)	0	(-5)	(-9)	0	(-5)
			0	0	0	0	0	0	(-1)	0	0	(-2)	0	0	(-7)	0	0	(-5)	0	(-3)	(-10)	0	(-5)	(-11)	0	(-9)
			0	0	0	0	0	0	(-1)	0	0	(-2)	0	0	(-5)	0	1	(-7)	0	(-5)	(-8)	0	(-5)	(-12)	0	(-5)
			0	0	0	0	0	0	(-1)	0	0	(-2)	0	0	(-5)	0	1	(-5)	0	(-5)	(-9)	0	(-4)	(-11)	0	(-8)
			0	0	0	0	0	0	(-1)	0	0	(-3)	0	(-1)	(-4)	0	2		(-4)	0	(-4)	(-13)	0	(-5)	(-11)	0	(-8)
			0	0	0	0	0	0	(-1)	0	0	(-2)	0	(-1)	(-4)	0	2		(-5)	0	(-5)	(-11)	0	(-6)	(-11)	0	(-8)
			0	0	0	0	0	0	(-1)	0	0	(-2)	0	(-1)	(-5)	0	1		(-5)	0	(-5)	(-7)	0	(-3)	(-10)	0	(-7)
			0	0	0	0	0	0	(-1)	0	0	(-2)	0	(-1)	(-5)	0	1		(-5)	0	(-5)	(-7)	0	(-4)	(-8)	0	(-8)
			1	0	0	(-1)	0	0	(-1)	0	0	(-1)	0	(-1)	(-4)	0	1	(-5)	0	(-5)	(-7)	0	(-4)	(-8)	0	(-8)
			1	0	0	(-1)	0	0	(-1)	0	0	(-1)	0	(-1)	(-4)	0	0	(-4)	0	(-4)	(-7)	0	(-4)	(-8)	0	(-8)
			1	0	0	0	0	0	(-1)	0	0	0	0	0	(-4)	0	(-1)	(-5)	0	(-5)	(-6)	0	(-4)	(-9)	0	(-10)
			1	0	0	0	0	0	(-1)	0	0	(-1)	0	(-1)	(-2)	0	0		(-5)	0	(-5)	(-6)	0	(-4)	(-9)	0	(-11)
			1	0	0	0	0	0	(-1)	0	0	0	0	0	(-3)	0	(-1)	(-4)	0	(-5)	(-6)	0	(-3)	(-8)	0	(-8)
			1	0	0	0	0	0	(-1)	0	0	0	0	0	(-3)	0	(-1)	(-4)	0	(-5)	(-6)	0	(-4)	(-8)	0	(-7)
			1	0	0	0	0	0	(-1)	0	0	0	0	0	(-3)	0	(-1)	(-3)	0	(-5)	(-6)	0	(-3)	(-9)	0	(-11)
			1	0	0	0	0	0	(-1)	0	0	0	0	0	(-3)	0	(-1)	(-3)	0	(-5)	(-5)	0	(-2)	(-8)	0	(-10)
			1	0	0	0	0	0	(-1)	0	0	0	0	0	(-2)	0	0	(-3)	0	(-5)	(-6)	0	(-4)	(-8)	0	(-12)
			1	0	0	0	0	0	(-1)	0	0	0	0	0	(-2)	0	0	(-3)	0	(-5)	(-6)	0	(-4)	(-7)	0	(-10)
			1	0	0	0	0	0	(-1)	0	0	0	0	0	(-2)	0	0	(-3)	0	(-5)	(-6)	0	(-5)	(-7)	0	(-12)
			1	0	0	0	0	0	(-2)	0	0	0	0	(-1)	(-2)	0	2	(-3)	0	(-5)	(-6)	0	(-6)	(-6)	0	(-8)
			1	0	0	0	0	0	(-2)	0	0	0	0	(-1)	(-2)	0	2	(-3)	0	(-5)	(-4)	0	(-4)	(-7)	0	(-11)
			1	0	0	0	0	0	(-2)	0	0	0	0	(-1)	(-2)	0	2	(-3)	0	(-5)	(-3)	0	(-6)	(-9)	0	(-9)
			1	0	0	0	0	0	(-2)	0	0	0	0	(-1)	(-2)	0	2	(-3)	0	(-5)	(-3)	0	(-3)	(-8)	0	(-8)
			1	0	0	0	0	0	(-2)	0	0	0	0	(-1)	(-2)	0	2	(-2)	0	(-5)	(-4)	0	(-6)	(-8)	0	(-9)
			1	0	0	0	0	0	(-2)	0	0	0	0	(-1)	(-2)	0	2	(-2)	0	(-5)	(-3)	0	(-5)	(-8)	0	(-8)
			1	0	0	0	0	0	(-2)	0	0	0	0	(-1)	(-2)	0	2	(-2)	0	(-5)	(-3)	0	(-4)	(-7)	0	(-6)
			1	0	0	0	0	0	(-2)	0	0	0	0	(-1)	(-2)	0	2	(-1)	0	(-4)	(-3)	0	(-3)	(-8)	0	(-9)
			0	0	0	0	0	0	(-1)	0	0	0	0	0	(-2)	0	1	(-2)	0	(-4)	(-2)	0	(-3)	(-7)	0	(-6)
			0	0	0	0	0	(-1)	(-1)	0	1	0	0	0	(-2)	0	2	(-1)	0	(-5)	(-4)	0	(-3)	(-7)	0	(-6)
			0	0	(-1)	1	0	0	0	0	0	0	0	0	(-1)	0	2	(-1)	0	(-4)	(-2)	0	(-3)	(-7)	0	(-7)
			1	0	0	0	0	0	(-1)	0	0	0	0	1	(-1)	0	2	1	0	(-2)	(-3)	0	(-4)	(-7)	0	(-7)
			1	0	0	(-1)	0	(-1)	0	0	0	0	0	1	(-1)	0	1	1	0	(-2)	(-5)	0	(-5)	(-6)	0	(-5)
			2	0	2	0	0	0	(-1)	0	0	0	0	1	(-1)	0	1	0	0	(-2)	(-1)	0	(-3)	(-6)	0	(-5)
			1	0	1	0	0	0	0	0	(-1)	0	0	1	0	0	2	0	0	(-2)	(-1)	0	(-1)	(-5)	0	(-4)
			1	0	1	1	0	1	0	0	0	(-1)	0	0	(-1)	0	1	1	0	(-1)	(-2)	0	(-2)	(-6)	0	(-5)
			1	0	1	1	0	1	0	0	0	0	0	1	(-1)	0	1	1	0	(-1)	(-2)	0	(-2)	(-5)	0	(-5)
			1	0	1	1	0	1	1	0	0	0	0	0	0	0	2	1	0	(-1)	(-1)	0	(-3)	(-4)	0	(-6)
			1	0	1	1	0	1	1	0	0	0	0	0	0	0	2	1	0	(-1)	(-2)	0	(-4)	(-3)	0	(-3)
			1	0	1	1	0	1	1	0	0	0	0	0	0	0	2	1	0	(-1)	(-2)	0	(-4)	(-1)	0	(-1)
			1	0	1	1	0	1	0	0	0	0	0	0	2	0	3	1	0	(-2)	(-2)	0	(-4)	(-1)	0	0
			1	0	1	1	0	1	0	0	0	0	0	0	1	0	2	2	0	(-2)	0	0	(-1)	(-2)	0	1
			1	0	1	1	0	1	0	0	0	0	0	0	1	0	2	2	0	(-2)	(-1)	0	(-2)	(-1)	0	3
			0	0	0	0	0	0	0	0	0	0	0	0	0	0	0	0	0	0	0	0	0	0	0	0
			0	0	0	0	0	0	0	0	0	0	0	0	0	0	0	0	0	0	0	0	0	0	0	0
			0	0	0	0	0	0	0	0	0	0	0	0	0	0	0	0	0	0	0	0	0	0	0	0
			0	0	0	0	0	0	0	0	0	0	0	0	0	0	0	0	0	0	0	0	0	0	0	0
			0	0	0	0	0	0	0	0	0	0	0	0	0	0	0	0	0	0	0	0	0	0	0	0
			0	0	0	0	0	0	0	0	0	0	0	0	0	0	0	0	0	0	0	0	0	0	0	0
			0	0	0	0	0	0	0	0	0	0	0	0	0	0	0	0	0	0	0	0	0	0	0	0
			0	0	0	0	0	0	0	0	0	0	0	0	0	0	0	0	0	0	0	0	0	0	0	0
			0	0	0	0	0	0	0	0	0	0	0	0	0	0	0	0	0	0	0	0	0	0	0	0
			0	0	0	0	0	0	0	0	0	0	0	0	0	0	0	0	0	0	0	0	0	0	0	0
			0	0	0	0	0	0	0	0	0	0	0	0	0	0	0	0	0	0	0	0	0	0	0	0
			0	0	0	0	0	0	0	0	0	0	0	0	0	0	0	0	0	0	0	0	0	0	0	0
		>;


		gen-panel-gamma-cmds = [
			39 00 00 00 00 22	CA 01 00 01 00 01 00 80 80 80 80 80 80 80 80 80
						80 80 80 80 80 80 80 80 80 80 80 80 80 80 80 00
						00 00
		];
		gen-panel-gamma-update-cmds = [
			15 00 00 05 00 02	F7 03
		];
		gen-panel-read-hbm = [
			B5 0D 06
			B5 1A 03
			B6 18 0C
		];
		gen-panel-read-mtp = [C8 00 21];
		gen-panel-read-id = [
			DA 00 01
			DB 00 01
			DC 00 01
		];
		gen-panel-read-status-reg = [0A];
		gen-panel-read-status-ok = [9A];
		status = "okay";
	};
};
