&gen_panel {
	dsi_s6d77a1_vid: gen-panel-s6d77a1-video {
		gen-panel-manu = "SDC";			/* condensed manufacturer name */
		gen-panel-name = "s6d77a1";
		gen-panel-id = <0x55b810>;
		gen-panel-dev-id = <0>;			/* SPRDFB_MAINLCD_ID : MAIN 0, SUB 1 */
		gen-panel-type = <2>;			/* LCD_MODE_DSI: MCU 0, RGB 1, DSI 2 */
		gen-panel-refresh = <60>;
		gen-panel-xres = <480>;
		gen-panel-yres = <800>;
		gen-panel-width= <56>;			/* screen width in mm */
		gen-panel-height = <94>;		/* screen height in mm */
		gen-panel-work-mode = <1>;		/* SPRDFB_MIPI_MODE_VIDEO : CMD 0, VIDEO 1*/
		gen-panel-direction = <0>;		/* LCD_DIRECT_NORMAL : Normal 0, ROT90 1, ROT180 2, ROT270 3 */
		gen-panel-suspend-mode = <1>;	/* SEND_SLEEP_CMD : RST 0, SLEEP 1 */
		gen-panel-bus-width = <24>;
		gen-panel-lanes = <2>;
		gen-panel-phy-feq = <481000>;
		gen-panel-h-sync-pol = <0>;		/*SPRDFB_POLARITY_POS : POS 0, NEG 1 */
		gen-panel-v-sync-pol = <0>;		/*SPRDFB_POLARITY_POS : POS 0, NEG 1 */
		gen-panel-de-pol = <0>;			/*SPRDFB_POLARITY_POS : POS 0, NEG 1 */
		gen-panel-te-pol = <0>;			/*SPRDFB_POLARITY_POS : POS 0, NEG 1 */
		gen-panel-color-mode-pol = <1>;	/*SPRDFB_POLARITY_POS : POS 0, NEG 1 */
		gen-panel-shut-down-pol = <1>;	/*SPRDFB_POLARITY_POS : POS 0, NEG 1 */
		gen-panel-h-front-porch = <84>; /* hfp */
		gen-panel-h-back-porch = <90>;	/* hbp */
		gen-panel-h-sync-width = <40>;	/* hsync */
		gen-panel-v-front-porch = <16>;	/* vfp */
		gen-panel-v-back-porch = <12>;	/* vbp */
		gen-panel-v-sync-width = <4>;	/* vsync */

		/*
		 * DSI PACKET HEADER INFO
		 * @ delay(msec) : 2byte
		 * @ size of data : 2byte
		 */
		gen-panel-pkt-dinfo-addr-offset = <0>;
		gen-panel-pkt-dinfo-addr-length = <1>;
		gen-panel-pkt-dinfo-data-offset = <1>;
		gen-panel-pkt-dinfo-data-length = <1>;
		gen-panel-init-cmds = [
			39 00 00 00 00 03		F0 5A 5A
			39 00 00 00 00 03		FC A5 A5
			15 00 00 00 00 02		B3 01
			15 00 00 00 00 02		B5 10
			39 00 00 00 00 04		BC 00 29 51
			39 00 00 00 00 03		E3 24 2C
			05 00 00 14 00 01		21
			39 00 00 00 00 08		F2 11 04 08 10 10 82 54
			39 00 00 00 00 06		F3 91 00 00 00 10
			39 00 00 00 00 2C		F4 01 02 23 24 25 25 26 26 29 29 2C 2B 2C 07 08
								05 04 04 01 01 22 0A 17 0F 11 23 0D 0A 0B 02 19
								13 1E 1F 23 20 05 16 1A 16 1E 24 1E
			39 00 00 00 00 2D		F5 5A 62 B9 21 35 55 06 08 00 39 00 00 0B 4B C4
								CB 4B 12 12 1A 00 10 E0 E2 0E 34 34 03
			39 00 00 00 00 12		FE 00 02 01 39 60 40 21 00 4B 00 80 00 F0 00 00
								00 02
			39 00 00 00 00 0B		EE 86 00 86 00 00 00 00 00 00 00
			39 00 00 00 00 16		EF 34 12 00 00 0A 29 08 27 21 40 10 28 02 21 21
								03 03 40 00 00 00
			39 00 00 00 00 1F		F7 02 1B 1A 00 01 0D 0D 09 09 0C 0C 08 08 04 06
								02 1B 1A 00 01 0F 0F 0B 0B 0E 0E 0A 0A 05 07
			39 00 00 00 00 07		F6 63 25 15 00 00 2E
			15 00 00 00 00 02		36 10
			39 00 00 00 00 12		FA 00 3F 09 10 08 0D 12 12 12 18 1B 1B 1D 1E 21
								25 2D
			39 00 00 00 00 12		FB 00 3F 09 11 08 0E 13 12 13 19 1B 1C 1D 1E 21
								25 2D
			39 00 00 00 00 08		FD 00 10 11 20 21 1F CC
			39 00 00 00 00 03		FC 5A 5A
		];
		gen-panel-enable-cmds = [
			05 00 00 78 00 01		11
			05 00 00 78 00 01		29
		];
		gen-panel-disable-cmds = [
			05 00 00 96 00 01		28
			05 00 00 96 00 01		10
		];


		gen-panel-read-id = [
			DA 00 01
			DB 00 01
			DC 00 01
		];
		gen-panel-read-status-reg = [0A];
		gen-panel-read-status-ok = [9A];
		status = "okay";
	};
};
