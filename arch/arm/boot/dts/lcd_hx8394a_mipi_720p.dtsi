/ {
	lcd_mipi_hx8394a_720p: lcd8394 {
			hfp = <16>;
			hbp = <16>;
			hsync = <10>;
			vfp = <12>;
			vbp = <15>;
			vsync = <4>;

			work_mode = <1>;
			bpp = <24>;
			lan_number = <4>;
			phy_feq = <450000>;
			h_sync_pol = <0>;
			v_sync_pol = <0>;
			de_pol = <0>;
			te_pol = <0>;
			color_mode_pol = <1>;
			shut_down_pol = <1>;

			width = <720>;
			height = <1280>;
			fps = <60>;
			direction = <0>;
			dev_id = <0>;
			type=<2>;
			lcd_id = <0x8394>;
			esd_return_code = <28>;
			//low_res_simu;
			simu_width = <480>;
			simu_height = <854>;
			panel_name = "lcd_hx8394a_mipi";
			init_data = [
				39 00 00 04 B9 FF 83 94
				39 00 00 03 BA 33 83
				39 00 00 10 B1 6C 12 12 26 04 11 F1 81 3A 54 23 80 C0 D2 58
				39 00 00 0C B2 00 64 0E 0D 22 1C 08 08 1C 4D 00
				39 00 00 0D B4 00 FF 51 5A 59 5A 03 5A 01 70 01 70
				39 00 00 02 BC 07
				39 00 00 04 BF 41 0E 01
				39 00 00 26 D3 00 0F 00 40 07 10 00 08 10 08 00 08 54 15 0E
				05 0E 02 15 06 05 06 47 44 0A 0A 4B 10 07 07 08 00 00 00 0A
				00 01
				39 00 00 2D D5 1A 1A 1B 1B 00 01 02 03 04 05 06 07 08 09 0A
				0B 24 25 18 18 26 27 18 18 18 18 18 18 18 18 18 18 18 18 18
				18 18 18 20 21 18 18 18 18
				39 00 00 2D D6 1A 1A 1B 1B 0B 0A 09 08 07 06 05 04 03 02 01
				00 21 20 58 58 27 26 18 18 18 18 18 18 18 18 18 18 18 18 18
				18 18 18 25 24 18 18 18 18
				39 00 00 02 CC 09
				39 00 00 03 C0 30 14
				39 00 00 05 C7 00 C0 40 C0
				39 00 00 03 B6 6B 6B
				39 00 00 2B E0 00 0A 0F 24 3A 3F 20 3B 08 0D 0E 16 0F 12 15
				13 15 09 12 12 18 00 0A 0F 24 3A 3F 20 3B 08 0D 0E 16 0F 12
				15 13 15 09 12 12 18
				39 00 00 02 BD 00
				39 00 00 2C C1 01 00 06 0C 14 1D 27 2F 38 41 49 51 59 61 69
				71 79 81 89 91 99 A1 A9 B2 B9 C1 CA D1 D8 E2 EA F0 F7 FF 38
				FC 3F 0B C1 13 F1 0D C0
				39 00 00 02 BD 01
				39 00 00 2B C1 00 06 0C 14 1D 27 2F 38 41 49 51 59 61 69 71
				79 81 89 91 99 A1 A9 B2 B9 C1 CA D1 D8 E2 EA F0 F7 FF 38 FC
				3F 0B C1 13 F1 0D C0
				39 00 00 02 BD 02
				39 00 00 2B C1 00 06 0C 14 1D 27 2F 38 41 49 51 59 61 69 71
				79 81 89 91 99 A1 A9 B2 B9 C1 CA D1 D8 E2 EA F0 F7 FF 38 FC
				3F 0B C1 13 F1 0D C0
				39 00 00 02 36 03
				39 78 00 01 11
				39 64 00 01 29
			];
			sleep_in =  [
			   39 00 00 02 28 00
			   39 78 00 02 10 00
			];
			sleep_out = [
				39 78 00 02 11 00
				39 00 00 02 29 00
			];
			esd_check = [
				37 00 00 02 01 00
			];
	};

};



