&gen_panel {
	dsi_ea8061s_wVGA_vid: gen-panel-ea8061s_wVGA-video {
		gen-panel-manu = "SMD";			/* condensed manufacturer name */
		gen-panel-name = "AMS450JV01";
		gen-panel-id = <0x000040 0x000041 0x000042 0x000043>;
		gen-panel-dev-id = <0>;			/* SPRDFB_MAINLCD_ID : MAIN 0, SUB 1 */
		gen-panel-type = <2>;			/* LCD_MODE_DSI: MCU 0, RGB 1, DSI 2 */
		gen-panel-refresh = <60>;
		gen-panel-xres = <480>;
		gen-panel-yres = <800>;
		gen-panel-width= <56>;			/* screen width in mm */
		gen-panel-height = <94>;		/* screen height in mm */
		gen-panel-work-mode = <1>;		/* SPRDFB_MIPI_MODE_VIDEO : CMD 0, VIDEO 1*/
		gen-panel-direction = <0>;		/* LCD_DIRECT_NORMAL : Normal 0, ROT90 1, ROT180 2, ROT270 3 */
		gen-panel-suspend-mode = <1>;	/* SEND_SLEEP_CMD : RST 0, SLEEP 1 */
		gen-panel-bus-width = <24>;
		gen-panel-lanes = <2>;
		gen-panel-phy-feq = <365000>;
		gen-panel-h-sync-pol = <0>;		/*SPRDFB_POLARITY_POS : POS 0, NEG 1 */
		gen-panel-v-sync-pol = <0>;		/*SPRDFB_POLARITY_POS : POS 0, NEG 1 */
		gen-panel-de-pol = <0>;			/*SPRDFB_POLARITY_POS : POS 0, NEG 1 */
		gen-panel-te-pol = <0>;			/*SPRDFB_POLARITY_POS : POS 0, NEG 1 */
		gen-panel-color-mode-pol = <1>;	/*SPRDFB_POLARITY_POS : POS 0, NEG 1 */
		gen-panel-shut-down-pol = <1>;	/*SPRDFB_POLARITY_POS : POS 0, NEG 1 */
		gen-panel-h-front-porch = <10>; /* hfp */
		gen-panel-h-back-porch = <2>;	/* hbp */
		gen-panel-h-sync-width = <2>;	/* hsync */
		gen-panel-v-front-porch = <14>;	/* vfp */
		gen-panel-v-back-porch = <8>;	/* vbp */
		gen-panel-v-sync-width = <2>;	/* vsync */
		gen-panel-octa-tset-param-offset = <0>;
		gen-panel-octa-elvss-param-offset = <1>;
		gen-panel-octa-aid-param-offset = <2>;
		gen-panel-octa-product-reg = [A1];	/* Product Date register */
		gen-panel-octa-product-gpara = <4>;	/* Global parameter should be 'count - 1' */
		gen-panel-octa-coordinate-reg = [A1];	/* Product Date register */
		gen-panel-octa-coordinate-gpara = <0>;	/* Global parameter should be 'count - 1' */
		gen-panel-acl-always-on;

		/*
		 * DSI PACKET HEADER INFO
		 * @ delay(msec) : 2byte
		 * @ size of data : 2byte
		 */
		gen-panel-pkt-dinfo-addr-offset = <0>;
		gen-panel-pkt-dinfo-addr-length = <1>;
		gen-panel-pkt-dinfo-data-offset = <1>;
		gen-panel-pkt-dinfo-data-length = <1>;
		gen-panel-post-enable-cmds = [
			39 00 00 00 00 03	F0 5A 5A
			15 00 00 00 00 02	BA 74
			39 00 00 00 00 05	B2 00 00 00 0A
			15 00 00 00 00 02	F7 03
			39 00 00 00 00 03	B8 19 00
			39 00 00 00 00 03	F0 A5 A5
			05 00 00 28 00 01	11
		];
		gen-panel-post-enable-1-cmds = [
			05 00 00 78 00 01	29
		];
		gen-panel-disable-cmds = [
			05 00 00 28 00 01	28
			05 00 00 96 00 01	10
		];
		gen-panel-nv-read-enable-cmds = [
			39 00 00 00 00 03	F0 5A 5A
		];
		gen-panel-nv-read-disable-cmds = [
			39 00 00 00 00 03	F0 A5 A5
		];
		gen-panel-acl-on-cmds = [
			15 00 00 00 00 02	55 02
		];
		gen-panel-acl-off-cmds = [
			15 00 00 00 00 02	55 00
		];
		gen-panel-hbm-on-cmds = [
			39 00 00 00 00 05	B2 00 00 00 0A
			39 00 00 00 00 03	B6 CC 8B
			15 00 00 00 00 02	53 C0
		];
		gen-panel-hbm-off-cmds = [
			15 00 00 00 00 02	53 00
		];
		gen-panel-tset-cmds = [
			15 00 00 00 00 02	B8 19
		];
		gen-panel-elvss-cmds = [
			39 00 00 00 00 03	B6 CC 8B
		];
		gen-panel-aid-cmds = [
			39 00 00 00 00 05	B2 00 00 00 0A
		];

		/* VREGOUT VOLTAGE 5.8 * 2^22 */
		gen-panel-octa-vregout = <24326963>;

		gen-panel-candela-table = <
			5	6	7	8	9	10	11	12	13	14
			15	16	17	19	20	21	22	24	25	27
			29	30	32	34	37	39	41	44	47	50
			53	56	60	64	68	72	77	82	87	93
			98	105	111	119	126	134	143	152	162	172
			183	195	207	220	234	249	265	282	300	316
			333	350
		>;

		gen-panel-aid-table = <
			0x31A	0x313	0x30C	0x307	0x2FE	0x2F9	0x2F1	0x2EF	0x2E8	0x2E3	/*5 ~ 14*/
			0x2DB	0x2D4	0x2CE	0x2C5	0x2B2	0x2AA	0x2A1	0x292	0x288	0x278	/*15 ~ 27*/
			0x26A	0x266	0x254	0x245	0x22F	0x21F	0x211	0x200	0x1EA	0x1D0	/*29 ~ 50*/
			0x1B9	0x1A9	0x185	0x167	0x146	0x146	0x146	0x146	0x146	0x146	/*53 ~ 93*/
			0x146	0x146	0x146	0x120	0x0FD	0x0D7	0x0AD	0x080	0x052	0x021	/*98 ~ 172*/
			0x00A	0x00A	0x00A	0x00A	0x00A	0x00A	0x00A	0x00A	0x00A	0x00A	/*183 ~ 316*/
			0x00A	0x00A									/*333 ~ 350*/
		>;

		gen-panel-elvss-table = <
			0x0B	0x0B	0x0B	0x0B	0x0B	0x0B	0x0B	0x0B	0x0B	0x0B
			0x0B	0x0B	0x0B	0x0B	0x0D	0x0F	0x11	0x13	0x15	0x17
			0x19	0x1A	0x1A	0x1A	0x1A	0x1A	0x1A	0x1A	0x1A	0x1A
			0x1A	0x1A	0x1A	0x1A	0x1A	0x1A	0x1A	0x1A	0x1A	0x1A
			0x19	0x18	0x16	0x16	0x16	0x16	0x16	0x16	0x15	0x15
			0x15	0x14	0x13	0x12	0x12	0x11	0x10	0x0F	0x0E	0x0D
			0x0C	0x0B
		>;

		gen-panel-base-lux-table = <
			115	115	115	115	115	115	115	115	115	115
			115	115	115	115	115	115	115	115	115	115
			115	115	115	115	115	115	115	115	115	115
			115	115	115	115	115	122	131	138	147	157
			163	175	186	186	186	186	186	186	186	186
			191	202	215	229	242	255	272	286	304	319
			336	350

		>;

		gen-panel-gamma-curve-table = <
			215	215	215	215	215	215	215	215	215	215
			215	215	215	215	215	215	215	215	215	215
			215	215	215	215	215	215	215	215	215	215
			215	215	215	215	215	215	215	215	215	215
			215	215	215	215	215	215	215	215	215	215
			215	215	215	215	215	215	215	215	215	215
			215	220
		>;

		gen-panel-candela-compensation-table = <
			/* V255 V203    V151    V87     V51     V35     V23     V11     V3 */
			0	3	4	7	9	12	15	18	15
			0	3	3	6	7	10	13	17	15
			0	3	3	5	6	9	12	15	20
			0	3	3	4	6	8	11	15	19
			0	2	3	4	5	7	9	14	18
			0	2	2	4	5	7	8	13	17
			0	2	2	3	4	6	8	13	14
			0	2	0	0	0	1	3	7	7
			0	1	0	0	0	1	3	6	13
			0	2	0	0	0	1	3	6	8
			0	2	0	0	0	1	3	5	9
			0	1	0	0	(-1)	1	2	5	9
			0	1	0	0	(-1)	0	2	5	6
			0	1	0	0	(-1)	0	2	5	6
			0	2	2	3	2	4	5	9	12
			0	3	2	3	3	4	5	9	11
			0	2	3	3	3	4	5	9	12
			0	3	3	3	3	4	5	9	12
			0	3	3	3	3	4	6	10	11
			0	3	3	4	3	4	6	9	14
			0	3	3	3	3	4	5	9	10
			0	3	3	4	3	4	5	9	11
			0	3	3	3	2	4	5	9	8
			0	3	3	3	2	4	5	8	10
			0	2	2	4	2	3	4	8	10
			0	2	2	3	2	3	4	7	10
			0	2	3	3	2	3	4	7	9
			0	2	2	3	2	3	4	7	8
			0	2	3	3	2	3	3	6	8
			0	2	3	3	2	2	3	6	5
			0	2	2	3	2	2	3	6	6
			0	2	2	3	2	2	3	5	8
			0	2	2	3	1	2	3	5	6
			0	2	2	3	1	2	3	4	7
			0	2	2	3	1	1	2	4	6
			0	2	1	3	1	1	2	4	6
			0	1	1	3	1	2	2	3	7
			0	1	2	4	1	1	2	4	4
			0	1	2	3	1	1	3	4	4
			0	1	2	3	1	2	2	4	5
			0	2	2	3	2	1	2	4	5
			0	1	2	4	1	1	2	3	5
			0	1	2	3	1	2	2	3	6
			0	1	2	3	1	2	2	3	5
			0	1	2	3	1	2	2	3	4
			0	1	1	2	1	2	2	3	3
			0	0	1	2	0	1	1	2	4
			0	0	1	2	0	1	1	2	3
			0	0	1	2	0	1	1	2	1
			0	0	1	2	0	1	1	1	5
			0	1	2	3	2	1	2	2	2
			0	0	2	3	1	0	1	2	0
			0	(-1)	2	2	1	1	1	2	0
			(-1)	0	1	1	0	1	1	1	1
			0	0	2	3	0	1	0	1	1
			0	0	1	1	0	0	0	1	1
			0	0	1	1	0	0	0	0	1
			0	1	1	1	1	1	0	0	1
			0	0	1	1	0	0	0	1	0
			0	(-1)	(-1)	0	(-1)	0	0	0	1
			0	(-1)	(-1)	(-1)	(-1)	(-1)	(-1)	(-1)	1
			0	0	0	0	0	0	0	0	0
		>;

		gen-panel-rgb-compensation-table = <
			/* R255 G255 B255 R203 G203 B203 R151 G151 B151 R87 G87 B87 R51 G51 B51 R35 G35 B35 R23 G23 B23 R11 G11 B11 */
			1	0	(-1)	(-1)	0	(-1)	(-1)	0	0	(-4)	0	(-2)	(-11)	2	(-7)	(-3)	0	0	(-5)	1	(-3)	(-3)	2	3
			1	0	(-1)	0	0	(-1)	(-1)	0	0	(-3)	0	0	(-8)	1	(-5)	(-3)	1	(-1)	(-9)	1	(-4)	(-6)	2	(-3)
			1	0	(-1)	0	0	(-1)	(-1)	0	0	(-3)	0	0	(-7)	1	(-6)	(-3)	0	0	(-6)	1	(-3)	(-4)	2	(-2)
			1	0	(-1)	(-1)	0	(-1)	0	0	0	(-1)	0	0	(-8)	0	(-1)	(-5)	1	(-6)	(-2)	1	(-1)	(-9)	3	(-7)
			1	0	(-1)	0	0	(-1)	(-1)	0	0	(-1)	0	0	(-7)	1	(-4)	(-3)	1	(-2)	(-8)	3	(-4)	(-5)	2	(-5)
			1	0	(-1)	0	0	(-1)	0	0	0	(-2)	0	(-1)	(-6)	0	(-2)	(-3)	1	(-4)	(-6)	0	(-1)	(-6)	3	(-6)
			1	0	(-1)	0	0	(-1)	0	0	0	(-2)	0	0	(-4)	0	(-2)	(-4)	1	(-4)	(-6)	0	(-2)	(-6)	2	(-6)
			0	0	(-3)	0	0	0	(-1)	0	(-1)	(-1)	0	1	(-4)	0	(-2)	(-4)	1	(-1)	(-7)	2	(-1)	(-10)	2	0
			0	0	(-3)	0	0	0	(-1)	0	(-1)	(-2)	0	0	(-3)	0	(-1)	(-4)	1	(-1)	(-7)	2	(-2)	(-15)	3	0
			0	0	(-3)	0	0	0	(-1)	0	(-1)	(-1)	0	1	(-4)	0	(-1)	(-3)	1	(-2)	(-9)	2	(-3)	(-11)	1	2
			0	0	(-3)	0	0	0	(-1)	0	(-1)	0	0	1	(-4)	0	(-1)	(-3)	1	(-2)	(-6)	1	(-2)	(-11)	3	(-5)
			0	0	(-3)	0	0	0	(-1)	0	(-1)	0	0	2	(-3)	0	(-2)	(-2)	1	(-1)	(-8)	1	(-3)	(-14)	3	(-3)
			0	0	(-3)	0	0	0	(-1)	0	(-1)	0	0	1	(-2)	0	(-1)	(-3)	1	(-2)	(-7)	1	(-3)	(-9)	1	(-1)
			0	0	(-3)	0	0	0	(-1)	0	(-1)	1	0	2	(-3)	0	(-2)	(-2)	0	(-2)	(-9)	1	(-5)	(-10)	2	(-2)
			1	0	(-1)	0	0	0	0	0	(-1)	0	0	1	(-4)	0	(-3)	(-1)	1	(-2)	(-4)	1	(-2)	(-2)	1	(-5)
			1	0	0	0	0	(-1)	0	0	0	(-1)	0	0	0	0	3	(-2)	1	(-5)	(-4)	1	(-3)	(-1)	2	(-4)
			1	0	0	1	0	0	(-1)	0	0	0	0	1	1	0	3	(-3)	0	(-6)	(-5)	1	(-4)	(-3)	3	(-8)
			2	0	1	(-1)	0	(-1)	1	0	1	0	0	1	(-1)	0	0	(-2)	1	(-4)	(-3)	1	(-3)	(-3)	2	(-7)
			2	0	1	(-1)	0	(-1)	1	0	1	0	0	1	(-2)	0	(-1)	(-2)	0	(-4)	(-4)	1	(-4)	(-3)	2	(-7)
			1	0	1	1	0	0	0	0	0	0	0	1	(-3)	0	(-2)	0	1	(-3)	(-3)	1	(-3)	(-6)	2	(-8)
			1	0	1	0	0	(-1)	1	0	1	1	0	2	(-1)	0	1	(-2)	1	(-5)	(-3)	1	(-4)	(-3)	3	(-6)
			1	0	1	1	0	0	0	0	0	0	0	1	(-2)	0	(-1)	(-3)	0	(-5)	(-2)	1	(-3)	(-4)	2	(-9)
			1	0	1	1	0	0	(-1)	0	0	0	0	1	(-2)	0	(-3)	(-3)	0	(-4)	(-2)	0	(-3)	(-3)	2	(-7)
			1	0	1	1	0	0	(-1)	0	0	0	0	1	(-1)	0	(-2)	(-2)	0	(-4)	(-2)	1	(-4)	(-5)	2	(-8)
			1	0	1	1	0	0	0	0	0	(-1)	0	0	0	0	1	(-2)	0	(-5)	(-4)	1	(-5)	(-8)	1	(-8)
			1	0	1	0	0	0	1	0	0	0	0	1	(-2)	0	(-1)	(-3)	0	(-5)	(-2)	1	(-4)	(-7)	2	(-9)
			1	0	1	0	0	0	0	0	0	1	0	2	(-2)	0	(-1)	(-3)	0	(-5)	(-1)	1	(-4)	(-7)	2	(-10)
			1	0	1	0	0	0	1	0	0	0	0	1	(-2)	0	0	(-2)	0	(-5)	(-4)	1	(-5)	(-3)	3	(-6)
			1	0	2	0	0	(-1)	0	0	1	0	0	1	0	0	1	(-2)	0	(-5)	(-3)	1	(-4)	(-6)	1	(-6)
			1	0	2	0	0	(-1)	0	0	1	0	0	1	0	0	1	(-2)	0	(-5)	1	1	(-3)	(-5)	2	(-6)
			1	0	2	0	0	(-1)	0	0	0	0	0	1	0	0	2	(-1)	0	(-5)	(-4)	1	(-6)	(-5)	1	(-5)
			1	0	2	0	0	(-1)	0	0	0	0	0	1	1	0	3	(-1)	1	(-5)	(-1)	1	(-4)	(-6)	2	(-6)
			1	0	2	0	0	(-1)	0	0	0	1	0	2	(-2)	0	(-1)	0	0	(-3)	(-1)	1	(-4)	(-5)	3	(-7)
			1	0	2	(-1)	0	(-1)	1	0	0	1	0	2	(-2)	0	(-1)	0	0	(-3)	(-2)	0	(-5)	(-6)	3	(-8)
			1	0	2	(-1)	0	(-1)	1	0	0	0	0	2	(-1)	0	0	0	0	(-4)	(-1)	1	(-5)	(-6)	1	(-8)
			1	0	1	(-1)	0	0	1	0	1	0	0	1	0	0	3	1	0	(-4)	(-3)	0	(-6)	(-3)	0	(-4)
			0	0	1	0	0	0	0	0	0	0	0	1	(-1)	0	1	1	0	(-3)	(-3)	0	(-5)	(-4)	2	(-6)
			0	0	1	1	0	0	0	0	0	0	0	1	(-1)	0	1	0	0	(-4)	(-3)	0	(-5)	(-2)	1	(-3)
			0	0	1	1	0	1	(-1)	0	0	0	0	2	(-1)	0	0	1	0	(-3)	(-1)	0	(-4)	(-3)	2	(-4)
			0	0	1	(-1)	0	0	0	0	0	1	0	1	0	0	3	(-1)	0	(-5)	0	0	(-3)	(-3)	0	(-3)
			1	0	1	(-1)	0	(-1)	1	0	1	(-1)	0	1	0	0	2	0	0	(-3)	0	0	(-3)	(-3)	1	(-3)
			1	0	1	(-1)	0	(-1)	1	0	0	0	0	1	1	0	1	(-1)	0	(-3)	(-2)	0	(-4)	(-3)	1	(-2)
			0	0	1	0	0	0	0	0	1	0	0	0	(-1)	0	1	(-1)	0	(-4)	0	0	(-3)	(-5)	1	(-6)
			0	0	1	(-1)	0	0	1	0	1	(-1)	0	0	0	0	1	0	0	(-3)	(-1)	0	(-4)	(-4)	0	(-2)
			(-1)	0	1	0	0	0	0	0	1	0	0	0	0	0	2	(-1)	0	(-4)	0	0	(-3)	(-2)	0	0
			(-1)	0	1	0	0	0	0	0	1	1	0	1	(-1)	(-1)	2	(-1)	0	(-4)	(-1)	0	(-3)	(-3)	0	(-2)
			(-1)	0	1	0	0	0	0	0	1	1	0	1	0	0	2	0	0	(-3)	1	0	(-2)	(-5)	1	(-3)
			(-1)	0	1	0	0	0	0	0	1	0	0	1	1	0	3	0	0	(-3)	1	0	(-4)	(-5)	0	(-2)
			(-1)	0	1	0	0	0	0	0	1	0	0	1	1	0	2	0	0	(-3)	0	0	(-4)	(-4)	0	0
			(-1)	0	1	(-1)	0	0	1	0	1	0	0	1	0	0	2	1	0	(-3)	0	1	(-3)	(-3)	0	3
			0	0	2	0	0	(-1)	0	0	0	1	0	1	0	0	1	1	0	(-2)	0	0	(-3)	(-2)	0	0
			0	0	2	0	0	0	0	0	0	(-1)	0	0	1	0	2	2	0	(-1)	0	0	(-4)	(-2)	0	1
			(-1)	0	0	0	0	0	(-1)	0	0	1	0	2	(-1)	0	(-1)	1	0	0	0	0	(-4)	(-2)	0	1
			0	0	1	0	0	0	0	0	(-1)	0	0	1	0	0	2	0	0	(-2)	0	0	(-2)	(-3)	0	1
			0	0	1	0	0	0	0	0	(-1)	0	0	1	0	0	0	0	0	(-1)	1	0	(-2)	0	0	3
			(-1)	0	0	0	0	0	0	0	0	1	0	1	0	0	1	0	0	(-2)	1	0	(-1)	0	0	3
			1	0	1	(-1)	0	(-1)	0	0	0	1	0	2	0	0	0	0	0	(-1)	0	0	0	(-1)	0	2
			0	0	1	0	0	0	0	0	0	0	0	1	1	0	1	0	0	(-1)	0	0	(-1)	0	0	3
			0	0	0	0	0	0	0	0	0	(-1)	0	(-1)	0	0	1	1	0	(-1)	(-1)	0	(-1)	0	0	1
			0	0	0	0	0	0	(-1)	0	0	1	0	1	0	0	0	1	0	0	0	0	0	0	0	1
			0	0	0	0	0	0	(-1)	0	0	1	0	1	0	0	0	3	0	1	0	0	0	2	0	1
			0	0	0	0	0	0	0	0	0	0	0	0	0	0	0	0	0	0	0	0	0	0	0	0
		>;

		gen-panel-gamma-cmds = [
			39 00 00 00 00 22	CA 01 00 01 00 01 00 80 80 80 80 80 80 80 80 80
						80 80 80 80 80 80 80 80 80 80 80 80 80 80 80 00
						00 00
		];
		gen-panel-gamma-update-cmds = [
			15 00 00 05 00 02	F7 03
		];
		gen-panel-read-hbm = [
		];
		gen-panel-read-mtp = [C8 00 21];
		gen-panel-read-id = [
			DA 00 01
			DB 00 01
			DC 00 01
		];
		gen-panel-read-status-reg = [0A];
		gen-panel-read-status-ok = [9A];
		status = "okay";

		/* #################### MDNIE SETTINGS #################### */
		gen-panel-mdnie-color-adjustment-mode-reg = [EC];
		gen-panel-mdnie-color-adjustment-mode-offset = <88>;

		gen-panel-mdnie-negative-mode-cmds = [
			39 00 00 00 00 04	EB 01 07 0c
			39 00 00 00 00 71	EC 00 00 00 07 ff 07 ff 01 83 00 20 00 20 00 20
						00 20 00 20 00 20 00 20 00 20 00 20 00 20 00 20
						00 20 00 20 00 20 00 20 00 20 00 20 00 20 00 20
						00 20 00 20 00 20 00 20 00 FF 00 67 a9 0c 0c 0c
						0c 00 aa ab 00 aa ab 00 aa ab 00 aa ab d5 2c 2a
						ff f5 63 fe 4a ff ff f9 f8 ff 00 00 ff 00 ff 00
						ff ff 00 00 ff 00 ff 00 ff ff 00 00 ff 00 ff 00
						ff
			39 00 00 00 00 04	EB 01 00 0c
		];
		gen-panel-mdnie-color-adjustment-mode-cmds = [
			39 00 00 00 00 04	EB 01 07 0c
			39 00 00 00 00 71	EC 00 00 00 07 ff 07 ff 01 83 00 20 00 20 00 20
						00 20 02 1b 02 1b 02 1b 02 1b 09 a6 09 a6 09 a6
						09 a6 00 20 00 20 00 20 00 20 00 20 00 20 00 20
						00 20 00 20 00 20 00 20 00 FF 00 67 a9 0c 0c 0c
						0c 00 aa ab 00 aa ab 00 aa ab 00 aa ab d5 2c 2a
						ff f5 63 fe 4a ff ff f9 f8 00 ff ff 00 ff 00 ff
						00 00 ff ff 00 ff 00 ff 00 00 ff ff 00 ff 00 ff
						00
			39 00 00 00 00 04	EB 01 00 0c
		];
		gen-panel-mdnie-dark-screene-mode-cmds = [
			39 00 00 00 00 04	EB 01 07 0c
			39 00 00 00 00 71	EC 00 00 00 07 ff 07 ff 01 83 00 20 00 20 00 20
						00 20 02 1b 02 1b 02 1b 02 1b 09 a6 09 a6 09 a6
						09 a6 00 20 00 20 00 20 00 20 00 20 00 20 00 20
						00 20 00 20 00 20 00 20 00 FF 00 67 a9 0c 0c 0c
						0c 00 aa ab 00 aa ab 00 aa ab 00 aa ab d5 2c 2a
						ff f5 63 fe 4a ff ff f9 f8 00 00 00 00 00 00 00
						00 00 00 00 00 00 00 00 00 00 00 00 00 00 00 00
						00
			39 00 00 00 00 04	EB 01 00 0c
		];
		gen-panel-mdnie-gray-scale-cmds = [
			39 00 00 00 00 04	EB 01 07 0c
			39 00 00 00 00 71	EC 00 00 00 07 ff 07 ff 01 83 00 20 00 20 00 20
						00 20 02 1b 02 1b 02 1b 02 1b 09 a6 09 a6 09 a6
						09 a6 00 20 00 20 00 20 00 20 00 20 00 20 00 20
						00 20 00 20 00 20 00 20 00 FF 00 67 a9 0c 0c 0c
						0c 00 aa ab 00 aa ab 00 aa ab 00 aa ab d5 2c 2a
						ff f5 63 fe 4a ff ff f9 f8 b3 4c b3 4c b3 4c 69
						96 69 96 69 96 e2 1d e2 1d e2 1d ff 00 ff 00 ff
						00
			39 00 00 00 00 04	EB 01 00 0c
		];
		gen-panel-mdnie-gray-scale-negative-cmds = [
			39 00 00 00 00 04	EB 01 07 0c
			39 00 00 00 00 71	EC 00 00 00 07 ff 07 ff 01 83 00 20 00 20 00 20
						00 20 02 1b 02 1b 02 1b 02 1b 09 a6 09 a6 09 a6
						09 a6 00 20 00 20 00 20 00 20 00 20 00 20 00 20
						00 20 00 20 00 20 00 20 00 FF 00 67 a9 0c 0c 0c
						0c 00 aa ab 00 aa ab 00 aa ab 00 aa ab d5 2c 2a
						ff f5 63 fe 4a ff ff f9 f8 4c b3 4c b3 4c b3 96
						69 96 69 96 69 1d e2 1d e2 1d e2 00 ff 00 ff 00
						ff
			39 00 00 00 00 04	EB 01 00 0c
		];
		gen-panel-mdnie-hbm-cmds = [
			39 00 00 00 00 04	EB 01 07 0f
			39 00 00 00 00 71	EC 02 00 08 00 a0 00 a0 01 20 00 20 00 20 00 20
						00 20 02 1b 02 1b 02 1b 02 1b 09 a6 09 a6 09 a6
						09 a6 00 20 00 20 00 20 00 20 00 20 00 20 00 20
						00 20 00 20 00 20 00 20 00 FF 30 6a 9a 25 1a 16
						2a 00 37 5a 00 4e c5 00 5d 17 00 30 c3 ff 00 00
						ff ff 00 ff 00 ff ff ff ff 00 ff ff 00 ff 00 ff
						00 00 ff ff 00 ff 00 ff 00 00 ff ff 00 ff 00 ff
						00
			39 00 00 00 00 04	EB 01 00 0f
		];
		gen-panel-mdnie-hbm-text-cmds = [
			39 00 00 00 00 04	EB 01 07 0f
			39 00 00 00 00 71	EC 02 00 08 00 a0 00 a0 01 20 00 20 00 20 00 20
						00 20 02 1b 02 1b 02 1b 02 1b 09 a6 09 a6 09 a6
						09 a6 00 20 00 20 00 20 00 20 00 20 00 20 00 20
						00 20 00 20 00 20 00 20 00 FF 30 6a 9a 25 1a 16
						2a 00 37 5a 00 4e c5 00 5d 17 00 30 c3 ff 00 00
						ff ff 00 ff 00 ff ff ff ff 00 ff ff 00 ff 00 ff
						00 00 ff ff 00 ff 00 ff 00 00 ff ff 00 ff 00 ff
						00
			39 00 00 00 00 04	EB 01 00 0f
		];

		/* STANDARD MODE */
		gen-panel-mdnie-ui-mode-cmds = [
			39 00 00 00 00 04	EB 01 07 0c
			39 00 00 00 00 71	EC 00 00 00 07 ff 07 ff 01 83 00 20 00 20 00 20
						00 20 00 20 00 20 00 20 00 20 00 20 00 20 00 20
						00 20 00 20 00 20 00 20 00 20 00 20 00 20 00 20
						00 20 00 20 00 20 00 20 00 FF 00 67 a9 0c 0c 0c
						0c 00 aa ab 00 aa ab 00 aa ab 00 aa ab d5 2c 2a
						ff f5 63 fe 4a ff ff f9 f8 00 f4 ed 0a e6 12 ff
						00 0a e1 e8 00 ee 28 ef 14 19 ef ff 00 fa 00 ee
						00
			39 00 00 00 00 04	EB 01 00 0c
		];
		gen-panel-mdnie-video-mode-cmds = [
			39 00 00 00 00 04	EB 01 07 0f
			39 00 00 00 00 71	EC 04 00 04 00 40 00 40 01 00 00 20 00 20 00 20
						00 20 00 20 00 20 00 20 00 20 00 20 00 20 00 20
						00 20 00 20 00 20 00 20 00 20 00 20 00 20 00 20
						00 20 00 20 00 20 00 20 00 FF 00 67 a9 0c 0c 0c
						0c 00 aa ab 00 aa ab 00 aa ab 00 aa ab d5 2c 2a
						ff f5 63 fe 4a ff ff f9 f8 00 f4 ed 0a e6 12 ff
						00 0a e1 e8 00 ee 28 ef 14 19 ef ff 00 fa 00 ee
						00
			39 00 00 00 00 04	EB 01 00 0f
		];
		gen-panel-mdnie-camera-mode-cmds = [
			39 00 00 00 00 04	EB 01 07 0f
			39 00 00 00 00 71	EC 00 00 00 07 ff 07 ff 01 83 00 20 00 20 00 20
						00 20 00 20 00 20 00 20 00 20 00 20 00 20 00 20
						00 20 00 20 00 20 00 20 00 20 00 20 00 20 00 20
						00 20 00 20 00 20 00 20 00 FF 00 67 a9 0c 0c 0c
						0c 00 aa ab 00 aa ab 00 aa ab 00 aa ab d5 2c 2a
						ff f5 63 fe 4a ff ff f9 f8 00 f4 ed 0a e6 12 ff
						00 0a e1 e8 00 ee 28 ef 14 19 ef ff 00 fa 00 ee
						00
			39 00 00 00 00 04	EB 01 00 0f
		];
		gen-panel-mdnie-gallery-mode-cmds = [
			39 00 00 00 00 04	EB 01 07 0f
			39 00 00 00 00 71	EC 04 00 04 00 a0 00 a0 01 00 00 20 00 20 00 20
						00 20 00 20 00 20 00 20 00 20 00 20 00 20 00 20
						00 20 00 20 00 20 00 20 00 20 00 20 00 20 00 20
						00 20 00 20 00 20 00 20 00 FF 00 67 a9 0c 0c 0c
						0c 00 aa ab 00 aa ab 00 aa ab 00 aa ab d5 2c 2a
						ff f5 63 fe 4a ff ff f9 f8 00 f4 ed 0a e6 12 ff
						00 0a e1 e8 00 ee 28 ef 14 19 ef ff 00 fa 00 ee
						00
			39 00 00 00 00 04	EB 01 00 0f
		];
		gen-panel-mdnie-vt-mode-cmds = [
			39 00 00 00 00 04	EB 01 07 0f
			39 00 00 00 00 71	EC 00 00 00 07 ff 07 ff 01 83 00 20 00 20 00 20
						00 20 00 20 00 20 00 20 00 20 00 20 00 20 00 20
						00 20 00 20 00 20 00 20 00 20 00 20 00 20 00 20
						00 20 00 20 00 20 00 20 00 FF 00 67 a9 0c 0c 0c
						0c 00 aa ab 00 aa ab 00 aa ab 00 aa ab d5 2c 2a
						ff f5 63 fe 4a ff ff f9 f8 00 f4 ed 0a e6 12 ff
						00 0a e1 e8 00 ee 28 ef 14 19 ef ff 00 fa 00 ee
						00
			39 00 00 00 00 04	EB 01 00 0f
		];
		gen-panel-mdnie-browser-mode-cmds = [
			39 00 00 00 00 04	EB 01 07 0c
			39 00 00 00 00 71	EC 00 00 00 07 ff 07 ff 01 83 00 20 00 20 00 20
						00 20 00 20 00 20 00 20 00 20 00 20 00 20 00 20
						00 20 00 20 00 20 00 20 00 20 00 20 00 20 00 20
						00 20 00 20 00 20 00 20 00 FF 00 67 a9 0c 0c 0c
						0c 00 aa ab 00 aa ab 00 aa ab 00 aa ab d5 2c 2a
						ff f5 63 fe 4a ff ff f9 f8 00 f4 ed 0a e6 12 ff
						00 0a e1 e8 00 ee 28 ef 14 19 ef ff 00 fa 00 ee
						00
			39 00 00 00 00 04	EB 01 00 0c
		];
		gen-panel-mdnie-ebook-mode-cmds = [
			39 00 00 00 00 04	EB 01 07 0f
			39 00 00 00 00 71	EC 00 00 00 07 ff 07 ff 01 83 00 20 00 20 00 20
						00 20 00 20 00 20 00 20 00 20 00 20 00 20 00 20
						00 20 00 20 00 20 00 20 00 20 00 20 00 20 00 20
						00 20 00 20 00 20 00 20 00 FF 00 67 a9 0c 0c 0c
						0c 00 aa ab 00 aa ab 00 aa ab 00 aa ab d5 2c 2a
						ff f5 63 fe 4a ff ff f9 f8 00 f4 ed 0a e6 12 ff
						00 0a e1 e8 00 ee 28 ef 14 19 ef ff 00 fa 00 ee
						00
			39 00 00 00 00 04	EB 01 00 0f
		];

		/* AUTO MODE */
		gen-panel-mdnie-auto-ui-mode-cmds = [
			39 00 00 00 00 04	EB 01 07 0c
			39 00 00 00 00 71	EC 00 00 00 07 ff 07 ff 01 83 00 20 00 20 00 20
						00 20 00 20 00 20 00 20 00 20 00 20 00 20 00 20
						00 20 00 20 00 20 00 20 00 20 00 20 00 20 00 20
						00 20 00 20 00 20 00 20 00 FF 00 67 a9 0c 0c 0c
						0c 00 aa ab 00 aa ab 00 aa ab 00 aa ab d5 2c 2a
						ff f5 63 fe 4a ff ff f9 f8 00 ff ff 00 ff 00 ff
						00 00 ff ff 00 ff 00 ff 00 00 ff ff 00 ff 00 ff
						00
			39 00 00 00 00 04	EB 01 00 0c
		];
		gen-panel-mdnie-auto-video-mode-cmds = [
			39 00 00 00 00 04	EB 01 07 0f
			39 00 00 00 00 71	EC 07 00 08 00 40 00 40 01 20 00 14 00 14 00 14
						00 14 03 9a 03 9a 03 9a 03 9a 07 9e 07 9e 07 9e
						07 9e 0a a0 0a a0 0a a0 0a a0 16 a6 16 a6 16 a6
						16 a6 05 21 0b 20 87 0f 00 FF 30 a9 67 37 29 19
						47 00 25 3d 00 31 f4 00 51 ec 00 1c d8 f0 58 68
						ff ff 00 ff 00 ff ff f4 ff 00 ff ff 10 ff 10 ff
						00 00 ff ff 00 ff 00 ff 00 00 ff ff 00 ff 00 ff
						00
			39 00 00 00 00 04	EB 01 00 0f
		];
		gen-panel-mdnie-auto-camera-mode-cmds = [
			39 00 00 00 00 04	EB 01 07 0c
			39 00 00 00 00 71	EC 00 00 08 00 a0 00 a0 01 00 00 20 00 20 00 20
						00 20 00 20 00 20 00 20 00 20 00 20 00 20 00 20
						00 20 00 20 00 20 00 20 00 20 00 20 00 20 00 20
						00 20 00 20 00 20 00 20 00 FF 30 9a 6a 25 1a 16
						2a 00 37 5a 00 4e c5 00 5d 17 00 30 c3 ff 5a 7a
						ff f0 00 d8 00 d9 ff ff ff 00 e0 ff 00 f6 00 d8
						3b 00 ff d9 00 ff 14 f9 00 00 ff ff 00 ff 00 ff
						00
			39 00 00 00 00 04	EB 01 00 0c
		];
		gen-panel-mdnie-auto-gallery-mode-cmds = [
			39 00 00 00 00 04	EB 01 07 0f
			39 00 00 00 00 71	EC 00 00 08 00 a0 00 a0 01 00 00 20 00 20 00 20
						00 20 00 20 00 20 00 20 00 20 00 20 00 20 00 20
						00 20 00 20 00 20 00 20 00 20 00 20 00 20 00 20
						00 20 00 20 00 20 00 20 00 FF 30 9a 6a 25 1a 16
						2a 00 37 5a 00 4e c5 00 5d 17 00 30 c3 ff 5a 7a
						ff f0 00 d8 00 d9 ff ff ff 00 e0 ff 00 f6 00 d8
						3b 00 ff d9 00 ff 14 f9 00 00 ff ff 00 ff 00 ff
						00
			39 00 00 00 00 04	EB 01 00 0f
		];
		gen-panel-mdnie-auto-vt-mode-cmds = [
			39 00 00 00 00 04	EB 01 07 0f
			39 00 00 00 00 71	EC 00 00 00 07 ff 07 ff 01 00 00 20 00 20 00 20
						00 20 00 20 00 20 00 20 00 20 00 20 00 20 00 20
						00 20 00 20 00 20 00 20 00 20 00 20 00 20 00 20
						00 20 00 20 00 20 00 20 00 FF 00 67 a9 0c 0c 0c
						0c 00 aa ab 00 aa ab 00 aa ab 00 aa ab d5 2c 2a
						ff f5 63 fe 4a ff ff f9 f8 00 ff ff 00 ff 00 ff
						00 00 ff ff 00 ff 00 ff 00 00 ff ff 00 ff 00 ff
						00
			39 00 00 00 00 04	EB 01 00 0f
		];
		gen-panel-mdnie-auto-browser-mode-cmds = [
			39 00 00 00 00 04	EB 01 07 0c
			39 00 00 00 00 71	EC 00 00 00 07 ff 07 ff 01 00 00 20 00 20 00 20
						00 20 00 20 00 20 00 20 00 20 00 20 00 20 00 20
						00 20 00 20 00 20 00 20 00 20 00 20 00 20 00 20
						00 20 00 20 00 20 00 20 00 FF 30 9a 6a 25 1a 16
						2a 00 37 5a 00 4e c5 00 5d 17 00 30 c3 fa 38 58
						ff ff 00 ff 00 ff ff ff ff 00 ff ff 00 ff 00 ff
						00 00 ff ff 00 ff 00 ff 00 00 ff ff 00 ff 00 ff
						00
			39 00 00 00 00 04	EB 01 00 0c
		];
		gen-panel-mdnie-auto-ebook-mode-cmds = [
			39 00 00 00 00 04	EB 01 07 0c
			39 00 00 00 00 71	EC 00 00 00 07 ff 07 ff 01 83 00 20 00 20 00 20
						00 20 02 1b 02 1b 02 1b 02 1b 09 a6 09 a6 09 a6
						09 a6 00 20 00 20 00 20 00 20 00 20 00 20 00 20
						00 20 00 20 00 20 00 20 00 FF 00 67 a9 0c 0c 0c
						0c 00 aa ab 00 aa ab 00 aa ab 00 aa ab d5 2c 2a
						ff f5 63 fe 4a ff ff f9 f8 00 ff ff 00 ff 00 ff
						00 00 ff ff 00 ff 00 ff 00 00 ff ff 00 f4 00 e4
						00
			39 00 00 00 00 04	EB 01 00 0c
		];

		/* DYNAMIC MODE */
		gen-panel-mdnie-dynamic-ui-mode-cmds = [
			39 00 00 00 00 04	EB 01 07 0f
			39 00 00 00 00 71	EC 03 00 08 00 40 00 40 01 20 00 14 00 14 00 14
						00 14 03 9a 03 9a 03 9a 03 9a 07 9e 07 9e 07 9e
						07 9e 0a a0 0a a0 0a a0 0a a0 16 a6 16 a6 16 a6
						16 a6 05 21 0b 20 87 0f 00 FF 30 a9 67 37 29 19
						47 00 25 3d 00 31 f4 00 51 ec 00 1c d8 f0 58 68
						ff ff 00 ff 00 ff ff f4 ff 00 ff ff 10 ff 10 ff
						00 00 ff ff 00 ff 00 ff 00 00 ff ff 00 ff 00 ff
						00
			39 00 00 00 00 04	EB 01 00 0f
		];
		gen-panel-mdnie-dynamic-video-mode-cmds = [
			39 00 00 00 00 04	EB 01 07 0f
			39 00 00 00 00 71	EC 07 00 0a 00 40 00 40 01 20 00 14 00 14 00 14
						00 14 03 9a 03 9a 03 9a 03 9a 07 9e 07 9e 07 9e
						07 9e 0a a0 0a a0 0a a0 0a a0 16 a6 16 a6 16 a6
						16 a6 05 21 0b 20 87 0f 00 FF 30 a9 67 37 29 19
						47 00 25 3d 00 31 f4 00 51 ec 00 1c d8 f0 58 68
						ff ff 00 ff 00 ff ff f4 ff 00 ff ff 10 ff 10 ff
						00 00 ff ff 00 ff 00 ff 00 00 ff ff 00 ff 00 ff
						00
			39 00 00 00 00 04	EB 01 00 0f
		];
		gen-panel-mdnie-dynamic-camera-mode-cmds = [
			39 00 00 00 00 04	EB 01 07 0f
			39 00 00 00 00 71	EC 03 00 0a 00 40 00 40 01 20 00 14 00 14 00 14
						00 14 03 9a 03 9a 03 9a 03 9a 07 9e 07 9e 07 9e
						07 9e 0a a0 0a a0 0a a0 0a a0 16 a6 16 a6 16 a6
						16 a6 05 21 0b 20 87 0f 00 FF 30 a9 67 37 29 19
						47 00 25 3d 00 31 f4 00 51 ec 00 1c d8 f0 58 68
						ff ff 00 ff 00 ff ff f4 ff 00 ff ff 10 ff 10 ff
						00 00 ff ff 00 ff 00 ff 00 00 ff ff 00 ff 00 ff
						00
			39 00 00 00 00 04	EB 01 00 0f
		];
		gen-panel-mdnie-dynamic-gallery-mode-cmds = [
			39 00 00 00 00 04	EB 01 07 0f
			39 00 00 00 00 71	EC 07 00 0a 00 a0 00 a0 01 20 00 14 00 14 00 14
						00 14 03 9a 03 9a 03 9a 03 9a 07 9e 07 9e 07 9e
						07 9e 0a a0 0a a0 0a a0 0a a0 16 a6 16 a6 16 a6
						16 a6 05 21 0b 20 87 0f 00 FF 30 a9 67 37 29 19
						47 00 25 3d 00 31 f4 00 51 ec 00 1c d8 f0 58 68
						ff ff 00 ff 00 ff ff f4 ff 00 ff ff 10 ff 10 ff
						00 00 ff ff 00 ff 00 ff 00 00 ff ff 00 ff 00 ff
						00
			39 00 00 00 00 04	EB 01 00 0f
		];
		gen-panel-mdnie-dynamic-vt-mode-cmds = [
			39 00 00 00 00 04	EB 01 07 0f
			39 00 00 00 00 71	EC 03 00 0a 00 a0 00 a0 01 20 00 14 00 14 00 14
						00 14 03 9a 03 9a 03 9a 03 9a 07 9e 07 9e 07 9e
						07 9e 0a a0 0a a0 0a a0 0a a0 16 a6 16 a6 16 a6
						16 a6 05 21 0b 20 87 0f 00 FF 30 a9 67 37 29 19
						47 00 25 3d 00 31 f4 00 51 ec 00 1c d8 f0 58 68
						ff ff 00 ff 00 ff ff f4 ff 00 ff ff 10 ff 10 ff
						00 00 ff ff 00 ff 00 ff 00 00 ff ff 00 ff 00 ff
						00
			39 00 00 00 00 04	EB 01 00 0f
		];
		gen-panel-mdnie-dynamic-browser-mode-cmds = [
			39 00 00 00 00 04	EB 01 07 0f
			39 00 00 00 00 71	EC 03 00 0a 00 40 00 40 01 20 00 14 00 14 00 14
						00 14 03 9a 03 9a 03 9a 03 9a 07 9e 07 9e 07 9e
						07 9e 0a a0 0a a0 0a a0 0a a0 16 a6 16 a6 16 a6
						16 a6 05 21 0b 20 87 0f 00 FF 30 a9 67 37 29 19
						47 00 25 3d 00 31 f4 00 51 ec 00 1c d8 f0 58 68
						ff ff 00 ff 00 ff ff f4 ff 00 ff ff 10 ff 10 ff
						00 00 ff ff 00 ff 00 ff 00 00 ff ff 00 ff 00 ff
						00
			39 00 00 00 00 04	EB 01 00 0f
		];
		gen-panel-mdnie-dynamic-ebook-mode-cmds = [
			39 00 00 00 00 04	EB 01 07 0f
			39 00 00 00 00 71	EC 03 00 0a 00 40 00 40 01 20 00 14 00 14 00 14
						00 14 03 9a 03 9a 03 9a 03 9a 07 9e 07 9e 07 9e
						07 9e 0a a0 0a a0 0a a0 0a a0 16 a6 16 a6 16 a6
						16 a6 05 21 0b 20 87 0f 00 FF 30 a9 67 37 29 19
						47 00 25 3d 00 31 f4 00 51 ec 00 1c d8 f0 58 68
						ff ff 00 ff 00 ff ff f4 ff 00 ff ff 10 ff 10 ff
						00 00 ff ff 00 ff 00 ff 00 00 ff ff 00 ff 00 ff
						00
			39 00 00 00 00 04	EB 01 00 0f
		];

		/* NATURAL MODE */
		gen-panel-mdnie-natural-ui-mode-cmds = [
			39 00 00 00 00 04	EB 01 07 0f
			39 00 00 00 00 71	EC 02 00 00 07 ff 07 ff 01 40 00 20 00 20 00 20
						00 20 00 20 00 20 00 20 00 20 00 20 00 20 00 20
						00 20 00 20 00 20 00 20 00 20 00 20 00 20 00 20
						00 20 00 20 00 20 00 20 00 FF 00 67 a9 0c 0c 0c
						0c 00 aa ab 00 aa ab 00 aa ab 00 aa ab ff 00 00
						ff ff 00 ff 00 ff ff ff ff 9a da fa 2a eb 29 dd
						90 2a ff e2 4a f5 34 f2 1c 54 e8 ff 00 fa 00 ee
						00
			39 00 00 00 00 04	EB 01 00 0f
		];
		gen-panel-mdnie-natural-video-mode-cmds = [
			39 00 00 00 00 04	EB 01 07 0f
			39 00 00 00 00 71	EC 06 00 04 00 40 00 40 01 40 00 20 00 20 00 20
						00 20 00 20 00 20 00 20 00 20 00 20 00 20 00 20
						00 20 00 20 00 20 00 20 00 20 00 20 00 20 00 20
						00 20 00 20 00 20 00 20 00 FF 00 67 a9 0c 0c 0c
						0c 00 aa ab 00 aa ab 00 aa ab 00 aa ab ff 00 00
						ff ff 00 ff 00 ff ff ff ff 9a da fa 2a eb 29 dd
						90 2a ff e2 4a f5 34 f2 1c 54 e8 ff 00 fa 00 ee
						00
			39 00 00 00 00 04	EB 01 00 0f
		];
		gen-panel-mdnie-natural-camera-mode-cmds = [
			39 00 00 00 00 04	EB 01 07 0f
			39 00 00 00 00 71	EC 02 00 00 00 a0 00 a0 01 40 00 20 00 20 00 20
						00 20 00 20 00 20 00 20 00 20 00 20 00 20 00 20
						00 20 00 20 00 20 00 20 00 20 00 20 00 20 00 20
						00 20 00 20 00 20 00 20 00 FF 00 67 a9 0c 0c 0c
						0c 00 aa ab 00 aa ab 00 aa ab 00 aa ab ff 00 00
						ff ff 00 ff 00 ff ff ff ff 9a da fa 2a eb 29 dd
						90 2a ff e2 4a f5 34 f2 1c 54 e8 ff 00 fa 00 ee
						00
			39 00 00 00 00 04	EB 01 00 0f
		];
		gen-panel-mdnie-natural-gallery-mode-cmds = [
			39 00 00 00 00 04	EB 01 07 0f
			39 00 00 00 00 71	EC 06 00 04 00 a0 00 a0 01 40 00 20 00 20 00 20
						00 20 00 20 00 20 00 20 00 20 00 20 00 20 00 20
						00 20 00 20 00 20 00 20 00 20 00 20 00 20 00 20
						00 20 00 20 00 20 00 20 00 FF 00 67 a9 0c 0c 0c
						0c 00 aa ab 00 aa ab 00 aa ab 00 aa ab ff 00 00
						ff ff 00 ff 00 ff ff ff ff 9a da fa 2a eb 29 dd
						90 2a ff e2 4a f5 34 f2 1c 54 e8 ff 00 fa 00 ee
						00
			39 00 00 00 00 04	EB 01 00 0f
		];
		gen-panel-mdnie-natural-vt-mode-cmds = [
			39 00 00 00 00 04	EB 01 07 0f
			39 00 00 00 00 71	EC 02 00 00 00 a0 00 a0 01 40 00 20 00 20 00 20
						00 20 00 20 00 20 00 20 00 20 00 20 00 20 00 20
						00 20 00 20 00 20 00 20 00 20 00 20 00 20 00 20
						00 20 00 20 00 20 00 20 00 FF 00 67 a9 0c 0c 0c
						0c 00 aa ab 00 aa ab 00 aa ab 00 aa ab ff 00 00
						ff ff 00 ff 00 ff ff ff ff 9a da fa 2a eb 29 dd
						90 2a ff e2 4a f5 34 f2 1c 54 e8 ff 00 fa 00 ee
						00
			39 00 00 00 00 04	EB 01 00 0f
		];
		gen-panel-mdnie-natural-browser-mode-cmds = [
			39 00 00 00 00 04	EB 01 07 0f
			39 00 00 00 00 71	EC 02 00 00 00 a0 00 a0 01 40 00 20 00 20 00 20
						00 20 00 20 00 20 00 20 00 20 00 20 00 20 00 20
						00 20 00 20 00 20 00 20 00 20 00 20 00 20 00 20
						00 20 00 20 00 20 00 20 00 FF 00 67 a9 0c 0c 0c
						0c 00 aa ab 00 aa ab 00 aa ab 00 aa ab ff 00 00
						ff ff 00 ff 00 ff ff ff ff 9a da fa 2a eb 29 dd
						90 2a ff e2 4a f5 34 f2 1c 54 e8 ff 00 fa 00 ee
						00
			39 00 00 00 00 04	EB 01 00 0f
		];
		gen-panel-mdnie-natural-ebook-mode-cmds = [
			39 00 00 00 00 04	EB 01 07 0f
			39 00 00 00 00 71	EC 02 00 00 00 a0 00 a0 01 40 00 20 00 20 00 20
						00 20 00 20 00 20 00 20 00 20 00 20 00 20 00 20
						00 20 00 20 00 20 00 20 00 20 00 20 00 20 00 20
						00 20 00 20 00 20 00 20 00 FF 00 67 a9 0c 0c 0c
						0c 00 aa ab 00 aa ab 00 aa ab 00 aa ab ff 00 00
						ff ff 00 ff 00 ff ff ff ff 9a da fa 2a eb 29 dd
						90 2a ff e2 4a f5 34 f2 1c 54 e8 ff 00 fa 00 ee
						00
			39 00 00 00 00 04	EB 01 00 0f
		];

		gen-panel-mdnie-cal {
			cal-reg = [EC];
			cal-offset = [6A 6C 6E];
			cal-modes = <
				0	/* MDNIE DYNAMIC MODE */
				4	/* MDNIE AUTO MODE */
			>;
			cal-linear-equation = <
				/* <nominator	denominator	constant>
				   f(x, y) = y + (x * nominator / denominator) + constant
				*/
				(-547)		503		31
				(-467)		447		(-25)
				201		39		(-18718)
				523		173		(-12111)
			>;
			cal-tune-value = [
				FF F8 F8	/* TUNE 1 */
				FF FA FE
				F9 F6 FF
				FF FD F9
				FF FF FF
				F8 FA FF
				FB FF F7
				FA FF FA
				F9 FF FE	/* TUNE 9 */
			];
		};
	};
};
