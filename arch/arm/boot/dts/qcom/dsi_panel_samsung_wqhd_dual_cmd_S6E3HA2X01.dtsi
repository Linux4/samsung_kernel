/* Copyright (c) 2012, Samsung Electronics Corporation. All rights reserved.
 *
 * This program is free software; you can redistribute it and/or modify
 * it under the terms of the GNU General Public License version 2 and
 * only version 2 as published by the Free Software Foundation.
 *
 * This program is distributed in the hope that it will be useful,
 * but WITHOUT ANY WARRANTY; without even the implied warranty of
 * MERCHANTABILITY or FITNESS FOR A PARTICULAR PURPOSE.  See the
 * GNU General Public License for more details.
 */

&mdss_mdp {
	dsi_dual_samsung_cmd_S6E3HA2X01_0: wqhd_cmd0 {
		qcom,mdss-dsi-panel-name = "samsung,mdss-amoled-dual_dsi-panel";
		label = "samsung amoled wqhd command mode dis0 S6E3HA2X01 panel";
		status = "disable";

		qcom,mdss-dsi-panel-controller = <&mdss_dsi0>;
		qcom,mdss-dsi-panel-type = "dsi_cmd_mode";
		qcom,mdss-pan-dest = "display_1";

		qcom,enable-gpio = <&pma8084_gpios 6 0>;
		qcom,rst-gpio = <&pma8084_gpios 21 0>;
		qcom,te-gpio = <&msmgpio 12 0>;
		qcom,fg-err-gpio = <&pma8084_gpios 13 0x1>;
		qcom,oled-det-gpio = <&pma8084_gpios 5 0x1>;

		qcom,cont-splash-enabled;
		qcom,cmd-sync-wait-broadcast;
		qcom,partial-update-enabled;
		qcom,partial-update-roi-merge;
		qcom,mdss-dsi-panel-broadcast-mode;
		qcom,panel-roi-alignment = <8 8 1 1 1 2>;

		qcom,mdss-pan-res = <720 2560>;
		qcom,mdss-pan-size = <72 126>; /* <Width> <Height> real size of panel in mm */
		qcom,mdss-pan-bpp = <24>;

		qcom,mdss-clk-rate=<898000000>;

		qcom,mdss-vsync-enable=<1>;
		qcom,mdss-hw-vsync-mode=<1>;
		qcom,mdss-pan-insert-dcs-cmd=<1>;
		qcom,mdss-pan-wr-mem-continue=<0x3c>;
		qcom,mdss-pan-wr-mem-start=<0x2c>;
		qcom,mdss-pan-te-sel=<1>;
		qcom,mdss-pan-clk-rate=<898000000>;

		qcom,mdss-pan-porch-values = <108 15 212 6 2 10>; /* <HBP> <HPW> <HFP> <VBP> <VPW> <VFP> */

		qcom,mdss-pan-underflow-clr = <0xff>;
		qcom,mdss-pan-bl-ctrl = "bl_ctrl_dcs_cmds";
		qcom,mdss-pan-bl-levels = <1 255>;
		qcom,mdss-pan-dsi-mode = <1>;
		qcom,mdss-pan-dsi-h-pulse-mode = <0>;
		qcom,mdss-pan-dsi-h-power-stop = <0 0 0>;
		qcom,mdss-pan-dsi-bllp-power-stop = <1 1>;
		qcom,mdss-pan-dsi-traffic-mode = <2>;
		qcom,mdss-pan-dsi-dst-format = <8>;
		qcom,mdss-pan-dsi-vc = <0>;
		qcom,mdss-pan-dsi-rgb-swap = <0>;
		qcom,mdss-force-clk-lane-hs = <0>;
		samsung,mdss-early-lcd-on = <1>;
		qcom,mdss-pan-dsi-data-lanes = <1 1 1 1>;
		qcom,mdss-pan-dsi-dlane-swap = <0>;
		qcom,mdss-pan-dsi-t-clk = <0x30 0x04>;
		qcom,mdss-pan-dsi-stream = <0>;
		qcom,mdss-pan-dsi-mdp-tr = <0x0>;
		qcom,mdss-pan-dsi-dma-tr = <0x04>;
		qcom,mdss-pan-dsi-tx-eot-append = <1>;
		qcom,mdss-pan-dsi-frame-rate = <60>;
		/* qcom,ulps-enabled; */
		qcom,panel-phy-regulatorSettings = [07 09 03 00  /* Regualotor settings */
						    20 00 01];
		qcom,panel-phy-timingSettings = [FA 4B 41 00 66 81 34 4C 41 03 04 A0];

		qcom,panel-phy-strengthCtrl = [ff 06];		/*!!!! */
		qcom,panel-phy-bistCtrl = [00 00 b1 ff
                                              00 00];   /*!!!! BIST Ctrl settings */
		qcom,panel-phy-laneConfig = [
			00 00 00 00 00 00 00 01 97 /* lane0 config */
			00 00 00 00 05 00 00 01 97 /* lane1 config */
			00 00 00 00 0a 00 00 01 97 /* lane2 config */
			00 00 00 00 0f 00 00 01 97 /* lane3 config */
			00 c0 00 00 00 00 00 01 bb]; /* Clk ln config */

		qcom,mdss-dsi-on-command= [

				29 01 00 00 05 00 03 F0 5A 5A 		/* TEST KEY Enable */
				29 01 00 00 00 00 03 FC 5A 5A 		/* TEST KEY Enable */

				05 01 00 00 05 00 01 11 			/* Sleep out, wait 5ms */
				29 01 00 00 78 00 04 F2 63 41 C5		/* DUAL DSI ,hsync timing: 453*/

				15 01 00 00 00 00 02 35 00			/* TE Vsync ON */
				29 01 00 00 00 00 07 BD 33 11 02 16 02 16  /*TSP TE*/
				29 01 00 00 00 00 05 C0 00 00 D8 D8	/* Pentile setting */

				15 01 00 00 00 00 02 B0 20
				15 01 00 00 00 00 02 FE 08			/*POC setting*/

				29 01 00 00 00 00 03 FC A5 A5 		/* TEST KEY Disable */
				15 01 00 00 00 00 02 ED 44 		/*ERR_FG VLIN monitoring on*/
				29 01 00 00 00 00 02 B0 03
				29 01 00 00 00 00 02 E7 67
				29 01 00 00 00 00 02 ED 01				

				29 01 00 00 00 00 24				/* Brightness condition set */
					CA
					01 00 01 00 01 00
					80 80 80
					80 80 80
					80 80 80
					80 80 80
					80 80 80
					80 80 80
					80 80 80
					80 80 80
					00 00 00
					00 00
				29 01 00 00 00 00 03 B2 03 10		/* AID 10% */
				29 01 00 00 00 00 03 B6 9C 0A		/* ELVSS Setting:CAPS ON : acl off*/
				29 01 00 00 00 00 03 F4 8B 21		/* VINT set*/
				15 01 00 00 00 00 02 B5 40		/* CAPS ON : 16 frame avg. at acl off*/
				15 01 00 00 00 00 02 55 00		/*acl off*/

				15 01 00 00 01 00 02 F7 03		/* Gamma, LTPS(AID) update */
				15 01 00 00 00 00 02 F7 00
				29 01 00 00 00 00 03 F0 A5 A5		/* TEST KEY key Disable  */
			];
		qcom,mdss-dsi-on-command-state = "dsi_lp_mode";
		qcom,mdss-dsi-off-command = [
				05 01 00 00 00 00 01 28		/*disp off*/
				05 01 00 00 78 00 01 10		/* sleep in :wait 120ms(0x78) */
		];
		qcom,mdss-dsi-off-command-state = "dsi_hs_mode";
		/*
			the last byte in read commands  represent READ LENGH,
			like below  READ LENGH = 0x21
		 */
		 	samsung,panel-test-key-enable-cmds 	= [ 29 01 00 00 00 00 03 F0 5A 5A];
		 	samsung,panel-test-key-disable-cmds = [ 29 01 00 00 00 00 03 F0 A5 A5];

			qcom,panel-hsync-on-seq = [
								29 01 00 00 00 00 03 F0 5A 5A
								29 01 00 00 00 00 07 BD 11 11 02 16 02 16 /*TSP TE*/
								29 01 00 00 00 00 03 F0 A5 A5];

			samsung,panel-nv-mtp-read-cmds		= [ 06 01 00 00 00 00 01 c8 23 00];

			samsung,panel-nv-mdnie-read-cmds	= [ 06 01 00 00 00 00 01 A1 04 00];
			samsung,panel-nv-mtp-read-elvss-cmds	= [ 06 01 00 00 00 00 01 b6 01 15];	/* read C6 22th , 21=0x15*/
			samsung,panel-nv-read-cmds			= [ 06 01 00 00 00 00 01 c8 21 00];
			samsung,panel-nv-read-enable-cmds = [
								29 01 00 00 00 00 03 f0 5a 5a
								29 01 00 00 00 00 03 F2 63 41];		/* DUAL DSI */
			samsung,panel-nv-read-disable-cmds = [ 29 01 00 00 00 00 03 f0 a5 a5 ];

			/* the last byte in all read commands will represent READ LENGH */
			samsung,panel-manufacture-id-read-cmds = [
								06 01 00 00 00 00 01 da 01 00
								06 01 00 00 00 00 01 db 01 00
								06 01 00 00 00 00 01 dc 01 00];

			samsung,panel-manufacture-date-read-cmds = [ 06 01 00 00 00 00 01 c8 04 28];	/* read C8 41~44th , 40=0x28*/

			samsung,panel-ddi-id-read-cmds = [ 06 01 00 00 00 00 01 d6 05 00];	/* read D6 1~5th */
			samsung,panel-rddpm-read-cmds = [ 06 01 00 00 00 00 01 0A 01 00];	/* read 0A 1st */
			samsung,panel-rddsm-read-cmds = [ 06 01 00 00 00 00 01 0E 01 00];	/* read 0E 1st */

			samsung,panel-ldi-debug-read-cmds = [
								06 01 00 00 00 00 01 0A 01 00
								06 01 00 00 00 00 01 0E 01 00
								06 01 00 00 00 00 01 EA 08 00];

			samsung,panel-ldi-fps-write-cmds = [
								29 01 00 00 00 00 03 FC 5A 5A
								29 01 00 00 00 00 04 F2 63 41 C5	/* DUAL DSI ,hsync timing: 453*/
								29 01 00 00 00 00 03 FC A5 A5];

			samsung,panel-ldi-partial-disp-on = [
								29 01 00 00 00 00 05 30 00 C8 03 20
								15 01 00 00 00 00 02 12 00 ];
			samsung,panel-ldi-partial-disp-off = [15 01 00 00 00 00 02 13 00];

			qcom,panel-display-on-cmds	= [05 01 00 00 00 00 01 29];
			qcom,panel-display-off-cmds	= [05 01 00 00 00 00 01 28];

			samsung,panel-elvss-lowtemp-cmds-list = [
								15 01 00 00 00 00 02 B0 07
								15 01 00 00 00 00 02 B8 00];	/* Low Temperature Command */

			samsung,panel-elvss-lowtemp2-cmds-list = [
								15 01 00 00 00 00 02 B0 15
								15 01 00 00 00 00 02 B6 00];	/* Low Temperature Command: default */

			samsung,panel-gamma-cmds-list = [
					29 01 00 00 00 00 24            /* Brightness Condition Set - Gamma 2.2 Setting*/
						CA 01 00 01 00 01 00 80
						80 80 80 80 80 80 80 80
						80 80 80 80 80 80 80 80
						80 80 80 80 80 80 80 00
						00 00 00 00
					15 01 00 00 01 00 02 F7 03		/* Gamma, LTPS(AID) update */
					15 01 00 00 00 00 02 F7 00
				];

			samsung,panel-hbm-cmds-list = [
					29 01 00 00 00 00 03 B6 8C 0A		/* ELVSS Setting */
					29 01 00 00 00 00 03 F4 8B 21		/* VINT set*/
					15 01 00 00 00 00 02 B5 50		/* 32 frame avg.*/
					15 01 00 00 00 00 02 53 C0		/* HBM on*/
				];

			samsung,panel-hbm-off-cmds = [
					15 01 00 00 00 00 02 53 00		/* HBM off*/
				];

			/*
			 * ************************************************************************************************************************
			 * AID command list and mappings
			 * ************************************************************************************************************************
			 */
			samsung,panel-aid-cmds-revA-list = [
				29 01 00 00 00 00 05 B2 E9 90 03 10 /* 0  samsung_brightness_aor_98.49cd_2 */
				29 01 00 00 00 00 05 B2 D5 90 03 10 /* 1  samsung_brightness_aor_97.71cd_3 */
				29 01 00 00 00 00 05 B2 C1 90 03 10 /* 2  samsung_brightness_aor_96.93cd_4*/
				29 01 00 00 00 00 05 B2 AD 90 03 10 /* 3  samsung_brightness_aor_96.16cd_5*/
				29 01 00 00 00 00 05 B2 99 90 03 10 /* 4  samsung_brightness_aor_95.38cd_6*/
				29 01 00 00 00 00 05 B2 85 90 03 10 /* 5  samsung_brightness_aor_94.60cd_7*/
				29 01 00 00 00 00 05 B2 71 90 03 10 /* 6  samsung_brightness_aor_93.83cd_8*/
				29 01 00 00 00 00 05 B2 5D 90 03 10 /* 7  samsung_brightness_aor_93.05cd_9*/
				29 01 00 00 00 00 05 B2 49 90 03 10 /* 8  samsung_brightness_aor_92.27cd_10*/
				29 01 00 00 00 00 05 B2 35 90 03 10 /* 9  samsung_brightness_aor_91.50cd_11*/
				29 01 00 00 00 00 05 B2 20 90 03 10 /* 10 samsung_brightness_aor_90.68cd_12*/
				29 01 00 00 00 00 05 B2 0C 90 03 10 /* 11 samsung_brightness_aor_89.91cd_13*/
				29 01 00 00 00 00 05 B2 F9 80 03 10 /* 12 samsung_brightness_aor_89.17cd_14*/
				29 01 00 00 00 00 05 B2 E4 80 03 10 /* 13 samsung_brightness_aor_88.35cd_15*/
				29 01 00 00 00 00 05 B2 CF 80 03 10 /* 14 samsung_brightness_aor_87.54cd_16*/
				29 01 00 00 00 00 05 B2 BB 80 03 10 /* 15 samsung_brightness_aor_86.76cd_17*/
				29 01 00 00 00 00 05 B2 90 80 03 10 /* 16 samsung_brightness_aor_85.09cd_19*/
				29 01 00 00 00 00 05 B2 7E 80 03 10 /* 17 samsung_brightness_aor_84.39cd_20*/
				29 01 00 00 00 00 05 B2 69 80 03 10 /* 18 samsung_brightness_aor_83.58cd_21*/
				29 01 00 00 00 00 05 B2 54 80 03 10 /* 19 samsung_brightness_aor_82.76cd_22*/
				29 01 00 00 00 00 05 B2 2A 80 03 10 /* 20 samsung_brightness_aor_81.13cd_24*/
				29 01 00 00 00 00 05 B2 16 80 03 10 /* 21 samsung_brightness_aor_80.36cd_25*/
				29 01 00 00 00 00 05 B2 EC 70 03 10 /* 22 samsung_brightness_aor_78.73cd_27*/
				29 01 00 00 00 00 05 B2 C3 70 03 10 /* 23 samsung_brightness_aor_77.14cd_29*/
				29 01 00 00 00 00 05 B2 AF 70 03 10 /* 24 samsung_brightness_aor_76.36cd_30*/
				29 01 00 00 00 00 05 B2 83 70 03 10 /* 25 samsung_brightness_aor_74.65cd_32*/
				29 01 00 00 00 00 05 B2 59 70 03 10 /* 26 samsung_brightness_aor_73.02cd_34*/
				29 01 00 00 00 00 05 B2 1A 70 03 10 /* 27 samsung_brightness_aor_70.57cd_37*/
				29 01 00 00 00 00 05 B2 EE 60 03 10 /* 28 samsung_brightness_aor_68.87cd_39*/
				29 01 00 00 00 00 05 B2 C3 60 03 10 /* 29 samsung_brightness_aor_67.20cd_41*/
				29 01 00 00 00 00 05 B2 82 60 03 10 /* 30 samsung_brightness_aor_64.67cd_44*/
				29 01 00 00 00 00 05 B2 42 60 03 10 /* 31 samsung_brightness_aor_62.19cd_47*/
				29 01 00 00 00 00 05 B2 01 60 03 10 /* 32 samsung_brightness_aor_59.67cd_50*/
				29 01 00 00 00 00 05 B2 BE 50 03 10 /* 33 samsung_brightness_aor_57.07cd_53*/
				29 01 00 00 00 00 05 B2 7D 50 03 10 /* 34 samsung_brightness_aor_54.54cd_56*/
				29 01 00 00 00 00 05 B2 24 50 03 10 /* 35 samsung_brightness_aor_51.09cd_60*/
				29 01 00 00 00 00 05 B2 C9 40 03 10 /* 36 samsung_brightness_aor_47.55cd_64*/
				29 01 00 00 00 00 05 B2 6C 40 03 10 /* 37 samsung_brightness_aor_43.94cd_68*/
				29 01 00 00 00 00 05 B2 06 40 03 10 /* 38 samsung_brightness_aor_39.98cd_72*/
				29 01 00 00 00 00 05 B2 06 40 03 10 /* 39 samsung_brightness_aor_39.98cd_77*/
				29 01 00 00 00 00 05 B2 06 40 03 10 /* 40 samsung_brightness_aor_39.98cd_82*/
				29 01 00 00 00 00 05 B2 06 40 03 10 /* 41 samsung_brightness_aor_39.98cd_87*/
				29 01 00 00 00 00 05 B2 06 40 03 10 /* 42 samsung_brightness_aor_39.98cd_93*/
				29 01 00 00 00 00 05 B2 06 40 03 10 /* 43 samsung_brightness_aor_39.98cd_98*/
				29 01 00 00 00 00 05 B2 06 40 03 10 /* 44 samsung_brightness_aor_39.98cd_105*/
				29 01 00 00 00 00 05 B2 06 40 03 10 /* 45 samsung_brightness_aor_39.98cd_111*/
				29 01 00 00 00 00 05 B2 06 40 03 10 /* 46 samsung_brightness_aor_39.98cd_119*/
				29 01 00 00 00 00 05 B2 06 40 03 10 /* 47 samsung_brightness_aor_39.98cd_126*/
				29 01 00 00 00 00 05 B2 06 40 03 10 /* 48 samsung_brightness_aor_39.98cd_134*/
				29 01 00 00 00 00 05 B2 06 40 03 10 /* 49 samsung_brightness_aor_39.98cd_143*/
				29 01 00 00 00 00 05 B2 06 40 03 10 /* 50 samsung_brightness_aor_39.98cd_152*/
				29 01 00 00 00 00 05 B2 06 40 03 10 /* 51 samsung_brightness_aor_39.98cd_162*/
				29 01 00 00 00 00 05 B2 06 40 03 10 /* 52 samsung_brightness_aor_39.98cd_172*/
				29 01 00 00 00 00 05 B2 AE 30 03 10 /* 53 samsung_brightness_aor_36.57cd_183*/
				29 01 00 00 00 00 05 B2 31 30 03 10 /* 54 samsung_brightness_aor_31.72cd_195*/
				29 01 00 00 00 00 05 B2 BB 20 03 10 /* 55 samsung_brightness_aor_27.14cd_207*/
				29 01 00 00 00 00 05 B2 2A 20 03 10 /* 56 samsung_brightness_aor_21.51cd_220*/
				29 01 00 00 00 00 05 B2 90 10 03 10 /* 57 samsung_brightness_aor_15.53cd_234*/
				29 01 00 00 00 00 05 B2 03 10 03 10 /* 58 samsung_brightness_aor_10.05cd_249*/
				29 01 00 00 00 00 05 B2 03 10 03 10 /* 59 samsung_brightness_aor_10.05cd_265*/
				29 01 00 00 00 00 05 B2 03 10 03 10 /* 60 samsung_brightness_aor_10.05cd_282*/
				29 01 00 00 00 00 05 B2 03 10 03 10 /* 61 samsung_brightness_aor_10.05cd_300*/
				29 01 00 00 00 00 05 B2 03 10 03 10 /* 62 samsung_brightness_aor_10.05cd_316*/
				29 01 00 00 00 00 05 B2 03 10 03 10 /* 63 samsung_brightness_aor_10.05cd_333*/
				29 01 00 00 00 00 05 B2 03 10 03 10 /* 64 samsung_brightness_aor_10.05cd_350*/
			];

			samsung,panel-aid-cmds-revF-list = [
				29 01 00 00 00 00 03 B2 E4 90 /* 0  samsung_brightness_aor_98.29_2 */
				29 01 00 00 00 00 03 B2 D1 90 /* 1  samsung_brightness_aor_97.55_3 */
				29 01 00 00 00 00 03 B2 B7 90 /* 2  samsung_brightness_aor_96.55_4*/
				29 01 00 00 00 00 03 B2 9F 90 /* 3  samsung_brightness_aor_95.61_5*/
				29 01 00 00 00 00 03 B2 8B 90 /* 4  samsung_brightness_aor_94.84_6*/
				29 01 00 00 00 00 03 B2 76 90 /* 5  samsung_brightness_aor_94.02_7*/
				29 01 00 00 00 00 03 B2 5F 90 /* 6  samsung_brightness_aor_93.13_8*/
				29 01 00 00 00 00 03 B2 55 90 /* 7  samsung_brightness_aor_92.74_9*/
				29 01 00 00 00 00 03 B2 44 90 /* 8  samsung_brightness_aor_92.08_10*/
				29 01 00 00 00 00 03 B2 35 90 /* 9  samsung_brightness_aor_91.50_11*/
				29 01 00 00 00 00 03 B2 25 90 /* 10 samsung_brightness_aor_90.88_12*/
				29 01 00 00 00 00 03 B2 15 90 /* 11 samsung_brightness_aor_90.26_13*/
				29 01 00 00 00 00 03 B2 05 90 /* 12 samsung_brightness_aor_89.64_14*/
				29 01 00 00 00 00 03 B2 F2 80 /* 13 samsung_brightness_aor_88.90_15*/
				29 01 00 00 00 00 03 B2 DA 80 /* 14 samsung_brightness_aor_87.97_16*/
				29 01 00 00 00 00 03 B2 C6 80 /* 15 samsung_brightness_aor_87.19_17*/
				29 01 00 00 00 00 03 B2 A2 80 /* 16 samsung_brightness_aor_85.79_19*/
				29 01 00 00 00 00 03 B2 8D 80 /* 17 samsung_brightness_aor_84.98_20*/
				29 01 00 00 00 00 03 B2 76 80 /* 18 samsung_brightness_aor_84.08_21*/
				29 01 00 00 00 00 03 B2 65 80 /* 19 samsung_brightness_aor_83.42_22*/
				29 01 00 00 00 00 03 B2 3F 80 /* 20 samsung_brightness_aor_81.95_24*/
				29 01 00 00 00 00 03 B2 28 80 /* 21 samsung_brightness_aor_81.06_25*/
				29 01 00 00 00 00 03 B2 05 80 /* 22 samsung_brightness_aor_79.70_27*/
				29 01 00 00 00 00 03 B2 D9 70 /* 23 samsung_brightness_aor_77.99_29*/
				29 01 00 00 00 00 03 B2 BC 70 /* 24 samsung_brightness_aor_76.86_30*/
				29 01 00 00 00 00 03 B2 9E 70 /* 25 samsung_brightness_aor_75.70_32*/
				29 01 00 00 00 00 03 B2 76 70 /* 26 samsung_brightness_aor_74.15_34*/
				29 01 00 00 00 00 03 B2 37 70 /* 27 samsung_brightness_aor_71.70_37*/
				29 01 00 00 00 00 03 B2 13 70 /* 28 samsung_brightness_aor_70.30_39*/
				29 01 00 00 00 00 03 B2 E6 60 /* 29 samsung_brightness_aor_68.56_41*/
				29 01 00 00 00 00 03 B2 A8 60 /* 30 samsung_brightness_aor_66.15_44*/
				29 01 00 00 00 00 03 B2 70 60 /* 31 samsung_brightness_aor_63.98_47*/
				29 01 00 00 00 00 03 B2 32 60 /* 32 samsung_brightness_aor_61.57_50*/
				29 01 00 00 00 00 03 B2 F2 50 /* 33 samsung_brightness_aor_59.08_53*/
				29 01 00 00 00 00 03 B2 B3 50 /* 34 samsung_brightness_aor_56.64_56*/
				29 01 00 00 00 00 03 B2 61 50 /* 35 samsung_brightness_aor_53.45_60*/
				29 01 00 00 00 00 03 B2 07 50 /* 36 samsung_brightness_aor_49.96_64*/
				29 01 00 00 00 00 03 B2 B3 40 /* 37 samsung_brightness_aor_46.70_68*/
				29 01 00 00 00 00 03 B2 57 40 /* 38 samsung_brightness_aor_43.13_72*/
				29 01 00 00 00 00 03 B2 F6 30 /* 39 samsung_brightness_aor_39.36_77*/
				29 01 00 00 00 00 03 B2 F6 30 /* 40 samsung_brightness_aor_39.36_82*/
				29 01 00 00 00 00 03 B2 F6 30 /* 41 samsung_brightness_aor_39.36_87*/
				29 01 00 00 00 00 03 B2 F6 30 /* 42 samsung_brightness_aor_39.36_93*/
				29 01 00 00 00 00 03 B2 F6 30 /* 43 samsung_brightness_aor_39.36_98*/
				29 01 00 00 00 00 03 B2 F6 30 /* 44 samsung_brightness_aor_39.36_105*/
				29 01 00 00 00 00 03 B2 F6 30 /* 45 samsung_brightness_aor_39.36_111*/
				29 01 00 00 00 00 03 B2 F6 30 /* 46 samsung_brightness_aor_39.36_119*/
				29 01 00 00 00 00 03 B2 F6 30 /* 47 samsung_brightness_aor_39.36_126*/
				29 01 00 00 00 00 03 B2 F6 30 /* 48 samsung_brightness_aor_39.36_134*/
				29 01 00 00 00 00 03 B2 F6 30 /* 49 samsung_brightness_aor_39.36_143*/
				29 01 00 00 00 00 03 B2 F6 30 /* 50 samsung_brightness_aor_39.36_152*/
				29 01 00 00 00 00 03 B2 F6 30 /* 51 samsung_brightness_aor_39.36_162*/
				29 01 00 00 00 00 03 B2 F6 30 /* 52 samsung_brightness_aor_39.36_172*/
				29 01 00 00 00 00 03 B2 A4 30 /* 53 samsung_brightness_aor_36.18_183*/
				29 01 00 00 00 00 03 B2 26 30 /* 54 samsung_brightness_aor_31.29_195*/
				29 01 00 00 00 00 03 B2 B5 20 /* 55 samsung_brightness_aor_26.90_207*/
				29 01 00 00 00 00 03 B2 24 20 /* 56 samsung_brightness_aor_21.27_220*/
				29 01 00 00 00 00 03 B2 88 10 /* 57 samsung_brightness_aor_15.22_234*/
				29 01 00 00 00 00 03 B2 03 10 /* 58 samsung_brightness_aor_10.05_249*/
				29 01 00 00 00 00 03 B2 03 10 /* 59 samsung_brightness_aor_10.05_265*/
				29 01 00 00 00 00 03 B2 03 10 /* 60 samsung_brightness_aor_10.05_282*/
				29 01 00 00 00 00 03 B2 03 10 /* 61 samsung_brightness_aor_10.05_300*/
				29 01 00 00 00 00 03 B2 03 10 /* 62 samsung_brightness_aor_10.05_316*/
				29 01 00 00 00 00 03 B2 03 10 /* 63 samsung_brightness_aor_10.05_333*/
				29 01 00 00 00 00 03 B2 03 10 /* 64 samsung_brightness_aor_10.05_350*/
			];

			samsung,panel-aid-cmds-revH-list = [
				29 01 00 00 00 00 03 B2 E5 90 /* 0  samsung_brightness_aor_98.29_2 */
				29 01 00 00 00 00 03 B2 CC 90 /* 1  samsung_brightness_aor_97.55_3 */
				29 01 00 00 00 00 03 B2 B6 90 /* 2  samsung_brightness_aor_96.55_4*/
				29 01 00 00 00 00 03 B2 A3 90 /* 3  samsung_brightness_aor_95.61_5*/
				29 01 00 00 00 00 03 B2 8E 90 /* 4  samsung_brightness_aor_94.84_6*/
				29 01 00 00 00 00 03 B2 79 90 /* 5  samsung_brightness_aor_94.02_7*/
				29 01 00 00 00 00 03 B2 66 90 /* 6  samsung_brightness_aor_93.13_8*/
				29 01 00 00 00 00 03 B2 57 90 /* 7  samsung_brightness_aor_92.74_9*/
				29 01 00 00 00 00 03 B2 44 90 /* 8  samsung_brightness_aor_92.08_10*/
				29 01 00 00 00 00 03 B2 35 90 /* 9  samsung_brightness_aor_91.50_11*/
				29 01 00 00 00 00 03 B2 25 90 /* 10 samsung_brightness_aor_90.88_12*/
				29 01 00 00 00 00 03 B2 14 90 /* 11 samsung_brightness_aor_90.26_13*/
				29 01 00 00 00 00 03 B2 05 90 /* 12 samsung_brightness_aor_89.64_14*/
				29 01 00 00 00 00 03 B2 EB 80 /* 13 samsung_brightness_aor_88.90_15*/
				29 01 00 00 00 00 03 B2 E0 80 /* 14 samsung_brightness_aor_87.97_16*/
				29 01 00 00 00 00 03 B2 C7 80 /* 15 samsung_brightness_aor_87.19_17*/
				29 01 00 00 00 00 03 B2 A4 80 /* 16 samsung_brightness_aor_85.79_19*/
				29 01 00 00 00 00 03 B2 92 80 /* 17 samsung_brightness_aor_84.98_20*/
				29 01 00 00 00 00 03 B2 7B 80 /* 18 samsung_brightness_aor_84.08_21*/
				29 01 00 00 00 00 03 B2 67 80 /* 19 samsung_brightness_aor_83.42_22*/
				29 01 00 00 00 00 03 B2 43 80 /* 20 samsung_brightness_aor_81.95_24*/
				29 01 00 00 00 00 03 B2 2F 80 /* 21 samsung_brightness_aor_81.06_25*/
				29 01 00 00 00 00 03 B2 FD 70 /* 22 samsung_brightness_aor_79.70_27*/
				29 01 00 00 00 00 03 B2 DF 70 /* 23 samsung_brightness_aor_77.99_29*/
				29 01 00 00 00 00 03 B2 C7 70 /* 24 samsung_brightness_aor_76.86_30*/
				29 01 00 00 00 00 03 B2 A4 70 /* 25 samsung_brightness_aor_75.70_32*/
				29 01 00 00 00 00 03 B2 6F 70 /* 26 samsung_brightness_aor_74.15_34*/
				29 01 00 00 00 00 03 B2 3D 70 /* 27 samsung_brightness_aor_71.70_37*/
				29 01 00 00 00 00 03 B2 14 70 /* 28 samsung_brightness_aor_70.30_39*/
				29 01 00 00 00 00 03 B2 EE 60 /* 29 samsung_brightness_aor_68.56_41*/
				29 01 00 00 00 00 03 B2 B2 60 /* 30 samsung_brightness_aor_66.15_44*/
				29 01 00 00 00 00 03 B2 73 60 /* 31 samsung_brightness_aor_63.98_47*/
				29 01 00 00 00 00 03 B2 34 60 /* 32 samsung_brightness_aor_61.57_50*/
				29 01 00 00 00 00 03 B2 F4 50 /* 33 samsung_brightness_aor_59.08_53*/
				29 01 00 00 00 00 03 B2 B5 50 /* 34 samsung_brightness_aor_56.64_56*/
				29 01 00 00 00 00 03 B2 5F 50 /* 35 samsung_brightness_aor_53.45_60*/
				29 01 00 00 00 00 03 B2 0E 50 /* 36 samsung_brightness_aor_49.96_64*/
				29 01 00 00 00 00 03 B2 B4 40 /* 37 samsung_brightness_aor_46.70_68*/
				29 01 00 00 00 00 03 B2 62 40 /* 38 samsung_brightness_aor_43.13_72*/
				29 01 00 00 00 00 03 B2 ED 30 /* 39 samsung_brightness_aor_39.36_77*/
				29 01 00 00 00 00 03 B2 ED 30 /* 40 samsung_brightness_aor_39.36_82*/
				29 01 00 00 00 00 03 B2 ED 30 /* 41 samsung_brightness_aor_39.36_87*/
				29 01 00 00 00 00 03 B2 ED 30 /* 42 samsung_brightness_aor_39.36_93*/
				29 01 00 00 00 00 03 B2 ED 30 /* 43 samsung_brightness_aor_39.36_98*/
				29 01 00 00 00 00 03 B2 ED 30 /* 44 samsung_brightness_aor_39.36_105*/
				29 01 00 00 00 00 03 B2 ED 30 /* 45 samsung_brightness_aor_39.36_111*/
				29 01 00 00 00 00 03 B2 ED 30 /* 46 samsung_brightness_aor_39.36_119*/
				29 01 00 00 00 00 03 B2 ED 30 /* 47 samsung_brightness_aor_39.36_126*/
				29 01 00 00 00 00 03 B2 ED 30 /* 48 samsung_brightness_aor_39.36_134*/
				29 01 00 00 00 00 03 B2 ED 30 /* 49 samsung_brightness_aor_39.36_143*/
				29 01 00 00 00 00 03 B2 ED 30 /* 50 samsung_brightness_aor_39.36_152*/
				29 01 00 00 00 00 03 B2 ED 30 /* 51 samsung_brightness_aor_39.36_162*/
				29 01 00 00 00 00 03 B2 ED 30 /* 52 samsung_brightness_aor_39.36_172*/
				29 01 00 00 00 00 03 B2 A7 30 /* 53 samsung_brightness_aor_36.18_183*/
				29 01 00 00 00 00 03 B2 26 30 /* 54 samsung_brightness_aor_31.29_195*/
				29 01 00 00 00 00 03 B2 B5 20 /* 55 samsung_brightness_aor_26.90_207*/
				29 01 00 00 00 00 03 B2 26 20 /* 56 samsung_brightness_aor_21.27_220*/
				29 01 00 00 00 00 03 B2 8F 10 /* 57 samsung_brightness_aor_15.22_234*/
				29 01 00 00 00 00 03 B2 03 10 /* 58 samsung_brightness_aor_10.05_249*/
				29 01 00 00 00 00 03 B2 03 10 /* 59 samsung_brightness_aor_10.05_265*/
				29 01 00 00 00 00 03 B2 03 10 /* 60 samsung_brightness_aor_10.05_282*/
				29 01 00 00 00 00 03 B2 03 10 /* 61 samsung_brightness_aor_10.05_300*/
				29 01 00 00 00 00 03 B2 03 10 /* 62 samsung_brightness_aor_10.05_316*/
				29 01 00 00 00 00 03 B2 03 10 /* 63 samsung_brightness_aor_10.05_333*/
				29 01 00 00 00 00 03 B2 03 10 /* 64 samsung_brightness_aor_10.05_350*/
			];

			/* bl_level, Index in acl command list */
			samsung,panel-aid-map-revA-table = <
				2	0
				4	2		5	3		6	4		8	6		9	7
				10	8		12	10		13	11		15	13		16	14
				17	15		19	16		20	17		21	18		24	20
				25	21		27	22		29	23		30	24		32	25
				34	26		37	27		39	28		41	29		44	30
				47	31		50	32		53	33		56	34		60	35
				64	36		68	37		72	38		77	39		82	40
				87	41		93	42		98	43		105	44		111	45
				119	46		126	47		134	48		143	49		152	50
				162	51		172	52		183	53		195	54		207	55
				220	56		234	57		249	58		265	59		282	60
				300	61		316	62		333	63		350	64
			>;


			/*
			 * ************************************************************************************************************************
			 * ACL command list and mappings
			 * ************************************************************************************************************************
			 */
			 samsung,panel-aclcont-cmds-list = [
					15 01 00 00 00 00 02 B5 50]; /* ACL on, B5 <- 0x50 */

			samsung,panel-acl-cmds-list = [
					15 01 00 00 00 00 02 55 00
					15 01 00 00 00 00 02 55 01		/* ACL 30% */
					15 01 00 00 00 00 02 55 02		/* default ACL 15% */
					15 01 00 00 00 00 02 55 03];	/* ACL 50% */

			samsung,panel-acl-off-cmds = [
								15 01 00 00 00 00 02 B5 40   /* ACL OFF - 40 (16Frame Averaging) */
								15 01 00 00 00 00 02 55 00];/*off, b5<-0x40*/

			/* bl_level , Index in acl command list */
			samsung,panel-acl-map-table =  <
					2    2
					4    2	5    2	6   2		8   2		9   2
					10   2	12   2	13   2	15   2	16   2
					17   2	19   2	20   2	21   2	24   2
					25   2	27   2	29   2	30   2	32   2
					34   2	37   2	39   2	41   2	44   2
					47   2	50   2	53   2	56   2	60   2
					64   2	68   2	72   2	77   2	 82   2
					87   2	93   2	98   2	105  2	111  2
					119  2	126  2	134  2	143  2	152  2
					162  2	172  2	183  2	195  2	207  2
					220  2	234  2	249  2	265  2	282  2
					300  2	316  2	333  2	350  2
				>;
			/*
			 * ************************************************************************************************************************
			 * ELVSS(ACL Off) command list and mappings
			 * ************************************************************************************************************************
			 */
			samsung,panel-elvss-cmds-list = [
				29 01 00 00 00 00 03 b6 8C 16 /* 0 */
				29 01 00 00 00 00 03 b6 8C 16 /* 1 */
				29 01 00 00 00 00 03 b6 8C 15 /* 2 */
				29 01 00 00 00 00 03 b6 8C 15 /* 3 */
				29 01 00 00 00 00 03 b6 8C 15 /* 4 */
				29 01 00 00 00 00 03 b6 8C 15 /* 5 */
				29 01 00 00 00 00 03 b6 8C 14 /* 6 */
				29 01 00 00 00 00 03 b6 8C 14 /* 7 */
				29 01 00 00 00 00 03 b6 8C 14 /* 8 */
				29 01 00 00 00 00 03 b6 8C 13 /* 9 */
				29 01 00 00 00 00 03 b6 8C 13 /* 10 */
				29 01 00 00 00 00 03 b6 8C 13 /* 11 */
				29 01 00 00 00 00 03 b6 8C 12 /* 12 */
				29 01 00 00 00 00 03 b6 8C 12 /* 13 */
				29 01 00 00 00 00 03 b6 8C 0F /* 14 */
				29 01 00 00 00 00 03 b6 8C 0F /* 15 */
				29 01 00 00 00 00 03 b6 8C 0E /* 16 */
				29 01 00 00 00 00 03 b6 8C 0E /* 17 */
				29 01 00 00 00 00 03 b6 8C 0E /* 18 */
				29 01 00 00 00 00 03 b6 8C 0D /* 19 */
				29 01 00 00 00 00 03 b6 8C 0D /* 20 */
				29 01 00 00 00 00 03 b6 8C 0C /* 21 */
				29 01 00 00 00 00 03 b6 8C 0C /* 22 */
				29 01 00 00 00 00 03 b6 8C 0B /* 23 */
				29 01 00 00 00 00 03 b6 8C 0B /* 24 */
				29 01 00 00 00 00 03 b6 8C 0A /* 25 */
			];

			/*
			 * ************************************************************************************************************************
			 * SMART ACL(ACL On) ELVSS command list and mappings
			 * ************************************************************************************************************************
			 */
			samsung,panel-smart-acl-elvss-cmds-list = [
				29 01 00 00 00 00 03 b6 8C 16 /* 0 */
				29 01 00 00 00 00 03 b6 8C 16 /* 1 */
				29 01 00 00 00 00 03 b6 8C 15 /* 2 */
				29 01 00 00 00 00 03 b6 8C 15 /* 3 */
				29 01 00 00 00 00 03 b6 8C 15 /* 4 */
				29 01 00 00 00 00 03 b6 8C 15 /* 5 */
				29 01 00 00 00 00 03 b6 8C 14 /* 6 */
				29 01 00 00 00 00 03 b6 8C 14 /* 7 */
				29 01 00 00 00 00 03 b6 8C 14 /* 8 */
				29 01 00 00 00 00 03 b6 8C 13 /* 9 */
				29 01 00 00 00 00 03 b6 8C 13 /* 10 */
				29 01 00 00 00 00 03 b6 8C 13 /* 11 */
				29 01 00 00 00 00 03 b6 8C 12 /* 12 */
				29 01 00 00 00 00 03 b6 8C 12 /* 13 */
				29 01 00 00 00 00 03 b6 8C 0F /* 14 */
				29 01 00 00 00 00 03 b6 8C 0F /* 15 */
				29 01 00 00 00 00 03 b6 8C 0E /* 16 */
				29 01 00 00 00 00 03 b6 8C 0E /* 17 */
				29 01 00 00 00 00 03 b6 8C 0E /* 18 */
				29 01 00 00 00 00 03 b6 8C 0D /* 19 */
				29 01 00 00 00 00 03 b6 8C 0D /* 20 */
				29 01 00 00 00 00 03 b6 8C 0C /* 21 */
				29 01 00 00 00 00 03 b6 8C 0C /* 22 */
				29 01 00 00 00 00 03 b6 8C 0B /* 23 */
				29 01 00 00 00 00 03 b6 8C 0B /* 24 */
				29 01 00 00 00 00 03 b6 8C 0A /* 25 */
			];

			/* bl_level, Index in elvss command list */
			samsung,panel-smart-acl-elvss-map-table = <
					2    0
					4    0	5    0		6   0            8   0       9   0
					10   0      12   0		13   0		15   0	16   0
					17   0	19   0		20   0		21   0      24   0
					25   0      27   0		29   0		30   0	32   0
					34   0      37   0		39   0		41   0	44   0
					47  0      50   0		53   0		56   0	60   0
					64   0      68   0		72   0		77   0	82   1
					87   2      93   3		98   4		105  5	111  6
					119  7      126  8		134  9		143  10	152  11
					162  12     172  13		183  14		195  15	207  16
					220  17     234  18		249  19		265  20	282  21
					300  22	  316  23		333	 24		350  25
					>;

			/*
			 * ************************************************************************************************************************
			 * SMART VINT set command list and mappings
			 * ************************************************************************************************************************
			 */
			samsung,panel-smart-vint-cmds-list = [
				29 01 00 00 00 00 03 F4 8B 21 /* 0 */
				29 01 00 00 00 00 03 F4 8B 20 /* 1 */
				29 01 00 00 00 00 03 F4 8B 1F /* 2 */
				29 01 00 00 00 00 03 F4 8B 1E /* 3 */
				29 01 00 00 00 00 03 F4 8B 1D /* 4 */
				29 01 00 00 00 00 03 F4 8B 1C /* 5 */
				29 01 00 00 00 00 03 F4 8B 1B /* 6 */
				29 01 00 00 00 00 03 F4 8B 1A /* 7 */
				29 01 00 00 00 00 03 F4 8B 19 /* 8 */
				29 01 00 00 00 00 03 F4 8B 18 /* 9 */
			];

			/* bl_level, Index in vint command list */
			samsung,panel-smart-vint-map-table = <
					2    9
					4    9	5    9		6   8            8   6       9   5
					10   4      12   2		13   1		15   0	16   0
					17   0	19   0		20   0		21   0      24   0
					25   0      27   0		29   0		30   0	32   0
					34   0      37   0		39   0		41   0	44   0
					47  0      50   0		53   0		56   0	60   0
					64   0      68   0		72   0		77   0	82   0
					87   0      93   0		98   0		105  0	111  0
					119  0      126  0		134  0		143  0	152  0
					162  0     172  0		183  0		195  0	207  0
					220  0     234  0		249  0		265  0	282  0
					300  0	  316  0		333	 0		350  0
					>;

			/*
			 * ************************************************************************************************************************
			 * candela to index mappings
			 * ************************************************************************************************************************
			 */
			samsung,panel-candella-mapping-table = <
			/*<idx><PMSL range> <candella> *//*linear map*/
				0	2	2	2
				1	3	3	4
				2	4	4	5
				3	5	5	6
				4	6	6	8
				5	7	7	9
				6	8	8	10
				7	9	9	12
				8	10	10	13
				9	11	11	15
				10	12	12	16
				11	13	13	17
				12	14	14	19
				13	15	15	20
				14	16	16	21
				15	17	17	24
				16	18	18	25
				17	19	19	27
				18	20	21	29
				19	22	23	30
				20	24	24	32
				21	25	26	34
				22	27	28	37
				23	29	29	39
				24	30	32	41
				25	33	34	44
				26	35	36	47
				27	37	38	50
				28	39	40	53
				29	41	43	56
				30	44	46	60
				31	47	49	64
				32	50	52	68
				33	53	56	72
				34	57	59	77
				35	60	63	82
				36	64	67	87
				37	68	71	93
				38	72	76	98
				39	77	80	105
				40	81	86	111
				41	87	91	119
				42	92	97	126
				43	98	104	134
				44	105	110	143
				45	111	118	152
				46	119	125	162
				47	126	133	172
				48	134	142	183
				49	143	150	195
				50	151	160	207
				51	161	170	220
				52	171	181	234
				53	182	193	249
				54	194	205	265
				55	206	218	282
				56	219	230	300
				57	231	242	316
				58	243	254	333
				59	255	255	350
				>;
	};

	dsi_dual_samsung_cmd_S6E3HA2X01_1: wqhd_cmd1{
		qcom,mdss-dsi-panel-name = "samsung,mdss-amoled-dual_dsi-panel";
		label = "samsung amoled wqhd command mode dsi1 S6E3HA2X01 panel";
		status = "disable";

		qcom,mdss-dsi-panel-controller = <&mdss_dsi1>;
		qcom,mdss-dsi-panel-type = "dsi_cmd_mode";
		qcom,mdss-pan-dest = "display_2";

		qcom,enable-gpio = <&pma8084_gpios 6 0>;
		qcom,rst-gpio = <&pma8084_gpios 21 0>;
		qcom,te-gpio = <&msmgpio 12 0>;
		qcom,fg-err-gpio = <&pma8084_gpios 13 0x1>;
		qcom,oled-det-gpio = <&pma8084_gpios 5 0x1>;

		qcom,cont-splash-enabled;
		qcom,cmd-sync-wait-broadcast;
		qcom,cmd-sync-wait-trigger; /*SYNC UP WITH DSI1*/
		qcom,partial-update-enabled;
		qcom,partial-update-roi-merge;
		qcom,mdss-dsi-panel-broadcast-mode;
		qcom,panel-roi-alignment = <8 8 1 1 1 2>;

		qcom,mdss-pan-res = <720 2560>;
		qcom,mdss-pan-size = <72 126>; /* <Width> <Height> real size of panel in mm */
		qcom,mdss-pan-bpp = <24>;

		qcom,mdss-clk-rate=<898000000>;

		qcom,mdss-vsync-enable=<1>;
		qcom,mdss-hw-vsync-mode=<1>;
		qcom,mdss-pan-insert-dcs-cmd=<1>;
		qcom,mdss-pan-wr-mem-continue=<0x3c>;
		qcom,mdss-pan-wr-mem-start=<0x2c>;
		qcom,mdss-pan-te-sel=<1>;
		qcom,mdss-pan-clk-rate=<898000000>;

		qcom,mdss-pan-porch-values = <108 15 212 6 2 10>; /* <HBP> <HPW> <HFP> <VBP> <VPW> <VFP> */

		qcom,mdss-pan-underflow-clr = <0xff>;
		qcom,mdss-pan-bl-ctrl = "bl_ctrl_dcs_cmds";
		qcom,mdss-pan-bl-levels = <1 255>;
		qcom,mdss-pan-dsi-mode = <1>;
		qcom,mdss-pan-dsi-h-pulse-mode = <0>;
		qcom,mdss-pan-dsi-h-power-stop = <0 0 0>;
		qcom,mdss-pan-dsi-bllp-power-stop = <1 1>;
		qcom,mdss-pan-dsi-traffic-mode = <2>;
		qcom,mdss-pan-dsi-dst-format = <8>;
		qcom,mdss-pan-dsi-vc = <0>;
		qcom,mdss-pan-dsi-rgb-swap = <0>;
		qcom,mdss-force-clk-lane-hs = <0>;
		samsung,mdss-early-lcd-on = <1>;
		qcom,mdss-pan-dsi-data-lanes = <1 1 1 1>;
		qcom,mdss-pan-dsi-dlane-swap = <0>;
		qcom,mdss-pan-dsi-t-clk = <0x30 0x04>;
		qcom,mdss-pan-dsi-stream = <0>;
		qcom,mdss-pan-dsi-mdp-tr = <0x0>;
		qcom,mdss-pan-dsi-dma-tr = <0x04>;
		qcom,mdss-pan-dsi-tx-eot-append = <1>;
		qcom,mdss-pan-dsi-frame-rate = <60>;
		/* qcom,ulps-enabled; */
		qcom,panel-phy-regulatorSettings = [07 09 03 00  /* Regualotor settings */
						    20 00 01];
		qcom,panel-phy-timingSettings = [FA 4B 41 00 66 81 34 4C 41 03 04 A0];

		qcom,panel-phy-strengthCtrl = [ff 06];		/*!!!! */
		qcom,panel-phy-bistCtrl = [00 00 b1 ff
                                              00 00];   /*!!!! BIST Ctrl settings */
		qcom,panel-phy-laneConfig = [
			00 00 00 00 00 00 00 01 97 /* lane0 config */
			00 00 00 00 05 00 00 01 97 /* lane1 config */
			00 00 00 00 0a 00 00 01 97 /* lane2 config */
			00 00 00 00 0f 00 00 01 97 /* lane3 config */
			00 c0 00 00 00 00 00 01 bb]; /* Clk ln config */

		qcom,mdss-dsi-on-command= [

				29 01 00 00 05 00 03 F0 5A 5A 		/* TEST KEY Enable */
				29 01 00 00 00 00 03 FC 5A 5A 		/* TEST KEY Enable */
				05 01 00 00 05 00 01 11 			/* Sleep out, wait 5ms */
				29 01 00 00 78 00 04 F2 63 41 C5		/* DUAL DSI ,hsync timing: 453*/

				15 01 00 00 00 00 02 35 00			/* TE Vsync ON */
				29 01 00 00 00 00 07 BD 33 11 02 16 02 16  /*TSP TE*/
				29 01 00 00 00 00 05 C0 00 00 D8 D8	/* Pentile setting */

				15 01 00 00 00 00 02 B0 20
				15 01 00 00 00 00 02 FE 08			/*POC setting*/

				29 01 00 00 00 00 03 FC A5 A5 		/* TEST KEY Disable */
				15 01 00 00 00 00 02 ED 44 		/*ERR_FG VLIN monitoring on*/
				29 01 00 00 00 00 02 B0 03
				29 01 00 00 00 00 02 E7 67
				29 01 00 00 00 00 02 ED 01				

				29 01 00 00 00 00 24				/* Brightness condition set */
					CA
					01 00 01 00 01 00
					80 80 80
					80 80 80
					80 80 80
					80 80 80
					80 80 80
					80 80 80
					80 80 80
					80 80 80
					00 00 00
					00 00
				29 01 00 00 00 00 03 B2 03 10		/* AID 10% */
				29 01 00 00 00 00 03 B6 9C 0A		/* ELVSS Setting:CAPS ON : acl off*/
				29 01 00 00 00 00 03 F4 8B 21		/* VINT set*/
				15 01 00 00 00 00 02 B5 40		/* CAPS ON : 16 frame avg. at acl off*/
				15 01 00 00 00 00 02 55 00		/*acl off*/

				15 01 00 00 01 00 02 F7 03		/* Gamma, LTPS(AID) update */
				15 01 00 00 00 00 02 F7 00
				29 01 00 00 00 00 03 F0 A5 A5		/* TEST KEY key Disable  */
			];
		qcom,mdss-dsi-on-command-state = "dsi_lp_mode";
		qcom,mdss-dsi-off-command = [
				05 01 00 00 00 00 01 28		/*disp off*/
				05 01 00 00 78 00 01 10		/* sleep in :wait 120ms(0x78) */
		];
		qcom,mdss-dsi-off-command-state = "dsi_hs_mode";
		/*
			the last byte in read commands  represent READ LENGH,
			like below  READ LENGH = 0x21
		 */
		 	samsung,panel-test-key-enable-cmds 	= [ 29 01 00 00 00 00 03 F0 5A 5A];
		 	samsung,panel-test-key-disable-cmds = [ 29 01 00 00 00 00 03 F0 A5 A5];

			qcom,panel-hsync-on-seq = [
								29 01 00 00 00 00 03 F0 5A 5A
								29 01 00 00 00 00 07 BD 11 11 02 16 02 16 /*TSP TE*/
								29 01 00 00 00 00 03 F0 A5 A5];

			samsung,panel-nv-mtp-read-cmds		= [ 06 01 00 00 00 00 01 c8 23 00];

			samsung,panel-nv-mdnie-read-cmds	= [ 06 01 00 00 00 00 01 A1 04 00];
			samsung,panel-nv-mtp-read-elvss-cmds	= [ 06 01 00 00 00 00 01 b6 01 15];	/* read C6 22th , 21=0x15*/
			samsung,panel-nv-read-cmds			= [ 06 01 00 00 00 00 01 c8 21 00];
			samsung,panel-nv-read-enable-cmds = [
								29 01 00 00 00 00 03 f0 5a 5a
								29 01 00 00 00 00 03 F2 63 41];		/* DUAL DSI */
			samsung,panel-nv-read-disable-cmds = [ 29 01 00 00 00 00 03 f0 a5 a5 ];

			/* the last byte in all read commands will represent READ LENGH */
			samsung,panel-manufacture-id-read-cmds = [
								06 01 00 00 00 00 01 da 01 00
								06 01 00 00 00 00 01 db 01 00
								06 01 00 00 00 00 01 dc 01 00];

			samsung,panel-manufacture-date-read-cmds = [ 06 01 00 00 00 00 01 c8 04 28];	/* read C8 41~44th , 40=0x28*/

			samsung,panel-ddi-id-read-cmds = [ 06 01 00 00 00 00 01 d6 05 00];	/* read D6 1~5th */
			samsung,panel-rddpm-read-cmds = [ 06 01 00 00 00 00 01 0A 01 00];	/* read 0A 1st */
			samsung,panel-rddsm-read-cmds = [ 06 01 00 00 00 00 01 0E 01 00];	/* read 0E 1st */

			samsung,panel-mtp-read-sysfs-cmds = [ 06 01 00 00 00 00 01 00 00 00];

			samsung,panel-ldi-debug-read-cmds = [
								06 01 00 00 00 00 01 0A 01 00
								06 01 00 00 00 00 01 0E 01 00
								06 01 00 00 00 00 01 EA 08 00];

			samsung,panel-ldi-fps-write-cmds = [
								29 01 00 00 00 00 03 FC 5A 5A
								29 01 00 00 00 00 04 F2 63 41 C5	/* DUAL DSI ,hsync timing: 453*/
								29 01 00 00 00 00 03 FC A5 A5];

			samsung,panel-ldi-partial-disp-on = [
								29 01 00 00 00 00 05 30 00 C8 03 20
								15 01 00 00 00 00 02 12 00 ];
			samsung,panel-ldi-partial-disp-off = [15 01 00 00 00 00 02 13 00];

			qcom,panel-display-on-cmds	= [05 01 00 00 00 00 01 29];
			qcom,panel-display-off-cmds	= [05 01 00 00 00 00 01 28];

			samsung,panel-elvss-lowtemp-cmds-list = [
								15 01 00 00 00 00 02 B0 07
								15 01 00 00 00 00 02 B8 00];	/* Low Temperature Command */

			samsung,panel-elvss-lowtemp2-cmds-list = [
								15 01 00 00 00 00 02 B0 15
								15 01 00 00 00 00 02 B6 00];	/* Low Temperature Command: default */

			samsung,panel-gamma-cmds-list = [
					29 01 00 00 00 00 24            /* Brightness Condition Set - Gamma 2.2 Setting*/
						CA 01 00 01 00 01 00 80
						80 80 80 80 80 80 80 80
						80 80 80 80 80 80 80 80
						80 80 80 80 80 80 80 00
						00 00 00 00
					15 01 00 00 01 00 02 F7 03		/* Gamma, LTPS(AID) update */
					15 01 00 00 00 00 02 F7 00
				];

			samsung,panel-hbm-cmds-list = [
					29 01 00 00 00 00 03 B6 8C 0A		/* ELVSS Setting */
					29 01 00 00 00 00 03 F4 8B 21		/* VINT set*/
					15 01 00 00 00 00 02 B5 50		/* 32 frame avg.*/
					15 01 00 00 00 00 02 53 C0		/* HBM on*/
				];

			samsung,panel-hbm-off-cmds = [
					15 01 00 00 00 00 02 53 00		/* HBM off*/
				];

			/*
			 * ************************************************************************************************************************
			 * AID command list and mappings
			 * ************************************************************************************************************************
			 */
			samsung,panel-aid-cmds-revA-list = [
				29 01 00 00 00 00 05 B2 E9 90 03 10 /* 0  samsung_brightness_aor_98.49cd_2 */
				29 01 00 00 00 00 05 B2 D5 90 03 10 /* 1  samsung_brightness_aor_97.71cd_3 */
				29 01 00 00 00 00 05 B2 C1 90 03 10 /* 2  samsung_brightness_aor_96.93cd_4*/
				29 01 00 00 00 00 05 B2 AD 90 03 10 /* 3  samsung_brightness_aor_96.16cd_5*/
				29 01 00 00 00 00 05 B2 99 90 03 10 /* 4  samsung_brightness_aor_95.38cd_6*/
				29 01 00 00 00 00 05 B2 85 90 03 10 /* 5  samsung_brightness_aor_94.60cd_7*/
				29 01 00 00 00 00 05 B2 71 90 03 10 /* 6  samsung_brightness_aor_93.83cd_8*/
				29 01 00 00 00 00 05 B2 5D 90 03 10 /* 7  samsung_brightness_aor_93.05cd_9*/
				29 01 00 00 00 00 05 B2 49 90 03 10 /* 8  samsung_brightness_aor_92.27cd_10*/
				29 01 00 00 00 00 05 B2 35 90 03 10 /* 9  samsung_brightness_aor_91.50cd_11*/
				29 01 00 00 00 00 05 B2 20 90 03 10 /* 10 samsung_brightness_aor_90.68cd_12*/
				29 01 00 00 00 00 05 B2 0C 90 03 10 /* 11 samsung_brightness_aor_89.91cd_13*/
				29 01 00 00 00 00 05 B2 F9 80 03 10 /* 12 samsung_brightness_aor_89.17cd_14*/
				29 01 00 00 00 00 05 B2 E4 80 03 10 /* 13 samsung_brightness_aor_88.35cd_15*/
				29 01 00 00 00 00 05 B2 CF 80 03 10 /* 14 samsung_brightness_aor_87.54cd_16*/
				29 01 00 00 00 00 05 B2 BB 80 03 10 /* 15 samsung_brightness_aor_86.76cd_17*/
				29 01 00 00 00 00 05 B2 90 80 03 10 /* 16 samsung_brightness_aor_85.09cd_19*/
				29 01 00 00 00 00 05 B2 7E 80 03 10 /* 17 samsung_brightness_aor_84.39cd_20*/
				29 01 00 00 00 00 05 B2 69 80 03 10 /* 18 samsung_brightness_aor_83.58cd_21*/
				29 01 00 00 00 00 05 B2 54 80 03 10 /* 19 samsung_brightness_aor_82.76cd_22*/
				29 01 00 00 00 00 05 B2 2A 80 03 10 /* 20 samsung_brightness_aor_81.13cd_24*/
				29 01 00 00 00 00 05 B2 16 80 03 10 /* 21 samsung_brightness_aor_80.36cd_25*/
				29 01 00 00 00 00 05 B2 EC 70 03 10 /* 22 samsung_brightness_aor_78.73cd_27*/
				29 01 00 00 00 00 05 B2 C3 70 03 10 /* 23 samsung_brightness_aor_77.14cd_29*/
				29 01 00 00 00 00 05 B2 AF 70 03 10 /* 24 samsung_brightness_aor_76.36cd_30*/
				29 01 00 00 00 00 05 B2 83 70 03 10 /* 25 samsung_brightness_aor_74.65cd_32*/
				29 01 00 00 00 00 05 B2 59 70 03 10 /* 26 samsung_brightness_aor_73.02cd_34*/
				29 01 00 00 00 00 05 B2 1A 70 03 10 /* 27 samsung_brightness_aor_70.57cd_37*/
				29 01 00 00 00 00 05 B2 EE 60 03 10 /* 28 samsung_brightness_aor_68.87cd_39*/
				29 01 00 00 00 00 05 B2 C3 60 03 10 /* 29 samsung_brightness_aor_67.20cd_41*/
				29 01 00 00 00 00 05 B2 82 60 03 10 /* 30 samsung_brightness_aor_64.67cd_44*/
				29 01 00 00 00 00 05 B2 42 60 03 10 /* 31 samsung_brightness_aor_62.19cd_47*/
				29 01 00 00 00 00 05 B2 01 60 03 10 /* 32 samsung_brightness_aor_59.67cd_50*/
				29 01 00 00 00 00 05 B2 BE 50 03 10 /* 33 samsung_brightness_aor_57.07cd_53*/
				29 01 00 00 00 00 05 B2 7D 50 03 10 /* 34 samsung_brightness_aor_54.54cd_56*/
				29 01 00 00 00 00 05 B2 24 50 03 10 /* 35 samsung_brightness_aor_51.09cd_60*/
				29 01 00 00 00 00 05 B2 C9 40 03 10 /* 36 samsung_brightness_aor_47.55cd_64*/
				29 01 00 00 00 00 05 B2 6C 40 03 10 /* 37 samsung_brightness_aor_43.94cd_68*/
				29 01 00 00 00 00 05 B2 06 40 03 10 /* 38 samsung_brightness_aor_39.98cd_72*/
				29 01 00 00 00 00 05 B2 06 40 03 10 /* 39 samsung_brightness_aor_39.98cd_77*/
				29 01 00 00 00 00 05 B2 06 40 03 10 /* 40 samsung_brightness_aor_39.98cd_82*/
				29 01 00 00 00 00 05 B2 06 40 03 10 /* 41 samsung_brightness_aor_39.98cd_87*/
				29 01 00 00 00 00 05 B2 06 40 03 10 /* 42 samsung_brightness_aor_39.98cd_93*/
				29 01 00 00 00 00 05 B2 06 40 03 10 /* 43 samsung_brightness_aor_39.98cd_98*/
				29 01 00 00 00 00 05 B2 06 40 03 10 /* 44 samsung_brightness_aor_39.98cd_105*/
				29 01 00 00 00 00 05 B2 06 40 03 10 /* 45 samsung_brightness_aor_39.98cd_111*/
				29 01 00 00 00 00 05 B2 06 40 03 10 /* 46 samsung_brightness_aor_39.98cd_119*/
				29 01 00 00 00 00 05 B2 06 40 03 10 /* 47 samsung_brightness_aor_39.98cd_126*/
				29 01 00 00 00 00 05 B2 06 40 03 10 /* 48 samsung_brightness_aor_39.98cd_134*/
				29 01 00 00 00 00 05 B2 06 40 03 10 /* 49 samsung_brightness_aor_39.98cd_143*/
				29 01 00 00 00 00 05 B2 06 40 03 10 /* 50 samsung_brightness_aor_39.98cd_152*/
				29 01 00 00 00 00 05 B2 06 40 03 10 /* 51 samsung_brightness_aor_39.98cd_162*/
				29 01 00 00 00 00 05 B2 06 40 03 10 /* 52 samsung_brightness_aor_39.98cd_172*/
				29 01 00 00 00 00 05 B2 AE 30 03 10 /* 53 samsung_brightness_aor_36.57cd_183*/
				29 01 00 00 00 00 05 B2 31 30 03 10 /* 54 samsung_brightness_aor_31.72cd_195*/
				29 01 00 00 00 00 05 B2 BB 20 03 10 /* 55 samsung_brightness_aor_27.14cd_207*/
				29 01 00 00 00 00 05 B2 2A 20 03 10 /* 56 samsung_brightness_aor_21.51cd_220*/
				29 01 00 00 00 00 05 B2 90 10 03 10 /* 57 samsung_brightness_aor_15.53cd_234*/
				29 01 00 00 00 00 05 B2 03 10 03 10 /* 58 samsung_brightness_aor_10.05cd_249*/
				29 01 00 00 00 00 05 B2 03 10 03 10 /* 59 samsung_brightness_aor_10.05cd_265*/
				29 01 00 00 00 00 05 B2 03 10 03 10 /* 60 samsung_brightness_aor_10.05cd_282*/
				29 01 00 00 00 00 05 B2 03 10 03 10 /* 61 samsung_brightness_aor_10.05cd_300*/
				29 01 00 00 00 00 05 B2 03 10 03 10 /* 62 samsung_brightness_aor_10.05cd_316*/
				29 01 00 00 00 00 05 B2 03 10 03 10 /* 63 samsung_brightness_aor_10.05cd_333*/
				29 01 00 00 00 00 05 B2 03 10 03 10 /* 64 samsung_brightness_aor_10.05cd_350*/
			];

			samsung,panel-aid-cmds-revF-list = [
				29 01 00 00 00 00 03 B2 E4 90 /* 0  samsung_brightness_aor_98.29_2 */
				29 01 00 00 00 00 03 B2 D1 90 /* 1  samsung_brightness_aor_97.55_3 */
				29 01 00 00 00 00 03 B2 B7 90 /* 2  samsung_brightness_aor_96.55_4*/
				29 01 00 00 00 00 03 B2 9F 90 /* 3  samsung_brightness_aor_95.61_5*/
				29 01 00 00 00 00 03 B2 8B 90 /* 4  samsung_brightness_aor_94.84_6*/
				29 01 00 00 00 00 03 B2 76 90 /* 5  samsung_brightness_aor_94.02_7*/
				29 01 00 00 00 00 03 B2 5F 90 /* 6  samsung_brightness_aor_93.13_8*/
				29 01 00 00 00 00 03 B2 55 90 /* 7  samsung_brightness_aor_92.74_9*/
				29 01 00 00 00 00 03 B2 44 90 /* 8  samsung_brightness_aor_92.08_10*/
				29 01 00 00 00 00 03 B2 35 90 /* 9  samsung_brightness_aor_91.50_11*/
				29 01 00 00 00 00 03 B2 25 90 /* 10 samsung_brightness_aor_90.88_12*/
				29 01 00 00 00 00 03 B2 15 90 /* 11 samsung_brightness_aor_90.26_13*/
				29 01 00 00 00 00 03 B2 05 90 /* 12 samsung_brightness_aor_89.64_14*/
				29 01 00 00 00 00 03 B2 F2 80 /* 13 samsung_brightness_aor_88.90_15*/
				29 01 00 00 00 00 03 B2 DA 80 /* 14 samsung_brightness_aor_87.97_16*/
				29 01 00 00 00 00 03 B2 C6 80 /* 15 samsung_brightness_aor_87.19_17*/
				29 01 00 00 00 00 03 B2 A2 80 /* 16 samsung_brightness_aor_85.79_19*/
				29 01 00 00 00 00 03 B2 8D 80 /* 17 samsung_brightness_aor_84.98_20*/
				29 01 00 00 00 00 03 B2 76 80 /* 18 samsung_brightness_aor_84.08_21*/
				29 01 00 00 00 00 03 B2 65 80 /* 19 samsung_brightness_aor_83.42_22*/
				29 01 00 00 00 00 03 B2 3F 80 /* 20 samsung_brightness_aor_81.95_24*/
				29 01 00 00 00 00 03 B2 28 80 /* 21 samsung_brightness_aor_81.06_25*/
				29 01 00 00 00 00 03 B2 05 80 /* 22 samsung_brightness_aor_79.70_27*/
				29 01 00 00 00 00 03 B2 D9 70 /* 23 samsung_brightness_aor_77.99_29*/
				29 01 00 00 00 00 03 B2 BC 70 /* 24 samsung_brightness_aor_76.86_30*/
				29 01 00 00 00 00 03 B2 9E 70 /* 25 samsung_brightness_aor_75.70_32*/
				29 01 00 00 00 00 03 B2 76 70 /* 26 samsung_brightness_aor_74.15_34*/
				29 01 00 00 00 00 03 B2 37 70 /* 27 samsung_brightness_aor_71.70_37*/
				29 01 00 00 00 00 03 B2 13 70 /* 28 samsung_brightness_aor_70.30_39*/
				29 01 00 00 00 00 03 B2 E6 60 /* 29 samsung_brightness_aor_68.56_41*/
				29 01 00 00 00 00 03 B2 A8 60 /* 30 samsung_brightness_aor_66.15_44*/
				29 01 00 00 00 00 03 B2 70 60 /* 31 samsung_brightness_aor_63.98_47*/
				29 01 00 00 00 00 03 B2 32 60 /* 32 samsung_brightness_aor_61.57_50*/
				29 01 00 00 00 00 03 B2 F2 50 /* 33 samsung_brightness_aor_59.08_53*/
				29 01 00 00 00 00 03 B2 B3 50 /* 34 samsung_brightness_aor_56.64_56*/
				29 01 00 00 00 00 03 B2 61 50 /* 35 samsung_brightness_aor_53.45_60*/
				29 01 00 00 00 00 03 B2 07 50 /* 36 samsung_brightness_aor_49.96_64*/
				29 01 00 00 00 00 03 B2 B3 40 /* 37 samsung_brightness_aor_46.70_68*/
				29 01 00 00 00 00 03 B2 57 40 /* 38 samsung_brightness_aor_43.13_72*/
				29 01 00 00 00 00 03 B2 F6 30 /* 39 samsung_brightness_aor_39.36_77*/
				29 01 00 00 00 00 03 B2 F6 30 /* 40 samsung_brightness_aor_39.36_82*/
				29 01 00 00 00 00 03 B2 F6 30 /* 41 samsung_brightness_aor_39.36_87*/
				29 01 00 00 00 00 03 B2 F6 30 /* 42 samsung_brightness_aor_39.36_93*/
				29 01 00 00 00 00 03 B2 F6 30 /* 43 samsung_brightness_aor_39.36_98*/
				29 01 00 00 00 00 03 B2 F6 30 /* 44 samsung_brightness_aor_39.36_105*/
				29 01 00 00 00 00 03 B2 F6 30 /* 45 samsung_brightness_aor_39.36_111*/
				29 01 00 00 00 00 03 B2 F6 30 /* 46 samsung_brightness_aor_39.36_119*/
				29 01 00 00 00 00 03 B2 F6 30 /* 47 samsung_brightness_aor_39.36_126*/
				29 01 00 00 00 00 03 B2 F6 30 /* 48 samsung_brightness_aor_39.36_134*/
				29 01 00 00 00 00 03 B2 F6 30 /* 49 samsung_brightness_aor_39.36_143*/
				29 01 00 00 00 00 03 B2 F6 30 /* 50 samsung_brightness_aor_39.36_152*/
				29 01 00 00 00 00 03 B2 F6 30 /* 51 samsung_brightness_aor_39.36_162*/
				29 01 00 00 00 00 03 B2 F6 30 /* 52 samsung_brightness_aor_39.36_172*/
				29 01 00 00 00 00 03 B2 A4 30 /* 53 samsung_brightness_aor_36.18_183*/
				29 01 00 00 00 00 03 B2 26 30 /* 54 samsung_brightness_aor_31.29_195*/
				29 01 00 00 00 00 03 B2 B5 20 /* 55 samsung_brightness_aor_26.90_207*/
				29 01 00 00 00 00 03 B2 24 20 /* 56 samsung_brightness_aor_21.27_220*/
				29 01 00 00 00 00 03 B2 88 10 /* 57 samsung_brightness_aor_15.22_234*/
				29 01 00 00 00 00 03 B2 03 10 /* 58 samsung_brightness_aor_10.05_249*/
				29 01 00 00 00 00 03 B2 03 10 /* 59 samsung_brightness_aor_10.05_265*/
				29 01 00 00 00 00 03 B2 03 10 /* 60 samsung_brightness_aor_10.05_282*/
				29 01 00 00 00 00 03 B2 03 10 /* 61 samsung_brightness_aor_10.05_300*/
				29 01 00 00 00 00 03 B2 03 10 /* 62 samsung_brightness_aor_10.05_316*/
				29 01 00 00 00 00 03 B2 03 10 /* 63 samsung_brightness_aor_10.05_333*/
				29 01 00 00 00 00 03 B2 03 10 /* 64 samsung_brightness_aor_10.05_350*/
			];

			samsung,panel-aid-cmds-revH-list = [
				29 01 00 00 00 00 03 B2 E5 90 /* 0  samsung_brightness_aor_98.29_2 */
				29 01 00 00 00 00 03 B2 CC 90 /* 1  samsung_brightness_aor_97.55_3 */
				29 01 00 00 00 00 03 B2 B6 90 /* 2  samsung_brightness_aor_96.55_4*/
				29 01 00 00 00 00 03 B2 A3 90 /* 3  samsung_brightness_aor_95.61_5*/
				29 01 00 00 00 00 03 B2 8E 90 /* 4  samsung_brightness_aor_94.84_6*/
				29 01 00 00 00 00 03 B2 79 90 /* 5  samsung_brightness_aor_94.02_7*/
				29 01 00 00 00 00 03 B2 66 90 /* 6  samsung_brightness_aor_93.13_8*/
				29 01 00 00 00 00 03 B2 57 90 /* 7  samsung_brightness_aor_92.74_9*/
				29 01 00 00 00 00 03 B2 44 90 /* 8  samsung_brightness_aor_92.08_10*/
				29 01 00 00 00 00 03 B2 35 90 /* 9  samsung_brightness_aor_91.50_11*/
				29 01 00 00 00 00 03 B2 25 90 /* 10 samsung_brightness_aor_90.88_12*/
				29 01 00 00 00 00 03 B2 14 90 /* 11 samsung_brightness_aor_90.26_13*/
				29 01 00 00 00 00 03 B2 05 90 /* 12 samsung_brightness_aor_89.64_14*/
				29 01 00 00 00 00 03 B2 EB 80 /* 13 samsung_brightness_aor_88.90_15*/
				29 01 00 00 00 00 03 B2 E0 80 /* 14 samsung_brightness_aor_87.97_16*/
				29 01 00 00 00 00 03 B2 C7 80 /* 15 samsung_brightness_aor_87.19_17*/
				29 01 00 00 00 00 03 B2 A4 80 /* 16 samsung_brightness_aor_85.79_19*/
				29 01 00 00 00 00 03 B2 92 80 /* 17 samsung_brightness_aor_84.98_20*/
				29 01 00 00 00 00 03 B2 7B 80 /* 18 samsung_brightness_aor_84.08_21*/
				29 01 00 00 00 00 03 B2 67 80 /* 19 samsung_brightness_aor_83.42_22*/
				29 01 00 00 00 00 03 B2 43 80 /* 20 samsung_brightness_aor_81.95_24*/
				29 01 00 00 00 00 03 B2 2F 80 /* 21 samsung_brightness_aor_81.06_25*/
				29 01 00 00 00 00 03 B2 FD 70 /* 22 samsung_brightness_aor_79.70_27*/
				29 01 00 00 00 00 03 B2 DF 70 /* 23 samsung_brightness_aor_77.99_29*/
				29 01 00 00 00 00 03 B2 C7 70 /* 24 samsung_brightness_aor_76.86_30*/
				29 01 00 00 00 00 03 B2 A4 70 /* 25 samsung_brightness_aor_75.70_32*/
				29 01 00 00 00 00 03 B2 6F 70 /* 26 samsung_brightness_aor_74.15_34*/
				29 01 00 00 00 00 03 B2 3D 70 /* 27 samsung_brightness_aor_71.70_37*/
				29 01 00 00 00 00 03 B2 14 70 /* 28 samsung_brightness_aor_70.30_39*/
				29 01 00 00 00 00 03 B2 EE 60 /* 29 samsung_brightness_aor_68.56_41*/
				29 01 00 00 00 00 03 B2 B2 60 /* 30 samsung_brightness_aor_66.15_44*/
				29 01 00 00 00 00 03 B2 73 60 /* 31 samsung_brightness_aor_63.98_47*/
				29 01 00 00 00 00 03 B2 34 60 /* 32 samsung_brightness_aor_61.57_50*/
				29 01 00 00 00 00 03 B2 F4 50 /* 33 samsung_brightness_aor_59.08_53*/
				29 01 00 00 00 00 03 B2 B5 50 /* 34 samsung_brightness_aor_56.64_56*/
				29 01 00 00 00 00 03 B2 5F 50 /* 35 samsung_brightness_aor_53.45_60*/
				29 01 00 00 00 00 03 B2 0E 50 /* 36 samsung_brightness_aor_49.96_64*/
				29 01 00 00 00 00 03 B2 B4 40 /* 37 samsung_brightness_aor_46.70_68*/
				29 01 00 00 00 00 03 B2 62 40 /* 38 samsung_brightness_aor_43.13_72*/
				29 01 00 00 00 00 03 B2 ED 30 /* 39 samsung_brightness_aor_39.36_77*/
				29 01 00 00 00 00 03 B2 ED 30 /* 40 samsung_brightness_aor_39.36_82*/
				29 01 00 00 00 00 03 B2 ED 30 /* 41 samsung_brightness_aor_39.36_87*/
				29 01 00 00 00 00 03 B2 ED 30 /* 42 samsung_brightness_aor_39.36_93*/
				29 01 00 00 00 00 03 B2 ED 30 /* 43 samsung_brightness_aor_39.36_98*/
				29 01 00 00 00 00 03 B2 ED 30 /* 44 samsung_brightness_aor_39.36_105*/
				29 01 00 00 00 00 03 B2 ED 30 /* 45 samsung_brightness_aor_39.36_111*/
				29 01 00 00 00 00 03 B2 ED 30 /* 46 samsung_brightness_aor_39.36_119*/
				29 01 00 00 00 00 03 B2 ED 30 /* 47 samsung_brightness_aor_39.36_126*/
				29 01 00 00 00 00 03 B2 ED 30 /* 48 samsung_brightness_aor_39.36_134*/
				29 01 00 00 00 00 03 B2 ED 30 /* 49 samsung_brightness_aor_39.36_143*/
				29 01 00 00 00 00 03 B2 ED 30 /* 50 samsung_brightness_aor_39.36_152*/
				29 01 00 00 00 00 03 B2 ED 30 /* 51 samsung_brightness_aor_39.36_162*/
				29 01 00 00 00 00 03 B2 ED 30 /* 52 samsung_brightness_aor_39.36_172*/
				29 01 00 00 00 00 03 B2 A7 30 /* 53 samsung_brightness_aor_36.18_183*/
				29 01 00 00 00 00 03 B2 26 30 /* 54 samsung_brightness_aor_31.29_195*/
				29 01 00 00 00 00 03 B2 B5 20 /* 55 samsung_brightness_aor_26.90_207*/
				29 01 00 00 00 00 03 B2 26 20 /* 56 samsung_brightness_aor_21.27_220*/
				29 01 00 00 00 00 03 B2 8F 10 /* 57 samsung_brightness_aor_15.22_234*/
				29 01 00 00 00 00 03 B2 03 10 /* 58 samsung_brightness_aor_10.05_249*/
				29 01 00 00 00 00 03 B2 03 10 /* 59 samsung_brightness_aor_10.05_265*/
				29 01 00 00 00 00 03 B2 03 10 /* 60 samsung_brightness_aor_10.05_282*/
				29 01 00 00 00 00 03 B2 03 10 /* 61 samsung_brightness_aor_10.05_300*/
				29 01 00 00 00 00 03 B2 03 10 /* 62 samsung_brightness_aor_10.05_316*/
				29 01 00 00 00 00 03 B2 03 10 /* 63 samsung_brightness_aor_10.05_333*/
				29 01 00 00 00 00 03 B2 03 10 /* 64 samsung_brightness_aor_10.05_350*/
			];

			/* bl_level, Index in acl command list */
			samsung,panel-aid-map-revA-table = <
				2	0
				4	2		5	3		6	4		8	6		9	7
				10	8		12	10		13	11		15	13		16	14
				17	15		19	16		20	17		21	18		24	20
				25	21		27	22		29	23		30	24		32	25
				34	26		37	27		39	28		41	29		44	30
				47	31		50	32		53	33		56	34		60	35
				64	36		68	37		72	38		77	39		82	40
				87	41		93	42		98	43		105	44		111	45
				119	46		126	47		134	48		143	49		152	50
				162	51		172	52		183	53		195	54		207	55
				220	56		234	57		249	58		265	59		282	60
				300	61		316	62		333	63		350	64
			>;


			/*
			 * ************************************************************************************************************************
			 * ACL command list and mappings
			 * ************************************************************************************************************************
			 */
			 samsung,panel-aclcont-cmds-list = [
					15 01 00 00 00 00 02 B5 50]; /* ACL on, B5 <- 0x50 */

			samsung,panel-acl-cmds-list = [
					15 01 00 00 00 00 02 55 00
					15 01 00 00 00 00 02 55 01		/* ACL 30% */
					15 01 00 00 00 00 02 55 02		/* default ACL 15% */
					15 01 00 00 00 00 02 55 03];	/* ACL 50% */

			samsung,panel-acl-off-cmds = [
								15 01 00 00 00 00 02 B5 40   /* ACL OFF - 40 (16Frame Averaging) */
								15 01 00 00 00 00 02 55 00];/*off, b5<-0x40*/

			/* bl_level , Index in acl command list */
			samsung,panel-acl-map-table =  <
					2    2
					4    2	5    2	6   2		8   2		9   2
					10   2	12   2	13   2	15   2	16   2
					17   2	19   2	20   2	21   2	24   2
					25   2	27   2	29   2	30   2	32   2
					34   2	37   2	39   2	41   2	44   2
					47   2	50   2	53   2	56   2	60   2
					64   2	68   2	72   2	77   2	 82   2
					87   2	93   2	98   2	105  2	111  2
					119  2	126  2	134  2	143  2	152  2
					162  2	172  2	183  2	195  2	207  2
					220  2	234  2	249  2	265  2	282  2
					300  2	316  2	333  2	350  2
				>;
			/*
			 * ************************************************************************************************************************
			 * ELVSS(ACL Off) command list and mappings
			 * ************************************************************************************************************************
			 */
			samsung,panel-elvss-cmds-list = [
				29 01 00 00 00 00 03 b6 8C 16 /* 0 */
				29 01 00 00 00 00 03 b6 8C 16 /* 1 */
				29 01 00 00 00 00 03 b6 8C 15 /* 2 */
				29 01 00 00 00 00 03 b6 8C 15 /* 3 */
				29 01 00 00 00 00 03 b6 8C 15 /* 4 */
				29 01 00 00 00 00 03 b6 8C 15 /* 5 */
				29 01 00 00 00 00 03 b6 8C 14 /* 6 */
				29 01 00 00 00 00 03 b6 8C 14 /* 7 */
				29 01 00 00 00 00 03 b6 8C 14 /* 8 */
				29 01 00 00 00 00 03 b6 8C 13 /* 9 */
				29 01 00 00 00 00 03 b6 8C 13 /* 10 */
				29 01 00 00 00 00 03 b6 8C 13 /* 11 */
				29 01 00 00 00 00 03 b6 8C 12 /* 12 */
				29 01 00 00 00 00 03 b6 8C 12 /* 13 */
				29 01 00 00 00 00 03 b6 8C 0F /* 14 */
				29 01 00 00 00 00 03 b6 8C 0F /* 15 */
				29 01 00 00 00 00 03 b6 8C 0E /* 16 */
				29 01 00 00 00 00 03 b6 8C 0E /* 17 */
				29 01 00 00 00 00 03 b6 8C 0E /* 18 */
				29 01 00 00 00 00 03 b6 8C 0D /* 19 */
				29 01 00 00 00 00 03 b6 8C 0D /* 20 */
				29 01 00 00 00 00 03 b6 8C 0C /* 21 */
				29 01 00 00 00 00 03 b6 8C 0C /* 22 */
				29 01 00 00 00 00 03 b6 8C 0B /* 23 */
				29 01 00 00 00 00 03 b6 8C 0B /* 24 */
				29 01 00 00 00 00 03 b6 8C 0A /* 25 */
			];

			/*
			 * ************************************************************************************************************************
			 * SMART ACL(ACL On) ELVSS command list and mappings
			 * ************************************************************************************************************************
			 */
			samsung,panel-smart-acl-elvss-cmds-list = [
				29 01 00 00 00 00 03 b6 8C 16 /* 0 */
				29 01 00 00 00 00 03 b6 8C 16 /* 1 */
				29 01 00 00 00 00 03 b6 8C 15 /* 2 */
				29 01 00 00 00 00 03 b6 8C 15 /* 3 */
				29 01 00 00 00 00 03 b6 8C 15 /* 4 */
				29 01 00 00 00 00 03 b6 8C 15 /* 5 */
				29 01 00 00 00 00 03 b6 8C 14 /* 6 */
				29 01 00 00 00 00 03 b6 8C 14 /* 7 */
				29 01 00 00 00 00 03 b6 8C 14 /* 8 */
				29 01 00 00 00 00 03 b6 8C 13 /* 9 */
				29 01 00 00 00 00 03 b6 8C 13 /* 10 */
				29 01 00 00 00 00 03 b6 8C 13 /* 11 */
				29 01 00 00 00 00 03 b6 8C 12 /* 12 */
				29 01 00 00 00 00 03 b6 8C 12 /* 13 */
				29 01 00 00 00 00 03 b6 8C 0F /* 14 */
				29 01 00 00 00 00 03 b6 8C 0F /* 15 */
				29 01 00 00 00 00 03 b6 8C 0E /* 16 */
				29 01 00 00 00 00 03 b6 8C 0E /* 17 */
				29 01 00 00 00 00 03 b6 8C 0E /* 18 */
				29 01 00 00 00 00 03 b6 8C 0D /* 19 */
				29 01 00 00 00 00 03 b6 8C 0D /* 20 */
				29 01 00 00 00 00 03 b6 8C 0C /* 21 */
				29 01 00 00 00 00 03 b6 8C 0C /* 22 */
				29 01 00 00 00 00 03 b6 8C 0B /* 23 */
				29 01 00 00 00 00 03 b6 8C 0B /* 24 */
				29 01 00 00 00 00 03 b6 8C 0A /* 25 */
			];

			/* bl_level, Index in elvss command list */
			samsung,panel-smart-acl-elvss-map-table = <
					2    0
					4    0	5    0		6   0            8   0       9   0
					10   0      12   0		13   0		15   0	16   0
					17   0	19   0		20   0		21   0      24   0
					25   0      27   0		29   0		30   0	32   0
					34   0      37   0		39   0		41   0	44   0
					47  0      50   0		53   0		56   0	60   0
					64   0      68   0		72   0		77   0	82   1
					87   2      93   3		98   4		105  5	111  6
					119  7      126  8		134  9		143  10	152  11
					162  12     172  13		183  14		195  15	207  16
					220  17     234  18		249  19		265  20	282  21
					300  22	  316  23		333	 24		350  25
					>;

			/*
			 * ************************************************************************************************************************
			 * SMART VINT set command list and mappings
			 * ************************************************************************************************************************
			 */
			samsung,panel-smart-vint-cmds-list = [
				29 01 00 00 00 00 03 F4 8B 21 /* 0 */
				29 01 00 00 00 00 03 F4 8B 20 /* 1 */
				29 01 00 00 00 00 03 F4 8B 1F /* 2 */
				29 01 00 00 00 00 03 F4 8B 1E /* 3 */
				29 01 00 00 00 00 03 F4 8B 1D /* 4 */
				29 01 00 00 00 00 03 F4 8B 1C /* 5 */
				29 01 00 00 00 00 03 F4 8B 1B /* 6 */
				29 01 00 00 00 00 03 F4 8B 1A /* 7 */
				29 01 00 00 00 00 03 F4 8B 19 /* 8 */
				29 01 00 00 00 00 03 F4 8B 18 /* 9 */
			];

			/* bl_level, Index in vint command list */
			samsung,panel-smart-vint-map-table = <
					2    9
					4    9	5    9		6   8            8   6       9   5
					10   4      12   2		13   1		15   0	16   0
					17   0	19   0		20   0		21   0      24   0
					25   0      27   0		29   0		30   0	32   0
					34   0      37   0		39   0		41   0	44   0
					47  0      50   0		53   0		56   0	60   0
					64   0      68   0		72   0		77   0	82   0
					87   0      93   0		98   0		105  0	111  0
					119  0      126  0		134  0		143  0	152  0
					162  0     172  0		183  0		195  0	207  0
					220  0     234  0		249  0		265  0	282  0
					300  0	  316  0		333	 0		350  0
					>;

			/*
			 * ************************************************************************************************************************
			 * candela to index mappings
			 * ************************************************************************************************************************
			 */
			samsung,panel-candella-mapping-table = <
			/*<idx><PMSL range> <candella> *//*linear map*/
				0	2	2	2
				1	3	3	4
				2	4	4	5
				3	5	5	6
				4	6	6	8
				5	7	7	9
				6	8	8	10
				7	9	9	12
				8	10	10	13
				9	11	11	15
				10	12	12	16
				11	13	13	17
				12	14	14	19
				13	15	15	20
				14	16	16	21
				15	17	17	24
				16	18	18	25
				17	19	19	27
				18	20	21	29
				19	22	23	30
				20	24	24	32
				21	25	26	34
				22	27	28	37
				23	29	29	39
				24	30	32	41
				25	33	34	44
				26	35	36	47
				27	37	38	50
				28	39	40	53
				29	41	43	56
				30	44	46	60
				31	47	49	64
				32	50	52	68
				33	53	56	72
				34	57	59	77
				35	60	63	82
				36	64	67	87
				37	68	71	93
				38	72	76	98
				39	77	80	105
				40	81	86	111
				41	87	91	119
				42	92	97	126
				43	98	104	134
				44	105	110	143
				45	111	118	152
				46	119	125	162
				47	126	133	172
				48	134	142	183
				49	143	150	195
				50	151	160	207
				51	161	170	220
				52	171	181	234
				53	182	193	249
				54	194	205	265
				55	206	218	282
				56	219	230	300
				57	231	242	316
				58	243	254	333
				59	255	255	350
				>;

			/* HMT */
			samsung,panel-aid-cmds-list-hmt = [
				29 01 00 00 00 00 07 B2 03 12 03 00 00 00	/* 20cd */
				29 01 00 00 00 00 07 B2 03 12 03 00 00 00	/* 21cd */
				29 01 00 00 00 00 07 B2 03 12 03 00 00 00	/* 22cd */
				29 01 00 00 00 00 07 B2 03 12 03 00 00 00	/* 23cd */
				29 01 00 00 00 00 07 B2 03 12 03 00 00 00	/* 25cd */
				29 01 00 00 00 00 07 B2 03 12 03 00 00 00	/* 27cd */
				29 01 00 00 00 00 07 B2 03 12 03 00 00 00	/* 29cd */
				29 01 00 00 00 00 07 B2 03 12 03 00 00 00	/* 31cd */
				29 01 00 00 00 00 07 B2 03 12 03 00 00 00	/* 33cd */
				29 01 00 00 00 00 07 B2 03 12 03 00 00 00	/* 35cd */
				29 01 00 00 00 00 07 B2 03 12 03 00 00 00	/* 37cd */
				29 01 00 00 00 00 07 B2 03 12 03 00 00 00	/* 39cd */
				29 01 00 00 00 00 07 B2 03 12 03 00 00 00	/* 41cd */
				29 01 00 00 00 00 07 B2 03 12 03 00 00 00	/* 44cd */
				29 01 00 00 00 00 07 B2 03 12 03 00 00 00	/* 47cd */
				29 01 00 00 00 00 07 B2 03 12 03 00 00 00	/* 50cd */
				29 01 00 00 00 00 07 B2 03 12 03 00 00 00	/* 53cd */
				29 01 00 00 00 00 07 B2 03 12 03 00 00 00	/* 56cd */
				29 01 00 00 00 00 07 B2 03 12 03 00 00 00	/* 60cd */
				29 01 00 00 00 00 07 B2 03 12 03 00 00 00	/* 64cd */
				29 01 00 00 00 00 07 B2 03 12 03 00 00 00	/* 68cd */
				29 01 00 00 00 00 07 B2 03 12 03 00 00 00	/* 72cd */
				29 01 00 00 00 00 07 B2 03 13 04 00 00 00	/* 77cd */
				29 01 00 00 00 00 07 B2 03 13 04 00 00 00	/* 82cd */
				29 01 00 00 00 00 07 B2 03 13 04 00 00 00	/* 87cd */
				29 01 00 00 00 00 07 B2 03 13 04 00 00 00	/* 93cd */
				29 01 00 00 00 00 07 B2 03 13 04 00 00 00	/* 99cd */
				29 01 00 00 00 00 07 B2 03 13 04 00 00 00	/* 105cd */
				29 01 00 00 00 00 07 B2 03 13 04 00 00 00	/* 150cd */
			];

			/* bl_level, Index in acl command list */
			samsung,panel-aid-map-table-reverse-hmt = <
				20 0
				21 1
				22 2
				23 3
				25 4
				27 5
				29 6
				31 7
				33 8
				35 9
				37 10
				39 11
				41 12
				44 13
				47 14
				50 15
				53 16
				56 17
				60 18
				64 19
				68 20
				72 21
				77 22
				82 23
				87 24
				93 25
				99 26
				105 27
				150 28
			>;

			samsung,panel-candella-mapping-table-reverse-hmt = <
			/*<idx>	  <from>  <till> <candella> */
				0	0	9	20
				1	10	19	21
				2	20	29	22
				3	30	39	23
				4	40	49	25
				5	50	59	27
				6	60	68	29
				7	69	77	31
				8	78	86	33
				9	87	95	35
				10	96	104	37
				11	105	113	39
				12	114	122	41
				13	123	131	44
				14	132	140	47
				15	141	149	50
				16	150	158	53
				17	159	167	56
				18	168	176	60
				19	177	185	64
				20	186	194	68
				21	195	203	72
				22	204	212	77
				23	213	221	82
				24	222	230	87
				25	231	239	93
				26	240	248	99
				27	249	255	105
			>;

			samsung,panel-hmt_150cd-read-cmds = [06 01 00 00 00 00 01 B4 1E 01];	/* read B4 2~31th , 1=0x01*/

			samsung,hmt-panel-bright-cmds-list = [
					29 01 00 00 00 00 03 F0 5A 5A
					29 01 00 00 00 00 24
						CA 01 00 01 00 01 00 80
						80 80 80 80 80 80 80 80
						80 80 80 80 80 80 80 80
						80 80 80 80 80 80 80 00
						00 00 00 00
					29 01 00 00 00 00 07 B2 00 00 00 00 00 00
					29 01 00 00 00 00 03 B6 00 0A
					29 01 00 00 00 00 03 F4 8B 21
					29 01 00 00 01 00 02 F7 03
					29 01 00 00 00 00 02 F7 00
					29 01 00 00 00 00 03 F0 A5 A5
				];
			samsung,panel-hmt-single-scan-enable = [
					29 01 00 00 00 00 03 F0 5A 5A
					29 01 00 00 00 00 02 B0 03
					29 01 00 00 00 00 03 F2 0A 06
					29 01 00 00 00 00 02 B0 05
					29 01 00 00 00 00 02 B2 00
					29 01 00 00 00 00 02 B0 06
					29 01 00 00 00 00 02 F3 10
					29 01 00 00 00 00 05 2B 00 00 09 FF
					29 01 00 00 00 00 03 F0 A5 A5
				];

			samsung,panel-hmt-disable = [
					29 01 00 00 00 00 03 F0 5A 5A
					29 01 00 00 00 00 02 B0 03
					29 01 00 00 00 00 03 F2 06 0A
					29 01 00 00 00 00 02 B0 05
					29 01 00 00 00 00 02 B2 40
					29 01 00 00 00 00 02 F7 03
					29 01 00 00 00 00 02 F7 00
					29 01 00 00 00 00 03 F0 A5 A5
				];
			samsung,panel-hmt-reverse-enable = [
					29 01 00 00 00 00 03 F0 5A 5A
					29 01 00 00 00 00 02 B0 09
					29 01 00 00 00 00 02 CB 0B
					29 01 00 00 00 00 02 B0 0F
					29 01 00 00 00 00 02 CB 09
					29 01 00 00 00 00 02 B0 1D
					29 01 00 00 00 00 02 CB 10
					29 01 00 00 00 00 02 B0 3D
					29 01 00 00 00 00 02 CB 0C
					29 01 00 00 00 00 02 F7 03
					29 01 00 00 00 00 02 F7 00
					29 01 00 00 00 00 03 F0 A5 A5
				];
			samsung,panel-hmt-reverse-disable = [
					29 01 00 00 00 00 03 F0 5A 5A
					29 01 00 00 00 00 02 B0 09
					29 01 00 00 00 00 02 CB 09
					29 01 00 00 00 00 02 B0 0F
					29 01 00 00 00 00 02 CB 05
					29 01 00 00 00 00 02 B0 3D
					29 01 00 00 00 00 02 CB 0B
					29 01 00 00 00 00 02 F7 03
					29 01 00 00 00 00 02 F7 00
					29 01 00 00 00 00 03 F0 A5 A5
				];
	};
};
