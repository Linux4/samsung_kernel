/ {
	lcd_mipi_nt35516_qhd: lcd16 {
			hfp = <20>;
			hbp = <20>;
			hsync = <20>;
			vfp = <10>;
			vbp = <10>;
			vsync = <6>;

			work_mode = <1>;
			bpp = <24>;
			lan_number = <3>;
			phy_feq = <500000>;
			h_sync_pol = <0>;
			v_sync_pol = <0>;
			de_pol = <0>;
			te_pol = <0>;
			color_mode_pol = <1>;
			shut_down_pol = <1>;

			width = <540>;
			height = <960>;
			fps = <60>;
			direction = <0>;
			dev_id = <0>;
			type=<2>;
			lcd_id = <0x16>;
			esd_return_code = <156>;
			//low_res_simu;
			simu_width = <480>;
			simu_height = <854>;
			panel_name = "lcd_nt35516_mipi_qhd";
			init_data = [
				39 00 00 05 FF AA 55 25 01
				39 00 00 24 F2 00 00 4A 0A A8 00 00 00 00 00 00 00 00 00 00 00 00 0B 00 00 00 00 00 00 00 00 00 00 40 01 51 00 01 00 01
				39 00 00 08 F3 02 03 07 45 88 D1 0D
				39 00 00 06 F0 55 AA 52 08 00
				39 00 00 04 B1 7C 00 00
				39 00 00 04 B1 7C 06 00
				39 00 00 05 B8 01 02 02 02
				39 00 00 04 BC 00 00 00
				39 00 00 07 C9 63 06 0D 1A 17 00
				39 00 00 06 F0 55 AA 52 08 01
				39 00 00 04 B0 05 05 05
				39 00 00 04 B1 05 05 05
				39 00 00 04 B2 01 01 01
				39 00 00 04 B3 0D 0D 0D
				39 00 00 04 B4 09 09 09
				39 00 00 04 B6 44 44 44
				39 00 00 04 B7 34 34 34
				39 00 00 04 B8 10 10 10
				39 00 00 04 B9 36 36 36
				39 00 00 04 BA 24 24 24
				39 00 00 04 BC 00 D0 00
				39 00 00 04 BD 00 D0 00
				15 00 00 02 BE 5D
				39 00 00 03 C0 04 00
				15 00 00 02 CA 00
				39 00 00 05 D0 0A 10 0D 0F
				39 00 00 11 D1 00 A7 01 0F 01 34 01 49 01 56 01 75 01 8F 01 B7
				39 00 00 11 D2 01 D1 02 03 02 23 02 57 02 85 02 87 02 AA 02 E1
				39 00 00 11 D3 03 04 03 31 03 42 03 6D 03 83 03 9C 03 AA 03 CD
				39 00 00 05 D4 03 EF 03 FF
				39 00 00 11 D5 00 A7 01 0F 01 34 01 49 01 56 01 75 01 8F 01 B7
				39 00 00 11 D6 01 D1 02 03 02 23 02 57 02 85 02 87 02 AA 02 E1
				39 00 00 11 D7 03 04 03 31 03 42 03 6D 03 83 03 9C 03 AA 03 CD
				39 00 00 05 D8 03 EF 03 FF
				39 00 00 11 D9 00 A7 01 0F 01 34 01 49 01 56 01 75 01 8F 01 B7
				39 00 00 11 DD 01 D1 02 03 02 23 02 57 02 85 02 87 02 AA 02 E1
				39 00 00 11 DE 03 04 03 31 03 42 03 6D 03 83 03 9C 03 AA 03 CD
				39 00 00 05 DF 03 EF 03 FF
				39 00 00 11 E0 00 A7 01 0F 01 34 01 49 01 56 01 75 01 8F 01 B7
				39 00 00 11 E1 01 D1 02 03 02 23 02 57 02 85 02 87 02 AA 02 E1
				39 00 00 11 E2 03 04 03 31 03 42 03 6D 03 83 03 9C 03 AA 03 CD
				39 00 00 05 E3 03 EF 03 FF
				39 00 00 11 E4 00 A7 01 0F 01 34 01 49 01 56 01 75 01 8F 01 B7
				39 00 00 11 E5 01 D1 02 03 02 23 02 57 02 85 02 87 02 AA 02 E1
				39 00 00 11 E6 03 04 03 31 03 42 03 6D 03 83 03 9C 03 AA 03 CD
				39 00 00 05 E7 03 EF 03 FF
				39 00 00 11 E8 00 A7 01 0F 01 34 01 49 01 56 01 75 01 8F 01 B7
				39 00 00 11 E9 01 D1 02 03 02 23 02 57 02 85 02 87 02 AA 02 E1
				39 00 00 11 EA 03 04 03 31 03 42 03 6D 03 83 03 9C 03 AA 03 CD
				39 00 00 05 EB 03 EF 03 FF
				15 00 00 02 35 00
				39 00 00 03 44 03 98
				15 00 00 02 3A 77
				15 00 00 02 36 00
				15 00 00 01 22
				15 00 00 01 13
				15 78 00 01 11
				15 00 00 01 29
				];
			sleep_in =  [
				15 0A 00 01 28
				15 78 00 01 10
				];
			sleep_out = [
				15 78 00 01 11
				15 64 00 01 29
				];
			//esd_check = [
			//	37 00 00 02 01 00
			//	];
	};

};



