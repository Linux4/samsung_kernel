&gen_panel {
	dsi_s6d7aa0x11_vid: gen-panel-s6d7aa0x11-video {
		gen-panel-manu = "SDC";			/* condensed manufacturer name */
		gen-panel-name = "s6d7aa0x11";
		gen-panel-id = <0x5EB810>;
		gen-panel-dev-id = <0>;			/* SPRDFB_MAINLCD_ID : MAIN 0, SUB 1 */
		gen-panel-type = <2>;			/* LCD_MODE_DSI: MCU 0, RGB 1, DSI 2 */
		gen-panel-refresh = <57>;
		gen-panel-xres = <800>;
		gen-panel-yres = <1280>;
		gen-panel-width= <94>;			/* screen width in mm */
		gen-panel-height = <150>;		/* screen height in mm */
		gen-panel-work-mode = <1>;		/* SPRDFB_MIPI_MODE_VIDEO : CMD 0, VIDEO 1*/
		gen-panel-direction = <0>;		/* LCD_DIRECT_NORMAL : Normal 0, ROT90 1, ROT180 2, ROT270 3 */
		gen-panel-suspend-mode = <1>;	/* SEND_SLEEP_CMD : RST 0, SLEEP 1 */
		gen-panel-bus-width = <24>;
		gen-panel-lanes = <4>;
		gen-panel-phy-feq = <500000>;
		gen-panel-h-sync-pol = <0>;		/*SPRDFB_POLARITY_POS : POS 0, NEG 1 */
		gen-panel-v-sync-pol = <0>;		/*SPRDFB_POLARITY_POS : POS 0, NEG 1 */
		gen-panel-de-pol = <0>;			/*SPRDFB_POLARITY_POS : POS 0, NEG 1 */
		gen-panel-te-pol = <0>;			/*SPRDFB_POLARITY_POS : POS 0, NEG 1 */
		gen-panel-color-mode-pol = <1>;	/*SPRDFB_POLARITY_POS : POS 0, NEG 1 */
		gen-panel-shut-down-pol = <1>;	/*SPRDFB_POLARITY_POS : POS 0, NEG 1 */
		gen-panel-h-front-porch = <226>; /* hfp */
		gen-panel-h-back-porch = <100>;	/* hbp */
		gen-panel-h-sync-width = <20>;	/* hsync */
		gen-panel-v-front-porch = <14>;	/* vfp */
		gen-panel-v-back-porch = <8>;	/* vbp */
		gen-panel-v-sync-width = <2>;	/* vsync */

		/*
		 * DSI PACKET HEADER INFO
		 * @ delay(msec) : 2byte
		 * @ size of data : 2byte
		 */
		gen-panel-pkt-dinfo-addr-offset = <0>;
		gen-panel-pkt-dinfo-addr-length = <1>;
		gen-panel-pkt-dinfo-data-offset = <1>;
		gen-panel-pkt-dinfo-data-length = <1>;
		gen-panel-init-cmds = [
		    /*  ty lp de    le  */
			39 00 00 00 00 03	F0 5A 5A
			39 00 00 00 00 03	F1 5A 5A
			39 00 00 00 00 03	FC A5 A5
			39 00 00 01 00 03	D0 00 10
			39 00 00 00 00 04	C3 3B 00 2A
			39 00 00 00 00 04	BC 01 4E 0A
			39 00 00 00 00 06	FD 16 10 11 23 09
			39 00 00 00 00 07	FE 00 02 03 21 00 78
			39 00 00 00 00 02	B3 51
			39 00 00 0A 00 04	F2 02 08 08
			05 00 00 78 00 01	11
			39 00 00 00 00 03	F0 A5 A5
			39 00 00 00 00 03	F1 A5 A5
			39 00 00 00 00 03	FC 5A 5A
			05 00 00 00 00 01	35
			05 00 00 00 00 01	29
		];
		gen-panel-enable-cmds = [];
		gen-panel-disable-cmds = [
			05 00 00 28 00 01	28
			05 00 00 78 00 01	10
		];

		gen-panel-backlight-on-cmds = [
			15 00 00 00 00 02	53 2C
		];
		gen-panel-backlight-set-brightness-cmds = [
			15 00 00 00 00 02	51 5F
		];

		gen-panel-read-id = [
			DA 00 01
			DB 00 01
			DC 00 01
		];
		gen-panel-read-status-reg = [0A];
		gen-panel-read-status-ok = [9A];
		status = "okay";
	};
};
