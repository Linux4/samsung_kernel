&gen_panel {
	dsi_s6e3fa3_fhd_ams549ku01_cmd: gen-panel-s6e3fa3-fhd-ams549ku01-cmd {
		gen-panel-manu = "SDC";			/* condensed manufacturer name */
		gen-panel-name = "AMS549KU01";
		gen-panel-id = <0x400001>;
		gen-panel-dev-id = <0>;			/* SPRDFB_MAINLCD_ID : MAIN 0, SUB 1 */
		gen-panel-type = <2>;			/* LCD_MODE_DSI: MCU 0, RGB 1, DSI 2 */
		gen-panel-refresh = <60>;
		gen-panel-xres = <1080>;
		gen-panel-yres = <1920>;
		gen-panel-width= <62>;			/* screen width in mm */
		gen-panel-height = <106>;		/* screen height in mm */
		gen-panel-work-mode = <1>;		/* SPRDFB_MIPI_MODE_VIDEO : CMD 0, VIDEO 1*/
		gen-panel-direction = <0>;		/* LCD_DIRECT_NORMAL : Normal 0, ROT90 1, ROT180 2, ROT270 3 */
		gen-panel-suspend-mode = <1>;	/* SEND_SLEEP_CMD : RST 0, SLEEP 1 */
		gen-panel-bus-width = <24>;
		gen-panel-lanes = <4>;
		gen-panel-phy-feq = <500000>;
		gen-panel-h-sync-pol = <0>;		/*SPRDFB_POLARITY_POS : POS 0, NEG 1 */
		gen-panel-v-sync-pol = <0>;		/*SPRDFB_POLARITY_POS : POS 0, NEG 1 */
		gen-panel-de-pol = <0>;			/*SPRDFB_POLARITY_POS : POS 0, NEG 1 */
		gen-panel-te-pol = <0>;			/*SPRDFB_POLARITY_POS : POS 0, NEG 1 */
		gen-panel-color-mode-pol = <1>;	/*SPRDFB_POLARITY_POS : POS 0, NEG 1 */
		gen-panel-shut-down-pol = <1>;	/*SPRDFB_POLARITY_POS : POS 0, NEG 1 */
		gen-panel-h-front-porch = <18>; /* hfp */
		gen-panel-h-back-porch = <18>;	/* hbp */
		gen-panel-h-sync-width = <10>;	/* hsync */
		gen-panel-v-front-porch = <7>;	/* vfp */
		gen-panel-v-back-porch = <9>;	/* vbp */
		gen-panel-v-sync-width = <2>;	/* vsync */
		gen-panel-octa-tset-param-offset = <0>;
		gen-panel-octa-mps-param-offset = <0>;
		gen-panel-octa-elvss-param-offset = <1>;
		gen-panel-octa-elvss-temp-param-offset = <21>;
		gen-panel-octa-aid-param-offset = <0>;
		gen-panel-octa-hbm-gamma-param-offset = <1>;
		gen-panel-octa-product-reg = [C8];	/* Product Date register */
		gen-panel-octa-product-gpara = <40>;		/* Global parameter should be 'count - 1' */
		gen-panel-octa-coordinate-reg = [A1];	/* Product Date register */
		gen-panel-octa-coordinate-gpara = <0>;		/* Global parameter should be 'count - 1' */
		gen-panel-acl-always-on;

		/*
		 * DSI PACKET HEADER INFO
		 * @ delay(msec) : 2byte
		 * @ size of data : 2byte
		 */
		gen-panel-pkt-dinfo-addr-offset = <0>;
		gen-panel-pkt-dinfo-addr-length = <1>;
		gen-panel-pkt-dinfo-data-offset = <1>;
		gen-panel-pkt-dinfo-data-length = <1>;
		gen-panel-init-cmds = [
			05 00 00 14 00 01	11
			15 00 00 00 00 02	35 00
			39 00 00 00 00 03	F0 5A 5A
			15 00 00 00 00 02	B0 1E
			15 00 00 00 00 02	FD B2
			39 00 00 00 00 03	F0 A5 A5
		];
		gen-panel-post-enable-1-cmds = [
			/* SET BRIGHTNESS */
			05 00 00 00 00 01	2C
			05 00 00 00 00 01	3C
			05 00 00 78 00 01	29
		];
		gen-panel-disable-cmds = [
			05 00 00 14 00 01	28
			05 00 00 96 00 01	10
		];
		gen-panel-nv-read-enable-cmds = [
			39 00 00 00 00 03	F0 5A 5A
		];
		gen-panel-nv-read-disable-cmds = [
			39 00 00 00 00 03	F0 A5 A5
		];
		gen-panel-acl-on-cmds = [
			15 00 00 00 00 02	B5 50
			15 00 00 00 00 02	55 01
		];
		gen-panel-acl-off-cmds = [
			15 00 00 00 00 02	B5 40
			15 00 00 00 00 02	55 00
		];
		gen-panel-hbm-on-cmds = [
			39 00 00 00 00 03	B6 BC 07	/* MPS/ELVSS Setting */
			15 00 00 00 00 02	B5 50		/* OPR Average Calculation */
			15 00 00 00 00 02	53 C0		/* HBM Control */
		];
		gen-panel-hbm-off-cmds = [
			15 00 00 00 00 02	53 00
		];
		gen-panel-tset-cmds = [
			15 00 00 00 00 02	B8 19
			15 00 00 00 00 02	B0 15
			15 00 00 00 00 02	B6 00
		];
		gen-panel-elvss-cmds = [
			39 00 00 00 00 03	B6 BC 07
		];
		gen-panel-aid-cmds = [
			39 00 00 00 00 03	B2 00 10
		];

		gen-panel-tp-table = <
			0 3 11 23 35 51 87 151 203 255
		>;
		gen-panel-mtp-base-table = <
		/*   R     G     B   */
			0x00  0x00  0x00
			0x80  0x80  0x80
			0x80  0x80  0x80
			0x80  0x80  0x80
			0x80  0x80  0x80
			0x80  0x80  0x80
			0x80  0x80  0x80
			0x80  0x80  0x80
			0x80  0x80  0x80
			0x100 0x100 0x100
		>;

		gen-panel-v-coeff-table = <
		/*  num den  */
			0   860
			64  320
			64  320
			64  320
			64  320
			64  320
			64  320
			64  320
			64  320
			72  860
		>;

		gen-panel-vt-coeff-table = <
			0  12  24  36  48  60  72  84
			96 108 138 148 158 168 178 186
		>;
		gen-panel-gray-scale-offset-order = <
			9 8 7 6 5 4 3 2 1
			/* 255 203 151 87 51 35 23 11 3 */
		>;
		gen-panel-rgb-color-offset-order = <
			9 8 7 6 5 4 3 2
			/* 255 203 151 87 51 35 23 11 */
		>;

		/* VREGOUT VOLTAGE 5.8 * 2^22 */
		gen-panel-octa-vregout = <27262976>;

		gen-panel-candela-table = <
			5	6	7	8	9	10	11	12	13	14
			15	16	17	19	20	21	22	24	25	27
			29	30	32	34	37	39	41	44	47	50
			53	56	60	64	68	72	77	82	87	93
			98	105	111	119	126	134	143	152	162	172
			183	195	207	220	234	249	265	282	300	316
			333	360
		>;

		gen-panel-acl-table = <
			0x01	0x01	0x01	0x01	0x01	0x01	0x01	0x01	0x01	0x01
			0x01	0x01	0x01	0x01	0x01	0x01	0x01	0x01	0x01	0x01
			0x01	0x01	0x01	0x01	0x01	0x01	0x01	0x01	0x01	0x01
			0x01	0x01	0x01	0x01	0x01	0x01	0x01	0x01	0x01	0x01
			0x01	0x01	0x01	0x01	0x01	0x01	0x01	0x01	0x01	0x01
			0x01	0x01	0x01	0x01	0x01	0x01	0x01	0x01	0x01	0x01
			0x01	0x01
		>;

		gen-panel-aid-table = <
			0x704C	0x7042	0x7033	0x701E	0x7014	0x7005	0x60F6	0x60E7	0x60D6	0x60C8
			0x60BA	0x60AB	0x60A1	0x6082	0x606B	0x6057	0x6042	0x600D	0x50F8	0x50CE
			0x5098	0x507A	0x5044	0x5022	0x40E4	0x40BE	0x4095	0x4056	0x4021	0x30E3
			0x30A5	0x3064	0x3012	0x20D5	0x20C5	0x20C5	0x20C5	0x20C5	0x20C5	0x20C5
			0x20C5	0x20C5	0x20C5	0x20C5	0x20C5	0x20C5	0x20C5	0x20C5	0x20C5	0x2078
			0x2015	0x10B6	0x1059	0x00F5	0x0084	0x0010	0x0010	0x0010	0x0010	0x0010
			0x0010	0x0010
		>;

		gen-panel-mps-table = <
			0xAC	0xAC	0xAC	0xAC	0xAC	0xAC	0xAC	0xAC	0xAC	0xAC
			0xAC	0xAC	0xAC	0xAC	0xAC	0xAC	0xAC	0xAC	0xAC	0xAC
			0xAC	0xAC	0xAC	0xAC	0xAC	0xAC	0xBC	0xBC	0xBC	0xBC
			0xBC	0xBC	0xBC	0xBC	0xBC	0xBC	0xBC	0xBC	0xBC	0xBC
			0xBC	0xBC	0xBC	0xBC	0xBC	0xBC	0xBC	0xBC	0xBC	0xBC
			0xBC	0xBC	0xBC	0xBC	0xBC	0xBC	0xBC	0xBC	0xBC	0xBC
			0xBC	0xBC
		>;

		gen-panel-elvss-table = <
			0x07	0x07	0x07	0x07	0x07	0x07	0x07	0x07	0x07	0x07
			0x07	0x07	0x07	0x07	0x07	0x09	0x0B	0x0D	0x0F	0x11
			0x13	0x15	0x17	0x1A	0x1A	0x1A	0x1A	0x1A	0x1A	0x1A
			0x1A	0x1A	0x1A	0x1A	0x1A	0x1A	0x19	0x19	0x19	0x19
			0x19	0x18	0x18	0x17	0x17	0x17	0x17	0x16	0x15	0x14
			0x14	0x13	0x12	0x11	0x10	0x0F	0x0E	0x0D	0x0B	0x0A
			0x07	0x07
		>;

		gen-panel-elvss-temperature-table = <
			/* T > 0 */
			0x00	0x00	0x00	0x00	0x00	0x00	0x00	0x00	0x00	0x00
			0x00	0x00	0x00	0x00	0x00	0x00	0x00	0x00	0x00	0x00
			0x00	0x00	0x00	0x00	0x00	0x00	0x00	0x00	0x00	0x00
			0x00	0x00	0x00	0x00	0x00	0x00	0x00	0x00	0x00	0x00
			0x00	0x00	0x00	0x00	0x00	0x00	0x00	0x00	0x00	0x00
			0x00	0x00	0x00	0x00	0x00	0x00	0x00	0x00	0x00	0x00
			0x00	0x00

			/* 0 >= T > -20 */
			0x1B	0x1B	0x1B	0x1B	0x1B	0x1B	0x1B	0x1B	0x1B	0x1B
			0x1B	0x1B	0x1B	0x1B	0x1B	0x19	0x18	0x17	0x16	0x15
			0x14	0x13	0x00	0x00	0x00	0x00	0x00	0x00	0x00	0x00
			0x00	0x00	0x00	0x00	0x00	0x00	0x00	0x00	0x00	0x00
			0x00	0x00	0x00	0x00	0x00	0x00	0x00	0x00	0x00	0x00
			0x00	0x00	0x00	0x00	0x00	0x00	0x00	0x00	0x00	0x00
			0x00	0x00

			/* -20 > T */
			0x1F	0x1F	0x1F	0x1F	0x1F	0x1F	0x1F	0x1F	0x1F	0x1F
			0x1F	0x1F	0x1F	0x1F	0x1F	0x1E	0x1D	0x1C	0x1A	0x18
			0x16	0x14	0x00	0x00	0x00	0x00	0x00	0x00	0x00	0x00
			0x00	0x00	0x00	0x00	0x00	0x00	0x00	0x00	0x00	0x00
			0x00	0x00	0x00	0x00	0x00	0x00	0x00	0x00	0x00	0x00
			0x00	0x00	0x00	0x00	0x00	0x00	0x00	0x00	0x00	0x00
			0x00	0x00
		>;

		gen-panel-base-lux-table = <
			114 114 114 114 114 114 114 114 114 114
			114 114 114 114 114 114 114 114 114 114
			114 114 114 114 114 114 114 114 114 114
			114 114 114 114 121 127 135 144 151 159
			169 179 189 201 212 224 238 251 264 264
			264 264 264 264 264 264 278 296 310 325
			342 360
		>;

		gen-panel-gamma-curve-table = <
			215	215	215	215	215	215	215	215	215	215
			215	215	215	215	215	215	215	215	215	215
			215	215	215	215	215	215	215	215	215	215
			215	215	215	215	215	215	215	215	215	215
			215	215	215	215	215	215	215	215	215	215
			215	215	215	215	215	215	215	215	215	215
			215	220
		>;

		gen-panel-candela-compensation-table = <
		/*V255 V203 V151 V87  V51  V35  V23  V11   V3 */
			0    3    1    1    4    6    8   10   12
			0    1  (-3) (-2)   2    4    6    8   10
			0    2  (-1) (-1)   2    3    7    7    8
			0    5    4    3    4    5    8    7    8
			0    1  (-4) (-3)   0    1    5    8    8
			0    2    0  (-1)   1    2    5    8    8
			0    1  (-3) (-4) (-1)   0    4    7    8
			0    2  (-1) (-3) (-1)   0    3    6    8
			0    2  (-1) (-2)   0    1    4    6    7
			0    2  (-2) (-2) (-1)   0    3    5    7
			0    2  (-1) (-2) (-1)   0    3    5    7
			0    2  (-1) (-2)   0    0    3    5    7
			0    3    0  (-1)   0    0    3    5    0
			0    2  (-1) (-3) (-1) (-1)   2    4    6
			0    3    0  (-1)   0    0    2    4    6
			0    2  (-2) (-2) (-1) (-1)   2    4    7
			0    2  (-1) (-2) (-1) (-1)   2    4    7
			0    3    2    1    2    2    4    6    8
			0    2  (-1) (-1)   0    0    3    5    7
			0    3    2    2    2    1    4    6    8
			0    2    0    0    1    1    4    6    8
			0    2    1    1    1    1    4    6    8
			0    4    3    3    2    1    4    6    8
			0    3    2    2    2    1    4    6    8
			0    3    2    2    2    1    3    5    7
			0    3    2    2    2    1    3    5    7
			0    3    2    2    2    1    3    5    7
			0    3    2    2    2    1    3    5    7
			0    3    2    2    2    1    3    4    6
			0    3    2    1    1    1    3    4    6
			0    2    1    0    0    0    2    3    5
			0    2    1    0    0    0    2    3    5
			0    2    1    0    0    0    2    3    5
			0    2    1    0    0  (-1)   1    2    4
			0    3    1    1    0    0    1    3    5
			0    4    4    3    2    2    3    4    6
			0    2    3    3    1    1    1    2    5
			0    3    3    2    1    1    2    3    5
			0    4    4    3    1    1    2    3    5
			0    2    3    3    1    0    0    2    4
			0    3    4    3    1    1    1    3    5
			0    3    5    3    1    0    1    2    5
			0    3    4    3    2    1    1    2    5
			0    4    7    5    1    1    1    3    5
			0    3    4    3    1    0    1    2    3
			0    4    6    4    2    0    0    1    3
			0    3    4    2    0  (-1) (-1)   0    2
			0    2    2    0  (-2) (-3) (-2)   0    2
			0    2    4    3    1    0    0    1    2
			0    2    4    3    1    0    0    1    2
			0    2    3    3    1    0    0    1    2
			0    2    3    3    1    0    0    1    2
			0    2    2    2    0  (-1) (-1)   0    1
			0    2    2    2    0  (-1) (-1)   0    0
			0    1    2    1  (-1) (-2) (-1)   0    0
			0    1    3    3    2    1    1    2    3
			0    2    3    2    2    1    1    2    2
			0    0    2    1    2    2    1    1    2
			0  (-1)   1    1    1    1    0    1    1
			0  (-1)   0    0    1    0    0    1    1
			0  (-1)   0  (-1) (-1) (-1)   0    0    1
			0    0    0    0    0    0    0    0    0
		>;

		gen-panel-rgb-compensation-table = <
		/* R255 G255 B255 R203 G203 B203 R151 G151 B151 R87  G87  B87  R51  G51  B51  R35  G35  B35  R23  G23  B23  R11  G11  B11 */
			(-1) (-2)   1  (-1) (-1) (-1)   1    0    1    3    1    3    3    1    3    5    2    4   10    6    6   17   11   10
			  1    0    3    1    1    1    2    1    2    2    1    2    3    2    3    4    1    3   14    8    7   17   11   10
			  0  (-1)   2    0    0    0    2    1    2    2    1    2    4    1    3    5    4    4    3  (-3)   0   28   22   16
			(-4) (-4) (-2) (-2) (-3) (-2) (-1) (-2)   0    1  (-1)   1    2    1    3    4    2    3    3  (-2)   1   30   26   18
			  0    0    2    1    1    1    4    3    3    3    1    1    3    3    4    5    5    4    3  (-2) (-1)   6    0    2
			(-1) (-1)   1    0    0    0    1    0    1    3    1    2    3    3    4    4    2    2    6    3    2    6  (-2)   2
			  0    0    2    1    1    1    3    2    3    6    4    4    3    3    4    4    4    2    2  (-1) (-1)   4  (-2)   2
			  0    0    2    0    0    0    1    1    1    6    4    5    4    4    5    4    4    2    7    5    2    5  (-4)   1
			(-1) (-1)   1    1    1    1    1    0    0    3    3    3    3    3    4    1    1    1    5    2    0    3  (-4)   0
			  0    0    2    1    1    1    2    1    1    2    1    1    6    6    6    3    3    2    5    2    0   10    2    4
			  0    0    2    0    0    0    2    1    1    2    2    2    7    6    7    2    2    1    5    1    0    8    2    3
			  0    0    2    0    0    0    2    1    1    2    2    2    2    2    3    6    6    3    4    1    0    7    0    2
			(-1) (-1)   1  (-1)   0  (-1)   3    1    1    1    1    1    5    4    5    5    5    2    3    0  (-1)   7  (-1)   2
			  0    0    1    0    0    0    2    1    1    4    4    5    2    3    3    7    6    3    2    0  (-2)   5  (-2)   0
			(-1) (-1)   0    0    0    0    1    0  (-1)   2    2    3    3    3    3    5    4    2    7    6    2    5  (-3)   0
			  0    0    1    1    1    1    3    2    1    2    2    2    4    4    5    6    7    2    3    1  (-2)   6    0    0
			  0    0    1    1    1    1    2    1    1    3    3    3    6    6    6    6    7    2    3    2  (-2)   6    3    0
			(-1) (-1)   0    0    0    0    0    0  (-1)   2    1    2    1    1    1    2    3    2    5    4    0    6    2    0
			  0    0    1    1    1    1    3    3    2    2    2    2    4    5    4    5    6    1    4    2  (-2)   7    4    0
			(-1)   0    0    0    0    0    1    1    0    1    1    1    3    3    3    5    7    3    3    2  (-3)   5    3  (-1)
			  0    1    1    1    1    1    2    2    1    2    2    2    3    3    3    3    4    0    2    3  (-3)   5    3  (-2)
 			  0    1    1    1    1    1    1    1    0    3    3    3    4    4    4    4    5    0    2    3  (-4)   6    4  (-1)
			(-1)   0    0    0    0    0    1    0    0    2    2    2    5    5    5    6    7    3    1    2  (-5)   6    5  (-1)
			  0    1    1    0    0    0    2    2    1    2    2    2    3    4    3    6    7    3    1    2  (-5)   4    3  (-2)
			  0    1    1    0    0    0    1    1    0    3    3    3    2    3    2    6    7    3    5    7  (-1)   5    4  (-2)
			(-1)   0    0    1    1    1    1    1    0    2    2    2    3    4    3    4    6    2    6    7  (-1)   3    2  (-3)
			(-1)   0    0    1    1    1    1    1    0    2    2    2    3    4    3    4    6    2    5    6  (-1)   2    1  (-4)
			(-1)   0    0    1    1    1    1    1    0    2    2    2    2    3    2    5    6    3    4    6  (-2)   1  (-1) (-4)
			(-1)   0    0    1    1    1    1    1    0    2    2    2    2    3    2    5    6    3    3    5  (-2)   7    6  (-1)
			(-1)   0    0    0    1    0    2    1    1    4    5    4    3    3    3    1    2  (-1)   4    5  (-2)   5    4  (-2)
			  0    1    1    1    1    1    1    1    0    4    5    4    6    5    6    2    4  (-1)   5    5  (-2)   5    6    1
			  0    1    1    1    1    1    1    1    0    4    5    4    5    5    5    2    3  (-1)   4    5  (-2)   5    5    1
			  0    1    1    1    1    1    1    1    0    4    5    4    5    4    5    2    4  (-1)   4    4  (-2)   2    4    0
			  0    1    1    1    1    1    1    1    0    4    5    4    5    5    5    8    9    4    1    4  (-4)   4    5    2
			  0    1    1    0    1    1    3    2    1    2    3    2    5    5    5    5    7    2    3    3  (-3)   1    1  (-1)
			(-1)   0    0    0    0    0    1    1    1    2    1    1    1    1    2    3    3    1    2    4  (-1)   4    4  (-1)
			  0    0    1    0    1    1    1    1    0    2    2    2    3    3    3    6    6    4    4    5  (-2)   4    6    1
			(-1)   0    0    0    1    1    1    2    1    3    3    3    1    1    2    5    6    3    1    2  (-2)   2    3  (-2)
			  0    0    1    0    1    1    1    1    0    2    3    2    3    3    3    4    4    2    4    6  (-1)   1    1  (-3)
			  1    1    2    1    1    1    1    2    1    2    2    2    5    4    4    7    8    5    6    8    0    1    2  (-1)
			(-1)   0    0    0    1    1    2    3    1    2    2    2    2    3    2    5    5    3    7    9    1  (-1) (-1) (-4)
			  0    0    0    0    1    1    1    1    1    3    2    2    3    3    3    6    7    5    1    2  (-3)   3    4  (-1)
			  0    0    1    0    1    1    1    1    0    2    1    1    4    4    4    5    6    3    4    6    0    2    3  (-1)
			(-1)   0    0    0    0    0    0    1    0    3    2    2    6    6    6    3    4    1    2    4  (-1)   0    1  (-2)
			  0    0    1    0    1    1    2    1    1    3    2    2    3    4    3    6    7    4    2    3  (-1)   6    7    1
			  0    0    1    0    2    1    0    1    0    2    2    2    3    2    3    7    7    6    6    7    2    4    6    0
			  0    0    2    1    1    0    2    2    1    3    4    3    5    5    5    9   10    6    7    9    2    6    8    2
			  1    1    2    1    1    1    2    3    1    4    4    4    7    8    6    8    9    5    4    5    0    4    7    1
			  0    0    2    1    1    1    2    2    1    2    3    2    3    4    4    3    4    2    6    8    3    7    8    3
			  0    0    1    0    1    1    1    1    1    2    3    2    3    4    3    4    5    4    6    7    2    5    6    2
			  0    0    1    0    1    1    2    1    1    2    2    2    3    3    3    3    5    2    6    7    3    4    5    2
			  0    0    1    0    1    1    1    0    0    2    2    2    4    4    4    3    4    2    6    7    3    2    3    0
			  0    0    1    0    1    1    2    1    1    2    2    2    3    3    4    5    5    3    7    9    4    4    4    2
			  0    0    1    0    1    1    2    1    1    2    2    2    3    2    3    5    6    4    6    7    3    3    4    2
			  0    0    1    1    1    1    2    2    1    2    3    2    4    4    4    6    6    4    2    3    0    2    3    2
			  0    0    0    0    0    0    0    0    0    0    0    0    0    0    0    0    0    0    0    0    0    0    0    0
			  0    0    0    0    0    0    0    0    0    0    0    0    0    0    0    0    0    0    0    0    0    0    0    0
			  0    0    0    0    0    0    0    0    0    0    0    0    0    0    0    0    0    0    0    0    0    0    0    0
			  0    0    0    0    0    0    0    0    0    0    0    0    0    0    0    0    0    0    0    0    0    0    0    0
			  0    0    0    0    0    0    0    0    0    0    0    0    0    0    0    0    0    0    0    0    0    0    0    0
			  0    0    0    0    0    0    0    0    0    0    0    0    0    0    0    0    0    0    0    0    0    0    0    0
			  0    0    0    0    0    0    0    0    0    0    0    0    0    0    0    0    0    0    0    0    0    0    0    0
		>;

		gen-panel-gamma-cmds = [
			39 00 00 00 00 24	CA 01 00 01 00 01 00 80 80 80 80 80 80 80 80 80
								80 80 80 80 80 80 80 80 80 80 80 80 80 80 80 00
								00 00 00 00
		];
		gen-panel-gamma-update-cmds = [
			15 00 00 05 00 02	F7 03
		];
		gen-panel-read-hbm = [B4 00 21];
		gen-panel-read-mtp = [C8 00 21];
		gen-panel-read-id = [
			DA 00 01
			DB 00 01
			DC 00 01
		];
		gen-panel-read-status-reg = [0A];
		gen-panel-read-status-ok = [9A];
		status = "okay";

		/* #################### MDNIE SETTINGS #################### */
		gen-panel-mdnie-color-adjustment-mode-reg = [EC];
		gen-panel-mdnie-color-adjustment-mode-offset = <125>;

		gen-panel-mdnie-negative-mode-cmds = [
			39 00 00 00 00 9B	EC 98 24 00 B3 01 0E 01 00 66 17 03 96 00 FF 00
								00 07 FF 07 FF 14 00 0A 00 32 01 F4 0B 8A 20 2D
								6E 99 1B 17 14 1E 02 5F 02 C8 03 33 02 22 10 10
								07 07 01 00 00 20 00 20 00 20 00 20 00 20 00 20
								00 20 00 20 00 20 00 20 00 20 00 20 00 20 00 20
								00 20 00 20 00 20 00 20 00 20 00 20 00 20 00 20
								00 20 00 FF 00 67 A9 0C 0C 0C 0C 00 AA AB 00 AA
								AB 00 AA AB 00 AA AB D5 2C 2A FF F5 63 FE 4A FF
								FF F9 F8 FF 00 00 FF 00 FF 00 FF FF 00 00 FF 00
								FF 00 FF FF 00 00 FF 00 FF 00 FF
			39 00 00 00 00 04	EB 01 00 30
		];

		gen-panel-mdnie-color-adjustment-mode-cmds = [
			39 00 00 00 00 9B	EC 98 24 00 B3 01 0E 01 00 66 17 03 96 00 FF 00
								00 07 FF 07 FF 14 00 0A 00 32 01 F4 0B 8A 20 2D
								6E 99 1B 17 14 1E 02 5F 02 C8 03 33 02 22 10 10
								07 07 01 00 00 20 00 20 00 20 00 20 00 20 00 20
								00 20 00 20 00 20 00 20 00 20 00 20 00 20 00 20
								00 20 00 20 00 20 00 20 00 20 00 20 00 20 00 20
								00 20 00 FF 00 67 A9 0C 0C 0C 0C 00 AA AB 00 AA
								AB 00 AA AB 00 AA AB D5 2C 2A FF F5 63 FE 4A FF
								FF F9 F8 00 FF FF 00 FF 00 FF 00 00 FF FF 00 FF
								00 FF 00 00 FF FF 00 FF 00 FF 00
			39 00 00 00 00 04	EB 01 00 30
		];

		gen-panel-mdnie-dark-screene-mode-cmds = [
			39 00 00 00 00 9B	EC 98 24 00 B3 01 0E 01 00 66 17 03 96 00 FF 00
								00 07 FF 07 FF 14 00 0A 00 32 01 F4 0B 8A 20 2D
								6E 99 1B 17 14 1E 02 5F 02 C8 03 33 02 22 10 10
								07 07 01 00 00 20 00 20 00 20 00 20 00 20 00 20
								00 20 00 20 00 20 00 20 00 20 00 20 00 20 00 20
								00 20 00 20 00 20 00 20 00 20 00 20 00 20 00 20
								00 20 00 FF 00 67 A9 0C 0C 0C 0C 00 AA AB 00 AA
								AB 00 AA AB 00 AA AB D5 2C 2A FF F5 63 FE 4A FF
								FF F9 F8 00 00 00 00 00 00 00 00 00 00 00 00 00
								00 00 00 00 00 00 00 00 00 00 00
			39 00 00 00 00 04	EB 01 00 30
		];

		gen-panel-mdnie-gray-scale-cmds = [
			39 00 00 00 00 9B	EC 98 24 00 B3 01 0E 01 00 66 17 03 96 00 FF 00
								00 07 FF 07 FF 14 00 0A 00 32 01 F4 0B 8A 20 2D
								6E 99 1B 17 14 1E 02 5F 02 C8 03 33 02 22 10 10
								07 07 01 00 00 20 00 20 00 20 00 20 02 1B 02 1B
								02 1B 02 1B 09 A6 09 A6 09 A6 09 A6 00 20 00 20
								00 20 00 20 00 20 00 20 00 20 00 20 00 20 00 20
								00 20 00 FF 00 67 A9 0C 0C 0C 0C 00 AA AB 00 AA
								AB 00 AA AB 00 AA AB D5 2C 2A FF F5 63 FE 4A FF
								FF F9 F8 B3 4C B3 4C B3 4C 69 96 69 96 69 96 E2
								1D E2 1D E2 1D FF 00 FF 00 FF 00
			39 00 00 00 00 04	EB 01 00 30
		];

		gen-panel-mdnie-gray-scale-negative-cmds = [
			39 00 00 00 00 9B	EC 98 24 00 B3 01 0E 01 00 66 17 03 96 00 FF 00
								00 07 FF 07 FF 14 00 0A 00 32 01 F4 0B 8A 20 2D
								6E 99 1B 17 14 1E 02 5F 02 C8 03 33 02 22 10 10
								07 07 01 00 00 20 00 20 00 20 00 20 02 1B 02 1B
								02 1B 02 1B 09 A6 09 A6 09 A6 09 A6 00 20 00 20
								00 20 00 20 00 20 00 20 00 20 00 20 00 20 00 20
								00 20 00 FF 00 67 A9 0C 0C 0C 0C 00 AA AB 00 AA
								AB 00 AA AB 00 AA AB D5 2C 2A FF F5 63 FE 4A FF
								FF F9 F8 4C B3 4C B3 4C B3 96 69 96 69 96 69 1D
								E2 1D E2 1D E2 00 FF 00 FF 00 FF
			39 00 00 00 00 04	EB 01 00 30
		];

		gen-panel-mdnie-hbm-cmds = [
			39 00 00 00 00 9B	EC 86 0C 00 F0 01 0E 01 00 66 17 00 96 04 FF 00
								30 00 A0 00 A0 14 00 0A 00 32 01 F4 0B 8A 20 2D
								6E 99 1B 17 14 1E 02 5F 02 C8 03 33 02 22 10 10
								07 07 01 40 00 6B 03 48 08 32 08 32 08 32 08 32
								08 32 10 28 10 28 10 28 10 28 10 28 19 22 19 22
								19 22 19 22 19 22 19 22 23 1E 2E 1B 33 1A 40 18
								48 17 00 FF 00 6A 9A 25 1A 16 2A 00 37 5A 00 4E
								C5 00 5D 17 00 30 C3 FF 38 48 FF F0 00 D8 00 D9
								FF FF FF 00 E0 FF 00 F6 00 D8 3B 00 FF D9 00 FF
								14 F9 00 00 FF FF 00 FF 00 FF 00
			39 00 00 00 00 04	EB 01 00 3F
		];
		gen-panel-mdnie-hbm-text-cmds = [
			39 00 00 00 00 9B	EC 86 0C 00 F0 01 0E 01 00 66 17 00 96 04 FF 00
								30 00 A0 00 A0 14 00 0A 00 32 01 F4 0B 8A 20 2D
								6E 99 1B 17 14 1E 02 5F 02 C8 03 33 02 22 10 10
								07 07 01 40 00 6B 03 48 08 32 08 32 08 32 08 32
								08 32 10 28 10 28 10 28 10 28 10 28 19 22 19 22
								19 22 19 22 19 22 19 22 23 1E 2E 1B 33 1A 40 18
								48 17 00 FF 00 6A 9A 25 1A 16 2A 00 37 5A 00 4E
								C5 00 5D 17 00 30 C3 FF 38 48 FF F0 00 D8 00 D9
								FF FF FF 00 E0 FF 00 F6 00 D8 3B 00 FF D9 00 FF
								14 F9 00 00 FF FF 00 FF 00 FF 00
			39 00 00 00 00 04	EB 01 00 3F
		];


		/* STANDARD MODE */
		gen-panel-mdnie-ui-mode-cmds = [
			39 00 00 00 00 9B	EC 98 24 00 B3 01 0E 01 00 66 17 03 96 00 FF 00
								10 00 A0 00 A0 14 00 01 00 01 00 28 00 01 28 3C
								A9 67 27 19 29 17 01 A4 02 8F 01 90 02 C8 20 20
								07 07 01 00 00 20 00 20 00 20 00 20 00 20 00 20
								00 20 00 20 00 20 00 20 00 20 00 20 00 20 00 20
								00 20 00 20 00 20 00 20 00 20 00 20 00 20 00 20
								00 20 00 FF 40 6A 9A 25 1A 16 2A 00 37 5A 00 4E
								C5 00 5D 17 00 30 C3 FF 38 48 FF F0 00 D8 00 D9
								FF FF FF 05 EC EE 30 E9 30 FA 00 3E E2 E7 28 F0
								38 E9 23 42 DF FF 00 FA 00 F0 00
			39 00 00 00 00 04	EB 01 00 3C
		];

		gen-panel-mdnie-video-mode-cmds = [
			39 00 00 00 00 9B	EC 98 24 00 B3 01 0E 01 00 66 17 03 96 00 FF 00
								10 00 40 00 40 14 00 01 00 01 00 28 00 01 28 3C
								A9 67 27 19 29 17 01 A4 02 8F 01 90 02 C8 20 20
								07 07 01 00 00 20 00 20 00 20 00 20 00 20 00 20
								00 20 00 20 00 20 00 20 00 20 00 20 00 20 00 20
								00 20 00 20 00 20 00 20 00 20 00 20 00 20 00 20
								00 20 00 FF 40 6A 9A 25 1A 16 2A 00 37 5A 00 4E
								C5 00 5D 17 00 30 C3 FF 38 48 FF F0 00 D8 00 D9
								FF FF FF 05 EC EE 30 E9 30 FA 00 3E E2 E7 28 F0
								38 E9 23 42 DF FF 00 FA 00 F0 00
			39 00 00 00 00 04	EB 01 00 3C
		];

		gen-panel-mdnie-camera-mode-cmds = [
			39 00 00 00 00 9B	EC 98 24 00 B3 01 0E 01 00 66 17 03 96 00 FF 00
								10 00 A0 00 A0 14 00 01 00 01 00 28 00 01 28 3C
								A9 67 27 19 29 17 01 A4 02 8F 01 90 02 C8 20 20
								07 07 01 00 00 20 00 20 00 20 00 20 00 20 00 20
								00 20 00 20 00 20 00 20 00 20 00 20 00 20 00 20
								00 20 00 20 00 20 00 20 00 20 00 20 00 20 00 20
								00 20 00 FF 40 6A 9A 25 1A 16 2A 00 37 5A 00 4E
								C5 00 5D 17 00 30 C3 FF 38 48 FF F0 00 D8 00 D9
								FF FF FF 05 EC EE 30 E9 30 FA 00 3E E2 E7 28 F0
								38 E9 23 42 DF FF 00 FA 00 F0 00
			39 00 00 00 00 04	EB 01 00 3C
		];

		gen-panel-mdnie-gallery-mode-cmds = [
			39 00 00 00 00 9B	EC 98 24 00 B3 01 0E 01 00 66 17 03 96 00 FF 00
								10 00 A0 00 A0 14 00 01 00 01 00 28 00 01 28 3C
								A9 67 27 19 29 17 01 A4 02 8F 01 90 02 C8 20 20
								07 07 01 00 00 20 00 20 00 20 00 20 00 20 00 20
								00 20 00 20 00 20 00 20 00 20 00 20 00 20 00 20
								00 20 00 20 00 20 00 20 00 20 00 20 00 20 00 20
								00 20 00 FF 40 6A 9A 25 1A 16 2A 00 37 5A 00 4E
								C5 00 5D 17 00 30 C3 FF 38 48 FF F0 00 D8 00 D9
								FF FF FF 05 EC EE 30 E9 30 FA 00 3E E2 E7 28 F0
								38 E9 23 42 DF FF 00 FA 00 F0 00
			39 00 00 00 00 04	EB 01 00 3C
		];

		gen-panel-mdnie-vt-mode-cmds = [
			39 00 00 00 00 9B	EC 98 24 00 B3 01 0E 01 00 66 17 03 96 00 FF 00
								10 00 A0 00 A0 14 00 01 00 01 00 28 00 01 28 3C
								A9 67 27 19 29 17 01 A4 02 8F 01 90 02 C8 20 20
								07 07 01 00 00 20 00 20 00 20 00 20 00 20 00 20
								00 20 00 20 00 20 00 20 00 20 00 20 00 20 00 20
								00 20 00 20 00 20 00 20 00 20 00 20 00 20 00 20
								00 20 00 FF 40 6A 9A 25 1A 16 2A 00 37 5A 00 4E
								C5 00 5D 17 00 30 C3 FF 38 48 FF F0 00 D8 00 D9
								FF FF FF 05 EC EE 30 E9 30 FA 00 3E E2 E7 28 F0
								38 E9 23 42 DF FF 00 FA 00 F0 00
			39 00 00 00 00 04	EB 01 00 3C
		];

		gen-panel-mdnie-browser-mode-cmds = [
			39 00 00 00 00 9B	EC 98 24 00 B3 01 0E 01 00 66 17 03 96 00 FF 00
								10 00 A0 00 A0 14 00 01 00 01 00 28 00 01 28 3C
								A9 67 27 19 29 17 01 A4 02 8F 01 90 02 C8 20 20
								07 07 01 00 00 20 00 20 00 20 00 20 00 20 00 20
								00 20 00 20 00 20 00 20 00 20 00 20 00 20 00 20
								00 20 00 20 00 20 00 20 00 20 00 20 00 20 00 20
								00 20 00 FF 40 6A 9A 25 1A 16 2A 00 37 5A 00 4E
								C5 00 5D 17 00 30 C3 FF 38 48 FF F0 00 D8 00 D9
								FF FF FF 05 EC EE 30 E9 30 FA 00 3E E2 E7 28 F0
								38 E9 23 42 DF FF 00 FA 00 F0 00
			39 00 00 00 00 04	EB 01 00 3C
		];

		gen-panel-mdnie-ebook-mode-cmds = [
			39 00 00 00 00 9B	EC 98 24 00 B3 01 0E 01 00 66 17 03 96 00 FF 00
								10 00 A0 00 A0 14 00 01 00 01 00 28 00 01 28 3C
								A9 67 27 19 29 17 01 A4 02 8F 01 90 02 C8 20 20
								07 07 01 00 00 20 00 20 00 20 00 20 00 20 00 20
								00 20 00 20 00 20 00 20 00 20 00 20 00 20 00 20
								00 20 00 20 00 20 00 20 00 20 00 20 00 20 00 20
								00 20 00 FF 40 6A 9A 25 1A 16 2A 00 37 5A 00 4E
								C5 00 5D 17 00 30 C3 FF 38 48 FF F0 00 D8 00 D9
								FF FF FF 05 EC EE 30 E9 30 FA 00 3E E2 E7 28 F0
								38 E9 23 42 DF FF 00 FA 00 F0 00
			39 00 00 00 00 04	EB 01 00 3C
		];

		gen-panel-mdnie-email-mode-cmds = [
			39 00 00 00 00 9B	EC 98 24 00 B3 01 0E 01 00 66 17 03 96 00 FF 00
								28 00 A0 00 A0 14 00 01 00 01 00 28 00 01 28 3C
								A9 67 27 19 29 17 01 A4 02 8F 01 90 02 C8 20 20
								07 07 01 00 00 20 00 20 00 20 00 20 00 20 00 20
								00 20 00 20 00 20 00 20 00 20 00 20 00 20 00 20
								00 20 00 20 00 20 00 20 00 20 00 20 00 20 00 20
								00 20 00 FF 00 6A 9A 25 1A 16 2A 00 37 5A 00 4E
								C5 00 5D 17 00 30 C3 FF 38 48 FF F0 00 D8 00 D9
								FF FF FF 00 FF FF 00 FF 00 FF 00 00 FF FF 00 FF
								00 FF 00 00 FF FF 00 F8 00 EC 00
			39 00 00 00 00 04	EB 01 00 30
		];

		/* AUTO MODE */
		gen-panel-mdnie-auto-ui-mode-cmds = [
			39 00 00 00 00 9B	EC 98 24 00 B3 01 0E 01 00 66 17 03 96 00 FF 00
								28 00 A0 00 A0 14 00 01 00 01 00 28 00 01 28 3C
								A9 67 27 19 29 17 01 A4 02 8F 01 90 02 C8 20 20
								07 07 01 00 00 20 00 20 00 20 00 20 00 20 00 20
								00 20 00 20 00 20 00 20 00 20 00 20 00 20 00 20
								00 20 00 20 00 20 00 20 00 20 00 20 00 20 00 20
								00 20 00 FF 00 6A 9A 25 1A 16 2A 00 37 5A 00 4E
								C5 00 5D 17 00 30 C3 FF 38 48 FF F0 00 D8 00 D9
								FF FF FF 00 FF FF 00 FF 00 FF 00 00 FF FF 00 FF
								00 FF 00 00 FF FF 00 FF 00 FF 00
			39 00 00 00 00 04	EB 01 00 3C
		];

		gen-panel-mdnie-auto-video-mode-cmds = [
			39 00 00 00 00 9B	EC 98 24 00 B3 01 0E 01 00 66 17 03 96 0F FF 00
								28 00 40 00 40 14 00 01 00 01 00 28 00 01 28 3C
								A9 67 27 19 29 17 01 A4 02 8F 01 90 02 C8 20 20
								07 07 01 20 00 14 00 14 00 14 00 14 03 9A 03 9A
								03 9A 03 9A 07 9E 07 9E 07 9E 07 9E 0A A0 0A A0
								0A A0 0A A0 16 A6 16 A6 16 A6 16 A6 05 21 0B 20
								87 0F 00 FF 30 67 A9 37 29 19 47 00 25 3D 00 31
								F4 00 51 EC 00 1C D8 FF 64 78 FF FF 00 FF 00 FF
								FF F4 FF 00 FF FF 00 FF 00 FF 00 00 FF FF 00 FF
								00 FF 00 00 FF FF 00 FF 00 FF 00
			39 00 00 00 00 04	EB 01 00 3C
		];

		gen-panel-mdnie-auto-camera-mode-cmds = [
			39 00 00 00 00 9B	EC 98 24 00 B3 01 0E 01 00 66 17 03 96 00 FF 00
								28 00 A0 00 A0 14 00 01 00 01 00 28 00 01 28 3C
								A9 67 27 19 29 17 01 A4 02 8F 01 90 02 C8 20 20
								07 07 01 00 00 20 00 20 00 20 00 20 00 20 00 20
								00 20 00 20 00 20 00 20 00 20 00 20 00 20 00 20
								00 20 00 20 00 20 00 20 00 20 00 20 00 20 00 20
								00 20 00 FF 30 6A 9A 25 1A 16 2A 00 37 5A 00 4E
								C5 00 5D 17 00 30 C3 FF 40 5B FF F0 00 D8 00 D9
								FF FF FF 00 E0 FF 00 F6 00 D8 3B 00 FF D9 00 FF
								14 F9 00 00 FF FF 00 FF 00 FF 00
			39 00 00 00 00 04	EB 01 00 3C
		];

		gen-panel-mdnie-auto-gallery-mode-cmds = [
			39 00 00 00 00 9B	EC 98 24 00 B3 01 0E 01 00 66 17 03 96 0C FF 00
								28 00 A0 00 A0 14 00 01 00 01 00 28 00 01 28 3C
								A9 67 27 19 29 17 01 A4 02 8F 01 90 02 C8 20 20
								07 07 01 00 00 20 00 20 00 20 00 20 00 20 00 20
								00 20 00 20 00 20 00 20 00 20 00 20 00 20 00 20
								00 20 00 20 00 20 00 20 00 20 00 20 00 20 00 20
								00 20 00 FF 30 6A 9A 25 1A 16 2A 00 37 5A 00 4E
								C5 00 5D 17 00 30 C3 FF 40 5B FF F0 00 D8 00 D9
								FF FF FF 00 E0 FF 00 F6 00 D8 3B 00 FF D9 00 FF
								14 F9 00 00 FF FF 00 FF 00 FF 00
			39 00 00 00 00 04	EB 01 00 3C
		];

		gen-panel-mdnie-auto-vt-mode-cmds = [
			39 00 00 00 00 9B	EC 98 24 00 B3 01 0E 01 00 66 17 03 96 0C FF 00
								28 00 A0 00 A0 14 00 01 00 01 00 28 00 01 28 3C
								A9 67 27 19 29 17 01 A4 02 8F 01 90 02 C8 20 20
								07 07 01 00 00 20 00 20 00 20 00 20 00 20 00 20
								00 20 00 20 00 20 00 20 00 20 00 20 00 20 00 20
								00 20 00 20 00 20 00 20 00 20 00 20 00 20 00 20
								00 20 00 FF 00 6A 9A 25 1A 16 2A 00 37 5A 00 4E
								C5 00 5D 17 00 30 C3 FF 38 48 FF F0 00 D8 00 D9
								FF FF FF 00 FF FF 00 FF 00 FF 00 00 FF FF 00 FF
								00 FF 00 00 FF FF 00 FF 00 FF 00
			39 00 00 00 00 04	EB 01 00 3C
		];

		gen-panel-mdnie-auto-browser-mode-cmds = [
			39 00 00 00 00 9B	EC 98 24 00 B3 01 0E 01 00 66 17 03 96 00 FF 00
								28 00 A0 00 A0 14 00 01 00 01 00 28 00 01 28 3C
								A9 67 27 19 29 17 01 A4 02 8F 01 90 02 C8 20 20
								07 07 01 00 00 20 00 20 00 20 00 20 00 20 00 20
								00 20 00 20 00 20 00 20 00 20 00 20 00 20 00 20
								00 20 00 20 00 20 00 20 00 20 00 20 00 20 00 20
								00 20 00 FF 30 67 A9 17 29 19 27 00 59 0B 00 31
								F4 00 51 EC 00 34 83 FF 5C 70 FF FF 00 FF 00 FF
								FF F8 FF 00 FF FF 00 FF 00 FF 00 00 FF FF 00 FF
								00 FF 00 00 FF FF 00 FF 00 FF 00
			39 00 00 00 00 04	EB 01 00 3C
		];

		gen-panel-mdnie-auto-ebook-mode-cmds = [
			39 00 00 00 00 9B	EC 98 24 00 B3 01 0E 01 00 66 17 03 96 00 FF 00
								28 00 A0 00 A0 14 00 01 00 01 00 28 00 01 28 3C
								A9 67 27 19 29 17 01 A4 02 8F 01 90 02 C8 20 20
								07 07 01 00 00 20 00 20 00 20 00 20 00 20 00 20
								00 20 00 20 00 20 00 20 00 20 00 20 00 20 00 20
								00 20 00 20 00 20 00 20 00 20 00 20 00 20 00 20
								00 20 00 FF 00 6A 9A 25 1A 16 2A 00 37 5A 00 4E
								C5 00 5D 17 00 30 C3 FF 38 48 FF F0 00 D8 00 D9
								FF FF FF 00 FF FF 00 FF 00 FF 00 00 FF FF 00 FF
								00 FF 00 00 FF FF 00 F6 00 E6 00
			39 00 00 00 00 04	EB 01 00 30
		];


		/* DYNAMIC MODE */
		gen-panel-mdnie-dynamic-ui-mode-cmds = [
			39 00 00 00 00 9B	EC 98 24 00 B3 01 0E 01 00 66 17 03 96 03 FF 00
								30 00 A0 00 A0 14 00 01 00 01 00 28 00 01 28 3C
								A9 67 27 19 29 17 01 A4 02 8F 01 90 02 C8 20 20
								07 07 01 20 00 14 00 14 00 14 00 14 03 9A 03 9A
								03 9A 03 9A 07 9E 07 9E 07 9E 07 9E 0A A0 0A A0
								0A A0 0A A0 16 A6 16 A6 16 A6 16 A6 05 21 0B 20
								87 0F 00 FF 30 67 A9 37 29 19 47 00 25 3D 00 31
								F4 00 51 EC 00 1C D8 FF 64 78 FF FF 00 FF 00 FF
								FF F4 FF 00 FF FF 00 FF 00 FF 00 00 FF FF 00 FF
								00 FF 00 00 FF FF 00 FF 00 FF 00
			39 00 00 00 00 04	EB 01 00 3C
		];

		gen-panel-mdnie-dynamic-video-mode-cmds = [
			39 00 00 00 00 9B	EC 98 24 00 B3 01 0E 01 00 66 17 03 96 07 FF 00
								30 00 40 00 40 14 00 01 00 01 00 28 00 01 28 3C
								A9 67 27 19 29 17 01 A4 02 8F 01 90 02 C8 20 20
								07 07 01 20 00 14 00 14 00 14 00 14 03 9A 03 9A
								03 9A 03 9A 07 9E 07 9E 07 9E 07 9E 0A A0 0A A0
								0A A0 0A A0 16 A6 16 A6 16 A6 16 A6 05 21 0B 20
								87 0F 00 FF 30 67 A9 37 29 19 47 00 25 3D 00 31
								F4 00 51 EC 00 1C D8 FF 64 78 FF FF 00 FF 00 FF
								FF F4 FF 00 FF FF 00 FF 00 FF 00 00 FF FF 00 FF
								00 FF 00 00 FF FF 00 FF 00 FF 00
			39 00 00 00 00 04	EB 01 00 3C
		];

		gen-panel-mdnie-dynamic-camera-mode-cmds = [
			39 00 00 00 00 9B	EC 98 24 00 B3 01 0E 01 00 66 17 03 96 03 FF 00
								30 00 A0 00 A0 14 00 01 00 01 00 28 00 01 28 3C
								A9 67 27 19 29 17 01 A4 02 8F 01 90 02 C8 20 20
								07 07 01 20 00 14 00 14 00 14 00 14 03 9A 03 9A
								03 9A 03 9A 07 9E 07 9E 07 9E 07 9E 0A A0 0A A0
								0A A0 0A A0 16 A6 16 A6 16 A6 16 A6 05 21 0B 20
								87 0F 00 FF 30 67 A9 37 29 19 47 00 25 3D 00 31
								F4 00 51 EC 00 1C D8 FF 64 78 FF FF 00 FF 00 FF
								FF F4 FF 00 FF FF 00 FF 00 FF 00 00 FF FF 00 FF
								00 FF 00 00 FF FF 00 FF 00 FF 00
			39 00 00 00 00 04	EB 01 00 3C
		];

		gen-panel-mdnie-dynamic-gallery-mode-cmds = [
			39 00 00 00 00 9B	EC 98 24 00 B3 01 0E 01 00 66 17 03 96 07 FF 00
								30 00 A0 00 A0 14 00 01 00 01 00 28 00 01 28 3C
								A9 67 27 19 29 17 01 A4 02 8F 01 90 02 C8 20 20
								07 07 01 20 00 14 00 14 00 14 00 14 03 9A 03 9A
								03 9A 03 9A 07 9E 07 9E 07 9E 07 9E 0A A0 0A A0
								0A A0 0A A0 16 A6 16 A6 16 A6 16 A6 05 21 0B 20
								87 0F 00 FF 30 67 A9 37 29 19 47 00 25 3D 00 31
								F4 00 51 EC 00 1C D8 FF 64 78 FF FF 00 FF 00 FF
								FF F4 FF 00 FF FF 00 FF 00 FF 00 00 FF FF 00 FF
								00 FF 00 00 FF FF 00 FF 00 FF 00
			39 00 00 00 00 04	EB 01 00 3C
		];

		gen-panel-mdnie-dynamic-vt-mode-cmds = [
			39 00 00 00 00 9B	EC 98 24 00 B3 01 0E 01 00 66 17 03 96 07 FF 00
								30 00 A0 00 A0 14 00 01 00 01 00 28 00 01 28 3C
								A9 67 27 19 29 17 01 A4 02 8F 01 90 02 C8 20 20
								07 07 01 20 00 14 00 14 00 14 00 14 03 9A 03 9A
								03 9A 03 9A 07 9E 07 9E 07 9E 07 9E 0A A0 0A A0
								0A A0 0A A0 16 A6 16 A6 16 A6 16 A6 05 21 0B 20
								87 0F 00 FF 30 67 A9 37 29 19 47 00 25 3D 00 31
								F4 00 51 EC 00 1C D8 FF 64 78 FF FF 00 FF 00 FF
								FF F4 FF 00 FF FF 00 FF 00 FF 00 00 FF FF 00 FF
								00 FF 00 00 FF FF 00 FF 00 FF 00
			39 00 00 00 00 04	EB 01 00 3C
		];

		gen-panel-mdnie-dynamic-browser-mode-cmds = [
			39 00 00 00 00 9B	EC 98 24 00 B3 01 0E 01 00 66 17 03 96 03 FF 00
								30 00 A0 00 A0 14 00 01 00 01 00 28 00 01 28 3C
								A9 67 27 19 29 17 01 A4 02 8F 01 90 02 C8 20 20
								07 07 01 20 00 14 00 14 00 14 00 14 03 9A 03 9A
								03 9A 03 9A 07 9E 07 9E 07 9E 07 9E 0A A0 0A A0
								0A A0 0A A0 16 A6 16 A6 16 A6 16 A6 05 21 0B 20
								87 0F 00 FF 30 67 A9 37 29 19 47 00 25 3D 00 31
								F4 00 51 EC 00 1C D8 FF 64 78 FF FF 00 FF 00 FF
								FF F4 FF 00 FF FF 00 FF 00 FF 00 00 FF FF 00 FF
								00 FF 00 00 FF FF 00 FF 00 FF 00
			39 00 00 00 00 04	EB 01 00 3C
		];

		gen-panel-mdnie-dynamic-ebook-mode-cmds = [
			39 00 00 00 00 9B	EC 98 24 00 B3 01 0E 01 00 66 17 03 96 03 FF 00
								30 00 A0 00 A0 14 00 01 00 01 00 28 00 01 28 3C
								A9 67 27 19 29 17 01 A4 02 8F 01 90 02 C8 20 20
								07 07 01 20 00 14 00 14 00 14 00 14 03 9A 03 9A
								03 9A 03 9A 07 9E 07 9E 07 9E 07 9E 0A A0 0A A0
								0A A0 0A A0 16 A6 16 A6 16 A6 16 A6 05 21 0B 20
								87 0F 00 FF 30 67 A9 37 29 19 47 00 25 3D 00 31
								F4 00 51 EC 00 1C D8 FF 64 78 FF FF 00 FF 00 FF
								FF F4 FF 00 FF FF 00 FF 00 FF 00 00 FF FF 00 FF
								00 FF 00 00 FF FF 00 FF 00 FF 00
			39 00 00 00 00 04	EB 01 00 3C
		];


		/* NATURAL MODE */
		gen-panel-mdnie-natural-ui-mode-cmds = [
			39 00 00 00 00 9B	EC 98 24 00 B3 01 0E 01 00 66 17 03 96 00 FF 00
								10 00 A0 00 A0 14 00 01 00 01 00 28 00 01 28 3C
								A9 67 27 19 29 17 01 A4 02 8F 01 90 02 C8 20 20
								07 07 01 00 00 20 00 20 00 20 00 20 00 20 00 20
								00 20 00 20 00 20 00 20 00 20 00 20 00 20 00 20
								00 20 00 20 00 20 00 20 00 20 00 20 00 20 00 20
								00 20 00 FF 40 6A 9A 25 1A 16 2A 00 37 5A 00 4E
								C5 00 5D 17 00 30 C3 FF 38 48 FF F0 00 D8 00 D9
								FF FF FF A0 CE F2 29 EB 28 DC 90 36 E4 E0 4D F1
								39 EA 1E 57 DB FF 00 FA 00 F0 00
			39 00 00 00 00 04	EB 01 00 3C
		];

		gen-panel-mdnie-natural-video-mode-cmds = [
			39 00 00 00 00 9B	EC 98 24 00 B3 01 0E 01 00 66 17 03 96 00 FF 00
								10 00 40 00 40 14 00 01 00 01 00 28 00 01 28 3C
								A9 67 27 19 29 17 01 A4 02 8F 01 90 02 C8 20 20
								07 07 01 00 00 20 00 20 00 20 00 20 00 20 00 20
								00 20 00 20 00 20 00 20 00 20 00 20 00 20 00 20
								00 20 00 20 00 20 00 20 00 20 00 20 00 20 00 20
								00 20 00 FF 40 6A 9A 25 1A 16 2A 00 37 5A 00 4E
								C5 00 5D 17 00 30 C3 FF 38 48 FF F0 00 D8 00 D9
								FF FF FF A0 CE F2 29 EB 28 DC 90 36 E4 E0 4D F1
								39 EA 1E 57 DB FF 00 FA 00 F0 00
			39 00 00 00 00 04	EB 01 00 3C
		];

		gen-panel-mdnie-natural-camera-mode-cmds = [
			39 00 00 00 00 9B	EC 98 24 00 B3 01 0E 01 00 66 17 03 96 00 FF 00
								10 00 A0 00 A0 14 00 01 00 01 00 28 00 01 28 3C
								A9 67 27 19 29 17 01 A4 02 8F 01 90 02 C8 20 20
								07 07 01 00 00 20 00 20 00 20 00 20 00 20 00 20
								00 20 00 20 00 20 00 20 00 20 00 20 00 20 00 20
								00 20 00 20 00 20 00 20 00 20 00 20 00 20 00 20
								00 20 00 FF 40 6A 9A 25 1A 16 2A 00 37 5A 00 4E
								C5 00 5D 17 00 30 C3 FF 38 48 FF F0 00 D8 00 D9
								FF FF FF A0 CE F2 29 EB 28 DC 90 36 E4 E0 4D F1
								39 EA 1E 57 DB FF 00 FA 00 F0 00
			39 00 00 00 00 04	EB 01 00 3C
		];

		gen-panel-mdnie-natural-gallery-mode-cmds = [
			39 00 00 00 00 9B	EC 98 24 00 B3 01 0E 01 00 66 17 03 96 00 FF 00
								10 00 A0 00 A0 14 00 01 00 01 00 28 00 01 28 3C
								A9 67 27 19 29 17 01 A4 02 8F 01 90 02 C8 20 20
								07 07 01 00 00 20 00 20 00 20 00 20 00 20 00 20
								00 20 00 20 00 20 00 20 00 20 00 20 00 20 00 20
								00 20 00 20 00 20 00 20 00 20 00 20 00 20 00 20
								00 20 00 FF 40 6A 9A 25 1A 16 2A 00 37 5A 00 4E
								C5 00 5D 17 00 30 C3 FF 38 48 FF F0 00 D8 00 D9
								FF FF FF A0 CE F2 29 EB 28 DC 90 36 E4 E0 4D F1
								39 EA 1E 57 DB FF 00 FA 00 F0 00
			39 00 00 00 00 04	EB 01 00 3C
		];

		gen-panel-mdnie-natural-vt-mode-cmds = [
			39 00 00 00 00 9B	EC 98 24 00 B3 01 0E 01 00 66 17 03 96 00 FF 00
								10 00 A0 00 A0 14 00 01 00 01 00 28 00 01 28 3C
								A9 67 27 19 29 17 01 A4 02 8F 01 90 02 C8 20 20
								07 07 01 00 00 20 00 20 00 20 00 20 00 20 00 20
								00 20 00 20 00 20 00 20 00 20 00 20 00 20 00 20
								00 20 00 20 00 20 00 20 00 20 00 20 00 20 00 20
								00 20 00 FF 40 6A 9A 25 1A 16 2A 00 37 5A 00 4E
								C5 00 5D 17 00 30 C3 FF 38 48 FF F0 00 D8 00 D9
								FF FF FF A0 CE F2 29 EB 28 DC 90 36 E4 E0 4D F1
								39 EA 1E 57 DB FF 00 FA 00 F0 00
			39 00 00 00 00 04	EB 01 00 3C
		];

		gen-panel-mdnie-natural-browser-mode-cmds = [
			39 00 00 00 00 9B	EC 98 24 00 B3 01 0E 01 00 66 17 03 96 00 FF 00
								10 00 A0 00 A0 14 00 01 00 01 00 28 00 01 28 3C
								A9 67 27 19 29 17 01 A4 02 8F 01 90 02 C8 20 20
								07 07 01 00 00 20 00 20 00 20 00 20 00 20 00 20
								00 20 00 20 00 20 00 20 00 20 00 20 00 20 00 20
								00 20 00 20 00 20 00 20 00 20 00 20 00 20 00 20
								00 20 00 FF 40 6A 9A 25 1A 16 2A 00 37 5A 00 4E
								C5 00 5D 17 00 30 C3 FF 38 48 FF F0 00 D8 00 D9
								FF FF FF A0 CE F2 29 EB 28 DC 90 36 E4 E0 4D F1
								39 EA 1E 57 DB FF 00 FA 00 F0 00
			39 00 00 00 00 04	EB 01 00 3C
		];

		gen-panel-mdnie-natural-ebook-mode-cmds = [
			39 00 00 00 00 9B	EC 98 24 00 B3 01 0E 01 00 66 17 03 96 00 FF 00
								10 00 A0 00 A0 14 00 01 00 01 00 28 00 01 28 3C
								A9 67 27 19 29 17 01 A4 02 8F 01 90 02 C8 20 20
								07 07 01 00 00 20 00 20 00 20 00 20 00 20 00 20
								00 20 00 20 00 20 00 20 00 20 00 20 00 20 00 20
								00 20 00 20 00 20 00 20 00 20 00 20 00 20 00 20
								00 20 00 FF 40 6A 9A 25 1A 16 2A 00 37 5A 00 4E
								C5 00 5D 17 00 30 C3 FF 38 48 FF F0 00 D8 00 D9
								FF FF FF A0 CE F2 29 EB 28 DC 90 36 E4 E0 4D F1
								39 EA 1E 57 DB FF 00 FA 00 F0 00
			39 00 00 00 00 04	EB 01 00 3C
		];


		/* MOVIE MODE */
		gen-panel-mdnie-movie-ui-mode-cmds = [
			39 00 00 00 00 9B	EC 98 24 00 B3 01 0E 01 00 66 17 03 96 00 FF 00
								00 07 FF 07 FF 14 00 0A 00 32 01 F4 0B 8A 20 2D
								6E 99 1B 17 14 1E 02 5F 02 C8 03 33 02 22 10 10
								07 07 01 00 00 20 00 20 00 20 00 20 02 1B 02 1B
								02 1B 02 1B 09 A6 09 A6 09 A6 09 A6 00 20 00 20
								00 20 00 20 00 20 00 20 00 20 00 20 00 20 00 20
								00 20 00 FF 00 67 A9 0C 0C 0C 0C 00 AA AB 00 AA
								AB 00 AA AB 00 AA AB D5 2C 2A FF F5 63 FE 4A FF
								FF F9 F8 00 FF FF 00 FF 00 FF 00 00 FF FF 00 FF
								00 FF 00 00 FF FF 00 FF 00 FF 00
			39 00 00 00 00 04	EB 01 00 30
		];

		gen-panel-mdnie-movie-video-mode-cmds = [
			39 00 00 00 00 9B	EC 98 24 00 B3 01 0E 01 00 66 17 03 96 00 FF 00
								00 07 FF 07 FF 14 00 0A 00 32 01 F4 0B 8A 20 2D
								6E 99 1B 17 14 1E 02 5F 02 C8 03 33 02 22 10 10
								07 07 01 00 00 20 00 20 00 20 00 20 02 1B 02 1B
								02 1B 02 1B 09 A6 09 A6 09 A6 09 A6 00 20 00 20
								00 20 00 20 00 20 00 20 00 20 00 20 00 20 00 20
								00 20 00 FF 00 67 A9 0C 0C 0C 0C 00 AA AB 00 AA
								AB 00 AA AB 00 AA AB D5 2C 2A FF F5 63 FE 4A FF
								FF F9 F8 00 FF FF 00 FF 00 FF 00 00 FF FF 00 FF
								00 FF 00 00 FF FF 00 FF 00 FF 00
			39 00 00 00 00 04	EB 01 00 30
		];

		gen-panel-mdnie-movie-camera-mode-cmds = [
			39 00 00 00 00 9B	EC 98 24 00 B3 01 0E 01 00 66 17 03 96 00 FF 00
								00 07 FF 07 FF 14 00 0A 00 32 01 F4 0B 8A 20 2D
								6E 99 1B 17 14 1E 02 5F 02 C8 03 33 02 22 10 10
								07 07 01 00 00 20 00 20 00 20 00 20 00 20 00 20
								00 20 00 20 00 20 00 20 00 20 00 20 00 20 00 20
								00 20 00 20 00 20 00 20 00 20 00 20 00 20 00 20
								00 20 00 FF 00 67 A9 0C 0C 0C 0C 00 AA AB 00 AA
								AB 00 AA AB 00 AA AB D5 2C 2A FF F5 63 FE 4A FF
								FF F9 F8 00 FF FF 00 FF 00 FF 00 00 FF FF 00 FF
								00 FF 00 00 FF FF 00 FF 00 FF 00
			39 00 00 00 00 04	EB 01 00 00
		];

		gen-panel-mdnie-movie-gallery-mode-cmds = [
			39 00 00 00 00 9B	EC 98 24 00 B3 01 0E 01 00 66 17 03 96 00 FF 00
								00 07 FF 07 FF 14 00 0A 00 32 01 F4 0B 8A 20 2D
								6E 99 1B 17 14 1E 02 5F 02 C8 03 33 02 22 10 10
								07 07 01 00 00 20 00 20 00 20 00 20 02 1B 02 1B
								02 1B 02 1B 09 A6 09 A6 09 A6 09 A6 00 20 00 20
								00 20 00 20 00 20 00 20 00 20 00 20 00 20 00 20
								00 20 00 FF 00 67 A9 0C 0C 0C 0C 00 AA AB 00 AA
								AB 00 AA AB 00 AA AB D5 2C 2A FF F5 63 FE 4A FF
								FF F9 F8 00 FF FF 00 FF 00 FF 00 00 FF FF 00 FF
								00 FF 00 00 FF FF 00 FF 00 FF 00
			39 00 00 00 00 04	EB 01 00 30
		];

		gen-panel-mdnie-movie-vt-mode-cmds = [
			39 00 00 00 00 9B	EC 98 24 00 B3 01 0E 01 00 66 17 03 96 00 FF 00
								00 07 FF 07 FF 14 00 0A 00 32 01 F4 0B 8A 20 2D
								6E 99 1B 17 14 1E 02 5F 02 C8 03 33 02 22 10 10
								07 07 01 00 00 20 00 20 00 20 00 20 02 1B 02 1B
								02 1B 02 1B 09 A6 09 A6 09 A6 09 A6 00 20 00 20
								00 20 00 20 00 20 00 20 00 20 00 20 00 20 00 20
								00 20 00 FF 00 67 A9 0C 0C 0C 0C 00 AA AB 00 AA
								AB 00 AA AB 00 AA AB D5 2C 2A FF F5 63 FE 4A FF
								FF F9 F8 00 FF FF 00 FF 00 FF 00 00 FF FF 00 FF
								00 FF 00 00 FF FF 00 FF 00 FF 00
			39 00 00 00 00 04	EB 01 00 30
		];

		gen-panel-mdnie-movie-browser-mode-cmds = [
			39 00 00 00 00 9B	EC 98 24 00 B3 01 0E 01 00 66 17 03 96 00 FF 00
								00 07 FF 07 FF 14 00 0A 00 32 01 F4 0B 8A 20 2D
								6E 99 1B 17 14 1E 02 5F 02 C8 03 33 02 22 10 10
								07 07 01 00 00 20 00 20 00 20 00 20 02 1B 02 1B
								02 1B 02 1B 09 A6 09 A6 09 A6 09 A6 00 20 00 20
								00 20 00 20 00 20 00 20 00 20 00 20 00 20 00 20
								00 20 00 FF 00 67 A9 0C 0C 0C 0C 00 AA AB 00 AA
								AB 00 AA AB 00 AA AB D5 2C 2A FF F5 63 FE 4A FF
								FF F9 F8 00 FF FF 00 FF 00 FF 00 00 FF FF 00 FF
								00 FF 00 00 FF FF 00 FF 00 FF 00
			39 00 00 00 00 04	EB 01 00 30
		];

		gen-panel-mdnie-movie-ebook-mode-cmds = [
			39 00 00 00 00 9B	EC 98 24 00 B3 01 0E 01 00 66 17 03 96 00 FF 00
								00 07 FF 07 FF 14 00 0A 00 32 01 F4 0B 8A 20 2D
								6E 99 1B 17 14 1E 02 5F 02 C8 03 33 02 22 10 10
								07 07 01 00 00 20 00 20 00 20 00 20 02 1B 02 1B
								02 1B 02 1B 09 A6 09 A6 09 A6 09 A6 00 20 00 20
								00 20 00 20 00 20 00 20 00 20 00 20 00 20 00 20
								00 20 00 FF 00 67 A9 0C 0C 0C 0C 00 AA AB 00 AA
								AB 00 AA AB 00 AA AB D5 2C 2A FF F5 63 FE 4A FF
								FF F9 F8 00 FF FF 00 FF 00 FF 00 00 FF FF 00 FF
								00 FF 00 00 FF FF 00 FF 00 FF 00
			39 00 00 00 00 04	EB 01 00 30
		];

		gen-panel-mdnie-cal {
			cal-reg = [EC];
			cal-offset = [94 96 98];
			cal-modes = < 
				0   /* MDNIE DYNAMIC MODE */	0	/* cal-tune-value-0 */
				1	/* MDNIE STANDARD MODE */	1	/* cal-tune-value-1 */
				2	/* MDNIE NATURAL MODE */	1	/* cal-tune-value-1 */
				3	/* MDNIE MOVIE MODE */		0	/* cal-tune-value-0 */
				4   /* MDNIE AUTO MODE */		0	/* cal-tune-value-0 */
			>;
			cal-linear-equation = < 
				/* <nominator   denominator constant>
				   f(x, y) = y + (x * nominator / denominator) + constant
				 */
				(-547)      503     31
				(-467)      447     (-25)
				201     39      (-18718)
				523     173     (-12111)
			>;
			cal-tune-value-0 = [ 
				FF F9 F9    /* TUNE 1 */
				FF FB FF
				F9 F7 FF
				FF FD FA
				FF FF FF
				F9 FB FF
				FC FF F8
				FB FF FB
				F9 FF FF    /* TUNE 9 */
			];
			cal-tune-value-1 = [ 
				FF F4 EB    /* TUNE 1 */
				FF F6 F0
				FF F7 F5
				FF F9 EC
				FF FA F0
				FF FB F5
				FF FD ED
				FF FE F0
				FF FF F5    /* TUNE 9 */
			];
		}; 
	};
};
