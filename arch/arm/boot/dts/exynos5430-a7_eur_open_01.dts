/*
 * SAMSUNG UNIVERSAL5430 board device tree source
 *
 * Copyright (c) 2013 Samsung Electronics Co., Ltd.
 *		http://www.samsung.com
 *
 * This program is free software; you can redistribute it and/or modify
 * it under the terms of the GNU General Public License version 2 as
 * published by the Free Software Foundation.
*/

/dts-v1/;
#include "exynos5430-a7_common.dtsi"
#include "exynos5430-a7_gpio_00.dtsi"
#include "exynos5430-a7_battery.dtsi"


/ {
	model = "Samsung A7 LTE EUR revision 00 board(EVT1) based on EXYNOS5430 with Ericsson modem";
	model_info-chip = <5430>;
	model_info-platform = "a7";
	model_info-subtype = "a7_eur_open";
	model_info-hw_rev = <1>;
	model_info-hw_rev_end = <2>; /* If add new dts file for new hw , it is set to <x>. x is suppored max system revision by this dts */
	compatible = "samsung,A7 EUR,r01", "samsung,exynos5430";

	/* use pcd interrupt from rev01 */
	decon_fb: decon_fb {
		oled-pcd-gpio = <&gpa0 5 0xf>;
	};
};

