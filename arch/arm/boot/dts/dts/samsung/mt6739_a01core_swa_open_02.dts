/* Generated by MediaTek 
 * If these files should be chaned, then please make a sync with MTK
*/

/dts-v1/;
/plugin/;

#include "mt6739_a01core_cis_ser_02.dts"

/* Add Samsung configuration over here */
/ {
	compatible = "Samsung,A01CORE SWA OPEN 02", "Mediatek,MT6739";
};
/*End of this file, DO NOT ADD ANYTHING HERE*/
