/*
 *Copyright (C) 2019 MediaTek Inc.
 *
 *This program is free software: you can redistribute it and/or modify
 *it under the terms of the GNU General Public License version 2 as
 *published by the Free Software Foundation.
 *
 *This program is distributed in the hope that it will be useful,
 *but WITHOUT ANY WARRANTY; without even the implied warranty of
 *MERCHANTABILITY or FITNESS FOR A PARTICULAR PURPOSE. See the
 *GNU General Public License for more details.
 *
 *You should have received a copy of the GNU General Public License
 *along with this program.
 *If not, see <http://www.gnu.org/licenses/>.
 */

/*************************
 * GPIO DTSI File
 *************************/
 
/* Overwrite GPIO init. value of cust_k39tv1_bsp_1g_titan-rev00-gpio.dtsi
   for each samsung project / SKU / H/W Rev. */

/*****************************************************
 * <PIN: (MODE)(DIR)(DOUT)(PULL_EN)(PULL_SEL)(SMT)>  *
 *****************************************************/

&gpio{
	gpio_init_default_samsung = 
		<90 0 0 0 0 0 0 >,
		<91 0 0 0 0 0 0 >,
		<108 0 0 0 0 0 0 >,
		<112 0 0 0 0 0 0 >;
};