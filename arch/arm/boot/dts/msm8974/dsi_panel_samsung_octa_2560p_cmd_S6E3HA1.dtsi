/* Copyright (c) 2012, Samsung Electronics Corporation. All rights reserved.
 *
 * This program is free software; you can redistribute it and/or modify
 * it under the terms of the GNU General Public License version 2 and
 * only version 2 as published by the Free Software Foundation.
 *
 * This program is distributed in the hope that it will be useful,
 * but WITHOUT ANY WARRANTY; without even the implied warranty of
 * MERCHANTABILITY or FITNESS FOR A PARTICULAR PURPOSE.  See the
 * GNU General Public License for more details.
 */

&mdss_mdp {
	/* DSI_0 */
	dsi_dual_2560p_cmd_s6e3ha1_right: mdss_dsi_samsung_dual_2560p_cmd_s6e3ha1_right{
		qcom,mdss-dsi-panel-name = "samsung,mdss-amoled-dsi-panel";
		label = "samsung amoled wqxga command mode dsi S6E3HA1 right panel";
		status = "disable";

		qcom,mdss-dsi-panel-controller = <&mdss_dsi0>;
		qcom,mdss-dsi-panel-type = "dsi_cmd_mode";
		qcom,mdss-pan-dest = "display_1";

		qcom,rst-gpio = <&pm8941_gpios 9 0>;
		qcom,te-gpio = <&msmgpio 12 0>;

		qcom,mdss-pan-broadcast-mode = <1>;

		qcom,mdss-pan-res = <800 2560>;
		qcom,mdss-pan-size = <112 180>; /* <Width> <Height> real size of panel in mm */
		qcom,mdss-pan-bpp = <24>;

		qcom,mdss-clk-rate=<850000000>;

		qcom,mdss-vsync-enable=<1>;
		qcom,mdss-hw-vsync-mode=<1>;
		qcom,mdss-pan-insert-dcs-cmd=<1>;
		qcom,mdss-pan-wr-mem-continue=<0x3c>;
		qcom,mdss-pan-wr-mem-start=<0x2c>;
		qcom,mdss-pan-te-sel=<1>;
		qcom,mdss-pan-clk-rate=<850000000>;

		qcom,mdss-pan-porch-values = <108 15 212 5 2 11>; /* <HBP> <HPW> <HFP> <VBP> <VPW> <VFP> */

		qcom,mdss-pan-underflow-clr = <0xff>;
		qcom,mdss-pan-bl-ctrl = "bl_ctrl_dcs_cmds";
		qcom,mdss-pan-bl-levels = <1 255>;
		qcom,mdss-pan-dsi-mode = <1>;
		qcom,mdss-pan-dsi-h-pulse-mode = <0>;
		qcom,mdss-pan-dsi-h-power-stop = <0 0 0>;
		qcom,mdss-pan-dsi-bllp-power-stop = <1 1>;
		qcom,mdss-pan-dsi-traffic-mode = <2>;
		qcom,mdss-pan-dsi-dst-format = <8>;
		qcom,mdss-pan-dsi-vc = <0>;
		qcom,mdss-pan-dsi-rgb-swap = <0>;
		qcom,mdss-force-clk-lane-hs = <0>;
		samsung,mdss-early-lcd-on = <1>;
		qcom,mdss-pan-dsi-data-lanes = <1 1 1 1>;
		qcom,mdss-pan-dsi-dlane-swap = <0>;
		qcom,mdss-pan-dsi-t-clk = <0x1c 0x04>;
		qcom,mdss-pan-dsi-stream = <0>;
		qcom,mdss-pan-dsi-mdp-tr = <0x0>;
		qcom,mdss-pan-dsi-dma-tr = <0x04>;
		qcom,mdss-pan-dsi-frame-rate = <60>;
		qcom,mdss-pan-dsi-tx-eot-append = <1>;
		qcom,panel-phy-regulatorSettings = [07 09 03 00  /* Regualotor settings */
						    20 00 01];
		qcom,panel-phy-timingSettings = [FA 4B 41 00 66 81 34 4B 41 03 04 A0];

		qcom,panel-phy-strengthCtrl = [ff 06];		/*!!!! */
		qcom,panel-phy-bistCtrl = [00 00 b1 ff
                                              00 00];   /*!!!! BIST Ctrl settings */
		qcom,panel-phy-laneConfig = [
			00 00 00 00 00 00 00 01 97 /* lane0 config */
			00 00 00 00 05 00 00 01 97 /* lane1 config */
			00 00 00 00 0a 00 00 01 97 /* lane2 config */
			00 00 00 00 0f 00 00 01 97 /* lane3 config */
			00 c0 00 00 00 00 00 01 bb]; /* Clk ln config */

		qcom,panel-display-on-seq = [
				/* Interface Setting */
				29 01 00 00 00 00 03 F0 5A 5A 		/* TEST KEY Enable */
				29 01 00 00 00 00 03 F2 03 40 		/* Dual DSI */
				29 01 00 00 00 00 02 F9 0A 			/* MIC Control */
				29 01 00 00 00 00 02 B9 00			/* PSR Setting */
				29 01 00 00 00 00 03 F0 A5 A5		/* TEST KEY Disable */

				05 01 00 00 78 00 02 11 00  		/* Sleep out = Needs 120ms */

				/* Interface Setting */
				29 01 00 00 00 00 03 F0 5A 5A 		/* TEST KEY Enable */
				29 01 00 00 00 00 03 F2 03 40 		/* Dual DSI */
				29 01 00 00 00 00 02 F9 0A 			/* MIC Control */
				29 01 00 00 00 00 02 B9 00			/* PSR Setting */
				29 01 00 00 00 00 03 F0 A5 A5		/* TEST KEY Disable */

				/* TE On */
				29 01 00 00 00 00 02 35 00

				/* TSP TE(Hsync) Control
				29 01 00 00 00 00 03 F0 5A 5A 		/* TEST KEY Enable */
				29 01 00 00 00 00 02 BD 85
				29 01 00 00 00 00 03 F0 A5 A5 		/* TEST KEY Disable */

				/* PenTile Setting */
				29 01 00 00 00 00 03 F0 5A 5A 		/* TEST KEY Enable */
				29 01 00 00 00 00 05 C0 00 0F D8 D8	/* PenTile Setting */
				29 01 00 00 00 00 03 F0 A5 A5		/* TEST KEY Disable */

				/* POC & ETC Setting */
				29 01 00 00 00 00 03 F0 5A 5A 		/* TEST KEY Enable */
				29 01 00 00 00 00 03 FC 5A 5A 		/* TEST KEY(LEVEL3) Enable */
				29 01 00 00 00 00 02 B0 20			/* Global Para 33rd */
				29 01 00 00 00 00 02 FE 08			/* POC Setting */
				29 01 00 00 00 00 05 FF 00 00 00 08	/* Setup Margin */
				29 01 00 00 00 00 03 F0 A5 A5		/* TEST KEY Disable */
				29 01 00 00 00 00 03 FC A5 A5		/* TEST KEY(LEVEL3) Disable */

				/* Brightness condition set */
				29 01 00 00 00 00 03 F0 5A 5A 		/* TEST KEY Enable */
				29 01 00 00 00 00 22				/* Gamma 2.2 Setting */
					CA 01 00 01 00 01 00 80
					80 80 80 80 80 80 80 80
					80 80 80 80 80 80 80 80
					80 80 80 80 80 80 80 00
					00 00
				29 01 00 00 00 00 03 B2 00 0A 		/* AID 0% */
				29 01 00 00 00 00 03 B6 9C 0F		/* ELVSS Setting */
				23 01 00 00 00 00 02 F7 03			/* update */
				29 01 00 00 00 00 03 F0 A5 A5 		/* TEST KEY Disable */

				/* ACL Control */
				29 01 00 00 00 00 03 F0 5A 5A 		/* TEST KEY Enable */
				29 01 00 00 00 00 02 B5 41			/* Frame Avg.(16, ACL OFF) */
				29 01 00 00 00 00 02 55 00			/* POC Setting */
				29 01 00 00 00 00 03 F0 A5 A5		/* TEST KEY Disable */

				/* ELVSS Temp Compensation */
				29 01 00 00 00 00 03 F0 5A 5A 		/* TEST KEY Enable */
				29 01 00 00 00 00 02 B0 05			/* Global Para 6th */
				29 01 00 00 00 00 02 B8 19			/* TSET(Default:0x19) Setting */
				29 01 00 00 00 00 03 F0 A5 A5		/* TEST KEY Disable */
			];
		qcom,on-cmds-dsi-state = "DSI_HS_MODE";
		qcom,panel-display-off-seq = [
				05 01 00 00 0A 00 02 28 00			/* wait 10ms(0x0A) */
				05 01 00 00 78 00 02 10 00			/* wait 120ms(0x78) */
		];
		qcom,off-cmds-dsi-state = "DSI_HS_MODE";

		/*used for only fhd evt1 panel and over for*/
		qcom,panel-hsync-on-seq = [
				29 01 00 00 00 00 03 F0 5A 5A		/* TEST KEY Enable */
				29 01 00 00 00 00 04 BD 85 02 0C	/* Touch Hsync Enable */
				29 01 00 00 00 00 03 F0 A5 A5		/* TEST KEY Disable */
			];

		/*
			the last byte in read commands  represent READ LENGH,
			like below  READ LENGH = 0x21
		 */
		 	samsung,panel-test-key-enable-cmds 	= [ 29 01 00 00 00 00 03 F0 5A 5A];
		 	samsung,panel-test-key-disable-cmds = [ 29 01 00 00 00 00 03 F0 A5 A5];

			samsung,panel-nv-mtp-read-cmds		= [ 06 01 00 00 00 00 01 c8 21 00];
			samsung,panel-nv-mtp-read-hbm-cmds	= [ 06 01 00 00 00 00 01 c8 06 21];	/* read C8 34~39th , 33=0x21*/
			samsung,panel-nv-mtp-read-hbm2-cmds	= [ 06 01 00 00 00 00 01 c8 0F 48];	/* read C8 73~87th , 72=0x48*/
			samsung,panel-nv-mdnie-read-cmds	= [ 06 01 00 00 00 00 01 A1 04 00];
			samsung,panel-nv-mtp-read-elvss-cmds	= [ 06 01 00 00 00 00 01 b6 01 14];	/* read C6 21th , 20=0x14*/
			samsung,panel-nv-read-cmds			= [ 06 01 00 00 00 00 01 c8 21 00];
			samsung,panel-nv-read-enable-cmds = [
								29 01 00 00 00 00 03 f0 5a 5a
								29 01 00 00 00 00 03 fc 5a 5a ];
			samsung,panel-nv-read-disable-cmds = [ 29 01 00 00 00 00 03 f0 a5 a5 ];

			/* the last byte in all read commands will represent READ LENGH */
			samsung,panel-manufacture-id-read-cmds = [
								06 01 00 00 00 00 01 da 01 00
								06 01 00 00 00 00 01 db 01 00
								06 01 00 00 00 00 01 dc 01 00];

			samsung,panel-manufacture-date-read-cmds = [ 06 01 00 00 00 00 01 c8 02 28];	/* read C8 41~42th , 40=0x28*/

			samsung,panel-ddi-id-read-cmds = [ 06 01 00 00 00 00 01 d6 05 00];	/* read D6 1~5th */

			samsung,panel-ldi-debug-read-cmds = [
								06 01 00 00 00 00 01 0A 01 00
								06 01 00 00 00 00 01 0E 01 00
								06 01 00 00 00 00 01 EA 08 00];

			samsung,panel-ldi-fps-write-cmds = [
								29 01 00 00 00 00 02 B0 1A    /* Global Para. (27para) */
								29 01 00 00 00 00 02 D7 00];

			samsung,panel-ldi-fps-read-cmds = [
								06 01 00 00 00 00 01 D7 01 1A]; /* read D7 27th , 27=0x1B*/
			samsung,panel-ldi-partial-disp-on = [
								29 01 00 00 00 00 05 30 00 C8 03 20
								29 01 00 00 00 00 02 12 00 ];
			samsung,panel-ldi-partial-disp-off = [29 01 00 00 00 00 02 13 00];

			qcom,panel-display-on-cmds	= [05 01 00 00 32 00 02 29 00];
			qcom,panel-display-off-cmds	= [05 01 00 00 32 00 02 28 00];

			samsung,panel-elvss-lowtemp-cmds-list = [
								29 01 00 00 00 00 02 B0 05
								29 01 00 00 00 00 02 B8 00
								29 01 00 00 00 00 02 B6 8C];	/* Low Temperature Command */
			samsung,panel-elvss-lowtemp2-cmds-list = [
								29 01 00 00 00 00 02 B0 14
								29 01 00 00 00 00 02 B6 00];	/* Low Temperature Command: default */

			samsung,panel-gamma-cmds-list = [
					29 01 00 00 00 00 22            /* Brightness Condition Set - Gamma 2.2 Setting*/
						CA 01 00 01 00 01 00 80
						80 80 80 80 80 80 80 80
						80 80 80 80 80 80 80 80
						80 80 80 80 80 80 80 00
						00 00
					29 01 00 00 00 00 02 F7 03		/* Gamma, LTPS(AID) update */
				];

			samsung,panel-gamma-hbm-cmds-list = [
						29 01 00 00 00 00 22            /* Brightness Condition Set for HBM - Gamma 2.2 Setting*/
						CA 01 00 01 00 01 00 80
						80 80 80 80 80 80 80 80
						80 80 80 80 80 80 80 80
						80 80 80 80 80 80 80 00
						00 00
				];

			/*
			 * ************************************************************************************************************************
			 * AID command list and mappings
			 * ************************************************************************************************************************
			 */
			samsung,panel-aid-cmds-list = [
				29 01 00 00 00 00 05 B2 09 D8 00 06 /* 0  samsung_brightness_aor_ 2cd_97.8 */
				29 01 00 00 00 00 05 B2 09 C1 00 06 /* 1  samsung_brightness_aor_ 3cd_96.9 */
				29 01 00 00 00 00 05 B2 09 AB 00 06 /* 2  samsung_brightness_aor_ 4cd_96.1 */
				29 01 00 00 00 00 05 B2 09 8C 00 06 /* 3  samsung_brightness_aor_ 5cd_94.9 */
				29 01 00 00 00 00 05 B2 09 74 00 06 /* 4  samsung_brightness_aor_ 6cd_93.9 */
				29 01 00 00 00 00 05 B2 09 5F 00 06 /* 5  samsung_brightness_aor_ 7cd_93.1 */
				29 01 00 00 00 00 05 B2 09 48 00 06 /* 6  samsung_brightness_aor_ 8cd_92.2 */
				29 01 00 00 00 00 05 B2 09 30 00 06 /* 7  samsung_brightness_aor_ 9cd_91.3 */
				29 01 00 00 00 00 05 B2 09 14 00 06 /* 8  samsung_brightness_aor_10cd_90.2 */
				29 01 00 00 00 00 05 B2 08 FC 00 06 /* 9  samsung_brightness_aor_11cd_89.3 */
				29 01 00 00 00 00 05 B2 08 E4 00 06 /* 10 samsung_brightness_aor_12cd_88.4 */
				29 01 00 00 00 00 05 B2 08 CB 00 06 /* 11 samsung_brightness_aor_13cd_87.4 */
				29 01 00 00 00 00 05 B2 08 B3 00 06 /* 12 samsung_brightness_aor_14cd_86.5 */
				29 01 00 00 00 00 05 B2 08 9B 00 06 /* 13 samsung_brightness_aor_15cd_85.5 */
				29 01 00 00 00 00 05 B2 08 82 00 06 /* 14 samsung_brightness_aor_16cd_84.5 */
				29 01 00 00 00 00 05 B2 08 6A 00 06 /* 15 samsung_brightness_aor_17cd_83.6 */
				29 01 00 00 00 00 05 B2 08 39 00 06 /* 16 samsung_brightness_aor_19cd_81.7 */
				29 01 00 00 00 00 05 B2 08 1E 00 06 /* 17 samsung_brightness_aor_20cd_80.7 */
				29 01 00 00 00 00 05 B2 08 06 00 06 /* 18 samsung_brightness_aor_21cd_79.7 */
				29 01 00 00 00 00 05 B2 07 ED 00 06 /* 19 samsung_brightness_aor_22cd_78.8 */
				29 01 00 00 00 00 05 B2 07 BB 00 06 /* 20 samsung_brightness_aor_24cd_76.8 */
				29 01 00 00 00 00 05 B2 07 A2 00 06 /* 21 samsung_brightness_aor_25cd_75.9 */
				29 01 00 00 00 00 05 B2 07 6A 00 06 /* 22 samsung_brightness_aor_27cd_73.7 */
				29 01 00 00 00 00 05 B2 07 3F 00 06 /* 23 samsung_brightness_aor_29cd_72.0 */
				29 01 00 00 00 00 05 B2 07 32 00 06 /* 24 samsung_brightness_aor_30cd_71.5 */
				29 01 00 00 00 00 05 B2 06 F3 00 06 /* 25 samsung_brightness_aor_32cd_69.1 */
				29 01 00 00 00 00 05 B2 06 C0 00 06 /* 26 samsung_brightness_aor_34cd_67.1 */
				29 01 00 00 00 00 05 B2 06 79 00 06 /* 27 samsung_brightness_aor_37cd_64.3 */
				29 01 00 00 00 00 05 B2 06 45 00 06 /* 28 samsung_brightness_aor_39cd_62.3 */
				29 01 00 00 00 00 05 B2 06 11 00 06 /* 29 samsung_brightness_aor_41cd_60.3 */
				29 01 00 00 00 00 05 B2 05 C9 00 06 /* 30 samsung_brightness_aor_44cd_57.5 */
				29 01 00 00 00 00 05 B2 05 7B 00 06 /* 31 samsung_brightness_aor_47cd_54.5 */
				29 01 00 00 00 00 05 B2 05 2B 00 06 /* 32 samsung_brightness_aor_50cd_51.4 */
				29 01 00 00 00 00 05 B2 04 DC 00 06 /* 33 samsung_brightness_aor_53cd_48.3 */
				29 01 00 00 00 00 05 B2 04 86 00 06 /* 34 samsung_brightness_aor_56cd_45.0 */
				29 01 00 00 00 00 05 B2 04 1F 00 06 /* 35 samsung_brightness_aor_60cd_41.0 */
				29 01 00 00 00 00 05 B2 04 06 00 06 /* 36 samsung_brightness_aor_64_143cd_40.0 */
				29 01 00 00 00 00 05 B2 03 DA 00 06 /* 37 samsung_brightness_aor_152cd_38.3 */
				29 01 00 00 00 00 05 B2 03 6C 00 06 /* 38 samsung_brightness_aor_162cd_34.0 */
				29 01 00 00 00 00 05 B2 03 0B 00 06 /* 39 samsung_brightness_aor_172cd_30.2 */
				29 01 00 00 00 00 05 B2 02 97 00 06 /* 40 samsung_brightness_aor_183cd_25.7 */
				29 01 00 00 00 00 05 B2 02 12 00 06 /* 41 samsung_brightness_aor_195cd_20.6 */
				29 01 00 00 00 00 05 B2 01 7B 00 06 /* 42 samsung_brightness_aor_207cd_14.7 */
				29 01 00 00 00 00 05 B2 00 E8 00 06 /* 43 samsung_brightness_aor_220cd_9.0  */
				29 01 00 00 00 00 05 B2 00 3B 00 06 /* 44 samsung_brightness_aor_234cd_2.3 */
				29 01 00 00 00 00 05 B2 00 06 00 06 /* 45 samsung_brightness_aor_249_350cd_0.2 */
			];

			/* bl_level, Index in aid command list */
			samsung,panel-aid-map-table = <
				2	0		3	1		4	2		5	3		6	4
				7	5		8	6		9	7		10	8		11	9
				12	10		13	11		14	12		15	13		16	14
				17	15		19	16		20	17		21	18		22	19
				24	20		25	21		27	22		29	23		30	24
				32	25		34	26		37	27		39	28		41	29
				44	30		47	31		50	32		53	33		56	34
				60	35		64	36		68	37		72	37		77	37
				82	37		87	37		93	37		98	37		105	37
				111	37		119	37		126	37		134	37		143	37
				152	37		162	38		172	39		183	40		195	41
				207	42		220	43		234	44		249	44		265	44
				282	44		300	44
			>;

			/*
			 * ************************************************************************************************************************
			 * ACL command list and mappings
			 * ************************************************************************************************************************
			 */
			 samsung,panel-aclcont-cmds-list = [
					29 01 00 00 00 00 02 B5 51]; /* ACL on, B5 <- 0x51 */

			samsung,panel-acl-cmds-list = [
					29 01 00 00 00 00 02 55 00
					29 01 00 00 00 00 02 55 01		/* ACL 30% */
					29 01 00 00 00 00 02 55 02		/* default ACL 15% */
					29 01 00 00 00 00 02 55 03];	/* ACL 50% */

			samsung,panel-acl-off-cmds = [
								29 01 00 00 00 00 02 B5 41   /* ACL OFF - 41 (16Frame Averaging) */
								29 01 00 00 00 00 02 55 00];/*off, b5<-0x41*/

			/* bl_level , Index in acl command list */
			samsung,panel-acl-map-table =  <
					2    2          3   2        4    2
				 	5    2          6   2        7    2    8   2       9   2
				 	10   2         11   2        12   2   13   2      14   2
				 	15   2         16   2        17   2   19   2      20   2
				 	21   2         22   2        24   2   25   2      27   2
				 	29   2         30   2        32   2   34   2      37   2
				 	39   2         41   2        44   2   47   2      50   2
				 	53   2         56   2        60   2   64   2      68   2
				 	72   2         77   2        82   2   87   2      93   2
				 	98   2         105  2        111  2   119  2      126  2
				 	134  2         143  2        152  2   162  2      172  2
				 	183  2         195  2        207  2   220  2      234  2
				 	249  2         265  2        282  2   300  2	  316  2
				 	333  2		   350  2
				>;

			/*
			 * ************************************************************************************************************************
			 * ELVSS(ACL Off) command list and mappings
			 * ************************************************************************************************************************
			 */
			samsung,panel-elvss-cmds-list = [
				29 01 00 00 00 00 03 b6 88 12 /* 0 DEFAULT_ELVSS(0x12) */
				29 01 00 00 00 00 03 b6 88 12 /* 1 DEFAULT_ELVSS(0x12) */
				29 01 00 00 00 00 03 b6 88 12 /* 2 DEFAULT_ELVSS(0x12) */
				29 01 00 00 00 00 03 b6 88 11 /* 3 DEFAULT_ELVSS(0x11) */
				29 01 00 00 00 00 03 b6 88 10 /* 4 DEFAULT_ELVSS(0x10) */
				29 01 00 00 00 00 03 b6 88 0F /* 5 DEFAULT_ELVSS(0x0F) */
				29 01 00 00 00 00 03 b6 88 0E /* 6 DEFAULT_ELVSS(0x0E) */
				29 01 00 00 00 00 03 b6 88 0D /* 7 DEFAULT_ELVSS(0x0D) */
				29 01 00 00 00 00 03 b6 88 0C /* 8 DEFAULT_ELVSS(0x0C) */
				29 01 00 00 00 00 03 b6 88 0B /* 9 DEFAULT_ELVSS(0x0B) */
				29 01 00 00 00 00 03 b6 88 0A /* 10 DEFAULT_ELVSS(0x0A) */
				29 01 00 00 00 00 03 b6 88 0A /* 11 DEFAULT_ELVSS(0x0A) */
				29 01 00 00 00 00 03 b6 88 09 /* 12 DEFAULT_ELVSS(0x09) */
				29 01 00 00 00 00 03 b6 88 09 /* 13 DEFAULT_ELVSS(0x09) */
				29 01 00 00 00 00 03 b6 88 08 /* 14 DEFAULT_ELVSS(0x08) */
				29 01 00 00 00 00 03 b6 88 07 /* 15 DEFAULT_ELVSS(0x07) */
				29 01 00 00 00 00 03 b6 88 07 /* 16 DEFAULT_ELVSS(0x07) */
				29 01 00 00 00 00 03 b6 88 06 /* 17 DEFAULT_ELVSS(0x06) */
				29 01 00 00 00 00 03 b6 88 05 /* 18 DEFAULT_ELVSS(0x05) */
				29 01 00 00 00 00 03 b6 88 05 /* 19 DEFAULT_ELVSS(0x05) */
				29 01 00 00 00 00 03 b6 88 04 /* 20 DEFAULT_ELVSS(0x04) */
			];

			/*
			 * ************************************************************************************************************************
			 * SMART ACL(ACL On) ELVSS command list and mappings
			 * ************************************************************************************************************************
			 */
			samsung,panel-smart-acl-elvss-cmds-list = [
				29 01 00 00 00 00 03 b6 88 12 /* 0 SMART_ACL_ELVSS(0x12) */
				29 01 00 00 00 00 03 b6 88 12 /* 1 SMART_ACL_ELVSS(0x12) */
				29 01 00 00 00 00 03 b6 88 12 /* 2 SMART_ACL_ELVSS(0x12) */
				29 01 00 00 00 00 03 b6 88 11 /* 3 SMART_ACL_ELVSS(0x11) */
				29 01 00 00 00 00 03 b6 88 10 /* 4 SMART_ACL_ELVSS(0x10) */
				29 01 00 00 00 00 03 b6 88 0F /* 5 SMART_ACL_ELVSS(0x0F) */
				29 01 00 00 00 00 03 b6 88 0E /* 6 SMART_ACL_ELVSS(0x0E) */
				29 01 00 00 00 00 03 b6 88 0D /* 7 SMART_ACL_ELVSS(0x0D) */
				29 01 00 00 00 00 03 b6 88 0C /* 8 SMART_ACL_ELVSS(0x0C) */
				29 01 00 00 00 00 03 b6 88 0B /* 9 SMART_ACL_ELVSS(0x0B) */
				29 01 00 00 00 00 03 b6 88 0A /* 10 SMART_ACL_ELVSS(0x0A) */
				29 01 00 00 00 00 03 b6 88 0A /* 11 SMART_ACL_ELVSS(0x0A) */
				29 01 00 00 00 00 03 b6 88 09 /* 12 SMART_ACL_ELVSS(0x09) */
				29 01 00 00 00 00 03 b6 88 09 /* 13 SMART_ACL_ELVSS(0x09) */
				29 01 00 00 00 00 03 b6 88 08 /* 14 SMART_ACL_ELVSS(0x08) */
				29 01 00 00 00 00 03 b6 88 07 /* 15 SMART_ACL_ELVSS(0x07) */
				29 01 00 00 00 00 03 b6 88 07 /* 16 SMART_ACL_ELVSS(0x07) */
				29 01 00 00 00 00 03 b6 88 06 /* 17 SMART_ACL_ELVSS(0x06) */
				29 01 00 00 00 00 03 b6 88 05 /* 18 SMART_ACL_ELVSS(0x05) */
				29 01 00 00 00 00 03 b6 88 05 /* 19 SMART_ACL_ELVSS(0x05) */
				29 01 00 00 00 00 03 b6 88 04 /* 20 SMART_ACL_ELVSS(0x04) */
			];

			/* bl_level, Index in elvss command list */
			/* bl_level, Index in elvss command list */
			samsung,panel-smart-acl-elvss-map-table = <
					2	17		3	17		4	17
					5	17		6	17		7	17		8	17		9	17
					10	17		11	17		12	17		13	17		14	17
					15	17		16	17		17	17		19	17		20	17
					21	17		22	17		24	17		25	17		27	17
					29	17		30	17		32	17		34	17		37	17
					39	17		41	17		44	17		47	17		50	17
					53	17		56	17		60	17		64	17		68	17
					72	17		77	17		82	17		87	17		93	17
					98	17		105	17		111	16		119	15		126	14
					134	13		143	12		152	11		162	10		172	9
					183	8		195	7		207	6		220	5		234	4
					249	3		265	2		282	1		300	0
					>;
			/*
			 * ************************************************************************************************************************
			 * candela to index mappings
			 * ************************************************************************************************************************
			 */
			samsung,panel-candella-mapping-table = <
			/*<idx>	  <from>  <till> <candella> */
				0		0		2		2
				1		3		3		3
				2		4		4		4
				3		5		5		5
				4		6		6		6
				5		7		7		7
				6		8		8		8
				7		9		9		9
				8		10		10		10
				9		11		11		11
				10		12		12		12
				11		13		13		13
				12		14		14		14
				13		15		15		15
				14		16		16		16
				15		17		18		17
				16		19		19		19
				17		20		20		20
				18		21		21		21
				19		22		23		22
				20		24		24		24
				21		25		26		25
				22		27		28		27
				23		29		29		29
				24		30		31		30
				25		32		32		32
				26		33		36		34
				27		37		38		37
				28		39		40		39
				29		41		43		41
				30		44		46		44
				31		47		49		47
				32		50		52		50
				33		53		55		53
				34		56		59		56
				35		60		63		60
				36		64		67		64
				37		68		71		68
				38		72		76		72
				39		77		81		77
				40		82		86		82
				41		87		92		87
				42		93		97		93
				43		98		104		98
				44		105		110		105
				45		111		118		111
				46		119		125		119
				47		126		133		126
				48		134		142		134
				49		143		149		143
				50		150		161		152
				51		162		171		162
				52		172		182		172
				53		183		194		183
				54		195		206		195
				55		207		219		207
				56		220		232		220
				57		233		248		234
				58		249		249		249
				59		250		251		265
				60		252		253		282
				61		254		255		300
				>;
	};


	/* DSI_1 */
	dsi_dual_2560p_cmd_s6e3ha1_left: mdss_dsi_samsung_dual_2560p_cmd_s6e3ha1_left{
		qcom,mdss-dsi-panel-name = "samsung,mdss-amoled-dsi-panel";
		label = "samsung amoled wqxga command mode dsi S6E3HA1 left panel";
		status = "disable";

		qcom,mdss-dsi-panel-controller = <&mdss_dsi1>;
		qcom,mdss-dsi-panel-type = "dsi_cmd_mode";
		qcom,mdss-pan-dest = "display_2";

		qcom,rst-gpio = <&pm8941_gpios 9 0>;
		qcom,te-gpio = <&msmgpio 12 0>;

		qcom,mdss-pan-broadcast-mode = <1>;

		qcom,mdss-pan-res = <800 2560>;
		qcom,mdss-pan-size = <112 180>; /* <Width> <Height> real size of panel in mm */
		qcom,mdss-pan-bpp = <24>;

		qcom,mdss-clk-rate=<850000000>;

		qcom,mdss-vsync-enable=<1>;
		qcom,mdss-hw-vsync-mode=<1>;
		qcom,mdss-pan-insert-dcs-cmd=<1>;
		qcom,mdss-pan-wr-mem-continue=<0x3c>;
		qcom,mdss-pan-wr-mem-start=<0x2c>;
		qcom,mdss-pan-te-sel=<1>;
		qcom,mdss-pan-clk-rate=<850000000>;

		qcom,mdss-pan-porch-values = <108 15 212 5 2 11>; /* <HBP> <HPW> <HFP> <VBP> <VPW> <VFP> */

		qcom,mdss-pan-underflow-clr = <0xff>;
		qcom,mdss-pan-bl-ctrl = "bl_ctrl_dcs_cmds";
		qcom,mdss-pan-bl-levels = <1 255>;
		qcom,mdss-pan-dsi-mode = <1>;
		qcom,mdss-pan-dsi-h-pulse-mode = <0>;
		qcom,mdss-pan-dsi-h-power-stop = <0 0 0>;
		qcom,mdss-pan-dsi-bllp-power-stop = <1 1>;
		qcom,mdss-pan-dsi-traffic-mode = <2>;
		qcom,mdss-pan-dsi-dst-format = <8>;
		qcom,mdss-pan-dsi-vc = <0>;
		qcom,mdss-pan-dsi-rgb-swap = <0>;
		qcom,mdss-force-clk-lane-hs = <0>;
		samsung,mdss-early-lcd-on = <1>;
		qcom,mdss-pan-dsi-data-lanes = <1 1 1 1>;
		qcom,mdss-pan-dsi-dlane-swap = <0>;
		qcom,mdss-pan-dsi-t-clk = <0x1c 0x04>;
		qcom,mdss-pan-dsi-stream = <0>;
		qcom,mdss-pan-dsi-mdp-tr = <0x0>;
		qcom,mdss-pan-dsi-dma-tr = <0x04>;
		qcom,mdss-pan-dsi-frame-rate = <60>;
		qcom,mdss-pan-dsi-tx-eot-append = <1>;
		qcom,panel-phy-regulatorSettings = [07 09 03 00  /* Regualotor settings */
						    20 00 01];
		qcom,panel-phy-timingSettings = [FA 4B 41 00 66 81 34 4B 41 03 04 A0];

		qcom,panel-phy-strengthCtrl = [ff 06];		/*!!!! */
		qcom,panel-phy-bistCtrl = [00 00 b1 ff
                                              00 00];   /*!!!! BIST Ctrl settings */
		qcom,panel-phy-laneConfig = [
			00 00 00 00 00 00 00 01 97 /* lane0 config */
			00 00 00 00 05 00 00 01 97 /* lane1 config */
			00 00 00 00 0a 00 00 01 97 /* lane2 config */
			00 00 00 00 0f 00 00 01 97 /* lane3 config */
			00 c0 00 00 00 00 00 01 bb]; /* Clk ln config */

		qcom,panel-display-on-seq = [
				/* Interface Setting */
				29 01 00 00 00 00 03 F0 5A 5A 		/* TEST KEY Enable */
				29 01 00 00 00 00 03 F2 03 40 		/* Dual DSI */
				29 01 00 00 00 00 02 F9 0A 			/* MIC Control */
				29 01 00 00 00 00 02 B9 00			/* PSR Setting */
				29 01 00 00 00 00 03 F0 A5 A5		/* TEST KEY Disable */

				/* Sleep Out */
				05 01 00 00 78 00 02 11 00  		/* Sleep out = Needs 120ms */

				/* Interface Setting */
				29 01 00 00 00 00 03 F0 5A 5A 		/* TEST KEY Enable */
				29 01 00 00 00 00 03 F2 03 40 		/* Dual DSI */
				29 01 00 00 00 00 02 F9 0A 			/* MIC Control */
				29 01 00 00 00 00 02 B9 00			/* PSR Setting */
				29 01 00 00 00 00 03 F0 A5 A5		/* TEST KEY Disable */

				/* TE On */
				29 01 00 00 00 00 02 35 00

				/* TSP TE(Hsync) Control
				29 01 00 00 00 00 03 F0 5A 5A 		/* TEST KEY Enable */
				29 01 00 00 00 00 02 BD 85
				29 01 00 00 00 00 03 F0 A5 A5 		/* TEST KEY Disable */

				/* PenTile Setting */
				29 01 00 00 00 00 03 F0 5A 5A 		/* TEST KEY Enable */
				29 01 00 00 00 00 05 C0 00 0F D8 D8	/* PenTile Setting */
				29 01 00 00 00 00 03 F0 A5 A5		/* TEST KEY Disable */

				/* POC & ETC Setting */
				29 01 00 00 00 00 03 F0 5A 5A 		/* TEST KEY Enable */
				29 01 00 00 00 00 03 FC 5A 5A 		/* TEST KEY(LEVEL3) Enable */
				29 01 00 00 00 00 02 B0 20			/* Global Para 33rd */
				29 01 00 00 00 00 02 FE 08			/* POC Setting */
				29 01 00 00 00 00 05 FF 00 00 00 08	/* Setup Margin */
				29 01 00 00 00 00 03 F0 A5 A5		/* TEST KEY Disable */
				29 01 00 00 00 00 03 FC A5 A5		/* TEST KEY(LEVEL3) Disable */

				/* Brightness condition set */
				29 01 00 00 00 00 03 F0 5A 5A 		/* TEST KEY Enable */
				29 01 00 00 00 00 22				/* Gamma 2.2 Setting */
					CA 01 00 01 00 01 00 80
					80 80 80 80 80 80 80 80
					80 80 80 80 80 80 80 80
					80 80 80 80 80 80 80 00
					00 00
				29 01 00 00 00 00 03 B2 00 0A 		/* AID 0% */
				29 01 00 00 00 00 03 B6 9C 0F		/* ELVSS Setting */
				23 01 00 00 00 00 02 F7 03			/* update */
				29 01 00 00 00 00 03 F0 A5 A5 		/* TEST KEY Disable */

				/* ACL Control */
				29 01 00 00 00 00 03 F0 5A 5A 		/* TEST KEY Enable */
				29 01 00 00 00 00 02 B5 41			/* Frame Avg.(16, ACL OFF) */
				29 01 00 00 00 00 02 55 00			/* POC Setting */
				29 01 00 00 00 00 03 F0 A5 A5		/* TEST KEY Disable */

				/* ELVSS Temp Compensation */
				29 01 00 00 00 00 03 F0 5A 5A 		/* TEST KEY Enable */
				29 01 00 00 00 00 02 B0 05			/* Global Para 6th */
				29 01 00 00 00 00 02 B8 19			/* TSET(Default:0x19) Setting */
				29 01 00 00 00 00 03 F0 A5 A5		/* TEST KEY Disable */
			];
		qcom,on-cmds-dsi-state = "DSI_HS_MODE";
		qcom,panel-display-off-seq = [
				05 01 00 00 0A 00 02 28 00			/* wait 10ms(0x0A) */
				05 01 00 00 78 00 02 10 00			/* wait 120ms(0x78) */
		];
		qcom,off-cmds-dsi-state = "DSI_HS_MODE";

		/*used for only fhd evt1 panel and over for*/
		qcom,panel-hsync-on-seq = [
				29 01 00 00 00 00 03 F0 5A 5A		/* TEST KEY Enable */
				29 01 00 00 00 00 04 BD 85 02 0C	/* Touch Hsync Enable */
				29 01 00 00 00 00 03 F0 A5 A5		/* TEST KEY Disable */
			];

		/*
			the last byte in read commands  represent READ LENGH,
			like below  READ LENGH = 0x21
		 */
		 	samsung,panel-test-key-enable-cmds 	= [ 29 01 00 00 00 00 03 F0 5A 5A];
		 	samsung,panel-test-key-disable-cmds = [ 29 01 00 00 00 00 03 F0 A5 A5];

			samsung,panel-nv-mtp-read-cmds		= [ 06 01 00 00 00 00 01 c8 21 00];
			samsung,panel-nv-mtp-read-hbm-cmds	= [ 06 01 00 00 00 00 01 c8 07 21];	/* read C8 34~40th , 33=0x21*/
			samsung,panel-nv-mtp-read-hbm2-cmds	= [ 06 01 00 00 00 00 01 c8 0F 48];	/* read C8 73~87th , 72=0x48*/
			samsung,panel-nv-mdnie-read-cmds	= [ 06 01 00 00 00 00 01 A1 04 00];
			samsung,panel-nv-mtp-read-elvss-cmds	= [ 06 01 00 00 00 00 01 b6 01 14];	/* read C6 21th , 20=0x14*/
			samsung,panel-nv-read-cmds			= [ 06 01 00 00 00 00 01 c8 21 00];
			samsung,panel-nv-read-enable-cmds = [
								29 01 00 00 00 00 03 f0 5a 5a
								29 01 00 00 00 00 03 fc 5a 5a ];
			samsung,panel-nv-read-disable-cmds = [ 29 01 00 00 00 00 03 f0 a5 a5 ];

			/* the last byte in all read commands will represent READ LENGH */
			samsung,panel-manufacture-id-read-cmds = [
								06 01 00 00 00 00 01 da 01 00
								06 01 00 00 00 00 01 db 01 00
								06 01 00 00 00 00 01 dc 01 00];

			samsung,panel-manufacture-date-read-cmds = [ 06 01 00 00 00 00 01 c8 02 28];	/* read C8 41~42th , 40=0x28*/

			samsung,panel-ddi-id-read-cmds = [ 06 01 00 00 00 00 01 d6 05 00];	/* read D6 1~5th */

			samsung,panel-ldi-debug-read-cmds = [
								06 01 00 00 00 00 01 0A 01 00
								06 01 00 00 00 00 01 0E 01 00
								06 01 00 00 00 00 01 EA 08 00];

			samsung,panel-ldi-fps-write-cmds = [
								29 01 00 00 00 00 02 B0 1A    /* Global Para. (27para) */
								29 01 00 00 00 00 02 D7 00];

			samsung,panel-ldi-fps-read-cmds = [
								06 01 00 00 00 00 01 D7 01 1A]; /* read D7 27th , 27=0x1B*/
			samsung,panel-ldi-partial-disp-on = [
								29 01 00 00 00 00 05 30 00 C8 03 20
								29 01 00 00 00 00 02 12 00 ];
			samsung,panel-ldi-partial-disp-off = [29 01 00 00 00 00 02 13 00];

			qcom,panel-display-on-cmds	= [05 01 00 00 32 00 02 29 00];
			qcom,panel-display-off-cmds	= [05 01 00 00 32 00 02 28 00];

			samsung,panel-elvss-lowtemp-cmds-list = [
								29 01 00 00 00 00 02 B0 05
								29 01 00 00 00 00 02 B8 00
								29 01 00 00 00 00 02 B6 8C];	/* Low Temperature Command */
			samsung,panel-elvss-lowtemp2-cmds-list = [
								29 01 00 00 00 00 02 B0 14
								29 01 00 00 00 00 02 B6 00];	/* Low Temperature Command: default */

			samsung,panel-gamma-cmds-list = [
					29 01 00 00 00 00 22            /* Brightness Condition Set - Gamma 2.2 Setting*/
						CA 01 00 01 00 01 00 80
						80 80 80 80 80 80 80 80
						80 80 80 80 80 80 80 80
						80 80 80 80 80 80 80 00
						00 00
					29 01 00 00 00 00 02 F7 03		/* Gamma, LTPS(AID) update */
				];

			samsung,panel-gamma-hbm-cmds-list = [
						29 01 00 00 00 00 22            /* Brightness Condition Set for HBM - Gamma 2.2 Setting*/
						CA 01 00 01 00 01 00 80
						80 80 80 80 80 80 80 80
						80 80 80 80 80 80 80 80
						80 80 80 80 80 80 80 00
						00 00
				];

			/*
			 * ************************************************************************************************************************
			 * AID command list and mappings
			 * ************************************************************************************************************************
			 */
			samsung,panel-aid-cmds-list = [
				29 01 00 00 00 00 05 B2 09 D8 00 06 /* 0  samsung_brightness_aor_ 2cd_97.8 */
				29 01 00 00 00 00 05 B2 09 C1 00 06 /* 1  samsung_brightness_aor_ 3cd_96.9 */
				29 01 00 00 00 00 05 B2 09 AB 00 06 /* 2  samsung_brightness_aor_ 4cd_96.1 */
				29 01 00 00 00 00 05 B2 09 8C 00 06 /* 3  samsung_brightness_aor_ 5cd_94.9 */
				29 01 00 00 00 00 05 B2 09 74 00 06 /* 4  samsung_brightness_aor_ 6cd_93.9 */
				29 01 00 00 00 00 05 B2 09 5F 00 06 /* 5  samsung_brightness_aor_ 7cd_93.1 */
				29 01 00 00 00 00 05 B2 09 48 00 06 /* 6  samsung_brightness_aor_ 8cd_92.2 */
				29 01 00 00 00 00 05 B2 09 30 00 06 /* 7  samsung_brightness_aor_ 9cd_91.3 */
				29 01 00 00 00 00 05 B2 09 14 00 06 /* 8  samsung_brightness_aor_10cd_90.2 */
				29 01 00 00 00 00 05 B2 08 FC 00 06 /* 9  samsung_brightness_aor_11cd_89.3 */
				29 01 00 00 00 00 05 B2 08 E4 00 06 /* 10 samsung_brightness_aor_12cd_88.4 */
				29 01 00 00 00 00 05 B2 08 CB 00 06 /* 11 samsung_brightness_aor_13cd_87.4 */
				29 01 00 00 00 00 05 B2 08 B3 00 06 /* 12 samsung_brightness_aor_14cd_86.5 */
				29 01 00 00 00 00 05 B2 08 9B 00 06 /* 13 samsung_brightness_aor_15cd_85.5 */
				29 01 00 00 00 00 05 B2 08 82 00 06 /* 14 samsung_brightness_aor_16cd_84.5 */
				29 01 00 00 00 00 05 B2 08 6A 00 06 /* 15 samsung_brightness_aor_17cd_83.6 */
				29 01 00 00 00 00 05 B2 08 39 00 06 /* 16 samsung_brightness_aor_19cd_81.7 */
				29 01 00 00 00 00 05 B2 08 1E 00 06 /* 17 samsung_brightness_aor_20cd_80.7 */
				29 01 00 00 00 00 05 B2 08 06 00 06 /* 18 samsung_brightness_aor_21cd_79.7 */
				29 01 00 00 00 00 05 B2 07 ED 00 06 /* 19 samsung_brightness_aor_22cd_78.8 */
				29 01 00 00 00 00 05 B2 07 BB 00 06 /* 20 samsung_brightness_aor_24cd_76.8 */
				29 01 00 00 00 00 05 B2 07 A2 00 06 /* 21 samsung_brightness_aor_25cd_75.9 */
				29 01 00 00 00 00 05 B2 07 6A 00 06 /* 22 samsung_brightness_aor_27cd_73.7 */
				29 01 00 00 00 00 05 B2 07 3F 00 06 /* 23 samsung_brightness_aor_29cd_72.0 */
				29 01 00 00 00 00 05 B2 07 32 00 06 /* 24 samsung_brightness_aor_30cd_71.5 */
				29 01 00 00 00 00 05 B2 06 F3 00 06 /* 25 samsung_brightness_aor_32cd_69.1 */
				29 01 00 00 00 00 05 B2 06 C0 00 06 /* 26 samsung_brightness_aor_34cd_67.1 */
				29 01 00 00 00 00 05 B2 06 79 00 06 /* 27 samsung_brightness_aor_37cd_64.3 */
				29 01 00 00 00 00 05 B2 06 45 00 06 /* 28 samsung_brightness_aor_39cd_62.3 */
				29 01 00 00 00 00 05 B2 06 11 00 06 /* 29 samsung_brightness_aor_41cd_60.3 */
				29 01 00 00 00 00 05 B2 05 C9 00 06 /* 30 samsung_brightness_aor_44cd_57.5 */
				29 01 00 00 00 00 05 B2 05 7B 00 06 /* 31 samsung_brightness_aor_47cd_54.5 */
				29 01 00 00 00 00 05 B2 05 2B 00 06 /* 32 samsung_brightness_aor_50cd_51.4 */
				29 01 00 00 00 00 05 B2 04 DC 00 06 /* 33 samsung_brightness_aor_53cd_48.3 */
				29 01 00 00 00 00 05 B2 04 86 00 06 /* 34 samsung_brightness_aor_56cd_45.0 */
				29 01 00 00 00 00 05 B2 04 1F 00 06 /* 35 samsung_brightness_aor_60cd_41.0 */
				29 01 00 00 00 00 05 B2 04 06 00 06 /* 36 samsung_brightness_aor_64_143cd_40.0 */
				29 01 00 00 00 00 05 B2 03 DA 00 06 /* 37 samsung_brightness_aor_152cd_38.3 */
				29 01 00 00 00 00 05 B2 03 6C 00 06 /* 38 samsung_brightness_aor_162cd_34.0 */
				29 01 00 00 00 00 05 B2 03 0B 00 06 /* 39 samsung_brightness_aor_172cd_30.2 */
				29 01 00 00 00 00 05 B2 02 97 00 06 /* 40 samsung_brightness_aor_183cd_25.7 */
				29 01 00 00 00 00 05 B2 02 12 00 06 /* 41 samsung_brightness_aor_195cd_20.6 */
				29 01 00 00 00 00 05 B2 01 7B 00 06 /* 42 samsung_brightness_aor_207cd_14.7 */
				29 01 00 00 00 00 05 B2 00 E8 00 06 /* 43 samsung_brightness_aor_220cd_9.0  */
				29 01 00 00 00 00 05 B2 00 3B 00 06 /* 44 samsung_brightness_aor_234cd_2.3 */
				29 01 00 00 00 00 05 B2 00 06 00 06 /* 45 samsung_brightness_aor_249_350cd_0.2 */
			];

			/* bl_level, Index in aid command list */
			samsung,panel-aid-map-table = <
				2	0		3	1		4	2		5	3		6	4
				7	5		8	6		9	7		10	8		11	9
				12	10		13	11		14	12		15	13		16	14
				17	15		19	16		20	17		21	18		22	19
				24	20		25	21		27	22		29	23		30	24
				32	25		34	26		37	27		39	28		41	29
				44	30		47	31		50	32		53	33		56	34
				60	35		64	36		68	37		72	37		77	37
				82	37		87	37		93	37		98	37		105	37
				111	37		119	37		126	37		134	37		143	37
				152	37		162	38		172	39		183	40		195	41
				207	42		220	43		234	44		249	44		265	44
				282	44		300	44
			>;

			/*
			 * ************************************************************************************************************************
			 * ACL command list and mappings
			 * ************************************************************************************************************************
			 */
			 samsung,panel-aclcont-cmds-list = [
					29 01 00 00 00 00 02 B5 51]; /* ACL on, B5 <- 0x51 */

			samsung,panel-acl-cmds-list = [
					29 01 00 00 00 00 02 55 00
					29 01 00 00 00 00 02 55 01		/* ACL 30% */
					29 01 00 00 00 00 02 55 02		/* default ACL 15% */
					29 01 00 00 00 00 02 55 03];	/* ACL 50% */

			samsung,panel-acl-off-cmds = [
								29 01 00 00 00 00 02 B5 41   /* ACL OFF - 41 (16Frame Averaging) */
								29 01 00 00 00 00 02 55 00];/*off, b5<-0x41*/

			/* bl_level , Index in acl command list */
			samsung,panel-acl-map-table =  <
					2    2          3   2        4    2
				 	5    2          6   2        7    2    8   2       9   2
				 	10   2         11   2        12   2   13   2      14   2
				 	15   2         16   2        17   2   19   2      20   2
				 	21   2         22   2        24   2   25   2      27   2
				 	29   2         30   2        32   2   34   2      37   2
				 	39   2         41   2        44   2   47   2      50   2
				 	53   2         56   2        60   2   64   2      68   2
				 	72   2         77   2        82   2   87   2      93   2
				 	98   2         105  2        111  2   119  2      126  2
				 	134  2         143  2        152  2   162  2      172  2
				 	183  2         195  2        207  2   220  2      234  2
				 	249  2         265  2        282  2   300  2	  316  2
				 	333  2		   350  2
				>;

			/*
			 * ************************************************************************************************************************
			 * ELVSS(ACL Off) command list and mappings
			 * ************************************************************************************************************************
			 */
			samsung,panel-elvss-cmds-list = [
				29 01 00 00 00 00 03 b6 88 12 /* 0 DEFAULT_ELVSS(0x12) */
				29 01 00 00 00 00 03 b6 88 12 /* 1 DEFAULT_ELVSS(0x12) */
				29 01 00 00 00 00 03 b6 88 12 /* 2 DEFAULT_ELVSS(0x12) */
				29 01 00 00 00 00 03 b6 88 11 /* 3 DEFAULT_ELVSS(0x11) */
				29 01 00 00 00 00 03 b6 88 10 /* 4 DEFAULT_ELVSS(0x10) */
				29 01 00 00 00 00 03 b6 88 0F /* 5 DEFAULT_ELVSS(0x0F) */
				29 01 00 00 00 00 03 b6 88 0E /* 6 DEFAULT_ELVSS(0x0E) */
				29 01 00 00 00 00 03 b6 88 0D /* 7 DEFAULT_ELVSS(0x0D) */
				29 01 00 00 00 00 03 b6 88 0C /* 8 DEFAULT_ELVSS(0x0C) */
				29 01 00 00 00 00 03 b6 88 0B /* 9 DEFAULT_ELVSS(0x0B) */
				29 01 00 00 00 00 03 b6 88 0A /* 10 DEFAULT_ELVSS(0x0A) */
				29 01 00 00 00 00 03 b6 88 0A /* 11 DEFAULT_ELVSS(0x0A) */
				29 01 00 00 00 00 03 b6 88 09 /* 12 DEFAULT_ELVSS(0x09) */
				29 01 00 00 00 00 03 b6 88 09 /* 13 DEFAULT_ELVSS(0x09) */
				29 01 00 00 00 00 03 b6 88 08 /* 14 DEFAULT_ELVSS(0x08) */
				29 01 00 00 00 00 03 b6 88 07 /* 15 DEFAULT_ELVSS(0x07) */
				29 01 00 00 00 00 03 b6 88 07 /* 16 DEFAULT_ELVSS(0x07) */
				29 01 00 00 00 00 03 b6 88 06 /* 17 DEFAULT_ELVSS(0x06) */
				29 01 00 00 00 00 03 b6 88 05 /* 18 DEFAULT_ELVSS(0x05) */
				29 01 00 00 00 00 03 b6 88 05 /* 19 DEFAULT_ELVSS(0x05) */
				29 01 00 00 00 00 03 b6 88 04 /* 20 DEFAULT_ELVSS(0x04) */
			];

			/*
			 * ************************************************************************************************************************
			 * SMART ACL(ACL On) ELVSS command list and mappings
			 * ************************************************************************************************************************
			 */
			samsung,panel-smart-acl-elvss-cmds-list = [
				29 01 00 00 00 00 03 b6 88 12 /* 0 SMART_ACL_ELVSS(0x12) */
				29 01 00 00 00 00 03 b6 88 12 /* 1 SMART_ACL_ELVSS(0x12) */
				29 01 00 00 00 00 03 b6 88 12 /* 2 SMART_ACL_ELVSS(0x12) */
				29 01 00 00 00 00 03 b6 88 11 /* 3 SMART_ACL_ELVSS(0x11) */
				29 01 00 00 00 00 03 b6 88 10 /* 4 SMART_ACL_ELVSS(0x10) */
				29 01 00 00 00 00 03 b6 88 0F /* 5 SMART_ACL_ELVSS(0x0F) */
				29 01 00 00 00 00 03 b6 88 0E /* 6 SMART_ACL_ELVSS(0x0E) */
				29 01 00 00 00 00 03 b6 88 0D /* 7 SMART_ACL_ELVSS(0x0D) */
				29 01 00 00 00 00 03 b6 88 0C /* 8 SMART_ACL_ELVSS(0x0C) */
				29 01 00 00 00 00 03 b6 88 0B /* 9 SMART_ACL_ELVSS(0x0B) */
				29 01 00 00 00 00 03 b6 88 0A /* 10 SMART_ACL_ELVSS(0x0A) */
				29 01 00 00 00 00 03 b6 88 0A /* 11 SMART_ACL_ELVSS(0x0A) */
				29 01 00 00 00 00 03 b6 88 09 /* 12 SMART_ACL_ELVSS(0x09) */
				29 01 00 00 00 00 03 b6 88 09 /* 13 SMART_ACL_ELVSS(0x09) */
				29 01 00 00 00 00 03 b6 88 08 /* 14 SMART_ACL_ELVSS(0x08) */
				29 01 00 00 00 00 03 b6 88 07 /* 15 SMART_ACL_ELVSS(0x07) */
				29 01 00 00 00 00 03 b6 88 07 /* 16 SMART_ACL_ELVSS(0x07) */
				29 01 00 00 00 00 03 b6 88 06 /* 17 SMART_ACL_ELVSS(0x06) */
				29 01 00 00 00 00 03 b6 88 05 /* 18 SMART_ACL_ELVSS(0x05) */
				29 01 00 00 00 00 03 b6 88 05 /* 19 SMART_ACL_ELVSS(0x05) */
				29 01 00 00 00 00 03 b6 88 04 /* 20 SMART_ACL_ELVSS(0x04) */
			];

			/* bl_level, Index in elvss command list */
			/* bl_level, Index in elvss command list */
			samsung,panel-smart-acl-elvss-map-table = <
					2	17		3	17		4	17
					5	17		6	17		7	17		8	17		9	17
					10	17		11	17		12	17		13	17		14	17
					15	17		16	17		17	17		19	17		20	17
					21	17		22	17		24	17		25	17		27	17
					29	17		30	17		32	17		34	17		37	17
					39	17		41	17		44	17		47	17		50	17
					53	17		56	17		60	17		64	17		68	17
					72	17		77	17		82	17		87	17		93	17
					98	17		105	17		111	16		119	15		126	14
					134	13		143	12		152	11		162	10		172	9
					183	8		195	7		207	6		220	5		234	4
					249	3		265	2		282	1		300	0
					>;
			/*
			 * ************************************************************************************************************************
			 * candela to index mappings
			 * ************************************************************************************************************************
			 */
			samsung,panel-candella-mapping-table = <
			/*<idx>	  <from>  <till> <candella> */
				0		0		2		2
				1		3		3		3
				2		4		4		4
				3		5		5		5
				4		6		6		6
				5		7		7		7
				6		8		8		8
				7		9		9		9
				8		10		10		10
				9		11		11		11
				10		12		12		12
				11		13		13		13
				12		14		14		14
				13		15		15		15
				14		16		16		16
				15		17		18		17
				16		19		19		19
				17		20		20		20
				18		21		21		21
				19		22		23		22
				20		24		24		24
				21		25		26		25
				22		27		28		27
				23		29		29		29
				24		30		31		30
				25		32		32		32
				26		33		36		34
				27		37		38		37
				28		39		40		39
				29		41		43		41
				30		44		46		44
				31		47		49		47
				32		50		52		50
				33		53		55		53
				34		56		59		56
				35		60		63		60
				36		64		67		64
				37		68		71		68
				38		72		76		72
				39		77		81		77
				40		82		86		82
				41		87		92		87
				42		93		97		93
				43		98		104		98
				44		105		110		105
				45		111		118		111
				46		119		125		119
				47		126		133		126
				48		134		142		134
				49		143		149		143
				50		150		161		152
				51		162		171		162
				52		172		182		172
				53		183		194		183
				54		195		206		195
				55		207		219		207
				56		220		232		220
				57		233		248		234
				58		249		249		249
				59		250		251		265
				60		252		253		282
				61		254		255		300
				>;
	};

};

