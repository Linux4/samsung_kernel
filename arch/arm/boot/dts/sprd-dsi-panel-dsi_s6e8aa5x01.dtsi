&gen_panel {
	dsi_s6e8aa5x01_vid: gen-panel-s6e8aa5x01-video {
		gen-panel-manu = "SDC";			/* condensed manufacturer name */
		gen-panel-name = "s6e8aa5";
		gen-panel-id = <0x400002 0x400003>;
		gen-panel-dev-id = <0>;			/* SPRDFB_MAINLCD_ID : MAIN 0, SUB 1 */
		gen-panel-type = <2>;			/* LCD_MODE_DSI: MCU 0, RGB 1, DSI 2 */
		gen-panel-refresh = <60>;
		gen-panel-xres = <720>;
		gen-panel-yres = <1280>;
		gen-panel-width= <62>;			/* screen width in mm */
		gen-panel-height = <106>;		/* screen height in mm */
		gen-panel-work-mode = <1>;		/* SPRDFB_MIPI_MODE_VIDEO : CMD 0, VIDEO 1*/
		gen-panel-direction = <0>;		/* LCD_DIRECT_NORMAL : Normal 0, ROT90 1, ROT180 2, ROT270 3 */
		gen-panel-suspend-mode = <1>;	/* SEND_SLEEP_CMD : RST 0, SLEEP 1 */
		gen-panel-bus-width = <24>;
		gen-panel-lanes = <4>;
		gen-panel-phy-feq = <500000>;
		gen-panel-h-sync-pol = <0>;		/*SPRDFB_POLARITY_POS : POS 0, NEG 1 */
		gen-panel-v-sync-pol = <0>;		/*SPRDFB_POLARITY_POS : POS 0, NEG 1 */
		gen-panel-de-pol = <0>;			/*SPRDFB_POLARITY_POS : POS 0, NEG 1 */
		gen-panel-te-pol = <0>;			/*SPRDFB_POLARITY_POS : POS 0, NEG 1 */
		gen-panel-color-mode-pol = <1>;	/*SPRDFB_POLARITY_POS : POS 0, NEG 1 */
		gen-panel-shut-down-pol = <1>;	/*SPRDFB_POLARITY_POS : POS 0, NEG 1 */
		gen-panel-h-front-porch = <130>; /* hfp */
		gen-panel-h-back-porch = <90>;	/* hbp */
		gen-panel-h-sync-width = <40>;	/* hsync */
		gen-panel-v-front-porch = <14>;	/* vfp */
		gen-panel-v-back-porch = <6>;	/* vbp */
		gen-panel-v-sync-width = <4>;	/* vsync */
		gen-panel-octa-tset-param-offset = <7>;
		gen-panel-octa-mps-param-offset = <0>;
		gen-panel-octa-elvss-param-offset = <1>;
		gen-panel-octa-elvss-temp-param-offset = <21>;
		gen-panel-octa-aid-param-offset = <0>;
		gen-panel-octa-hbm-gamma-param-offset = <1>;
		gen-panel-octa-product-reg = [C8];	/* Product Date register */
		gen-panel-octa-product-gpara = <40>;		/* Global parameter should be 'count - 1' */
		gen-panel-octa-coordinate-reg = [D7];	/* Product Date register */
		gen-panel-octa-coordinate-gpara = <3>;		/* Global parameter should be 'count - 1' */
		gen-panel-acl-always-on;

		/*
		 * DSI PACKET HEADER INFO
		 * @ delay(msec) : 2byte
		 * @ size of data : 2byte
		 */
		gen-panel-pkt-dinfo-addr-offset = <0>;
		gen-panel-pkt-dinfo-addr-length = <1>;
		gen-panel-pkt-dinfo-data-offset = <1>;
		gen-panel-pkt-dinfo-data-length = <1>;
		gen-panel-post-enable-cmds = [
			05 00 00 16 00 01       11
		];
		gen-panel-post-enable-1-cmds = [
			39 00 00 00 00 03       F0 5A 5A
			39 00 00 00 00 04	C0 D8 D8 40
			39 00 00 00 00 08	B8 38 00 00 60 44 00 A8
			39 00 00 78 00 03       F0 A5 A5
			05 00 00 10 00 01       29
		];
		gen-panel-disable-cmds = [
			05 00 00 14 00 01	28
			05 00 00 78 00 01	10
		];
		gen-panel-nv-read-enable-cmds = [
			39 00 00 00 00 03	F0 5A 5A
		];
		gen-panel-nv-read-disable-cmds = [
			39 00 00 00 00 03	F0 A5 A5
		];
		gen-panel-acl-on-cmds = [
			15 00 00 00 00 02	55 02
			15 00 00 00 00 02	B5 50
		];
		gen-panel-acl-off-cmds = [
			15 00 00 00 00 02	55 00
			15 00 00 00 00 02	B5 40
		];
		gen-panel-hbm-on-cmds = [
			39 00 00 00 00 03	B6 BC 0F	/* MPS/ELVSS Setting */
			15 00 00 00 00 02	B5 50		/* OPR Average Calculation */
			15 00 00 00 00 02	53 C0		/* HBM Control */
			39 00 00 00 00 23	B4
						0B 01 27 01 21 01 27 80 80 80
						80 80 80 80 80 80 80 80 80 80
						80 80 80 80 80 80 80 80 80 80
						80 00 00 00
			15 00 00 00 00 02	55 02		/* 0x02 : ACL 15% on */
		];
		gen-panel-hbm-off-cmds = [
			15 00 00 00 00 02	53 00
		];
		gen-panel-tset-cmds = [
			39 00 00 00 00 09	B8 19 00 00 60 44 00 A8 19
		];
		gen-panel-elvss-cmds = [
			39 00 00 00 00 17	B6 BC 0F 00 00 00 00 00 00 00
						00 00 80 00 0A AA A2 12 03 33
						21 10 07
		];
		gen-panel-aid-cmds = [
			39 00 00 00 00 06	B2 40 00 28 00 0A
		];

		/* VREGOUT VOLTAGE 5.8 * 2^22 */
		gen-panel-octa-vregout = <24326963>;

		gen-panel-candela-table = <
			5	6	7	8	9	10	11	12	13	14
			15	16	17	19	20	21	22	24	25	27
			29	30	32	34	37	39	41	44	47	50
			53	56	60	64	68	72	77	82	87	93
			98	105	111	119	126	134	143	152	162	172
			183	195	207	220	234	249	265	282	300	316
			333	360
		>;

		gen-panel-acl-table = <
			0x02	0x02	0x02	0x02	0x02	0x02	0x02	0x02	0x02	0x02
			0x02	0x02	0x02	0x02	0x02	0x02	0x02	0x02	0x02	0x02
			0x02	0x02	0x02	0x02	0x02	0x02	0x02	0x02	0x02	0x02
			0x02	0x02	0x02	0x02	0x02	0x02	0x02	0x02	0x02	0x02
			0x02	0x02	0x02	0x02	0x02	0x02	0x02	0x02	0x02	0x02
			0x02	0x02	0x02	0x02	0x02	0x02	0x02	0x02	0x02	0x02
			0x02	0x02
		>;

		gen-panel-aid-table = <
			0x4EE	0x4E1	0x4D4	0x4CF	0x4C2	0x4B4	0x4AF	0x4A3	0x496	0x491
			0x482	0x475	0x470	0x454	0x450	0x442	0x433	0x41E	0x410	0x3F2
			0x3DE	0x3C6	0x3B1	0x395	0x373	0x35F	0x343	0x320	0x2FE	0x2DF
			0x2B2	0x290	0x25E	0x230	0x1F4	0x1F4	0x1F4	0x1F4	0x1F4	0x1F4
			0x1F4	0x1F4	0x1F4	0x1F4	0x1BF	0x182	0x140	0x100	0x0B2	0x062
			0x00F	0x00F	0x00F	0x00F	0x00F	0x00F	0x00F	0x00F	0x00F	0x00F
			0x00F	0x00F
		>;

		gen-panel-mps-table = <
			0xAC	0xAC	0xAC	0xAC	0xAC	0xAC	0xAC	0xAC	0xAC	0xAC
			0xAC	0xAC	0xAC	0xAC	0xAC	0xAC	0xAC	0xAC	0xAC	0xAC
			0xAC	0xAC	0xAC	0xAC	0xAC	0xAC	0xBC	0xBC	0xBC	0xBC
			0xBC	0xBC	0xBC	0xBC	0xBC	0xBC	0xBC	0xBC	0xBC	0xBC
			0xBC	0xBC	0xBC	0xBC	0xBC	0xBC	0xBC	0xBC	0xBC	0xBC
			0xBC	0xBC	0xBC	0xBC	0xBC	0xBC	0xBC	0xBC	0xBC	0xBC
			0xBC	0xBC
		>;

		gen-panel-elvss-table = <
			0x0F	0x0F	0x0F	0x0F	0x0F	0x0F	0x0F	0x0F	0x0F	0x0F
			0x0F	0x0F	0x0F	0x0F	0x0F	0x11	0x14	0x17	0x19	0x1B
			0x1D	0x1F	0x1F	0x1F	0x1F	0x1F	0x1F	0x1F	0x1F	0x1F
			0x1F	0x1F	0x1F	0x1F	0x1F	0x1F	0x1F	0x1F	0x1F	0x1F
			0x1F	0x1F	0x1E	0x1E	0x1E	0x1E	0x1D	0x1D	0x1D	0x1D
			0x1C	0x1B	0x1A	0x18	0x18	0x17	0x16	0x14	0x13	0x12
			0x10	0x0F
		>;

		gen-panel-elvss-temperature-table = <
			/* T > 0 */
			0x05	0x05	0x05	0x05	0x05	0x05	0x05	0x05	0x05	0x05
			0x05	0x05	0x05	0x05	0x05	0x07	0x07	0x07	0x07	0x07
			0x07	0x00	0x00	0x00	0x00	0x00	0x00	0x00	0x00	0x00
			0x00	0x00	0x00	0x00	0x00	0x00	0x00	0x00	0x00	0x00
			0x00	0x00	0x00	0x00	0x00	0x00	0x00	0x00	0x00	0x00
			0x00	0x00	0x00	0x00	0x00	0x00	0x00	0x00	0x00	0x00
			0x00	0x00

			/* 0 >= T > -20 */
			0x0F	0x0F	0x0F	0x0F	0x0F	0x0F	0x0F	0x0F	0x0F	0x0F
			0x0F	0x0F	0x0F	0x0F	0x0F	0x0F	0x0E	0x0D	0x0C	0x0B
			0x0A	0x00	0x00	0x00	0x00	0x00	0x00	0x00	0x00	0x00
			0x00	0x00	0x00	0x00	0x00	0x00	0x00	0x00	0x00	0x00
			0x00	0x00	0x00	0x00	0x00	0x00	0x00	0x00	0x00	0x00
			0x00	0x00	0x00	0x00	0x00	0x00	0x00	0x00	0x00	0x00
			0x00	0x00

			/* -20 > T */
			0x13	0x13	0x13	0x13	0x13	0x13	0x13	0x13	0x13	0x13
			0x13	0x13	0x13	0x13	0x13	0x13	0x12	0x10	0x0E	0x0C
			0x0A	0x00	0x00	0x00	0x00	0x00	0x00	0x00	0x00	0x00
			0x00	0x00	0x00	0x00	0x00	0x00	0x00	0x00	0x00	0x00
			0x00	0x00	0x00	0x00	0x00	0x00	0x00	0x00	0x00	0x00
			0x00	0x00	0x00	0x00	0x00	0x00	0x00	0x00	0x00	0x00
			0x00	0x00
		>;

		gen-panel-base-lux-table = <
			113	113	113	113	113	113	113	113	113	113
			113	113	113	113	113	113	113	113	113	113
			113	113	113	113	113	113	113	113	113	113
			113	113	113	113	113	118	127	135	142	151
			160	172	180	192	192	192	192	192	192	192
			192	204	215	228	240	255	271	286	303	318
			336	360
		>;

		gen-panel-gamma-curve-table = <
			200	200	200	200	200	200	200	200	200	200
			200	200	200	200	200	200	200	200	200	200
			200	200	200	200	200	200	200	200	200	200
			200	200	200	200	200	200	200	200	200	200
			200	200	200	200	200	200	200	200	200	200
			200	200	200	200	200	200	200	200	200	200
			200	200
		>;

		gen-panel-candela-compensation-table = <
			/* V255 V203 V151 V87 V51 V35 V23 V11 V3 */
			0	3	2	2	3	3	7	9	5
			0	2	1	2	3	3	6	9	5
			0	3	2	2	3	3	6	9	5
			0	3	2	1	2	3	5	8	5
			0	3	2	1	2	2	5	7	5
			0	2	1	1	2	2	5	7	5
			0	2	1	1	1	2	4	7	5
			0	3	2	1	2	2	4	6	5
			0	2	1	1	1	2	4	6	5
			0	3	2	1	2	2	4	5	5
			0	2	1	1	1 	2	3	5	5
			0	2	1	1	1	1	3	4	5
			0	3	2	1	1	1	3	4	5
			0	2	1	1	1	1	3	4	5
			0	3	2	1	1	1	3	4	5
			0	3	2	1	1	1	3	4	5
			0	3	2	1	1	2	3	4	5
			0	3	2	1	2	2	3	4	5
			0	3	2	2	2	2	4	5	5
			0	3	3	2	2	2	4	5	5
			0	3	3	2	2	2	4	5	5
			0	3	3	2	2	2	4	5	5
			0	3	3	2	2	2	4	5	5
			0	3	3	2	2	2	4	5	5
			0	3	3	2	2	2	4	4	5
			0	3	3	2	2	2	3	4	5
			0	3	3	2	2	2	3	4	5
			0	3	3	2	2	2	3	4	4
			0	3	3	2	2	2	3	3	4
			0	3	3	2	2	2	3	3	4
			0	3	3	2	2	2	2	3	4
			0	3	3	2	2	2	2	3	4
			0	3	3	2	2	2	2	3	3
			0	3	3	2	2	2	2	3	3
			0	3	3	2	2	2	2	3	3
			0	3	3	2	2	2	2	3	3
			0	3	3	2	2	2	2	2	3
			0	3	3	3	2	2	2	2	3
			0	3	3	4	2	2	2	2	3
			0	3	3	4	2	2	2	2	3
			0	3	3	4	2	2	2	2	3
			0	2	3	4	3	2	2	2	3
			0	2	3	4	3	2	2	2	3
			0	2	3	4	3	2	2	2	3
			0	2	3	4	3	2	2	2	3
			0	2	3	4	3	2	2	2	3
			0	2	3	4	3	2	2	2	2
			0	2	3	4	2	2	2	2	2
			0	2	3	3	2	2	2	2	2
			0	2	3	3	2	2	2	2	2
			0	1	3	3	2	2	2	2	2
			0	1	3	3	2	2	2	2	2
			0	1	3	3	2	2	2	2	2
			0	1	3	3	2	2	2	1	2
			0	1	3	3	2	2	2	1	2
			0	1	3	3	2	2	2	1	2
			0	1	3	3	2	2	2	0	1
			0	1	2	2	2	2	1	0	1
			0	1	1	2	2	2	1	0	0
			0	0	1	2	2	1	1	0	0
			0	0	1	1	2	1	1	0	0
			0	0	0	0	0	0	0	0	0
		>;

		gen-panel-rgb-compensation-table = <
			/* R255 G255 B255 R203 G203 B203 R151 G151 B151 R87 G87 B87 R51 G51 B51 R35 G35 B35 R23 G23 B23 R11 G11 B11 */
			2	0	1	0	0	1	(-1)	0	2	(-3)	0	0	(-5)	0	4	(-6)	0	(-3)	(-14)	0	(-2)	0	0	1
			2	0	1	0	0	1	(-1)	0	1	(-2)	0	0	(-4)	0	4	(-6)	0	(-3)	(-13)	0	(-4)	(-3)	0	1
			2	0	1	0	0	1	0	0	2	(-3)	0	0	(-4)	0	3	(-5)	0	(-3)	(-13)	0	(-3)	(-6)	0	0
			2	0	1	0	0	1	0	0	2	(-1)	0	1	(-4)	0	3	(-5)	0	(-4)	(-12)	0	(-4)	(-8)	0	0
			2	0	1	0	0	1	0	0	2	(-1)	0	1	(-3)	0	3	(-5)	0	(-5)	(-10)	0	(-2)	(-10)	0	1
			2	0	1	0	0	1	(-1)	0	1	0	0	1	(-4)	0	2	(-4)	0	(-3)	(-8)	0	(-2)	(-12)	0	(-1)
			2	0	1	0	0	1	(-1)	0	1	0	0	1	(-3)	0	2	(-4)	0	(-3)	(-9)	0	(-3)	(-13)	0	(-1)
			2	0	1	0	0	1	(-1)	0	1	(-1)	0	1	(-2)	0	3	(-3)	0	(-5)	(-9)	0	(-2)	(-13)	0	(-1)
			2	0	1	0	0	1	0	0	1	(-1)	0	1	(-3)	0	2	(-3)	0	(-5)	(-7)	0	(-1)	(-11)	0	(-1)
			2	0	1	0	0	1	0	0	2	(-2)	0	0	(-2)	0	3	(-2)	0	(-5)	(-5)	0	(-2)	(-11)	0	(-1)
			2	0	1	0	0	1	0	0	1	(-2)	0	0	(-2)	0	3	(-1)	0	(-4)	(-7)	0	(-3)	(-11)	0	(-2)
			2	0	1	0	0	1	0	0	1	(-2)	0	0	(-1)	0	3	(-1)	0	(-4)	(-5)	0	(-3)	(-13)	0	(-2)
			2	0	1	0	0	1	0	0	2	(-2)	0	0	(-2)	0	2	(-1)	0	(-4)	(-5)	0	(-3)	(-11)	0	0
			2	0	1	(-1)	0	0	0	0	2	0	0	1	(-2)	0	2	(-1)	0	(-4)	(-5)	0	(-4)	(-9)	0	1
			2	0	1	(-1)	0	0	0	0	2	0	0	1	(-2)	0	2	(-1)	0	(-4)	(-5)	0	(-3)	(-8)	0	2
			2	0	1	(-1)	0	0	0	0	2	0	0	1	(-2)	0	2	0	0	(-4)	(-6)	0	(-5)	(-7)	0	0
			2	0	1	(-1)	0	0	0	0	2	0	0	1	(-2)	0	2	0	0	(-4)	(-6)	0	(-4)	(-7)	1	(-3)
			2	0	1	(-1)	0	0	0	0	2	0	0	1	(-2)	0	2	0	0	(-4)	(-6)	0	(-6)	(-7)	1	(-3)
			2	0	1	(-1)	0	0	0	0	2	0	0	1	(-3)	0	1	0	0	(-5)	(-5)	0	(-5)	(-9)	0	(-4)
			2	0	1	(-1)	0	1	0	0	2	(-1)	0	0	(-2)	0	1	0	0	(-5)	(-3)	0	(-5)	(-9)	0	(-5)
			2	0	1	(-1)	0	1	0	0	2	(-1)	0	0	(-2)	0	1	0	0	(-5)	(-3)	0	(-5)	(-9)	0	(-5)
			2	0	1	(-1)	0	1	0	0	2	(-1)	0	0	(-2)	0	1	0	0	(-6)	(-4)	0	(-5)	(-9)	0	(-7)
			2	0	0	(-1)	0	1	0	0	2	(-1)	0	0	(-2)	0	1	1	0	(-6)	(-3)	0	(-5)	(-9)	0	(-6)
			2	0	0	(-1)	0	1	0	0	2	(-1)	0	0	(-1)	0	1	1	0	(-6)	(-3)	0	(-4)	(-9)	0	(-6)
			2	0	0	(-1)	0	1	0	0	2	(-1)	0	0	(-1)	0	1	1	0	(-6)	(-2)	0	(-4)	(-9)	0	(-7)
			2	0	0	(-1)	0	1	0	0	2	(-1)	0	0	(-1)	0	1	1	0	(-6)	(-2)	0	(-5)	(-8)	0	(-4)
			2	0	0	(-1)	0	1	(-1)	0	2	(-1)	0	0	(-1)	0	1	2	0	(-6)	(-1)	0	(-4)	(-8)	0	(-3)
			2	0	0	(-1)	0	1	(-1)	0	2	(-1)	0	0	(-1)	0	1	2	0	(-6)	(-1)	0	(-4)	(-7)	0	(-2)
			2	0	0	(-1)	0	1	(-1)	0	2	(-1)	0	0	(-1)	0	1	2	0	(-6)	(-1)	0	(-4)	(-6)	0	(-3)
			2	0	0	(-1)	0	1	(-1)	0	2	(-1)	0	0	(-1)	0	1	3	0	(-5)	(-2)	0	(-4)	(-5)	0	(-1)
			2	0	0	(-1)	0	1	(-1)	0	2	(-1)	0	0	(-1)	0	1	3	0	(-5)	(-1)	0	(-4)	(-5)	0	0
			2	0	0	(-1)	0	1	(-1)	0	2	(-1)	0	0	(-1)	0	1	3	0	(-5)	(-1)	0	(-4)	(-5)	0	1
			2	0	0	(-1)	0	1	(-1)	0	2	(-1)	0	0	(-1)	0	1	3	0	(-5)	0	0	(-4)	(-5)	0	3
			2	0	0	(-1)	0	1	(-1)	0	2	(-1)	0	0	(-1)	0	1	3	0	(-5)	0	0	(-4)	(-5)	0	4
			1	0	0	(-1)	0	0	(-1)	0	1	(-1)	0	0	0	0	2	3	0	(-5)	0	0	(-4)	(-6)	0	0
			1	0	0	(-1)	0	0	(-1)	0	1	(-1)	0	0	0	0	2	2	0	(-4)	0	0	(-4)	(-5)	0	0
			1	0	0	(-1)	0	0	(-1)	0	1	(-1)	0	0	0	0	2	1	0	(-5)	0	0	(-3)	(-3)	0	0
			1	0	0	(-1)	0	0	(-1)	0	1	(-1)	0	0	0	0	2	1	0	(-4)	0	0	(-3)	(-5)	0	0
			1	0	0	(-1)	0	0	(-1)	0	1	(-1)	0	(-1)	0	0	3	1	0	(-4)	0	0	(-4)	(-3)	0	1
			1	0	0	(-1)	0	0	(-1)	0	1	(-1)	0	(-1)	(-1)	0	2	3	0	(-4)	0	0	(-4)	(-3)	0	0
			1	0	0	(-1)	0	0	(-1)	0	1	(-1)	0	(-1)	0	0	2	3	0	(-3)	0	0	(-4)	(-3)	0	0
			1	0	0	(-1)	0	0	0	0	1	(-1)	0	(-1)	0	0	2	1	0	(-4)	0	0	(-4)	(-4)	0	0
			1	0	0	0	0	0	0	0	1	(-1)	0	(-1)	0	0	2	1	0	(-3)	0	0	(-4)	(-3)	0	(-1)
			0	0	0	1	0	(-1)	(-1)	0	1	(-1)	0	0	0	0	0	0	0	(-3)	1	0	(-1)	(-2)	0	(-1)
			0	0	0	1	0	(-1)	(-1)	0	0	(-1)	0	0	(-1)	0	1	1	0	(-3)	1	0	(-1)	(-1)	0	0
			0	0	0	1	0	(-1)	(-1)	0	0	(-1)	0	0	(-1)	0	1	1	0	(-3)	1	0	(-1)	(-1)	0	0
			0	0	0	1	0	(-1)	(-1)	0	0	(-1)	0	0	(-1)	0	1	1	0	(-3)	1	0	(-1)	0	0	1
			0	0	0	1	0	(-1)	(-1)	0	0	(-1)	0	0	(-1)	0	1	1	0	(-3)	1	0	(-1)	1	0	1
			0	0	0	1	0	(-1)	(-1)	0	0	0	0	1	(-1)	0	1	1	0	(-3)	0	0	(-2)	0	0	1
			0	0	0	1	0	(-1)	(-1)	0	0	0	0	1	(-1)	0	1	1	0	(-3)	0	0	(-2)	0	0	1
			0	0	0	0	0	0	0	0	0	0	0	0	0	0	0	0	0	0	0	0	0	0	0	0
			0	0	0	0	0	0	0	0	0	0	0	0	0	0	0	0	0	0	0	0	0	0	0	0
			0	0	0	0	0	0	0	0	0	0	0	0	0	0	0	0	0	0	0	0	0	0	0	0
			0	0	0	0	0	0	0	0	0	0	0	0	0	0	0	0	0	0	0	0	0	0	0	0
			0	0	0	0	0	0	0	0	0	0	0	0	0	0	0	0	0	0	0	0	0	0	0	0
			0	0	0	0	0	0	0	0	0	0	0	0	0	0	0	0	0	0	0	0	0	0	0	0
			0	0	0	0	0	0	0	0	0	0	0	0	0	0	0	0	0	0	0	0	0	0	0	0
			0	0	0	0	0	0	0	0	0	0	0	0	0	0	0	0	0	0	0	0	0	0	0	0
			0	0	0	0	0	0	0	0	0	0	0	0	0	0	0	0	0	0	0	0	0	0	0	0
			0	0	0	0	0	0	0	0	0	0	0	0	0	0	0	0	0	0	0	0	0	0	0	0
			0	0	0	0	0	0	0	0	0	0	0	0	0	0	0	0	0	0	0	0	0	0	0	0
			0	0	0	0	0	0	0	0	0	0	0	0	0	0	0	0	0	0	0	0	0	0	0	0
		>;


		gen-panel-gamma-cmds = [
			39 00 00 00 00 22	CA 01 00 01 00 01 00 80 80 80 80 80 80 80 80 80
						80 80 80 80 80 80 80 80 80 80 80 80 80 80 80 00
						00 00
		];
		gen-panel-gamma-update-cmds = [
			15 00 00 05 00 02	F7 03
		];
		gen-panel-read-hbm = [
			C8 21 06
			C8 48 0F
		];
		gen-panel-read-mtp = [C8 00 21];
		gen-panel-read-id = [
			DA 00 01
			DB 00 01
			DC 00 01
		];
		gen-panel-read-status-reg = [0A];
		gen-panel-read-status-ok = [9A];
		status = "okay";


		/* #################### MDNIE SETTINGS #################### */
		gen-panel-mdnie-color-adjustment-mode-reg = [EC];
		gen-panel-mdnie-color-adjustment-mode-offset = <106>;

		gen-panel-mdnie-negative-mode-cmds = [
			39 00 00 00 00 83	EC 00 00 00 00 00 00 00 00 00 00 00 00 00 00 00
						00 00 00 FF 00 00 07 FF 07 FF 01 00 00 20 00 20
						00 20 00 20 00 20 00 20 00 20 00 20 00 20 00 20
						00 20 00 20 00 20 00 20 00 20 00 20 00 20 00 20
						00 20 00 20 00 20 00 20 00 20 00 FF 00 67 A9 0C
						0C 0C 0C 00 AA AB 00 AA AB 00 AA AB 00 AA AB FF
						00 00 FF FF 00 FF 00 FF FF FF FF FF 00 00 FF 00
						FF 00 FF FF 00 00 FF 00 FF 00 FF FF 00 00 FF 00
						FF 00 FF
			39 00 00 00 00 04       EB 01 30 00
		];

		gen-panel-mdnie-color-adjustment-mode-cmds = [
			39 00 00 00 00 83	EC 00 00 00 00 00 00 00 00 00 00 00 00 00 00 00
						00 00 00 FF 00 00 07 FF 07 FF 01 00 00 20 00 20
						00 20 00 20 00 20 00 20 00 20 00 20 00 20 00 20
						00 20 00 20 00 20 00 20 00 20 00 20 00 20 00 20
						00 20 00 20 00 20 00 20 00 20 00 FF 00 67 A9 0C
						0C 0C 0C 00 AA AB 00 AA AB 00 AA AB 00 AA AB FF
						00 00 FF FF 00 FF 00 FF FF FF FF 00 FF FF 00 FF
						00 FF 00 00 FF FF 00 FF 00 FF 00 00 FF FF 00 FF
						00 FF 00
			39 00 00 00 00 04       EB 01 30 00
		];

		gen-panel-mdnie-dark-screene-mode-cmds = [
			39 00 00 00 00 83	EC 00 00 00 00 00 00 00 00 00 00 00 00 00 00 00
						00 00 00 FF 00 00 07 FF 07 FF 01 00 00 20 00 20
						00 20 00 20 00 20 00 20 00 20 00 20 00 20 00 20
						00 20 00 20 00 20 00 20 00 20 00 20 00 20 00 20
						00 20 00 20 00 20 00 20 00 20 00 FF 00 67 A9 0C
						0C 0C 0C 00 AA AB 00 AA AB 00 AA AB 00 AA AB FF
						00 00 FF FF 00 FF 00 FF FF FF FF 00 00 00 00 00
						00 00 00 00 00 00 00 00 00 00 00 00 00 00 00 00
						00 00 00
			39 00 00 00 00 04	EB 01 30 00
		];

		gen-panel-mdnie-gray-scale-cmds = [
			39 00 00 00 00 83	EC 00 00 00 00 00 00 00 00 00 00 00 00 00 00 00
						00 00 00 FF 00 00 07 FF 07 FF 01 00 00 20 00 20
						00 20 00 20 00 20 00 20 00 20 00 20 00 20 00 20
						00 20 00 20 00 20 00 20 00 20 00 20 00 20 00 20
						00 20 00 20 00 20 00 20 00 20 00 FF 00 67 A9 0C
						0C 0C 0C 00 AA AB 00 AA AB 00 AA AB 00 AA AB FF
						00 00 FF FF 00 FF 00 FF FF FF FF B3 4C B3 4C B3
						4C 69 96 69 96 69 96 E2 1D E2 1D E2 1D FF 00 FF
						00 FF 00
			39 00 00 00 00 04       EB 01 30 00
		];

		gen-panel-mdnie-gray-scale-negative-cmds = [
			39 00 00 00 00 83	EC 00 00 00 00 00 00 00 00 00 00 00 00 00 00 00
						00 00 00 FF 00 00 07 FF 07 FF 01 00 00 20 00 20
						00 20 00 20 00 20 00 20 00 20 00 20 00 20 00 20
						00 20 00 20 00 20 00 20 00 20 00 20 00 20 00 20
						00 20 00 20 00 20 00 20 00 20 00 FF 00 67 A9 0C
						0C 0C 0C 00 AA AB 00 AA AB 00 AA AB 00 AA AB FF
						00 00 FF FF 00 FF 00 FF FF FF FF 4C B3 4C B3 4C
						B3 96 69 96 69 96 69 1D E2 1D E2 1D E2 00 FF 00
						FF 00 FF
			39 00 00 00 00 04       EB 01 30 00
		];

		gen-panel-mdnie-hbm-cmds = [
			39 00 00 00 00 83	EC 00 00 00 00 00 00 00 00 00 00 00 00 00 00 00
						00 00 02 FF 00 00 07 FF 07 FF 01 20 00 20 00 20
						00 20 00 20 00 20 00 20 00 20 00 20 00 20 00 20
						00 20 00 20 00 20 00 20 00 20 00 20 00 20 00 20
						00 20 00 20 00 20 00 20 00 20 00 FF 00 67 A9 0C
						0C 0C 0C 00 AA AB 00 AA AB 00 AA AB 00 AA AB FF
						00 00 FF FF 00 FF 00 FF FF FF FF 00 FF FF 00 FF
						00 FF 00 00 FF FF 00 FF 00 FF 00 00 FF FF 00 FF
						00 FF 00
			39 00 00 00 00 04       EB 01 33 00
		];
		gen-panel-mdnie-hbm-text-cmds = [
			39 00 00 00 00 83	EC 00 00 00 00 00 00 00 00 00 00 00 00 00 00 00
						00 00 02 FF 00 00 07 FF 07 FF 01 20 00 20 00 20
						00 20 00 20 00 20 00 20 00 20 00 20 00 20 00 20
						00 20 00 20 00 20 00 20 00 20 00 20 00 20 00 20
						00 20 00 20 00 20 00 20 00 20 00 FF 00 67 A9 0C
						0C 0C 0C 00 AA AB 00 AA AB 00 AA AB 00 AA AB FF
						00 00 FF FF 00 FF 00 FF FF FF FF 00 FF FF 00 FF
						00 FF 00 00 FF FF 00 FF 00 FF 00 00 FF FF 00 FF
						00 FF 00
			39 00 00 00 00 04       EB 01 33 00
		];


		/* STANDARD MODE */
		gen-panel-mdnie-ui-mode-cmds = [
			39 00 00 00 00 83	EC 00 00 00 00 00 00 00 00 00 00 00 00 00 00 00
						00 00 00 FF 00 00 00 A0 00 A0 01 00 00 20 00 20
						00 20 00 20 00 20 00 20 00 20 00 20 00 20 00 20
						00 20 00 20 00 20 00 20 00 20 00 20 00 20 00 20
						00 20 00 20 00 20 00 20 00 20 00 FF 00 67 A9 0C
						0C 0C 0C 00 AA AB 00 AA AB 00 AA AB 00 AA AB FF
						00 00 FF FF 00 FF 00 FF FF FF FF 00 F9 EF 00 E4
						00 FF 00 00 E4 E4 00 F3 00 EE 00 18 ED FF 00 F7
						00 ED 00
			39 00 00 00 00 04	EB 01 33 00
		];

		gen-panel-mdnie-video-mode-cmds = [
			39 00 00 00 00 83	EC 00 00 00 00 00 00 00 00 00 00 00 00 00 00 00
						00 00 04 FF 00 04 00 40 00 40 01 00 00 20 00 20
						00 20 00 20 00 20 00 20 00 20 00 20 00 20 00 20
						00 20 00 20 00 20 00 20 00 20 00 20 00 20 00 20
						00 20 00 20 00 20 00 20 00 20 00 FF 00 67 A9 0C
						0C 0C 0C 00 AA AB 00 AA AB 00 AA AB 00 AA AB FF
						00 00 FF FF 00 FF 00 FF FF FF FF 00 F9 EF 00 E4
						00 FF 00 00 E4 E4 00 F3 00 EE 00 18 ED FF 00 F7
						00 ED 00
			39 00 00 00 00 04	EB 01 33 00
		];

		gen-panel-mdnie-camera-mode-cmds = [
			39 00 00 00 00 83	EC 00 00 00 00 00 00 00 00 00 00 00 00 00 00 00
						00 00 00 FF 00 00 00 A0 00 A0 01 00 00 20 00 20
						00 20 00 20 00 20 00 20 00 20 00 20 00 20 00 20
						00 20 00 20 00 20 00 20 00 20 00 20 00 20 00 20
						00 20 00 20 00 20 00 20 00 20 00 FF 00 67 A9 0C
						0C 0C 0C 00 AA AB 00 AA AB 00 AA AB 00 AA AB FF
						00 00 FF FF 00 FF 00 FF FF FF FF 00 F9 EF 00 E4
						00 FF 00 00 E4 E4 00 F3 00 EE 00 18 ED FF 00 F7
						00 ED 00
			39 00 00 00 00 04	EB 01 33 00
		];

		gen-panel-mdnie-gallery-mode-cmds = [
			39 00 00 00 00 83	EC 00 00 00 00 00 00 00 00 00 00 00 00 00 00 00
						00 00 04 FF 00 04 00 A0 00 A0 01 00 00 20 00 20
						00 20 00 20 00 20 00 20 00 20 00 20 00 20 00 20
						00 20 00 20 00 20 00 20 00 20 00 20 00 20 00 20
						00 20 00 20 00 20 00 20 00 20 00 FF 00 67 A9 0C
						0C 0C 0C 00 AA AB 00 AA AB 00 AA AB 00 AA AB FF
						00 00 FF FF 00 FF 00 FF FF FF FF 00 F9 EF 00 E4
						00 FF 00 00 E4 E4 00 F3 00 EE 00 18 ED FF 00 F7
						00 ED 00
			39 00 00 00 00 04	EB 01 33 00
		];

		gen-panel-mdnie-vt-mode-cmds = [
			39 00 00 00 00 83	EC 00 00 00 00 00 00 00 00 00 00 00 00 00 00 00
						00 00 00 FF 00 00 00 A0 00 A0 01 00 00 20 00 20
						00 20 00 20 00 20 00 20 00 20 00 20 00 20 00 20
						00 20 00 20 00 20 00 20 00 20 00 20 00 20 00 20
						00 20 00 20 00 20 00 20 00 20 00 FF 00 67 A9 0C
						0C 0C 0C 00 AA AB 00 AA AB 00 AA AB 00 AA AB FF
						00 00 FF FF 00 FF 00 FF FF FF FF 00 F9 EF 00 E4
						00 FF 00 00 E4 E4 00 F3 00 EE 00 18 ED FF 00 F7
						00 ED 00
			39 00 00 00 00 04	EB 01 33 00
		];

		gen-panel-mdnie-browser-mode-cmds = [
			39 00 00 00 00 83	EC 00 00 00 00 00 00 00 00 00 00 00 00 00 00 00
						00 00 00 FF 00 00 00 A0 00 A0 01 00 00 20 00 20
						00 20 00 20 00 20 00 20 00 20 00 20 00 20 00 20
						00 20 00 20 00 20 00 20 00 20 00 20 00 20 00 20
						00 20 00 20 00 20 00 20 00 20 00 FF 00 67 A9 0C
						0C 0C 0C 00 AA AB 00 AA AB 00 AA AB 00 AA AB FF
						00 00 FF FF 00 FF 00 FF FF FF FF 00 F9 EF 00 E4
						00 FF 00 00 E4 E4 00 F3 00 EE 00 18 ED FF 00 F7
						00 ED 00
			39 00 00 00 00 04	EB 01 33 00
		];

		gen-panel-mdnie-ebook-mode-cmds = [
			39 00 00 00 00 83	EC 00 00 00 00 00 00 00 00 00 00 00 00 00 00 00
						00 00 00 FF 00 00 00 A0 00 A0 01 00 00 20 00 20
						00 20 00 20 00 20 00 20 00 20 00 20 00 20 00 20
						00 20 00 20 00 20 00 20 00 20 00 20 00 20 00 20
						00 20 00 20 00 20 00 20 00 20 00 FF 00 67 A9 0C
						0C 0C 0C 00 AA AB 00 AA AB 00 AA AB 00 AA AB FF
						00 00 FF FF 00 FF 00 FF FF FF FF 00 F9 EF 00 E4
						00 FF 00 00 E4 E4 00 F3 00 EE 00 18 ED FF 00 F7
						00 ED 00
			39 00 00 00 00 04	EB 01 33 00
		];

		gen-panel-mdnie-email-mode-cmds = [
			39 00 00 00 00 83	EC 00 00 00 00 00 00 00 00 00 00 00 00 00 00 00
						00 00 00 FF 00 00 07 FF 07 FF 01 00 00 20 00 20
						00 20 00 20 00 20 00 20 00 20 00 20 00 20 00 20
						00 20 00 20 00 20 00 20 00 20 00 20 00 20 00 20
						00 20 00 20 00 20 00 20 00 20 00 FF 00 67 A9 0C
						0C 0C 0C 00 AA AB 00 AA AB 00 AA AB 00 AA AB FF
						00 00 FF FF 00 FF 00 FF FF FF FF 00 FF FF 00 FF
						00 FF 00 00 FF FF 00 FF 00 FF 00 00 FF FF 00 F4
						00 E4 00
			39 00 00 00 00 04       EB 01 30 00
		];

		/* AUTO MODE */
		gen-panel-mdnie-auto-ui-mode-cmds = [
			39 00 00 00 00 83	EC 00 00 00 00 00 00 00 00 00 00 00 00 00 00 00
						00 00 00 FF 00 08 00 A0 00 A0 01 00 00 20 00 20
						00 20 00 20 00 20 00 20 00 20 00 20 00 20 00 20
						00 20 00 20 00 20 00 20 00 20 00 20 00 20 00 20
						00 20 00 20 00 20 00 20 00 20 00 FF 00 6A 9A 25
						1A 16 2A 00 37 5A 00 4E C5 00 5D 17 00 30 C3 FF
						00 00 FF FF 00 FF 00 FF FF FF FF 00 FF FF 00 FF
						00 FF 00 00 FF FF 00 FF 00 FF 00 00 FF FF 00 FF
						00 FF 00
			39 00 00 00 00 04       EB 01 33 00
		];

		gen-panel-mdnie-auto-video-mode-cmds = [
			39 00 00 00 00 83	EC 00 00 00 00 00 00 00 00 00 00 00 00 00 00 00
						00 00 07 FF 00 08 00 40 00 40 01 20 00 14 00 14
						00 14 00 14 03 9A 03 9A 03 9A 03 9A 07 9E 07 9E
						07 9E 07 9E 0A A0 0A A0 0A A0 0A A0 16 A6 16 A6
						16 A6 16 A6 05 21 0B 20 87 0F 00 FF 30 67 A9 37
						29 19 47 00 25 3D 00 31 F4 00 51 EC 00 1C D8 FF
						30 48 FF FF 00 FF 00 FF FF F4 FF 00 FF FF 00 FF
						00 FF 00 00 FF FF 00 FF 00 FF 00 00 FF FF 00 FF
						00 FF 00
			39 00 00 00 00 04       EB 01 33 00
		];

		gen-panel-mdnie-auto-camera-mode-cmds = [
			39 00 00 00 00 83	EC 00 00 00 00 00 00 00 00 00 00 00 00 00 00 00
						00 00 00 FF 00 08 00 A0 00 A0 01 00 00 20 00 20
						00 20 00 20 00 20 00 20 00 20 00 20 00 20 00 20
						00 20 00 20 00 20 00 20 00 20 00 20 00 20 00 20
						00 20 00 20 00 20 00 20 00 20 00 FF 30 6A 9A 25
						1A 16 2A 00 37 5A 00 4E C5 00 5D 17 00 30 C3 FF
						08 18 FF F0 00 D8 00 D9 FF FF FF 00 E0 FF 00 F6
						00 D8 3B 00 FF D9 00 FF 14 F9 00 00 FF FF 00 FF
						00 FF 00
			39 00 00 00 00 04       EB 01 30 00
		];

		gen-panel-mdnie-auto-gallery-mode-cmds = [
			39 00 00 00 00 83	EC 00 00 00 00 00 00 00 00 00 00 00 00 00 00 00
						00 00 04 FF 00 08 00 A0 00 A0 01 00 00 20 00 20
						00 20 00 20 00 20 00 20 00 20 00 20 00 20 00 20
						00 20 00 20 00 20 00 20 00 20 00 20 00 20 00 20
						00 20 00 20 00 20 00 20 00 20 00 FF 30 6A 9A 25
						1A 16 2A 00 37 5A 00 4E C5 00 5D 17 00 30 C3 FF
						08 18 FF F0 00 D8 00 D9 FF FF FF 00 E0 FF 00 F6
						00 D8 3B 00 FF D9 00 FF 14 F9 00 00 FF FF 00 FF
						00 FF 00
			39 00 00 00 00 04       EB 01 33 00
		];

		gen-panel-mdnie-auto-vt-mode-cmds = [
			39 00 00 00 00 83	EC 00 00 00 00 00 00 00 00 00 00 00 00 00 00 00
						00 00 00 FF 00 08 00 A0 00 A0 01 00 00 20 00 20
						00 20 00 20 00 20 00 20 00 20 00 20 00 20 00 20
						00 20 00 20 00 20 00 20 00 20 00 20 00 20 00 20
						00 20 00 20 00 20 00 20 00 20 00 FF 00 6A 9A 25
						1A 16 2A 00 37 5A 00 4E C5 00 5D 17 00 30 C3 FF
						00 00 FF FF 00 FF 00 FF FF FF FF 00 FF FF 00 FF
						00 FF 00 00 FF FF 00 FF 00 FF 00 00 FF FF 00 FF
						00 FF 00
			39 00 00 00 00 04       EB 01 33 00
		];

		gen-panel-mdnie-auto-browser-mode-cmds = [
			39 00 00 00 00 83	EC 00 00 00 00 00 00 00 00 00 00 00 00 00 00 00
						00 00 00 FF 00 08 00 A0 00 A0 01 00 00 20 00 20
						00 20 00 20 00 20 00 20 00 20 00 20 00 20 00 20
						00 20 00 20 00 20 00 20 00 20 00 20 00 20 00 20
						00 20 00 20 00 20 00 20 00 20 00 FF 30 6A 9A 25
						1A 16 2A 00 37 5A 00 4E C5 00 5D 17 00 30 C3 FF
						10 28 FF FF 00 FF 00 FF FF FF FF 00 FF FF 00 FF
						00 FF 00 00 FF FF 00 FF 00 FF 00 00 FF FF 00 FF
						00 FF 00
			39 00 00 00 00 04       EB 01 30 00
		];

		gen-panel-mdnie-auto-ebook-mode-cmds = [
			39 00 00 00 00 83	EC 00 00 00 00 00 00 00 00 00 00 00 00 00 00 00
						00 00 00 FF 00 00 07 FF 07 FF 01 00 00 20 00 20
						00 20 00 20 00 20 00 20 00 20 00 20 00 20 00 20
						00 20 00 20 00 20 00 20 00 20 00 20 00 20 00 20
						00 20 00 20 00 20 00 20 00 20 00 FF 00 67 A9 0C
						0C 0C 0C 00 AA AB 00 AA AB 00 AA AB 00 AA AB FF
						00 00 FF FF 00 FF 00 FF FF FF FF 00 FF FF 00 FF
						00 FF 00 00 FF FF 00 FF 00 FF 00 00 FF FF 00 F4
						00 E4 00
			39 00 00 00 00 04       EB 01 30 00
		];


		/* DYNAMIC MODE */
		gen-panel-mdnie-dynamic-ui-mode-cmds = [
			39 00 00 00 00 83	EC 00 00 00 00 00 00 00 00 00 00 00 00 00 00 00
						00 00 03 FF 00 0A 00 A0 00 A0 01 20 00 14 00 14
						00 14 00 14 03 9A 03 9A 03 9A 03 9A 07 9E 07 9E
						07 9E 07 9E 0A A0 0A A0 0A A0 0A A0 16 A6 16 A6
						16 A6 16 A6 05 21 0B 20 87 0F 00 FF 30 67 A9 37
						29 19 47 00 25 3D 00 31 F4 00 51 EC 00 1C D8 FF
						30 48 FF FF 00 FF 00 FF FF F4 FF 00 FF FF 00 FF
						00 FF 00 00 FF FF 00 FF 00 FF 00 00 FF FF 00 FF
						00 FF 00
			39 00 00 00 00 04       EB 01 33 00
		];

		gen-panel-mdnie-dynamic-video-mode-cmds = [
			39 00 00 00 00 83	EC 00 00 00 00 00 00 00 00 00 00 00 00 00 00 00
						00 00 07 FF 00 0A 00 40 00 40 01 20 00 14 00 14
						00 14 00 14 03 9A 03 9A 03 9A 03 9A 07 9E 07 9E
						07 9E 07 9E 0A A0 0A A0 0A A0 0A A0 16 A6 16 A6
						16 A6 16 A6 05 21 0B 20 87 0F 00 FF 30 67 A9 37
						29 19 47 00 25 3D 00 31 F4 00 51 EC 00 1C D8 FF
						30 48 FF FF 00 FF 00 FF FF F4 FF 00 FF FF 00 FF
						00 FF 00 00 FF FF 00 FF 00 FF 00 00 FF FF 00 FF
						00 FF 00
			39 00 00 00 00 04       EB 01 33 00
		];

		gen-panel-mdnie-dynamic-camera-mode-cmds = [
			39 00 00 00 00 83	EC 00 00 00 00 00 00 00 00 00 00 00 00 00 00 00
						00 00 03 FF 00 0A 00 A0 00 A0 01 20 00 14 00 14
						00 14 00 14 03 9A 03 9A 03 9A 03 9A 07 9E 07 9E
						07 9E 07 9E 0A A0 0A A0 0A A0 0A A0 16 A6 16 A6
						16 A6 16 A6 05 21 0B 20 87 0F 00 FF 30 67 A9 37
						29 19 47 00 25 3D 00 31 F4 00 51 EC 00 1C D8 FF
						30 48 FF FF 00 FF 00 FF FF F4 FF 00 FF FF 00 FF
						00 FF 00 00 FF FF 00 FF 00 FF 00 00 FF FF 00 FF
						00 FF 00
			39 00 00 00 00 04       EB 01 33 00
		];

		gen-panel-mdnie-dynamic-gallery-mode-cmds = [
			39 00 00 00 00 83	EC 00 00 00 00 00 00 00 00 00 00 00 00 00 00 00
						00 00 07 FF 00 0A 00 A0 00 A0 01 20 00 14 00 14
						00 14 00 14 03 9A 03 9A 03 9A 03 9A 07 9E 07 9E
						07 9E 07 9E 0A A0 0A A0 0A A0 0A A0 16 A6 16 A6
						16 A6 16 A6 05 21 0B 20 87 0F 00 FF 30 67 A9 37
						29 19 47 00 25 3D 00 31 F4 00 51 EC 00 1C D8 FF
						30 48 FF FF 00 FF 00 FF FF F4 FF 00 FF FF 00 FF
						00 FF 00 00 FF FF 00 FF 00 FF 00 00 FF FF 00 FF
						00 FF 00
			39 00 00 00 00 04       EB 01 33 00
		];

		gen-panel-mdnie-dynamic-vt-mode-cmds = [
			39 00 00 00 00 83	EC 00 00 00 00 00 00 00 00 00 00 00 00 00 00 00
						00 00 03 FF 00 0A 00 A0 00 A0 01 20 00 14 00 14
						00 14 00 14 03 9A 03 9A 03 9A 03 9A 07 9E 07 9E
						07 9E 07 9E 0A A0 0A A0 0A A0 0A A0 16 A6 16 A6
						16 A6 16 A6 05 21 0B 20 87 0F 00 FF 30 67 A9 37
						29 19 47 00 25 3D 00 31 F4 00 51 EC 00 1C D8 FF
						30 48 FF FF 00 FF 00 FF FF F4 FF 00 FF FF 00 FF
						00 FF 00 00 FF FF 00 FF 00 FF 00 00 FF FF 00 FF
						00 FF 00
			39 00 00 00 00 04       EB 01 33 00
		];

		gen-panel-mdnie-dynamic-browser-mode-cmds = [
			39 00 00 00 00 83	EC 00 00 00 00 00 00 00 00 00 00 00 00 00 00 00
						00 00 03 FF 00 0A 00 A0 00 A0 01 20 00 14 00 14
						00 14 00 14 03 9A 03 9A 03 9A 03 9A 07 9E 07 9E
						07 9E 07 9E 0A A0 0A A0 0A A0 0A A0 16 A6 16 A6
						16 A6 16 A6 05 21 0B 20 87 0F 00 FF 30 67 A9 37
						29 19 47 00 25 3D 00 31 F4 00 51 EC 00 1C D8 FF
						30 48 FF FF 00 FF 00 FF FF F4 FF 00 FF FF 00 FF
						00 FF 00 00 FF FF 00 FF 00 FF 00 00 FF FF 00 FF
						00 FF 00
			39 00 00 00 00 04       EB 01 33 00
		];

		gen-panel-mdnie-dynamic-ebook-mode-cmds = [
			39 00 00 00 00 83	EC 00 00 00 00 00 00 00 00 00 00 00 00 00 00 00
						00 00 03 FF 00 0A 00 A0 00 A0 01 20 00 14 00 14
						00 14 00 14 03 9A 03 9A 03 9A 03 9A 07 9E 07 9E
						07 9E 07 9E 0A A0 0A A0 0A A0 0A A0 16 A6 16 A6
						16 A6 16 A6 05 21 0B 20 87 0F 00 FF 30 67 A9 37
						29 19 47 00 25 3D 00 31 F4 00 51 EC 00 1C D8 FF
						30 48 FF FF 00 FF 00 FF FF F4 FF 00 FF FF 00 FF
						00 FF 00 00 FF FF 00 FF 00 FF 00 00 FF FF 00 FF
						00 FF 00
			39 00 00 00 00 04       EB 01 33 00
		];


		/* NATURAL MODE */
		gen-panel-mdnie-natural-ui-mode-cmds = [
			39 00 00 00 00 83	EC 00 00 00 00 00 00 00 00 00 00 00 00 00 00 00
						00 00 02 FF 00 00 00 A0 00 A0 01 40 00 20 00 20
						00 20 00 20 00 20 00 20 00 20 00 20 00 20 00 20
						00 20 00 20 00 20 00 20 00 20 00 20 00 20 00 20
						00 20 00 20 00 20 00 20 00 20 00 FF 00 67 A9 0C
						0C 0C 0C 00 AA AB 00 AA AB 00 AA AB 00 AA AB FF
						00 00 FF FF 00 FF 00 FF FF FF FF 8C D5 F4 16 EC
						15 DE 64 1A EF DE 28 F3 1C EF 11 50 E5 FF 00 F7
						00 ED 00
			39 00 00 00 00 04	EB 01 33 00
		];

		gen-panel-mdnie-natural-video-mode-cmds = [
			39 00 00 00 00 83	EC 00 00 00 00 00 00 00 00 00 00 00 00 00 00 00
						00 00 06 FF 00 04 00 40 00 40 01 40 00 20 00 20
						00 20 00 20 00 20 00 20 00 20 00 20 00 20 00 20
						00 20 00 20 00 20 00 20 00 20 00 20 00 20 00 20
						00 20 00 20 00 20 00 20 00 20 00 FF 00 67 A9 0C
						0C 0C 0C 00 AA AB 00 AA AB 00 AA AB 00 AA AB FF
						00 00 FF FF 00 FF 00 FF FF FF FF 8C D5 F4 16 EC
						15 DE 64 1A EF DE 28 F3 1C EF 11 50 E5 FF 00 F7
						00 ED 00
			39 00 00 00 00 04	EB 01 33 00
		];

		gen-panel-mdnie-natural-camera-mode-cmds = [
			39 00 00 00 00 83	EC 00 00 00 00 00 00 00 00 00 00 00 00 00 00 00
						00 00 02 FF 00 00 00 A0 00 A0 01 40 00 20 00 20
						00 20 00 20 00 20 00 20 00 20 00 20 00 20 00 20
						00 20 00 20 00 20 00 20 00 20 00 20 00 20 00 20
						00 20 00 20 00 20 00 20 00 20 00 FF 00 67 A9 0C
						0C 0C 0C 00 AA AB 00 AA AB 00 AA AB 00 AA AB FF
						00 00 FF FF 00 FF 00 FF FF FF FF 8C D5 F4 16 EC
						15 DE 64 1A EF DE 28 F3 1C EF 11 50 E5 FF 00 F7
						00 ED 00
			39 00 00 00 00 04	EB 01 33 00
		];

		gen-panel-mdnie-natural-gallery-mode-cmds = [
			39 00 00 00 00 83	EC 00 00 00 00 00 00 00 00 00 00 00 00 00 00 00
						00 00 06 FF 00 04 00 A0 00 A0 01 40 00 20 00 20
						00 20 00 20 00 20 00 20 00 20 00 20 00 20 00 20
						00 20 00 20 00 20 00 20 00 20 00 20 00 20 00 20
						00 20 00 20 00 20 00 20 00 20 00 FF 00 67 A9 0C
						0C 0C 0C 00 AA AB 00 AA AB 00 AA AB 00 AA AB FF
						00 00 FF FF 00 FF 00 FF FF FF FF 8C D5 F4 16 EC
						15 DE 64 1A EF DE 28 F3 1C EF 11 50 E5 FF 00 F7
						00 ED 00
			39 00 00 00 00 04	EB 01 33 00
		];

		gen-panel-mdnie-natural-vt-mode-cmds = [
			39 00 00 00 00 83	EC 00 00 00 00 00 00 00 00 00 00 00 00 00 00 00
						00 00 02 FF 00 00 00 A0 00 A0 01 40 00 20 00 20
						00 20 00 20 00 20 00 20 00 20 00 20 00 20 00 20
						00 20 00 20 00 20 00 20 00 20 00 20 00 20 00 20
						00 20 00 20 00 20 00 20 00 20 00 FF 00 67 A9 0C
						0C 0C 0C 00 AA AB 00 AA AB 00 AA AB 00 AA AB FF
						00 00 FF FF 00 FF 00 FF FF FF FF 8C D5 F4 16 EC
						15 DE 64 1A EF DE 28 F3 1C EF 11 50 E5 FF 00 F7
						00 ED 00
			39 00 00 00 00 04	EB 01 33 00
		];

		gen-panel-mdnie-natural-browser-mode-cmds = [
			39 00 00 00 00 83	EC 00 00 00 00 00 00 00 00 00 00 00 00 00 00 00
						00 00 02 FF 00 00 00 A0 00 A0 01 40 00 20 00 20
						00 20 00 20 00 20 00 20 00 20 00 20 00 20 00 20
						00 20 00 20 00 20 00 20 00 20 00 20 00 20 00 20
						00 20 00 20 00 20 00 20 00 20 00 FF 00 67 A9 0C
						0C 0C 0C 00 AA AB 00 AA AB 00 AA AB 00 AA AB FF
						00 00 FF FF 00 FF 00 FF FF FF FF 8C D5 F4 16 EC
						15 DE 64 1A EF DE 28 F3 1C EF 11 50 E5 FF 00 F7
						00 ED 00
			39 00 00 00 00 04	EB 01 33 00
		];

		gen-panel-mdnie-natural-ebook-mode-cmds = [
			39 00 00 00 00 83	EC 00 00 00 00 00 00 00 00 00 00 00 00 00 00 00
						00 00 02 FF 00 00 00 A0 00 A0 01 40 00 20 00 20
						00 20 00 20 00 20 00 20 00 20 00 20 00 20 00 20
						00 20 00 20 00 20 00 20 00 20 00 20 00 20 00 20
						00 20 00 20 00 20 00 20 00 20 00 FF 00 67 A9 0C
						0C 0C 0C 00 AA AB 00 AA AB 00 AA AB 00 AA AB FF
						00 00 FF FF 00 FF 00 FF FF FF FF 8C D5 F4 16 EC
						15 DE 64 1A EF DE 28 F3 1C EF 11 50 E5 FF 00 F7
						00 ED 00
			39 00 00 00 00 04	EB 01 33 00
		];


		/* MOVIE MODE */
		gen-panel-mdnie-movie-ui-mode-cmds = [
			39 00 00 00 00 83	EC 00 00 00 00 00 00 00 00 00 00 00 00 00 00 00
						00 00 00 FF 00 00 07 FF 07 FF 01 83 00 20 00 20
						00 20 00 20 00 20 00 20 00 20 00 20 00 20 00 20
						00 20 00 20 00 20 00 20 00 20 00 20 00 20 00 20
						00 20 00 20 00 20 00 20 00 20 00 FF 00 67 A9 0C
						0C 0C 0C 00 AA AB 00 AA AB 00 AA AB 00 AA AB D5
						2C 2A FF F5 63 FE 4A FF FF F9 F8 00 FF FF 00 FF
						00 FF 00 00 FF FF 00 FF 00 FF 00 00 FF FF 00 FF
						00 FF 00
			39 00 00 00 00 04       EB 01 30 00
		];

		gen-panel-mdnie-movie-video-mode-cmds = [
			39 00 00 00 00 83	EC 00 00 00 00 00 00 00 00 00 00 00 00 00 00 00
						00 00 00 FF 00 00 07 FF 07 FF 01 83 00 20 00 20
						00 20 00 20 00 20 00 20 00 20 00 20 00 20 00 20
						00 20 00 20 00 20 00 20 00 20 00 20 00 20 00 20
						00 20 00 20 00 20 00 20 00 20 00 FF 00 67 A9 0C
						0C 0C 0C 00 AA AB 00 AA AB 00 AA AB 00 AA AB D5
						2C 2A FF F5 63 FE 4A FF FF F9 F8 00 FF FF 00 FF
						00 FF 00 00 FF FF 00 FF 00 FF 00 00 FF FF 00 FF
						00 FF 00
			39 00 00 00 00 04       EB 01 30 00
		];

		gen-panel-mdnie-movie-camera-mode-cmds = [
			39 00 00 00 00 83	EC 00 00 00 00 00 00 00 00 00 00 00 00 00 00 00
						00 00 00 FF 00 08 00 A0 00 A0 01 00 00 20 00 20
						00 20 00 20 00 20 00 20 00 20 00 20 00 20 00 20
						00 20 00 20 00 20 00 20 00 20 00 20 00 20 00 20
						00 20 00 20 00 20 00 20 00 20 00 FF 30 6A 9A 25
						1A 16 2A 00 37 5A 00 4E C5 00 5D 17 00 30 C3 FF
						38 48 FF F0 00 D8 00 D9 FF FF FF 00 E0 FF 00 F6
						00 D8 3B 00 FF D9 00 FF 14 F9 00 00 FF FF 00 FF
						00 FF 00
			39 00 00 00 00 04       EB 01 30 00
		];

		gen-panel-mdnie-movie-gallery-mode-cmds = [
			39 00 00 00 00 83	EC 00 00 00 00 00 00 00 00 00 00 00 00 00 00 00
						00 00 00 FF 00 00 07 FF 07 FF 01 83 00 20 00 20
						00 20 00 20 00 20 00 20 00 20 00 20 00 20 00 20
						00 20 00 20 00 20 00 20 00 20 00 20 00 20 00 20
						00 20 00 20 00 20 00 20 00 20 00 FF 30 67 A9 0C
						0C 0C 0C 00 AA AB 00 AA AB 00 AA AB 00 AA AB D5
						2C 2A FF F5 63 FE 4A FF FF F9 F8 00 FF FF 00 FF
						00 FF 00 00 FF FF 00 FF 00 FF 00 00 FF FF 00 FF
						00 FF 00
			39 00 00 00 00 04       EB 01 30 00
		];

		gen-panel-mdnie-movie-vt-mode-cmds = [
			39 00 00 00 00 83	EC 00 00 00 00 00 00 00 00 00 00 00 00 00 00 00
						00 00 00 FF 00 00 07 FF 07 FF 01 83 00 20 00 20
						00 20 00 20 00 20 00 20 00 20 00 20 00 20 00 20
						00 20 00 20 00 20 00 20 00 20 00 20 00 20 00 20
						00 20 00 20 00 20 00 20 00 20 00 FF 30 67 A9 0C
						0C 0C 0C 00 AA AB 00 AA AB 00 AA AB 00 AA AB D5
						2C 2A FF F5 63 FE 4A FF FF F9 F8 00 FF FF 00 FF
						00 FF 00 00 FF FF 00 FF 00 FF 00 00 FF FF 00 FF
						00 FF 00
			39 00 00 00 00 04       EB 01 30 00
		];

		gen-panel-mdnie-movie-browser-mode-cmds = [
			39 00 00 00 00 83	EC 00 00 00 00 00 00 00 00 00 00 00 00 00 00 00
						00 00 00 FF 00 00 07 FF 07 FF 01 83 00 20 00 20
						00 20 00 20 00 20 00 20 00 20 00 20 00 20 00 20
						00 20 00 20 00 20 00 20 00 20 00 20 00 20 00 20
						00 20 00 20 00 20 00 20 00 20 00 FF 30 67 A9 0C
						0C 0C 0C 00 AA AB 00 AA AB 00 AA AB 00 AA AB D5
						2C 2A FF F5 63 FE 4A FF FF F9 F8 00 FF FF 00 FF
						00 FF 00 00 FF FF 00 FF 00 FF 00 00 FF FF 00 FF
						00 FF 00
			39 00 00 00 00 04       EB 01 30 00
		];

		gen-panel-mdnie-movie-ebook-mode-cmds = [
			39 00 00 00 00 83	EC 00 00 00 00 00 00 00 00 00 00 00 00 00 00 00
						00 00 00 FF 00 00 07 FF 07 FF 01 83 00 20 00 20
						00 20 00 20 00 20 00 20 00 20 00 20 00 20 00 20
						00 20 00 20 00 20 00 20 00 20 00 20 00 20 00 20
						00 20 00 20 00 20 00 20 00 20 00 FF 30 67 A9 0C
						0C 0C 0C 00 AA AB 00 AA AB 00 AA AB 00 AA AB D5
						2C 2A FF F5 63 FE 4A FF FF F9 F8 00 FF FF 00 FF
						00 FF 00 00 FF FF 00 FF 00 FF 00 00 FF FF 00 FF
						00 FF 00
			39 00 00 00 00 04       EB 01 30 00
		];

		gen-panel-mdnie-cal {
			cal-reg = [EC];
			cal-offset = [7C 7E 80];
			cal-modes = <
				0	/* MDNIE DYNAMIC MODE */
				4	/* MDNIE AUTO MODE */
			>;
			cal-linear-equation = <
				/* <nominator	denominator	constant>
				   f(x, y) = y + (x * nominator / denominator) + constant
				*/
				(-547)		503		31
				(-467)		447		(-25)
				201		39		(-18718)
				523		173		(-12111)
			>;
			cal-tune-value = [
				FF F9 F9	/* TUNE 1 */
				FF FA FE
				F8 F5 FF
				FF FD FA
				FF FF FF
				F9 FA FF
				FC FF F8
				FA FF FA
				F9 FF FF	/* TUNE 9 */
			];
		};
	};
};
