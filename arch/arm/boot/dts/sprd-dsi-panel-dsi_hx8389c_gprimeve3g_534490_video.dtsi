&gen_panel {
	dsi_hx8389c_gprimeve3g_534490_vid: gen-panel-hx8389c-gprimeve3g-534490-video {
		/*gen-panel-manu = "CPT";			 condensed manufacturer name */
		gen-panel-name = "lcd_hx8389C_534490_mipi";
		gen-panel-id = <0x534490>;
		gen-panel-dev-id = <0>;			/* SPRDFB_MAINLCD_ID : MAIN 0, SUB 1 */
		gen-panel-type = <2>;			/* LCD_MODE_DSI: MCU 0, RGB 1, DSI 2 */
		gen-panel-refresh = <60>;
		gen-panel-xres = <540>;
		gen-panel-yres = <960>;
		gen-panel-width = <64>;			/* screen width in mm */
		gen-panel-height = <110>;		/* screen height in mm */
		gen-panel-work-mode = <1>;		/* SPRDFB_MIPI_MODE_VIDEO : CMD 0, VIDEO 1*/
		gen-panel-direction = <0>;		/* LCD_DIRECT_NORMAL : Normal 0, ROT90 1, ROT180 2, ROT270 3 */
		gen-panel-suspend-mode = <1>;	/* SEND_SLEEP_CMD : RST 0, SLEEP 1 */
		gen-panel-bus-width = <24>;
		gen-panel-lanes = <2>;
		gen-panel-phy-feq = <455000>;
		gen-panel-h-sync-pol = <0>;		/*SPRDFB_POLARITY_POS : POS 0, NEG 1 */
		gen-panel-v-sync-pol = <0>;		/*SPRDFB_POLARITY_POS : POS 0, NEG 1 */
		gen-panel-de-pol = <0>;			/*SPRDFB_POLARITY_POS : POS 0, NEG 1 */
		gen-panel-te-pol = <0>;			/*SPRDFB_POLARITY_POS : POS 0, NEG 1 */
		gen-panel-color-mode-pol = <1>;	/*SPRDFB_POLARITY_POS : POS 0, NEG 1 */
		gen-panel-shut-down-pol = <1>;	/*SPRDFB_POLARITY_POS : POS 0, NEG 1 */
		gen-panel-h-front-porch = <20>;	/* hfp */
		gen-panel-h-back-porch = <20>;	/* hbp */
		gen-panel-h-sync-width = <12>;	/* hsync */
		gen-panel-v-front-porch = <9>;	/* vfp */
		gen-panel-v-back-porch = <5>;	/* vbp */
		gen-panel-v-sync-width = <10>;	/* vsync */
		gen-panel-rst-high-in-sleep;

		/*
		 * DSI PACKET HEADER INFO
		 * @ delay(msec) : 2byte
		 * @ size of data : 2byte
		 */
		gen-panel-pkt-dinfo-addr-offset = <0>;
		gen-panel-pkt-dinfo-addr-length = <1>;
		gen-panel-pkt-dinfo-data-offset = <1>;
		gen-panel-pkt-dinfo-data-length = <1>;
		gen-panel-init-cmds = [
			39 00 00 00 00 04		B9 FF 83 89
			39 00 00 00 00 15		B1 7F 10 10 D2 32 80 10 F0 56 80 20 20 F8 AA AA
									A1 00 80 30 00
			39 00 00 00 00 0B		B2 82 50 05 07 F0 38 11 64 5D 09
			39 00 00 00 00 0C		B4 66 66 66 70 00 00 18 76 28 76 A8
			15 00 00 00 00 02		D2 33
			39 00 00 00 00 05		C0 30 17 00 03
			39 00 00 00 00 05		C7 00 80 00 C0
			39 00 00 0A 00 05		BF 05 50 00 3E
			39 00 00 00 00 04		B9 FF 83 89
			15 00 00 00 00 02		CC 0E
			39 00 00 00 00 24		D3 00 00 00 00 00 08 00 32 10 00 00 00 03 C6 03
									C6 00 00 00 00 35 33 04 04 37 00 00 00 05 08 00
									00 0A 00 01
			39 00 00 00 00 27		D5 18 18 18 18 19 19 18 18 20 21 24 25 18 18 18
									18 00 01 04 05 02 03 06 07 18 18 18 18 18 18 18
									18 18 18 18 18 18 18
			39 00 00 00 00 27		D6 18 18 18 18 18 18 19 19 25 24 21 20 18 18 18
									18 07 06 03 02 05 04 01 00 18 18 18 18 18 18 18
									18 18 18 18 18 18 18
			39 00 00 00 00 04		B7 20 80 00
			39 00 00 00 00 2B		E0 00 02 06 38 3C 3F 1B 46 06 09 0C 17 10 13 16
									13 14 08 13 15 19 00 02 06 37 3C 3F 1A 45 05 09
									0B 16 0F 13 15 13 14 07 12 14 18
			15 00 00 00 00 02		BD 00
			39 00 00 00 00 2C		C1 00 00 08 10 18 20 28 30 38 40 48 50 58 60 68
									70 78 80 88 90 98 A0 A8 B0 B8 C0 C8 D0 D8 E0 E8
									F0 F8 FF 00 00 00 00 00 00 00 00 00
			15 00 00 00 00 02		BD 01
			39 00 00 00 00 2B		C1 00 08 10 18 20 28 30 38 40 48 50 58 60 68 70
									78 80 88 90 98 A0 A8 B0 B8 C0 C8 D0 D8 E0 E8 F0
									F8 FF 00 00 00 00 00 00 00 00 00
			15 00 00 00 00 02		BD 02
			39 00 00 00 00 2B		C1 00 08 10 18 20 28 30 38 40 48 50 58 60 68 70
									78 80 88 90 98 A0 A8 B0 B8 C0 C8 D0 D8 E0 E8 F0
									F8 FF 00 00 00 00 00 00 00 00 00
		];
		gen-panel-enable-cmds = [
			05 00 00 78 00 01		11
			05 00 00 0A 00 01		29
		];
		gen-panel-disable-cmds = [
			05 00 00 0A 00 01		28
			05 00 00 78 00 01		10
		];
		gen-panel-read-id = [
			DA 00 01
			DB 00 01
			DC 00 01
		];
		gen-panel-read-status-reg = [0A];
		gen-panel-read-status-ok = [9A];
		status = "okay";
	};
};
