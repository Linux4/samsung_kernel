/*
 * Copyright (C) 2010 - 2018 Novatek, Inc.
 *
 * $Revision$
 * $Date$
 *
 * This program is free software; you can redistribute it and/or modify
 * it under the terms of the GNU General Public License as published by
 * the Free Software Foundation; either version 2 of the License, or
 * (at your option) any later version.
 *
 * This program is distributed in the hope that it will be useful, but WITHOUT
 * ANY WARRANTY; without even the implied warranty of MERCHANTABILITY or
 * FITNESS FOR A PARTICULAR PURPOSE.  See the GNU General Public License for
 * more details.
 *
 */
&spi0 {
	status = "ok";

	#address-cells = <1>;
	#size-cells = <0>;

	/* Novatek device tree node */
	novatek@0 {
		compatible = "novatek,NVT-ts-spi";
		reg = <0>;
		status = "ok";

		spi-max-frequency = <9600000>;
		//4800000,9600000,15000000,19200000

		novatek,reset-gpio = <&pio 11 0x0>;
		novatek,irq-gpio = <&pio 0 0x0>;

		/* 525 */
		//novatek,swrst-n8-addr = <0x01F01A>;

		/* 672A, 525B, 675, 526, 672C */
		novatek,swrst-n8-addr = <0x03F0FE>;
		novatek,spi-rd-fast-addr = <0x03F310>;

		/*Panel setting*/
		novatek,resolution = <720 1600>;
		novatek,max_touch_num = <10>;
		novatek,area-size = <56 112 60>;
				//indicator navigation edge
		novatek,fw_name = "tsp_novatek/nt36525_a02_csot.bin",
					"novatek_ts_fw.bin";
		novatek,fw_name_mp = "novatek_ts_mp.bin",
				"tsp_novatek/nt36525_a02_csot_mp.bin";
		novatek,support_ear_detect_mode;
		novatek,enable_settings_aot;

		/* MP */
		/* novatek,mp-support-dt; */

		novatek-mp-criteria-7210@0 {
			#address-cells = <1>;
			#size-cells = <0>;
			compatible = "novatek-mp-criteria-7210";

			/* sec cmd test config */
			open_test_spec = <(-511) 5120>;
			short_test_spec = <10000 14008>;
			diff_test_frame = <50>;

			/* MP Config */
			IC_X_CFG_SIZE = <18>;
			IC_Y_CFG_SIZE = <32>;
			IC_KEY_CFG_SIZE = <4>;
			X_Channel = <18>;
			Y_Channel = <32>;
			AIN_X = <0 1 2 3 4 5 6 7 8 9 10 11 12 13 14 15 16 17>;
			AIN_Y = <0 1 2 3 4 5 6 7 8 9 10 11 12 13 14 15 16 17
				18 19 20 21 22 23 24 25 26 27 28 29 30 31>;
			AIN_KEY = <0 1 2 0xFF>;

			/* MP Criteria */
			PS_Config_Lmt_Short_Rawdata_P = <
				14008 14008 14008 14008 14008 14008 14008 14008 14008
				14008 14008 14008 14008 14008 14008 14008 14008 14008
				14008 14008 14008 14008 14008 14008 14008 14008 14008
				14008 14008 14008 14008 14008 14008 14008 14008 14008
				14008 14008 14008 14008 14008 14008 14008 14008 14008
				14008 14008 14008 14008 14008 14008 14008 14008 14008
				14008 14008 14008 14008 14008 14008 14008 14008 14008
				14008 14008 14008 14008 14008 14008 14008 14008 14008
				14008 14008 14008 14008 14008 14008 14008 14008 14008
				14008 14008 14008 14008 14008 14008 14008 14008 14008
				14008 14008 14008 14008 14008 14008 14008 14008 14008
				14008 14008 14008 14008 14008 14008 14008 14008 14008
				14008 14008 14008 14008 14008 14008 14008 14008 14008
				14008 14008 14008 14008 14008 14008 14008 14008 14008
				14008 14008 14008 14008 14008 14008 14008 14008 14008
				14008 14008 14008 14008 14008 14008 14008 14008 14008
				14008 14008 14008 14008 14008 14008 14008 14008 14008
				14008 14008 14008 14008 14008 14008 14008 14008 14008
				14008 14008 14008 14008 14008 14008 14008 14008 14008
				14008 14008 14008 14008 14008 14008 14008 14008 14008
				14008 14008 14008 14008 14008 14008 14008 14008 14008
				14008 14008 14008 14008 14008 14008 14008 14008 14008
				14008 14008 14008 14008 14008 14008 14008 14008 14008
				14008 14008 14008 14008 14008 14008 14008 14008 14008
				14008 14008 14008 14008 14008 14008 14008 14008 14008
				14008 14008 14008 14008 14008 14008 14008 14008 14008
				14008 14008 14008 14008 14008 14008 14008 14008 14008
				14008 14008 14008 14008 14008 14008 14008 14008 14008
				14008 14008 14008 14008 14008 14008 14008 14008 14008
				14008 14008 14008 14008 14008 14008 14008 14008 14008
				14008 14008 14008 14008 14008 14008 14008 14008 14008
				14008 14008 14008 14008 14008 14008 14008 14008 14008
				14008 14008 14008 14008 14008 14008 14008 14008 14008
				14008 14008 14008 14008 14008 14008 14008 14008 14008
				14008 14008 14008 14008 14008 14008 14008 14008 14008
				14008 14008 14008 14008 14008 14008 14008 14008 14008
				14008 14008 14008 14008 14008 14008 14008 14008 14008
				14008 14008 14008 14008 14008 14008 14008 14008 14008
				14008 14008 14008 14008 14008 14008 14008 14008 14008
				14008 14008 14008 14008 14008 14008 14008 14008 14008
				14008 14008 14008 14008 14008 14008 14008 14008 14008
				14008 14008 14008 14008 14008 14008 14008 14008 14008
				14008 14008 14008 14008 14008 14008 14008 14008 14008
				14008 14008 14008 14008 14008 14008 14008 14008 14008
				14008 14008 14008 14008 14008 14008 14008 14008 14008
				14008 14008 14008 14008 14008 14008 14008 14008 14008
				14008 14008 14008 14008 14008 14008 14008 14008 14008
				14008 14008 14008 14008 14008 14008 14008 14008 14008
				14008 14008 14008 14008 14008 14008 14008 14008 14008
				14008 14008 14008 14008 14008 14008 14008 14008 14008
				14008 14008 14008 14008 14008 14008 14008 14008 14008
				14008 14008 14008 14008 14008 14008 14008 14008 14008
				14008 14008 14008 14008 14008 14008 14008 14008 14008
				14008 14008 14008 14008 14008 14008 14008 14008 14008
				14008 14008 14008 14008 14008 14008 14008 14008 14008
				14008 14008 14008 14008 14008 14008 14008 14008 14008
				14008 14008 14008 14008 14008 14008 14008 14008 14008
				14008 14008 14008 14008 14008 14008 14008 14008 14008
				14008 14008 14008 14008 14008 14008 14008 14008 14008
				14008 14008 14008 14008 14008 14008 14008 14008 14008
				14008 14008 14008 14008 14008 14008 14008 14008 14008
				14008 14008 14008 14008 14008 14008 14008 14008 14008
				14008 14008 14008 14008 14008 14008 14008 14008 14008
				14008 14008 14008 14008 14008 14008 14008 14008 14008
				14008 14008 14008>;

			PS_Config_Lmt_Short_Rawdata_N = <
				10000 10000 10000 10000 10000 10000 10000 10000 10000
				10000 10000 10000 10000 10000 10000 10000 10000 10000
				10000 10000 10000 10000 10000 10000 10000 10000 10000
				10000 10000 10000 10000 10000 10000 10000 10000 10000
				10000 10000 10000 10000 10000 10000 10000 10000 10000
				10000 10000 10000 10000 10000 10000 10000 10000 10000
				10000 10000 10000 10000 10000 10000 10000 10000 10000
				10000 10000 10000 10000 10000 10000 10000 10000 10000
				10000 10000 10000 10000 10000 10000 10000 10000 10000
				10000 10000 10000 10000 10000 10000 10000 10000 10000
				10000 10000 10000 10000 10000 10000 10000 10000 10000
				10000 10000 10000 10000 10000 10000 10000 10000 10000
				10000 10000 10000 10000 10000 10000 10000 10000 10000
				10000 10000 10000 10000 10000 10000 10000 10000 10000
				10000 10000 10000 10000 10000 10000 10000 10000 10000
				10000 10000 10000 10000 10000 10000 10000 10000 10000
				10000 10000 10000 10000 10000 10000 10000 10000 10000
				10000 10000 10000 10000 10000 10000 10000 10000 10000
				10000 10000 10000 10000 10000 10000 10000 10000 10000
				10000 10000 10000 10000 10000 10000 10000 10000 10000
				10000 10000 10000 10000 10000 10000 10000 10000 10000
				10000 10000 10000 10000 10000 10000 10000 10000 10000
				10000 10000 10000 10000 10000 10000 10000 10000 10000
				10000 10000 10000 10000 10000 10000 10000 10000 10000
				10000 10000 10000 10000 10000 10000 10000 10000 10000
				10000 10000 10000 10000 10000 10000 10000 10000 10000
				10000 10000 10000 10000 10000 10000 10000 10000 10000
				10000 10000 10000 10000 10000 10000 10000 10000 10000
				10000 10000 10000 10000 10000 10000 10000 10000 10000
				10000 10000 10000 10000 10000 10000 10000 10000 10000
				10000 10000 10000 10000 10000 10000 10000 10000 10000
				10000 10000 10000 10000 10000 10000 10000 10000 10000
				10000 10000 10000 10000 10000 10000 10000 10000 10000
				10000 10000 10000 10000 10000 10000 10000 10000 10000
				10000 10000 10000 10000 10000 10000 10000 10000 10000
				10000 10000 10000 10000 10000 10000 10000 10000 10000
				10000 10000 10000 10000 10000 10000 10000 10000 10000
				10000 10000 10000 10000 10000 10000 10000 10000 10000
				10000 10000 10000 10000 10000 10000 10000 10000 10000
				10000 10000 10000 10000 10000 10000 10000 10000 10000
				10000 10000 10000 10000 10000 10000 10000 10000 10000
				10000 10000 10000 10000 10000 10000 10000 10000 10000
				10000 10000 10000 10000 10000 10000 10000 10000 10000
				10000 10000 10000 10000 10000 10000 10000 10000 10000
				10000 10000 10000 10000 10000 10000 10000 10000 10000
				10000 10000 10000 10000 10000 10000 10000 10000 10000
				10000 10000 10000 10000 10000 10000 10000 10000 10000
				10000 10000 10000 10000 10000 10000 10000 10000 10000
				10000 10000 10000 10000 10000 10000 10000 10000 10000
				10000 10000 10000 10000 10000 10000 10000 10000 10000
				10000 10000 10000 10000 10000 10000 10000 10000 10000
				10000 10000 10000 10000 10000 10000 10000 10000 10000
				10000 10000 10000 10000 10000 10000 10000 10000 10000
				10000 10000 10000 10000 10000 10000 10000 10000 10000
				10000 10000 10000 10000 10000 10000 10000 10000 10000
				10000 10000 10000 10000 10000 10000 10000 10000 10000
				10000 10000 10000 10000 10000 10000 10000 10000 10000
				10000 10000 10000 10000 10000 10000 10000 10000 10000
				10000 10000 10000 10000 10000 10000 10000 10000 10000
				10000 10000 10000 10000 10000 10000 10000 10000 10000
				10000 10000 10000 10000 10000 10000 10000 10000 10000
				10000 10000 10000 10000 10000 10000 10000 10000 10000
				10000 10000 10000 10000 10000 10000 10000 10000 10000
				10000 10000 10000 10000 10000 10000 10000 10000 10000
				10000 10000 10000>;

			PS_Config_Lmt_Open_Rawdata_P = <
				5120 5120 5120 5120 5120 5120 5120 5120 5120
				5120 5120 5120 5120 5120 5120 5120 5120 5120
				5120 5120 5120 5120 5120 5120 5120 5120 5120
				5120 5120 5120 5120 5120 5120 5120 5120 5120
				5120 5120 5120 5120 5120 5120 5120 5120 5120
				5120 5120 5120 5120 5120 5120 5120 5120 5120
				5120 5120 5120 5120 5120 5120 5120 5120 5120
				5120 5120 5120 5120 5120 5120 5120 5120 5120
				5120 5120 5120 5120 5120 5120 5120 5120 5120
				5120 5120 5120 5120 5120 5120 5120 5120 5120
				5120 5120 5120 5120 5120 5120 5120 5120 5120
				5120 5120 5120 5120 5120 5120 5120 5120 5120
				5120 5120 5120 5120 5120 5120 5120 5120 5120
				5120 5120 5120 5120 5120 5120 5120 5120 5120
				5120 5120 5120 5120 5120 5120 5120 5120 5120
				5120 5120 5120 5120 5120 5120 5120 5120 5120
				5120 5120 5120 5120 5120 5120 5120 5120 5120
				5120 5120 5120 5120 5120 5120 5120 5120 5120
				5120 5120 5120 5120 5120 5120 5120 5120 5120
				5120 5120 5120 5120 5120 5120 5120 5120 5120
				5120 5120 5120 5120 5120 5120 5120 5120 5120
				5120 5120 5120 5120 5120 5120 5120 5120 5120
				5120 5120 5120 5120 5120 5120 5120 5120 5120
				5120 5120 5120 5120 5120 5120 5120 5120 5120
				5120 5120 5120 5120 5120 5120 5120 5120 5120
				5120 5120 5120 5120 5120 5120 5120 5120 5120
				5120 5120 5120 5120 5120 5120 5120 5120 5120
				5120 5120 5120 5120 5120 5120 5120 5120 5120
				5120 5120 5120 5120 5120 5120 5120 5120 5120
				5120 5120 5120 5120 5120 5120 5120 5120 5120
				5120 5120 5120 5120 5120 5120 5120 5120 5120
				5120 5120 5120 5120 5120 5120 5120 5120 5120
				5120 5120 5120 5120 5120 5120 5120 5120 5120
				5120 5120 5120 5120 5120 5120 5120 5120 5120
				5120 5120 5120 5120 5120 5120 5120 5120 5120
				5120 5120 5120 5120 5120 5120 5120 5120 5120
				5120 5120 5120 5120 5120 5120 5120 5120 5120
				5120 5120 5120 5120 5120 5120 5120 5120 5120
				5120 5120 5120 5120 5120 5120 5120 5120 5120
				5120 5120 5120 5120 5120 5120 5120 5120 5120
				5120 5120 5120 5120 5120 5120 5120 5120 5120
				5120 5120 5120 5120 5120 5120 5120 5120 5120
				5120 5120 5120 5120 5120 5120 5120 5120 5120
				5120 5120 5120 5120 5120 5120 5120 5120 5120
				5120 5120 5120 5120 5120 5120 5120 5120 5120
				5120 5120 5120 5120 5120 5120 5120 5120 5120
				5120 5120 5120 5120 5120 5120 5120 5120 5120
				5120 5120 5120 5120 5120 5120 5120 5120 5120
				5120 5120 5120 5120 5120 5120 5120 5120 5120
				5120 5120 5120 5120 5120 5120 5120 5120 5120
				5120 5120 5120 5120 5120 5120 5120 5120 5120
				5120 5120 5120 5120 5120 5120 5120 5120 5120
				5120 5120 5120 5120 5120 5120 5120 5120 5120
				5120 5120 5120 5120 5120 5120 5120 5120 5120
				5120 5120 5120 5120 5120 5120 5120 5120 5120
				5120 5120 5120 5120 5120 5120 5120 5120 5120
				5120 5120 5120 5120 5120 5120 5120 5120 5120
				5120 5120 5120 5120 5120 5120 5120 5120 5120
				5120 5120 5120 5120 5120 5120 5120 5120 5120
				5120 5120 5120 5120 5120 5120 5120 5120 5120
				5120 5120 5120 5120 5120 5120 5120 5120 5120
				5120 5120 5120 5120 5120 5120 5120 5120 5120
				5120 5120 5120 5120 5120 5120 5120 5120 5120
				5120 5120 5120 5120 5120 5120 5120 5120 5120
				5120 5120 5120>;

			PS_Config_Lmt_Open_Rawdata_N = <
				(-511) (-511) (-511) (-511) (-511) (-511) (-511) (-511) (-511)
				(-511) (-511) (-511) (-511) (-511) (-511) (-511) (-511) (-511)
				(-511) (-511) (-511) (-511) (-511) (-511) (-511) (-511) (-511)
				(-511) (-511) (-511) (-511) (-511) (-511) (-511) (-511) (-511)
				(-511) (-511) (-511) (-511) (-511) (-511) (-511) (-511) (-511)
				(-511) (-511) (-511) (-511) (-511) (-511) (-511) (-511) (-511)
				(-511) (-511) (-511) (-511) (-511) (-511) (-511) (-511) (-511)
				(-511) (-511) (-511) (-511) (-511) (-511) (-511) (-511) (-511)
				(-511) (-511) (-511) (-511) (-511) (-511) (-511) (-511) (-511)
				(-511) (-511) (-511) (-511) (-511) (-511) (-511) (-511) (-511)
				(-511) (-511) (-511) (-511) (-511) (-511) (-511) (-511) (-511)
				(-511) (-511) (-511) (-511) (-511) (-511) (-511) (-511) (-511)
				(-511) (-511) (-511) (-511) (-511) (-511) (-511) (-511) (-511)
				(-511) (-511) (-511) (-511) (-511) (-511) (-511) (-511) (-511)
				(-511) (-511) (-511) (-511) (-511) (-511) (-511) (-511) (-511)
				(-511) (-511) (-511) (-511) (-511) (-511) (-511) (-511) (-511)
				(-511) (-511) (-511) (-511) (-511) (-511) (-511) (-511) (-511)
				(-511) (-511) (-511) (-511) (-511) (-511) (-511) (-511) (-511)
				(-511) (-511) (-511) (-511) (-511) (-511) (-511) (-511) (-511)
				(-511) (-511) (-511) (-511) (-511) (-511) (-511) (-511) (-511)
				(-511) (-511) (-511) (-511) (-511) (-511) (-511) (-511) (-511)
				(-511) (-511) (-511) (-511) (-511) (-511) (-511) (-511) (-511)
				(-511) (-511) (-511) (-511) (-511) (-511) (-511) (-511) (-511)
				(-511) (-511) (-511) (-511) (-511) (-511) (-511) (-511) (-511)
				(-511) (-511) (-511) (-511) (-511) (-511) (-511) (-511) (-511)
				(-511) (-511) (-511) (-511) (-511) (-511) (-511) (-511) (-511)
				(-511) (-511) (-511) (-511) (-511) (-511) (-511) (-511) (-511)
				(-511) (-511) (-511) (-511) (-511) (-511) (-511) (-511) (-511)
				(-511) (-511) (-511) (-511) (-511) (-511) (-511) (-511) (-511)
				(-511) (-511) (-511) (-511) (-511) (-511) (-511) (-511) (-511)
				(-511) (-511) (-511) (-511) (-511) (-511) (-511) (-511) (-511)
				(-511) (-511) (-511) (-511) (-511) (-511) (-511) (-511) (-511)
				(-511) (-511) (-511) (-511) (-511) (-511) (-511) (-511) (-511)
				(-511) (-511) (-511) (-511) (-511) (-511) (-511) (-511) (-511)
				(-511) (-511) (-511) (-511) (-511) (-511) (-511) (-511) (-511)
				(-511) (-511) (-511) (-511) (-511) (-511) (-511) (-511) (-511)
				(-511) (-511) (-511) (-511) (-511) (-511) (-511) (-511) (-511)
				(-511) (-511) (-511) (-511) (-511) (-511) (-511) (-511) (-511)
				(-511) (-511) (-511) (-511) (-511) (-511) (-511) (-511) (-511)
				(-511) (-511) (-511) (-511) (-511) (-511) (-511) (-511) (-511)
				(-511) (-511) (-511) (-511) (-511) (-511) (-511) (-511) (-511)
				(-511) (-511) (-511) (-511) (-511) (-511) (-511) (-511) (-511)
				(-511) (-511) (-511) (-511) (-511) (-511) (-511) (-511) (-511)
				(-511) (-511) (-511) (-511) (-511) (-511) (-511) (-511) (-511)
				(-511) (-511) (-511) (-511) (-511) (-511) (-511) (-511) (-511)
				(-511) (-511) (-511) (-511) (-511) (-511) (-511) (-511) (-511)
				(-511) (-511) (-511) (-511) (-511) (-511) (-511) (-511) (-511)
				(-511) (-511) (-511) (-511) (-511) (-511) (-511) (-511) (-511)
				(-511) (-511) (-511) (-511) (-511) (-511) (-511) (-511) (-511)
				(-511) (-511) (-511) (-511) (-511) (-511) (-511) (-511) (-511)
				(-511) (-511) (-511) (-511) (-511) (-511) (-511) (-511) (-511)
				(-511) (-511) (-511) (-511) (-511) (-511) (-511) (-511) (-511)
				(-511) (-511) (-511) (-511) (-511) (-511) (-511) (-511) (-511)
				(-511) (-511) (-511) (-511) (-511) (-511) (-511) (-511) (-511)
				(-511) (-511) (-511) (-511) (-511) (-511) (-511) (-511) (-511)
				(-511) (-511) (-511) (-511) (-511) (-511) (-511) (-511) (-511)
				(-511) (-511) (-511) (-511) (-511) (-511) (-511) (-511) (-511)
				(-511) (-511) (-511) (-511) (-511) (-511) (-511) (-511) (-511)
				(-511) (-511) (-511) (-511) (-511) (-511) (-511) (-511) (-511)
				(-511) (-511) (-511) (-511) (-511) (-511) (-511) (-511) (-511)
				(-511) (-511) (-511) (-511) (-511) (-511) (-511) (-511) (-511)
				(-511) (-511) (-511) (-511) (-511) (-511) (-511) (-511) (-511)
				(-511) (-511) (-511) (-511) (-511) (-511) (-511) (-511) (-511)
				(-511) (-511) (-511) (-511) (-511) (-511) (-511) (-511) (-511)
				(-511) (-511) (-511)>;

			PS_Config_Lmt_FW_Rawdata_P = <
				3750 3750 3750 3750 3750 3750 3750 3750 3750
				3750 3750 3750 3750 3750 3750 3750 3750 3750
				3750 3750 3750 3750 3750 3750 3750 3750 3750
				3750 3750 3750 3750 3750 3750 3750 3750 3750
				3750 3750 3750 3750 3750 3750 3750 3750 3750
				3750 3750 3750 3750 3750 3750 3750 3750 3750
				3750 3750 3750 3750 3750 3750 3750 3750 3750
				3750 3750 3750 3750 3750 3750 3750 3750 3750
				3750 3750 3750 3750 3750 3750 3750 3750 3750
				3750 3750 3750 3750 3750 3750 3750 3750 3750
				3750 3750 3750 3750 3750 3750 3750 3750 3750
				3750 3750 3750 3750 3750 3750 3750 3750 3750
				3750 3750 3750 3750 3750 3750 3750 3750 3750
				3750 3750 3750 3750 3750 3750 3750 3750 3750
				3750 3750 3750 3750 3750 3750 3750 3750 3750
				3750 3750 3750 3750 3750 3750 3750 3750 3750
				3750 3750 3750 3750 3750 3750 3750 3750 3750
				3750 3750 3750 3750 3750 3750 3750 3750 3750
				3750 3750 3750 3750 3750 3750 3750 3750 3750
				3750 3750 3750 3750 3750 3750 3750 3750 3750
				3750 3750 3750 3750 3750 3750 3750 3750 3750
				3750 3750 3750 3750 3750 3750 3750 3750 3750
				3750 3750 3750 3750 3750 3750 3750 3750 3750
				3750 3750 3750 3750 3750 3750 3750 3750 3750
				3750 3750 3750 3750 3750 3750 3750 3750 3750
				3750 3750 3750 3750 3750 3750 3750 3750 3750
				3750 3750 3750 3750 3750 3750 3750 3750 3750
				3750 3750 3750 3750 3750 3750 3750 3750 3750
				3750 3750 3750 3750 3750 3750 3750 3750 3750
				3750 3750 3750 3750 3750 3750 3750 3750 3750
				3750 3750 3750 3750 3750 3750 3750 3750 3750
				3750 3750 3750 3750 3750 3750 3750 3750 3750
				3750 3750 3750 3750 3750 3750 3750 3750 3750
				3750 3750 3750 3750 3750 3750 3750 3750 3750
				3750 3750 3750 3750 3750 3750 3750 3750 3750
				3750 3750 3750 3750 3750 3750 3750 3750 3750
				3750 3750 3750 3750 3750 3750 3750 3750 3750
				3750 3750 3750 3750 3750 3750 3750 3750 3750
				3750 3750 3750 3750 3750 3750 3750 3750 3750
				3750 3750 3750 3750 3750 3750 3750 3750 3750
				3750 3750 3750 3750 3750 3750 3750 3750 3750
				3750 3750 3750 3750 3750 3750 3750 3750 3750
				3750 3750 3750 3750 3750 3750 3750 3750 3750
				3750 3750 3750 3750 3750 3750 3750 3750 3750
				3750 3750 3750 3750 3750 3750 3750 3750 3750
				3750 3750 3750 3750 3750 3750 3750 3750 3750
				3750 3750 3750 3750 3750 3750 3750 3750 3750
				3750 3750 3750 3750 3750 3750 3750 3750 3750
				3750 3750 3750 3750 3750 3750 3750 3750 3750
				3750 3750 3750 3750 3750 3750 3750 3750 3750
				3750 3750 3750 3750 3750 3750 3750 3750 3750
				3750 3750 3750 3750 3750 3750 3750 3750 3750
				3750 3750 3750 3750 3750 3750 3750 3750 3750
				3750 3750 3750 3750 3750 3750 3750 3750 3750
				3750 3750 3750 3750 3750 3750 3750 3750 3750
				3750 3750 3750 3750 3750 3750 3750 3750 3750
				3750 3750 3750 3750 3750 3750 3750 3750 3750
				3750 3750 3750 3750 3750 3750 3750 3750 3750
				3750 3750 3750 3750 3750 3750 3750 3750 3750
				3750 3750 3750 3750 3750 3750 3750 3750 3750
				3750 3750 3750 3750 3750 3750 3750 3750 3750
				3750 3750 3750 3750 3750 3750 3750 3750 3750
				3750 3750 3750 3750 3750 3750 3750 3750 3750
				3750 3750 3750 3750 3750 3750 3750 3750 3750
				3750 3750 3750>;

			PS_Config_Lmt_FW_Rawdata_N = <
				240 240 240 240 240 240 240 240 240
				240 240 240 240 240 240 240 240 240
				240 240 240 240 240 240 240 240 240
				240 240 240 240 240 240 240 240 240
				240 240 240 240 240 240 240 240 240
				240 240 240 240 240 240 240 240 240
				240 240 240 240 240 240 240 240 240
				240 240 240 240 240 240 240 240 240
				240 240 240 240 240 240 240 240 240
				240 240 240 240 240 240 240 240 240
				240 240 240 240 240 240 240 240 240
				240 240 240 240 240 240 240 240 240
				240 240 240 240 240 240 240 240 240
				240 240 240 240 240 240 240 240 240
				240 240 240 240 240 240 240 240 240
				240 240 240 240 240 240 240 240 240
				240 240 240 240 240 240 240 240 240
				240 240 240 240 240 240 240 240 240
				240 240 240 240 240 240 240 240 240
				240 240 240 240 240 240 240 240 240
				240 240 240 240 240 240 240 240 240
				240 240 240 240 240 240 240 240 240
				240 240 240 240 240 240 240 240 240
				240 240 240 240 240 240 240 240 240
				240 240 240 240 240 240 240 240 240
				240 240 240 240 240 240 240 240 240
				240 240 240 240 240 240 240 240 240
				240 240 240 240 240 240 240 240 240
				240 240 240 240 240 240 240 240 240
				240 240 240 240 240 240 240 240 240
				240 240 240 240 240 240 240 240 240
				240 240 240 240 240 240 240 240 240
				240 240 240 240 240 240 240 240 240
				240 240 240 240 240 240 240 240 240
				240 240 240 240 240 240 240 240 240
				240 240 240 240 240 240 240 240 240
				240 240 240 240 240 240 240 240 240
				240 240 240 240 240 240 240 240 240
				240 240 240 240 240 240 240 240 240
				240 240 240 240 240 240 240 240 240
				240 240 240 240 240 240 240 240 240
				240 240 240 240 240 240 240 240 240
				240 240 240 240 240 240 240 240 240
				240 240 240 240 240 240 240 240 240
				240 240 240 240 240 240 240 240 240
				240 240 240 240 240 240 240 240 240
				240 240 240 240 240 240 240 240 240
				240 240 240 240 240 240 240 240 240
				240 240 240 240 240 240 240 240 240
				240 240 240 240 240 240 240 240 240
				240 240 240 240 240 240 240 240 240
				240 240 240 240 240 240 240 240 240
				240 240 240 240 240 240 240 240 240
				240 240 240 240 240 240 240 240 240
				240 240 240 240 240 240 240 240 240
				240 240 240 240 240 240 240 240 240
				240 240 240 240 240 240 240 240 240
				240 240 240 240 240 240 240 240 240
				240 240 240 240 240 240 240 240 240
				240 240 240 240 240 240 240 240 240
				240 240 240 240 240 240 240 240 240
				240 240 240 240 240 240 240 240 240
				240 240 240 240 240 240 240 240 240
				240 240 240 240 240 240 240 240 240
				240 240 240>;

			PS_Config_Lmt_FW_CC_P = <
				314 314 314 314 314 314 314 314 314
				314 314 314 314 314 314 314 314 314
				314 314 314 314 314 314 314 314 314
				314 314 314 314 314 314 314 314 314
				314 314 314 314 314 314 314 314 314
				314 314 314 314 314 314 314 314 314
				314 314 314 314 314 314 314 314 314
				314 314 314 314 314 314 314 314 314
				314 314 314 314 314 314 314 314 314
				314 314 314 314 314 314 314 314 314
				314 314 314 314 314 314 314 314 314
				314 314 314 314 314 314 314 314 314
				314 314 314 314 314 314 314 314 314
				314 314 314 314 314 314 314 314 314
				314 314 314 314 314 314 314 314 314
				314 314 314 314 314 314 314 314 314
				314 314 314 314 314 314 314 314 314
				314 314 314 314 314 314 314 314 314
				314 314 314 314 314 314 314 314 314
				314 314 314 314 314 314 314 314 314
				314 314 314 314 314 314 314 314 314
				314 314 314 314 314 314 314 314 314
				314 314 314 314 314 314 314 314 314
				314 314 314 314 314 314 314 314 314
				314 314 314 314 314 314 314 314 314
				314 314 314 314 314 314 314 314 314
				314 314 314 314 314 314 314 314 314
				314 314 314 314 314 314 314 314 314
				314 314 314 314 314 314 314 314 314
				314 314 314 314 314 314 314 314 314
				314 314 314 314 314 314 314 314 314
				314 314 314 314 314 314 314 314 314
				314 314 314 314 314 314 314 314 314
				314 314 314 314 314 314 314 314 314
				314 314 314 314 314 314 314 314 314
				314 314 314 314 314 314 314 314 314
				314 314 314 314 314 314 314 314 314
				314 314 314 314 314 314 314 314 314
				314 314 314 314 314 314 314 314 314
				314 314 314 314 314 314 314 314 314
				314 314 314 314 314 314 314 314 314
				314 314 314 314 314 314 314 314 314
				314 314 314 314 314 314 314 314 314
				314 314 314 314 314 314 314 314 314
				314 314 314 314 314 314 314 314 314
				314 314 314 314 314 314 314 314 314
				314 314 314 314 314 314 314 314 314
				314 314 314 314 314 314 314 314 314
				314 314 314 314 314 314 314 314 314
				314 314 314 314 314 314 314 314 314
				314 314 314 314 314 314 314 314 314
				314 314 314 314 314 314 314 314 314
				314 314 314 314 314 314 314 314 314
				314 314 314 314 314 314 314 314 314
				314 314 314 314 314 314 314 314 314
				314 314 314 314 314 314 314 314 314
				314 314 314 314 314 314 314 314 314
				314 314 314 314 314 314 314 314 314
				314 314 314 314 314 314 314 314 314
				314 314 314 314 314 314 314 314 314
				314 314 314 314 314 314 314 314 314
				314 314 314 314 314 314 314 314 314
				314 314 314 314 314 314 314 314 314
				314 314 314 314 314 314 314 314 314
				314 314 314>;

			PS_Config_Lmt_FW_CC_N = <
				0 0 0 0 0 0 0 0 0 0 0 0 0 0 0 0 0 0
				0 0 0 0 0 0 0 0 0 0 0 0 0 0 0 0 0 0
				0 0 0 0 0 0 0 0 0 0 0 0 0 0 0 0 0 0
				0 0 0 0 0 0 0 0 0 0 0 0 0 0 0 0 0 0
				0 0 0 0 0 0 0 0 0 0 0 0 0 0 0 0 0 0
				0 0 0 0 0 0 0 0 0 0 0 0 0 0 0 0 0 0
				0 0 0 0 0 0 0 0 0 0 0 0 0 0 0 0 0 0
				0 0 0 0 0 0 0 0 0 0 0 0 0 0 0 0 0 0
				0 0 0 0 0 0 0 0 0 0 0 0 0 0 0 0 0 0
				0 0 0 0 0 0 0 0 0 0 0 0 0 0 0 0 0 0
				0 0 0 0 0 0 0 0 0 0 0 0 0 0 0 0 0 0
				0 0 0 0 0 0 0 0 0 0 0 0 0 0 0 0 0 0
				0 0 0 0 0 0 0 0 0 0 0 0 0 0 0 0 0 0
				0 0 0 0 0 0 0 0 0 0 0 0 0 0 0 0 0 0
				0 0 0 0 0 0 0 0 0 0 0 0 0 0 0 0 0 0
				0 0 0 0 0 0 0 0 0 0 0 0 0 0 0 0 0 0
				0 0 0 0 0 0 0 0 0 0 0 0 0 0 0 0 0 0
				0 0 0 0 0 0 0 0 0 0 0 0 0 0 0 0 0 0
				0 0 0 0 0 0 0 0 0 0 0 0 0 0 0 0 0 0
				0 0 0 0 0 0 0 0 0 0 0 0 0 0 0 0 0 0
				0 0 0 0 0 0 0 0 0 0 0 0 0 0 0 0 0 0
				0 0 0 0 0 0 0 0 0 0 0 0 0 0 0 0 0 0
				0 0 0 0 0 0 0 0 0 0 0 0 0 0 0 0 0 0
				0 0 0 0 0 0 0 0 0 0 0 0 0 0 0 0 0 0
				0 0 0 0 0 0 0 0 0 0 0 0 0 0 0 0 0 0
				0 0 0 0 0 0 0 0 0 0 0 0 0 0 0 0 0 0
				0 0 0 0 0 0 0 0 0 0 0 0 0 0 0 0 0 0
				0 0 0 0 0 0 0 0 0 0 0 0 0 0 0 0 0 0
				0 0 0 0 0 0 0 0 0 0 0 0 0 0 0 0 0 0
				0 0 0 0 0 0 0 0 0 0 0 0 0 0 0 0 0 0
				0 0 0 0 0 0 0 0 0 0 0 0 0 0 0 0 0 0
				0 0 0 0 0 0 0 0 0 0 0 0 0 0 0 0 0 0
				0 0 0>;

			PS_Config_Lmt_FW_Diff_P = <
				75 75 75 75 75 75 75 75 75 75 75 75 75 75 75 75 75 75
				75 75 75 75 75 75 75 75 75 75 75 75 75 75 75 75 75 75
				75 75 75 75 75 75 75 75 75 75 75 75 75 75 75 75 75 75
				75 75 75 75 75 75 75 75 75 75 75 75 75 75 75 75 75 75
				75 75 75 75 75 75 75 75 75 75 75 75 75 75 75 75 75 75
				75 75 75 75 75 75 75 75 75 75 75 75 75 75 75 75 75 75
				75 75 75 75 75 75 75 75 75 75 75 75 75 75 75 75 75 75
				75 75 75 75 75 75 75 75 75 75 75 75 75 75 75 75 75 75
				75 75 75 75 75 75 75 75 75 75 75 75 75 75 75 75 75 75
				75 75 75 75 75 75 75 75 75 75 75 75 75 75 75 75 75 75
				75 75 75 75 75 75 75 75 75 75 75 75 75 75 75 75 75 75
				75 75 75 75 75 75 75 75 75 75 75 75 75 75 75 75 75 75
				75 75 75 75 75 75 75 75 75 75 75 75 75 75 75 75 75 75
				75 75 75 75 75 75 75 75 75 75 75 75 75 75 75 75 75 75
				75 75 75 75 75 75 75 75 75 75 75 75 75 75 75 75 75 75
				75 75 75 75 75 75 75 75 75 75 75 75 75 75 75 75 75 75
				75 75 75 75 75 75 75 75 75 75 75 75 75 75 75 75 75 75
				75 75 75 75 75 75 75 75 75 75 75 75 75 75 75 75 75 75
				75 75 75 75 75 75 75 75 75 75 75 75 75 75 75 75 75 75
				75 75 75 75 75 75 75 75 75 75 75 75 75 75 75 75 75 75
				75 75 75 75 75 75 75 75 75 75 75 75 75 75 75 75 75 75
				75 75 75 75 75 75 75 75 75 75 75 75 75 75 75 75 75 75
				75 75 75 75 75 75 75 75 75 75 75 75 75 75 75 75 75 75
				75 75 75 75 75 75 75 75 75 75 75 75 75 75 75 75 75 75
				75 75 75 75 75 75 75 75 75 75 75 75 75 75 75 75 75 75
				75 75 75 75 75 75 75 75 75 75 75 75 75 75 75 75 75 75
				75 75 75 75 75 75 75 75 75 75 75 75 75 75 75 75 75 75
				75 75 75 75 75 75 75 75 75 75 75 75 75 75 75 75 75 75
				75 75 75 75 75 75 75 75 75 75 75 75 75 75 75 75 75 75
				75 75 75 75 75 75 75 75 75 75 75 75 75 75 75 75 75 75
				75 75 75 75 75 75 75 75 75 75 75 75 75 75 75 75 75 75
				75 75 75 75 75 75 75 75 75 75 75 75 75 75 75 75 75 75
				75 75 75>;

			PS_Config_Lmt_FW_Diff_N = <
				(-75) (-75) (-75) (-75) (-75) (-75) (-75) (-75) (-75)
				(-75) (-75) (-75) (-75) (-75) (-75) (-75) (-75) (-75)
				(-75) (-75) (-75) (-75) (-75) (-75) (-75) (-75) (-75)
				(-75) (-75) (-75) (-75) (-75) (-75) (-75) (-75) (-75)
				(-75) (-75) (-75) (-75) (-75) (-75) (-75) (-75) (-75)
				(-75) (-75) (-75) (-75) (-75) (-75) (-75) (-75) (-75)
				(-75) (-75) (-75) (-75) (-75) (-75) (-75) (-75) (-75)
				(-75) (-75) (-75) (-75) (-75) (-75) (-75) (-75) (-75)
				(-75) (-75) (-75) (-75) (-75) (-75) (-75) (-75) (-75)
				(-75) (-75) (-75) (-75) (-75) (-75) (-75) (-75) (-75)
				(-75) (-75) (-75) (-75) (-75) (-75) (-75) (-75) (-75)
				(-75) (-75) (-75) (-75) (-75) (-75) (-75) (-75) (-75)
				(-75) (-75) (-75) (-75) (-75) (-75) (-75) (-75) (-75)
				(-75) (-75) (-75) (-75) (-75) (-75) (-75) (-75) (-75)
				(-75) (-75) (-75) (-75) (-75) (-75) (-75) (-75) (-75)
				(-75) (-75) (-75) (-75) (-75) (-75) (-75) (-75) (-75)
				(-75) (-75) (-75) (-75) (-75) (-75) (-75) (-75) (-75)
				(-75) (-75) (-75) (-75) (-75) (-75) (-75) (-75) (-75)
				(-75) (-75) (-75) (-75) (-75) (-75) (-75) (-75) (-75)
				(-75) (-75) (-75) (-75) (-75) (-75) (-75) (-75) (-75)
				(-75) (-75) (-75) (-75) (-75) (-75) (-75) (-75) (-75)
				(-75) (-75) (-75) (-75) (-75) (-75) (-75) (-75) (-75)
				(-75) (-75) (-75) (-75) (-75) (-75) (-75) (-75) (-75)
				(-75) (-75) (-75) (-75) (-75) (-75) (-75) (-75) (-75)
				(-75) (-75) (-75) (-75) (-75) (-75) (-75) (-75) (-75)
				(-75) (-75) (-75) (-75) (-75) (-75) (-75) (-75) (-75)
				(-75) (-75) (-75) (-75) (-75) (-75) (-75) (-75) (-75)
				(-75) (-75) (-75) (-75) (-75) (-75) (-75) (-75) (-75)
				(-75) (-75) (-75) (-75) (-75) (-75) (-75) (-75) (-75)
				(-75) (-75) (-75) (-75) (-75) (-75) (-75) (-75) (-75)
				(-75) (-75) (-75) (-75) (-75) (-75) (-75) (-75) (-75)
				(-75) (-75) (-75) (-75) (-75) (-75) (-75) (-75) (-75)
				(-75) (-75) (-75) (-75) (-75) (-75) (-75) (-75) (-75)
				(-75) (-75) (-75) (-75) (-75) (-75) (-75) (-75) (-75)
				(-75) (-75) (-75) (-75) (-75) (-75) (-75) (-75) (-75)
				(-75) (-75) (-75) (-75) (-75) (-75) (-75) (-75) (-75)
				(-75) (-75) (-75) (-75) (-75) (-75) (-75) (-75) (-75)
				(-75) (-75) (-75) (-75) (-75) (-75) (-75) (-75) (-75)
				(-75) (-75) (-75) (-75) (-75) (-75) (-75) (-75) (-75)
				(-75) (-75) (-75) (-75) (-75) (-75) (-75) (-75) (-75)
				(-75) (-75) (-75) (-75) (-75) (-75) (-75) (-75) (-75)
				(-75) (-75) (-75) (-75) (-75) (-75) (-75) (-75) (-75)
				(-75) (-75) (-75) (-75) (-75) (-75) (-75) (-75) (-75)
				(-75) (-75) (-75) (-75) (-75) (-75) (-75) (-75) (-75)
				(-75) (-75) (-75) (-75) (-75) (-75) (-75) (-75) (-75)
				(-75) (-75) (-75) (-75) (-75) (-75) (-75) (-75) (-75)
				(-75) (-75) (-75) (-75) (-75) (-75) (-75) (-75) (-75)
				(-75) (-75) (-75) (-75) (-75) (-75) (-75) (-75) (-75)
				(-75) (-75) (-75) (-75) (-75) (-75) (-75) (-75) (-75)
				(-75) (-75) (-75) (-75) (-75) (-75) (-75) (-75) (-75)
				(-75) (-75) (-75) (-75) (-75) (-75) (-75) (-75) (-75)
				(-75) (-75) (-75) (-75) (-75) (-75) (-75) (-75) (-75)
				(-75) (-75) (-75) (-75) (-75) (-75) (-75) (-75) (-75)
				(-75) (-75) (-75) (-75) (-75) (-75) (-75) (-75) (-75)
				(-75) (-75) (-75) (-75) (-75) (-75) (-75) (-75) (-75)
				(-75) (-75) (-75) (-75) (-75) (-75) (-75) (-75) (-75)
				(-75) (-75) (-75) (-75) (-75) (-75) (-75) (-75) (-75)
				(-75) (-75) (-75) (-75) (-75) (-75) (-75) (-75) (-75)
				(-75) (-75) (-75) (-75) (-75) (-75) (-75) (-75) (-75)
				(-75) (-75) (-75) (-75) (-75) (-75) (-75) (-75) (-75)
				(-75) (-75) (-75) (-75) (-75) (-75) (-75) (-75) (-75)
				(-75) (-75) (-75) (-75) (-75) (-75) (-75) (-75) (-75)
				(-75) (-75) (-75) (-75) (-75) (-75) (-75) (-75) (-75)
				(-75) (-75) (-75) (-75) (-75) (-75) (-75) (-75) (-75)
				(-75) (-75) (-75)>;

			PS_Config_Diff_Test_Frame = <50>;

			PS_Config_Lmt_LPWG_Rawdata_P = <
				3000 3000 3000 3000 3000 3000 3000 3000 3000
				3000 3000 3000 3000 3000 3000 3000 3000 3000
				3000 3000 3000 3000 3000 3000 3000 3000 3000
				3000 3000 3000 3000 3000 3000 3000 3000 3000
				3000 3000 3000 3000 3000 3000 3000 3000 3000
				3000 3000 3000 3000 3000 3000 3000 3000 3000
				3000 3000 3000 3000 3000 3000 3000 3000 3000
				3000 3000 3000 3000 3000 3000 3000 3000 3000
				3000 3000 3000 3000 3000 3000 3000 3000 3000
				3000 3000 3000 3000 3000 3000 3000 3000 3000
				3000 3000 3000 3000 3000 3000 3000 3000 3000
				3000 3000 3000 3000 3000 3000 3000 3000 3000
				3000 3000 3000 3000 3000 3000 3000 3000 3000
				3000 3000 3000 3000 3000 3000 3000 3000 3000
				3000 3000 3000 3000 3000 3000 3000 3000 3000
				3000 3000 3000 3000 3000 3000 3000 3000 3000
				3000 3000 3000 3000 3000 3000 3000 3000 3000
				3000 3000 3000 3000 3000 3000 3000 3000 3000
				3000 3000 3000 3000 3000 3000 3000 3000 3000
				3000 3000 3000 3000 3000 3000 3000 3000 3000
				3000 3000 3000 3000 3000 3000 3000 3000 3000
				3000 3000 3000 3000 3000 3000 3000 3000 3000
				3000 3000 3000 3000 3000 3000 3000 3000 3000
				3000 3000 3000 3000 3000 3000 3000 3000 3000
				3000 3000 3000 3000 3000 3000 3000 3000 3000
				3000 3000 3000 3000 3000 3000 3000 3000 3000
				3000 3000 3000 3000 3000 3000 3000 3000 3000
				3000 3000 3000 3000 3000 3000 3000 3000 3000
				3000 3000 3000 3000 3000 3000 3000 3000 3000
				3000 3000 3000 3000 3000 3000 3000 3000 3000
				3000 3000 3000 3000 3000 3000 3000 3000 3000
				3000 3000 3000 3000 3000 3000 3000 3000 3000
				3000 3000 3000 3000 3000 3000 3000 3000 3000
				3000 3000 3000 3000 3000 3000 3000 3000 3000
				3000 3000 3000 3000 3000 3000 3000 3000 3000
				3000 3000 3000 3000 3000 3000 3000 3000 3000
				3000 3000 3000 3000 3000 3000 3000 3000 3000
				3000 3000 3000 3000 3000 3000 3000 3000 3000
				3000 3000 3000 3000 3000 3000 3000 3000 3000
				3000 3000 3000 3000 3000 3000 3000 3000 3000
				3000 3000 3000 3000 3000 3000 3000 3000 3000
				3000 3000 3000 3000 3000 3000 3000 3000 3000
				3000 3000 3000 3000 3000 3000 3000 3000 3000
				3000 3000 3000 3000 3000 3000 3000 3000 3000
				3000 3000 3000 3000 3000 3000 3000 3000 3000
				3000 3000 3000 3000 3000 3000 3000 3000 3000
				3000 3000 3000 3000 3000 3000 3000 3000 3000
				3000 3000 3000 3000 3000 3000 3000 3000 3000
				3000 3000 3000 3000 3000 3000 3000 3000 3000
				3000 3000 3000 3000 3000 3000 3000 3000 3000
				3000 3000 3000 3000 3000 3000 3000 3000 3000
				3000 3000 3000 3000 3000 3000 3000 3000 3000
				3000 3000 3000 3000 3000 3000 3000 3000 3000
				3000 3000 3000 3000 3000 3000 3000 3000 3000
				3000 3000 3000 3000 3000 3000 3000 3000 3000
				3000 3000 3000 3000 3000 3000 3000 3000 3000
				3000 3000 3000 3000 3000 3000 3000 3000 3000
				3000 3000 3000 3000 3000 3000 3000 3000 3000
				3000 3000 3000 3000 3000 3000 3000 3000 3000
				3000 3000 3000 3000 3000 3000 3000 3000 3000
				3000 3000 3000 3000 3000 3000 3000 3000 3000
				3000 3000 3000 3000 3000 3000 3000 3000 3000
				3000 3000 3000 3000 3000 3000 3000 3000 3000
				3000 3000 3000 3000 3000 3000 3000 3000 3000
				3000 3000 3000>;

			PS_Config_Lmt_LPWG_Rawdata_N = <
				240 240 240 240 240 240 240 240 240
				240 240 240 240 240 240 240 240 240
				240 240 240 240 240 240 240 240 240
				240 240 240 240 240 240 240 240 240
				240 240 240 240 240 240 240 240 240
				240 240 240 240 240 240 240 240 240
				240 240 240 240 240 240 240 240 240
				240 240 240 240 240 240 240 240 240
				240 240 240 240 240 240 240 240 240
				240 240 240 240 240 240 240 240 240
				240 240 240 240 240 240 240 240 240
				240 240 240 240 240 240 240 240 240
				240 240 240 240 240 240 240 240 240
				240 240 240 240 240 240 240 240 240
				240 240 240 240 240 240 240 240 240
				240 240 240 240 240 240 240 240 240
				240 240 240 240 240 240 240 240 240
				240 240 240 240 240 240 240 240 240
				240 240 240 240 240 240 240 240 240
				240 240 240 240 240 240 240 240 240
				240 240 240 240 240 240 240 240 240
				240 240 240 240 240 240 240 240 240
				240 240 240 240 240 240 240 240 240
				240 240 240 240 240 240 240 240 240
				240 240 240 240 240 240 240 240 240
				240 240 240 240 240 240 240 240 240
				240 240 240 240 240 240 240 240 240
				240 240 240 240 240 240 240 240 240
				240 240 240 240 240 240 240 240 240
				240 240 240 240 240 240 240 240 240
				240 240 240 240 240 240 240 240 240
				240 240 240 240 240 240 240 240 240
				240 240 240 240 240 240 240 240 240
				240 240 240 240 240 240 240 240 240
				240 240 240 240 240 240 240 240 240
				240 240 240 240 240 240 240 240 240
				240 240 240 240 240 240 240 240 240
				240 240 240 240 240 240 240 240 240
				240 240 240 240 240 240 240 240 240
				240 240 240 240 240 240 240 240 240
				240 240 240 240 240 240 240 240 240
				240 240 240 240 240 240 240 240 240
				240 240 240 240 240 240 240 240 240
				240 240 240 240 240 240 240 240 240
				240 240 240 240 240 240 240 240 240
				240 240 240 240 240 240 240 240 240
				240 240 240 240 240 240 240 240 240
				240 240 240 240 240 240 240 240 240
				240 240 240 240 240 240 240 240 240
				240 240 240 240 240 240 240 240 240
				240 240 240 240 240 240 240 240 240
				240 240 240 240 240 240 240 240 240
				240 240 240 240 240 240 240 240 240
				240 240 240 240 240 240 240 240 240
				240 240 240 240 240 240 240 240 240
				240 240 240 240 240 240 240 240 240
				240 240 240 240 240 240 240 240 240
				240 240 240 240 240 240 240 240 240
				240 240 240 240 240 240 240 240 240
				240 240 240 240 240 240 240 240 240
				240 240 240 240 240 240 240 240 240
				240 240 240 240 240 240 240 240 240
				240 240 240 240 240 240 240 240 240
				240 240 240 240 240 240 240 240 240
				240 240 240>;

			PS_Config_Lmt_LPWG_Diff_P = <
				75 75 75 75 75 75 75 75 75 75 75 75 75 75 75 75 75 75
				75 75 75 75 75 75 75 75 75 75 75 75 75 75 75 75 75 75
				75 75 75 75 75 75 75 75 75 75 75 75 75 75 75 75 75 75
				75 75 75 75 75 75 75 75 75 75 75 75 75 75 75 75 75 75
				75 75 75 75 75 75 75 75 75 75 75 75 75 75 75 75 75 75
				75 75 75 75 75 75 75 75 75 75 75 75 75 75 75 75 75 75
				75 75 75 75 75 75 75 75 75 75 75 75 75 75 75 75 75 75
				75 75 75 75 75 75 75 75 75 75 75 75 75 75 75 75 75 75
				75 75 75 75 75 75 75 75 75 75 75 75 75 75 75 75 75 75
				75 75 75 75 75 75 75 75 75 75 75 75 75 75 75 75 75 75
				75 75 75 75 75 75 75 75 75 75 75 75 75 75 75 75 75 75
				75 75 75 75 75 75 75 75 75 75 75 75 75 75 75 75 75 75
				75 75 75 75 75 75 75 75 75 75 75 75 75 75 75 75 75 75
				75 75 75 75 75 75 75 75 75 75 75 75 75 75 75 75 75 75
				75 75 75 75 75 75 75 75 75 75 75 75 75 75 75 75 75 75
				75 75 75 75 75 75 75 75 75 75 75 75 75 75 75 75 75 75
				75 75 75 75 75 75 75 75 75 75 75 75 75 75 75 75 75 75
				75 75 75 75 75 75 75 75 75 75 75 75 75 75 75 75 75 75
				75 75 75 75 75 75 75 75 75 75 75 75 75 75 75 75 75 75
				75 75 75 75 75 75 75 75 75 75 75 75 75 75 75 75 75 75
				75 75 75 75 75 75 75 75 75 75 75 75 75 75 75 75 75 75
				75 75 75 75 75 75 75 75 75 75 75 75 75 75 75 75 75 75
				75 75 75 75 75 75 75 75 75 75 75 75 75 75 75 75 75 75
				75 75 75 75 75 75 75 75 75 75 75 75 75 75 75 75 75 75
				75 75 75 75 75 75 75 75 75 75 75 75 75 75 75 75 75 75
				75 75 75 75 75 75 75 75 75 75 75 75 75 75 75 75 75 75
				75 75 75 75 75 75 75 75 75 75 75 75 75 75 75 75 75 75
				75 75 75 75 75 75 75 75 75 75 75 75 75 75 75 75 75 75
				75 75 75 75 75 75 75 75 75 75 75 75 75 75 75 75 75 75
				75 75 75 75 75 75 75 75 75 75 75 75 75 75 75 75 75 75
				75 75 75 75 75 75 75 75 75 75 75 75 75 75 75 75 75 75
				75 75 75 75 75 75 75 75 75 75 75 75 75 75 75 75 75 75
				75 75 75>;

			PS_Config_Lmt_LPWG_Diff_N = <
				(-75) (-75) (-75) (-75) (-75) (-75) (-75) (-75) (-75)
				(-75) (-75) (-75) (-75) (-75) (-75) (-75) (-75) (-75)
				(-75) (-75) (-75) (-75) (-75) (-75) (-75) (-75) (-75)
				(-75) (-75) (-75) (-75) (-75) (-75) (-75) (-75) (-75)
				(-75) (-75) (-75) (-75) (-75) (-75) (-75) (-75) (-75)
				(-75) (-75) (-75) (-75) (-75) (-75) (-75) (-75) (-75)
				(-75) (-75) (-75) (-75) (-75) (-75) (-75) (-75) (-75)
				(-75) (-75) (-75) (-75) (-75) (-75) (-75) (-75) (-75)
				(-75) (-75) (-75) (-75) (-75) (-75) (-75) (-75) (-75)
				(-75) (-75) (-75) (-75) (-75) (-75) (-75) (-75) (-75)
				(-75) (-75) (-75) (-75) (-75) (-75) (-75) (-75) (-75)
				(-75) (-75) (-75) (-75) (-75) (-75) (-75) (-75) (-75)
				(-75) (-75) (-75) (-75) (-75) (-75) (-75) (-75) (-75)
				(-75) (-75) (-75) (-75) (-75) (-75) (-75) (-75) (-75)
				(-75) (-75) (-75) (-75) (-75) (-75) (-75) (-75) (-75)
				(-75) (-75) (-75) (-75) (-75) (-75) (-75) (-75) (-75)
				(-75) (-75) (-75) (-75) (-75) (-75) (-75) (-75) (-75)
				(-75) (-75) (-75) (-75) (-75) (-75) (-75) (-75) (-75)
				(-75) (-75) (-75) (-75) (-75) (-75) (-75) (-75) (-75)
				(-75) (-75) (-75) (-75) (-75) (-75) (-75) (-75) (-75)
				(-75) (-75) (-75) (-75) (-75) (-75) (-75) (-75) (-75)
				(-75) (-75) (-75) (-75) (-75) (-75) (-75) (-75) (-75)
				(-75) (-75) (-75) (-75) (-75) (-75) (-75) (-75) (-75)
				(-75) (-75) (-75) (-75) (-75) (-75) (-75) (-75) (-75)
				(-75) (-75) (-75) (-75) (-75) (-75) (-75) (-75) (-75)
				(-75) (-75) (-75) (-75) (-75) (-75) (-75) (-75) (-75)
				(-75) (-75) (-75) (-75) (-75) (-75) (-75) (-75) (-75)
				(-75) (-75) (-75) (-75) (-75) (-75) (-75) (-75) (-75)
				(-75) (-75) (-75) (-75) (-75) (-75) (-75) (-75) (-75)
				(-75) (-75) (-75) (-75) (-75) (-75) (-75) (-75) (-75)
				(-75) (-75) (-75) (-75) (-75) (-75) (-75) (-75) (-75)
				(-75) (-75) (-75) (-75) (-75) (-75) (-75) (-75) (-75)
				(-75) (-75) (-75) (-75) (-75) (-75) (-75) (-75) (-75)
				(-75) (-75) (-75) (-75) (-75) (-75) (-75) (-75) (-75)
				(-75) (-75) (-75) (-75) (-75) (-75) (-75) (-75) (-75)
				(-75) (-75) (-75) (-75) (-75) (-75) (-75) (-75) (-75)
				(-75) (-75) (-75) (-75) (-75) (-75) (-75) (-75) (-75)
				(-75) (-75) (-75) (-75) (-75) (-75) (-75) (-75) (-75)
				(-75) (-75) (-75) (-75) (-75) (-75) (-75) (-75) (-75)
				(-75) (-75) (-75) (-75) (-75) (-75) (-75) (-75) (-75)
				(-75) (-75) (-75) (-75) (-75) (-75) (-75) (-75) (-75)
				(-75) (-75) (-75) (-75) (-75) (-75) (-75) (-75) (-75)
				(-75) (-75) (-75) (-75) (-75) (-75) (-75) (-75) (-75)
				(-75) (-75) (-75) (-75) (-75) (-75) (-75) (-75) (-75)
				(-75) (-75) (-75) (-75) (-75) (-75) (-75) (-75) (-75)
				(-75) (-75) (-75) (-75) (-75) (-75) (-75) (-75) (-75)
				(-75) (-75) (-75) (-75) (-75) (-75) (-75) (-75) (-75)
				(-75) (-75) (-75) (-75) (-75) (-75) (-75) (-75) (-75)
				(-75) (-75) (-75) (-75) (-75) (-75) (-75) (-75) (-75)
				(-75) (-75) (-75) (-75) (-75) (-75) (-75) (-75) (-75)
				(-75) (-75) (-75) (-75) (-75) (-75) (-75) (-75) (-75)
				(-75) (-75) (-75) (-75) (-75) (-75) (-75) (-75) (-75)
				(-75) (-75) (-75) (-75) (-75) (-75) (-75) (-75) (-75)
				(-75) (-75) (-75) (-75) (-75) (-75) (-75) (-75) (-75)
				(-75) (-75) (-75) (-75) (-75) (-75) (-75) (-75) (-75)
				(-75) (-75) (-75) (-75) (-75) (-75) (-75) (-75) (-75)
				(-75) (-75) (-75) (-75) (-75) (-75) (-75) (-75) (-75)
				(-75) (-75) (-75) (-75) (-75) (-75) (-75) (-75) (-75)
				(-75) (-75) (-75) (-75) (-75) (-75) (-75) (-75) (-75)
				(-75) (-75) (-75) (-75) (-75) (-75) (-75) (-75) (-75)
				(-75) (-75) (-75) (-75) (-75) (-75) (-75) (-75) (-75)
				(-75) (-75) (-75) (-75) (-75) (-75) (-75) (-75) (-75)
				(-75) (-75) (-75) (-75) (-75) (-75) (-75) (-75) (-75)
				(-75) (-75) (-75) (-75) (-75) (-75) (-75) (-75) (-75)
				(-75) (-75) (-75)>;
		};
	};
};
