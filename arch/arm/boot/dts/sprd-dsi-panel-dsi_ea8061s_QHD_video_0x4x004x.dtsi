&gen_panel {
	dsi_ea8061s_QHD_4x004x_vid: gen-panel-ea8061s_QHD_4x004x-video {
		gen-panel-manu = "SDC";			/* condensed manufacturer name */
		gen-panel-name = "ea8061s";
		gen-panel-id = <0x400041 0x400042>;
		gen-panel-dev-id = <0>;			/* SPRDFB_MAINLCD_ID : MAIN 0, SUB 1 */
		gen-panel-type = <2>;			/* LCD_MODE_DSI: MCU 0, RGB 1, DSI 2 */
		gen-panel-refresh = <60>;
		gen-panel-xres = <540>;
		gen-panel-yres = <960>;
		gen-panel-width= <56>;			/* screen width in mm */
		gen-panel-height = <94>;		/* screen height in mm */
		gen-panel-work-mode = <1>;		/* SPRDFB_MIPI_MODE_VIDEO : CMD 0, VIDEO 1*/
		gen-panel-direction = <0>;		/* LCD_DIRECT_NORMAL : Normal 0, ROT90 1, ROT180 2, ROT270 3 */
		gen-panel-suspend-mode = <1>;	/* SEND_SLEEP_CMD : RST 0, SLEEP 1 */
		gen-panel-bus-width = <24>;
		gen-panel-lanes = <2>;
		gen-panel-phy-feq = <490000>;
		gen-panel-h-sync-pol = <0>;		/*SPRDFB_POLARITY_POS : POS 0, NEG 1 */
		gen-panel-v-sync-pol = <0>;		/*SPRDFB_POLARITY_POS : POS 0, NEG 1 */
		gen-panel-de-pol = <0>;			/*SPRDFB_POLARITY_POS : POS 0, NEG 1 */
		gen-panel-te-pol = <0>;			/*SPRDFB_POLARITY_POS : POS 0, NEG 1 */
		gen-panel-color-mode-pol = <1>;	/*SPRDFB_POLARITY_POS : POS 0, NEG 1 */
		gen-panel-shut-down-pol = <1>;	/*SPRDFB_POLARITY_POS : POS 0, NEG 1 */
		gen-panel-h-front-porch = <59>; /* hfp */
		gen-panel-h-back-porch = <59>;	/* hbp */
		gen-panel-h-sync-width = <8>;	/* hsync */
		gen-panel-v-front-porch = <14>;	/* vfp */
		gen-panel-v-back-porch = <9>;	/* vbp */
		gen-panel-v-sync-width = <1>;	/* vsync */
		gen-panel-esd-mode = <1>;		/*ESD_DET_INTERRUPT : POLLING 0, INTERRUPT 1 */
		gen-panel-esd-gpio = <102>;
		gen-panel-esd-state = <0>;		/* ESD_DET_NOT_INITIALIZED : NOT_INT 0, OFF 1, ON 0 */
		gen-panel-esd-level = <1>;		/* ESD_DET_HIGH : LOW 0, HIGH 1 */
		gen-panel-octa-tset-param-offset = <0>;
		gen-panel-octa-elvss-param-offset = <7>;
		gen-panel-octa-aid-param-offset = <2>;

		/*
		 * DSI PACKET HEADER INFO
		 * @ delay(msec) : 2byte
		 * @ size of data : 2byte
		 */
		gen-panel-pkt-dinfo-addr-offset = <0>;
		gen-panel-pkt-dinfo-addr-length = <1>;
		gen-panel-pkt-dinfo-data-offset = <1>;
		gen-panel-pkt-dinfo-data-length = <1>;
		gen-panel-post-enable-cmds = [
			39 00 00 00 00 03	F0 5A 5A
			15 00 00 00 00 02	BA 74
			39 00 00 00 00 05	B2 00 00 00	0A
			15 00 00 00 00 02	F7 03
			39 00 00 00 00 03	B8 19 00
			39 00 00 00 00 03	F0 A5 A5
			05 00 00 14 00 01	11
		];
		gen-panel-post-enable-1-cmds = [
			05 00 00 14 00 01	29
		];
		gen-panel-disable-cmds = [
			05 00 00 14 00 01	28
			05 00 00 64 00 01	10
		];
		gen-panel-nv-read-enable-cmds = [
			39 00 00 00 00 03	F0 5A 5A
		];
		gen-panel-nv-read-disable-cmds = [
			39 00 00 00 00 03	F0 A5 A5
		];
		gen-panel-acl-on-cmds = [
			15 00 00 00 00 02	55 02
		];
		gen-panel-acl-off-cmds = [
			15 00 00 00 00 02	55 00
		];
		gen-panel-hbm-on-cmds = [
			39 00 00 00 00 05	B2 00 00 00	0A
			39 00 00 00 00 03	B6 CC 8B
			15 00 00 00 00 02	53 C0
			15 00 00 00 00 02	55 02
		];
		gen-panel-hbm-off-cmds = [
			15 00 00 00 00 02	53 00
		];
		gen-panel-tset-cmds = [
			15 00 00 00 00 02	B8 19
		];
		gen-panel-elvss-cmds = [
			39 00 00 00 00 09	B6 CC 00 00 00 00 00 00 00
		];
		gen-panel-aid-cmds = [
			39 00 00 00 00 05	B2 00 00 00	0A
		];

		/* VREGOUT VOLTAGE 5.4 * 2^22 */
		gen-panel-octa-vregout = <22649241>;


		gen-panel-candela-table = <
			5	6	7	8	9	10	11	12	13	14
			15	16	17	19	20	21	22	24	25	27
			29	30	32	34	37	39	41	44	47	50
			53	56	60	64	68	72	77	82	87	93
			98	105	111	119	126	134	143	152	162	172
			183	195	207	220	234	249	265	282	300	316
			333	350
		>;

		gen-panel-aid-table = <
			0x3B7	0x3B0	0x3A8	0x3A1	0x39A	0x393	0x38B	0x384	0x37D	0x375
			0x36E	0x367	0x35F	0x350	0x348	0x33F	0x336	0x324	0x31A	0x306
			0x2F4	0x2EA	0x2D9	0x2C8	0x2B0	0x29F	0x28F	0x276	0x25D	0x245
			0x22B	0x212	0x1F0	0x1CE	0x1AF	0x192	0x192	0x192	0x192	0x192
			0x192	0x192	0x192	0x166	0x13E	0x116	0x0E3	0x0B5	0x07B	0x047
			0x00A	0x00A	0x00A	0x00A	0x00A	0x00A	0x00A	0x00A	0x00A	0x00A
			0x00A	0x00A
		>;

		gen-panel-elvss-table = <
			0x8B	0x8B	0x8B	0x8B	0x8B	0x8B	0x8B	0x8B	0x8B	0x8B
			0x8B	0x8B	0x8B	0x8B	0x8B	0x8D	0x8F	0x91	0x93	0x95
			0x97	0x98	0x98	0x98	0x98	0x98	0x98	0x98	0x98	0x98
			0x98	0x98	0x98	0x98	0x98	0x98	0x98	0x98	0x98	0x98
			0x98	0x98	0x98	0x98	0x98	0x97	0x97	0x96	0x96	0x95
			0x95	0x94	0x93	0x92	0x92	0x91	0x90	0x8F	0x8E	0x8D
			0x8C	0x8B
		>;

		gen-panel-elvss-temperature-table = <
			/* T > 0 */
			0x11	0x11	0x11	0x11	0x11	0x11	0x11	0x11	0x11	0x11
			0x11	0x11	0x11	0x11	0x11	0x11	0x11	0x11	0x11	0x11
			0x11	0x00	0x00	0x00	0x00	0x00	0x00	0x00	0x00	0x00
			0x00	0x00	0x00	0x00	0x00	0x00	0x00	0x00	0x00	0x00
			0x00	0x00	0x00	0x00	0x00	0x00	0x00	0x00	0x00	0x00
			0x00	0x00	0x00	0x00	0x00	0x00	0x00	0x00	0x00	0x00
			0x00	0x00

			/* 0 >= T > -20 */
			0x1E	0x1E	0x1E	0x1E	0x1E	0x1E	0x1E	0x1E	0x1E	0x1E
			0x1E	0x1E	0x1E	0x1E	0x1E	0x1C	0x1A	0x18	0x16	0x14
			0x12	0x00	0x00	0x00	0x00	0x00	0x00	0x00	0x00	0x00
			0x00	0x00	0x00	0x00	0x00	0x00	0x00	0x00	0x00	0x00
			0x00	0x00	0x00	0x00	0x00	0x00	0x00	0x00	0x00	0x00
			0x00	0x00	0x00	0x00	0x00	0x00	0x00	0x00	0x00	0x00
			0x00	0x00

			/* -20 > T */
			0x1E	0x1E	0x1E	0x1E	0x1E	0x1E	0x1E	0x1E	0x1E	0x1E
			0x1E	0x1E	0x1E	0x1E	0x1E	0x1C	0x1A	0x18	0x16	0x14
			0x12	0x00	0x00	0x00	0x00	0x00	0x00	0x00	0x00	0x00
			0x00	0x00	0x00	0x00	0x00	0x00	0x00	0x00	0x00	0x00
			0x00	0x00	0x00	0x00	0x00	0x00	0x00	0x00	0x00	0x00
			0x00	0x00	0x00	0x00	0x00	0x00	0x00	0x00	0x00	0x00
			0x00	0x00
		>;
		gen-panel-base-lux-table = <
			128 128 128 128 128 128 128 128 128 128 128 128 128
			128 128 128 128 128 128 128 128 128 128 128 128 128
			128 128 128 128 128 128 128 128 128 128 137 146 153
			163 171 183 191 191 191 191 191 191 191 191 191 206
			217 229 243 256 272 288 304 320 334 350
		>;

		gen-panel-candela-compensation-table = <
			/* V255 V203 V151 V87 V51 V35 V23 V11 V3 */
			0	2	3	6	11	14	18	23	6
			0	3	4	6	9	12	16	21	6
			0	2	3	5	8	11	14	19	6
			0	2	3	5	7	9	13	17	6
			0	2	3	4	6	9	12	16	6
			0	2	3	3	5	8	11	15	6
			0	2	3	3	5	7	10	14	6
			0	2	2	3	5	7	9	13	6
			0	2	2	3	4	6	8	13	6
			0	2	2	3	4	6	8	12	6
			0	2	2	3	5	6	8	12	6
			0	2	2	3	3	5	7	11	5
			0	2	2	2	4	4	7	11	5
			0	2	2	2	3	4	6	10	5
			0	2	2	2	3	4	6	10	5
			0	2	2	2	3	5	6	10	5
			0	2	3	3	4	5	7	11	5
			0	2	3	3	4	5	7	11	5
			0	2	3	4	4	5	7	11	5
			0	2	3	4	4	5	7	11	5
			0	2	3	4	4	5	7	11	5
			0	2	3	4	4	5	7	11	5
			0	2	3	4	4	5	7	10	5
			0	2	3	3	4	5	6	10	5
			0	2	3	3	4	4	6	9	4
			0	2	3	3	4	4	6	9	4
			0	2	3	3	4	4	5	8	4
			0	2	3	3	3	4	5	8	4
			0	2	3	3	3	3	5	8	4
			0	2	3	3	3	3	5	7	4
			0	2	3	3	3	3	4	7	4
			0	2	3	3	3	3	4	6	4
			0	2	3	3	3	3	4	6	4
			0	2	3	3	3	2	4	6	4
			0	2	2	3	3	2	4	5	4
			0	2	3	3	2	2	3	5	3
			0	2	3	3	1	2	2	4	3
			0	2	3	3	1	2	3	4	3
			0	1	4	3	2	2	2	4	3
			0	1	4	4	3	2	3	5	3
			0	1	4	4	2	3	2	4	3
			0	1	4	5	3	3	3	4	3
			0	1	4	4	3	2	3	4	3
			0	1	3	4	3	2	3	3	3
			0	1	3	3	2	2	3	3	3
			0	1	3	3	2	1	2	3	3
			0	1	3	3	2	1	2	3	3
			0	1	3	3	2	1	2	2	3
			0	1	3	3	2	1	2	2	3
			0	1	2	2	1	1	2	2	3
			0	1	3	2	1	1	1	2	2
			0	0	2	2	1	1	1	2	2
			0	0	2	1	0	1	0	2	2
			0	0	2	1	0	1	0	1	1
			0	0	2	1	0	1	0	1	1
			0	0	1	1	0	0	0	1	1
			0	0	1	0	0	0	0	0	1
			0	0	1	0	0	(-1)	0	0	1
			0	0	1	0	(-1)	0	0	0	0
			0	0	0	(-1)	(-1)	0	0	0	0
			0	(-1)	(-1)	(-1)	(-1)	(-1)	(-1)	(-1)	0
			0	0	0	0	0	0	0	0	0
		>;

		gen-panel-rgb-compensation-table = <
			/* R255 G255 B255 R203 G203 B203 R151 G151 B151 R87 G87 B87 R51 G51 B51 R35 G35 B35 R23 G23 B23 R11 G11 B11 */
			0	0	1	(-1)	0	0	(-2)	0	(-2)	(-1)	0	0	(-14)	0	(-1)	(-16)	0	(-7)	(-18)	0	(-7)	1	0	(-1)
			0	0	1	(-1)	0	(-1)	(-2)	0	(-2)	(-1)	0	0	(-18)	0	(-5)	(-4)	0	1	(-15)	0	(-5)	(-1)	0	0
			0	0	1	0	0	0	(-2)	0	(-2)	(-1)	0	(-1)	(-17)	0	1	(-6)	0	(-2)	(-7)	0	2	(-9)	0	(-6)
			0	0	1	0	0	0	(-2)	0	(-2)	(-1)	0	(-1)	(-15)	0	(-5)	(-11)	0	(-3)	(-16)	0	(-7)	(-1)	0	3
			0	0	1	0	0	0	(-2)	0	(-2)	2	0	1	(-13)	0	(-5)	(-7)	0	1	(-12)	0	(-1)	(-10)	0	(-6)
			0	0	1	0	0	0	(-2)	0	(-2)	2	0	0	(-12)	0	3	(-7)	0	(-6)	(-15)	0	(-3)	(-9)	0	(-5)
			0	0	1	0	0	0	(-2)	0	(-2)	2	0	1	(-13)	0	3	(-7)	0	(-5)	(-14)	0	(-5)	(-8)	0	(-6)
			0	0	0	0	0	0	(-2)	0	(-1)	0	0	2	(-11)	0	(-4)	(-6)	0	0	(-9)	0	(-1)	(-12)	0	(-11)
			0	0	0	0	0	0	(-1)	0	(-1)	(-2)	0	(-1)	(-10)	0	(-2)	(-5)	0	0	(-8)	0	2	(-14)	0	(-13)
			0	0	0	0	0	0	(-1)	0	(-1)	(-1)	0	(-1)	(-10)	0	(-2)	(-4)	0	0	(-11)	0	(-2)	(-14)	0	(-12)
			0	0	0	0	0	0	(-1)	0	(-1)	1	0	2	(-10)	0	3	(-7)	0	(-6)	(-9)	0	(-2)	(-13)	0	(-10)
			0	0	0	0	0	0	(-1)	0	(-1)	1	0	1	(-7)	0	0	(-8)	0	(-3)	(-6)	0	0	(-18)	0	(-14)
			0	0	0	0	0	0	(-1)	0	(-1)	3	0	2	(-4)	0	5	(-6)	0	(-5)	(-9)	0	(-2)	(-18)	0	(-12)
			0	0	0	0	0	0	(-1)	0	(-1)	1	0	0	(-8)	0	5	(-2)	0	(-5)	(-6)	0	0	(-18)	0	(-15)
			0	0	0	0	0	0	(-1)	0	(-1)	1	0	0	(-8)	0	5	(-3)	0	(-5)	(-1)	0	(-1)	(-20)	0	(-12)
			0	0	0	0	0	0	(-1)	0	(-1)	1	0	0	(-7)	0	4	(-2)	0	(-7)	(-13)	0	(-5)	(-12)	0	(-9)
			0	0	0	0	0	0	(-1)	0	(-1)	1	0	1	(-7)	0	(-3)	(-4)	0	(-3)	(-3)	0	2	(-15)	0	(-9)
			0	0	0	0	0	0	(-1)	0	(-1)	2	0	(-1)	(-7)	0	(-2)	(-4)	0	(-2)	(-2)	0	2	(-14)	0	(-9)
			1	0	0	0	0	0	(-1)	0	(-1)	2	0	(-1)	(-6)	0	(-1)	(-4)	0	(-2)	(-2)	0	1	(-14)	0	(-11)
			1	0	0	0	0	0	(-1)	0	(-1)	2	0	(-1)	(-6)	0	(-1)	(-3)	0	(-2)	(-3)	0	1	(-13)	0	(-12)
			1	0	0	0	0	0	(-1)	0	(-1)	2	0	(-1)	(-6)	0	(-1)	(-3)	0	(-2)	(-1)	0	1	(-14)	0	(-12)
			1	0	0	0	0	0	(-1)	0	(-1)	2	0	(-1)	(-5)	0	(-1)	(-4)	0	(-3)	(-1)	0	1	(-14)	0	(-12)
			1	0	0	0	0	0	(-1)	0	(-1)	2	0	(-1)	(-5)	0	(-1)	(-2)	0	(-1)	(-11)	0	(-6)	(-11)	0	(-14)
			1	0	0	0	0	0	(-1)	0	(-1)	2	0	1	(-7)	0	(-4)	0	0	0	(-10)	0	(-7)	(-10)	0	(-8)
			1	0	0	0	0	0	(-1)	0	(-1)	2	0	0	(-6)	0	4	(-2)	0	(-7)	(-6)	0	(-4)	(-12)	0	(-12)
			1	0	0	0	0	0	(-1)	0	(-1)	2	0	0	(-6)	0	4	(-2)	0	(-7)	(-5)	0	(-3)	(-11)	0	(-10)
			1	0	0	0	0	0	(-1)	0	(-1)	2	0	0	(-5)	0	4	(-1)	0	(-6)	(-7)	0	(-1)	(-12)	0	(-15)
			1	0	0	0	0	0	(-1)	0	(-1)	2	0	0	(-4)	0	(-1)	1	0	(-1)	(-6)	0	(-1)	(-13)	0	(-11)
			1	0	0	0	0	0	(-1)	0	(-1)	2	0	(-1)	(-6)	0	0	0	0	(-3)	2	0	(-1)	(-14)	0	(-7)
			1	0	0	0	0	0	(-1)	0	(-1)	2	0	(-1)	(-6)	0	0	2	0	(-2)	(-7)	0	(-5)	(-12)	0	(-11)
			1	0	0	0	0	0	(-1)	0	(-1)	2	0	(-1)	(-6)	0	0	3	0	0	(-5)	0	(-5)	(-12)	0	(-8)
			1	0	0	0	0	0	(-1)	0	(-1)	2	0	(-1)	(-6)	0	0	3	0	0	2	0	(-2)	(-15)	0	(-13)
			1	0	0	0	0	0	(-1)	0	(-1)	2	0	(-1)	(-5)	0	(-1)	2	0	1	2	0	(-1)	(-14)	0	(-11)
			1	0	0	0	0	0	(-1)	0	(-1)	2	0	(-1)	(-6)	0	1	0	0	(-3)	(-2)	0	(-4)	(-10)	0	(-4)
			1	0	0	0	0	0	(-1)	0	(-1)	2	0	0	(-6)	0	0	0	0	(-3)	(-3)	0	(-2)	(-11)	0	(-10)
			1	0	0	0	0	0	(-1)	0	(-1)	4	0	1	(-4)	0	0	(-1)	0	(-2)	1	0	0	(-12)	0	(-8)
			1	0	1	0	0	0	(-1)	0	(-2)	2	0	1	(-3)	0	1	(-1)	0	(-2)	(-3)	0	(-4)	(-13)	0	(-8)
			0	0	0	0	0	0	(-1)	0	(-1)	3	0	1	(-2)	0	1	(-1)	0	(-2)	2	0	0	(-13)	0	(-11)
			1	0	1	0	0	0	(-1)	0	(-1)	0	0	0	(-3)	0	0	2	0	0	2	0	0	(-12)	0	(-10)
			1	0	0	0	0	0	(-2)	0	(-2)	2	0	0	(-3)	0	0	1	0	1	0	0	(-1)	(-11)	0	(-7)
			1	0	1	0	0	0	(-1)	0	(-2)	2	0	0	0	0	0	(-3)	0	(-1)	(-2)	0	(-2)	(-10)	0	(-6)
			1	0	1	0	0	0	0	0	(-1)	0	0	(-1)	0	0	0	(-2)	0	0	(-4)	0	(-2)	(-10)	0	(-6)
			1	0	1	0	0	1	1	0	(-1)	(-1)	0	(-3)	(-1)	0	5	3	0	0	(-5)	0	(-3)	(-10)	0	(-6)
			1	0	1	0	0	1	0	0	(-1)	0	0	(-2)	(-1)	0	2	1	0	1	(-4)	0	(-3)	(-9)	0	(-7)
			1	0	1	0	0	1	0	0	(-1)	(-1)	0	(-2)	(-1)	0	0	2	0	2	(-5)	0	(-3)	(-9)	0	(-5)
			1	0	1	0	0	1	0	0	(-1)	(-1)	0	(-2)	(-2)	0	0	2	0	1	1	0	0	(-10)	0	(-5)
			1	0	1	0	0	1	0	0	(-1)	(-1)	0	(-2)	(-2)	0	0	2	0	1	1	0	0	(-7)	0	(-2)
			1	0	1	0	0	1	0	0	(-1)	(-1)	0	(-2)	(-2)	0	0	2	0	1	(-3)	0	(-3)	(-6)	0	(-2)
			1	0	1	0	0	1	0	0	(-1)	(-1)	0	(-2)	(-2)	0	1	2	0	0	(-2)	0	(-5)	(-6)	0	0
			1	0	1	0	0	1	0	0	(-1)	(-1)	0	(-3)	(-1)	0	2	1	0	0	(-2)	0	(-6)	(-3)	0	2
			0	0	0	0	0	0	0	0	0	0	0	0	0	0	0	0	0	0	0	0	0	0	0	0
			0	0	0	0	0	0	0	0	0	0	0	0	0	0	0	0	0	0	0	0	0	0	0	0
			0	0	0	0	0	0	0	0	0	0	0	0	0	0	0	0	0	0	0	0	0	0	0	0
			0	0	0	0	0	0	0	0	0	0	0	0	0	0	0	0	0	0	0	0	0	0	0	0
			0	0	0	0	0	0	0	0	0	0	0	0	0	0	0	0	0	0	0	0	0	0	0	0
			0	0	0	0	0	0	0	0	0	0	0	0	0	0	0	0	0	0	0	0	0	0	0	0
			0	0	0	0	0	0	0	0	0	0	0	0	0	0	0	0	0	0	0	0	0	0	0	0
			0	0	0	0	0	0	0	0	0	0	0	0	0	0	0	0	0	0	0	0	0	0	0	0
			0	0	0	0	0	0	0	0	0	0	0	0	0	0	0	0	0	0	0	0	0	0	0	0
			0	0	0	0	0	0	0	0	0	0	0	0	0	0	0	0	0	0	0	0	0	0	0	0
			0	0	0	0	0	0	0	0	0	0	0	0	0	0	0	0	0	0	0	0	0	0	0	0
			0	0	0	0	0	0	0	0	0	0	0	0	0	0	0	0	0	0	0	0	0	0	0	0
		>;


		gen-panel-gamma-cmds = [
			39 00 00 00 00 22	CA 01 00 01 00 01 00 80 80 80 80 80 80 80 80 80
						80 80 80 80 80 80 80 80 80 80 80 80 80 80 80 00
						00 00
		];
		gen-panel-gamma-update-cmds = [
			15 00 00 05 00 02	F7 03
		];
		gen-panel-read-hbm = [
			B5 0D 06
			B5 1A 03
			B6 18 0C
		];
		gen-panel-read-mtp = [C8 00 21];
		gen-panel-read-id = [
			DA 00 01
			DB 00 01
			DC 00 01
		];
		gen-panel-read-status-reg = [0A];
		gen-panel-read-status-ok = [9A];
		status = "okay";
	};
};
