## arch/arm64/configs/vendor/lito_sec_eng_defconfig
```kconfig
# lito_sec_eng_defconfig

CONFIG_PSI_FTRACE=y
CONFIG_DEBUG_BLK_CGROUP=y
CONFIG_CGROUP_DEBUG=y
CONFIG_PRINT_VMEMLAYOUT=y
CONFIG_PM_DEBUG=y
CONFIG_KPROBES=y
CONFIG_CLEANCACHE=y
CONFIG_CMA_DEBUG=y
CONFIG_CMA_ALLOW_WRITE_DEBUGFS=y
CONFIG_L2TP_DEBUGFS=y
CONFIG_SCSI_UFSHCD_CMD_LOGGING=y
CONFIG_SERIAL_MSM_GENI_CONSOLE=y
CONFIG_SERIAL_DEV_BUS=y
CONFIG_VIDEO_VIM2M=y
CONFIG_MMC_IPC_LOGGING=y
CONFIG_EDAC_QCOM=y
CONFIG_EDAC_QCOM_LLCC_PANIC_ON_UE=y
CONFIG_QCOM_GPI_DMA_DEBUG=y
CONFIG_USB_BAM=y
CONFIG_IOMMU_TLBSYNC_DEBUG=y
CONFIG_ARM_SMMU_TESTBUS_DUMP=y
CONFIG_BUG_ON_HW_MEM_ONLINE_FAIL=y
CONFIG_MSM_CORE_HANG_DETECT=y
CONFIG_MSM_GLADIATOR_HANG_DETECT=y
CONFIG_ICNSS_DEBUG=y
CONFIG_EFIVAR_FS=y
CONFIG_XZ_DEC=y
CONFIG_DYNAMIC_DEBUG=y
CONFIG_DEBUG_CONSOLE_UNHASHED_POINTERS=y
CONFIG_DEBUG_MODULE_LOAD_INFO=y
CONFIG_PAGE_OWNER=y
CONFIG_PAGE_OWNER_ENABLE_DEFAULT=y
CONFIG_DEBUG_SECTION_MISMATCH=y
CONFIG_CMA_DEBUGFS=y
CONFIG_DEBUG_PAGEALLOC=y
CONFIG_SLUB_DEBUG_PANIC_ON=y
CONFIG_DEBUG_PANIC_ON_OOM=y
CONFIG_DEBUG_PAGEALLOC_ENABLE_DEFAULT=y
CONFIG_PAGE_POISONING=y
CONFIG_PAGE_POISONING_ENABLE_DEFAULT=y
CONFIG_SLUB_DEBUG_ON=y
CONFIG_DEBUG_KMEMLEAK=y
CONFIG_DEBUG_KMEMLEAK_EARLY_LOG_SIZE=4000
CONFIG_DEBUG_KMEMLEAK_DEFAULT_OFF=y
CONFIG_DEBUG_STACK_USAGE=y
CONFIG_DEBUG_MEMORY_INIT=y
CONFIG_SOFTLOCKUP_DETECTOR=y
CONFIG_WQ_WATCHDOG=y
CONFIG_PANIC_ON_SCHED_BUG=y
CONFIG_PANIC_ON_RT_THROTTLING=y
CONFIG_SCHED_STACK_END_CHECK=y
CONFIG_PROVE_LOCKING=y
CONFIG_LOCK_STAT=y
CONFIG_DEBUG_ATOMIC_SLEEP=y
CONFIG_LOCK_TORTURE_TEST=m
CONFIG_DEBUG_SG=y
CONFIG_DEBUG_NOTIFIERS=y
CONFIG_DEBUG_CREDENTIALS=y
CONFIG_RCU_TORTURE_TEST=m
CONFIG_FAULT_INJECTION=y
CONFIG_FAIL_PAGE_ALLOC=y
CONFIG_FAULT_INJECTION_DEBUG_FS=y
CONFIG_FAULT_INJECTION_STACKTRACE_FILTER=y
CONFIG_FUNCTION_TRACER=y
CONFIG_PREEMPTIRQ_EVENTS=y
CONFIG_IRQSOFF_TRACER=y
CONFIG_PREEMPT_TRACER=y
CONFIG_BLK_DEV_IO_TRACE=y
CONFIG_LKDTM=m
CONFIG_ATOMIC64_SELFTEST=m
CONFIG_TEST_USER_COPY=m
CONFIG_MEMTEST=y
CONFIG_BUG_ON_DATA_CORRUPTION=y
CONFIG_PANIC_ON_DATA_CORRUPTION=y
CONFIG_PID_IN_CONTEXTIDR=y
CONFIG_CORESIGHT_SOURCE_ETM4X=y
CONFIG_SEC_GPIO_DVS=y

# Samsung Eng Debugging Feature
CONFIG_SEC_DEBUG_FORCE_ERROR=y
CONFIG_SEC_DEBUG_SEC_WDOG_BITE=y
CONFIG_SEC_USER_RESET_DEBUG_TEST=y

# Micro Hypervisor
# CONFIG_KDP_CRED is not set
# CONFIG_UH_LKM_BLOCK is not set

# Battery driver
CONFIG_ENG_BATTERY_CONCEPT=y

CONFIG_CC_OPTIMIZE_FOR_SIZE=y
# CONFIG_CC_OPTIMIZE_FOR_PERFORMANCE is not set

CONFIG_FIVE_DEBUG=y
CONFIG_FIVE_SIGN_TA=y
CONFIG_FIVE_SIGNCLIENT_PATH="/home/dpi/qb5_8815/workspace/P4_1716/buildscript/tools/signclient.jar"
CONFIG_FIVE_PILSPLITTER_PATH="/home/dpi/qb5_8815/workspace/P4_1716/buildscript/tools/pil_splitter.py"


CONFIG_PROCA=y


# CONFIG_FIVE_PA_FEATURE is not set


CONFIG_GAF_V6=y
```

## arch/arm64/configs/vendor/lito_sec_kasan_defconfig
```kconfig
#
# KASAN Kernel Address SANitizer
#
CONFIG_KASAN=y
CONFIG_LOG_BUF_SHIFT=21
CONFIG_CC_OPTIMIZE_FOR_SIZE=y

CONFIG_SLUB_DEBUG=y

# needed, otherwise you'll get "stack frame size of <x> bytes in ...' [-Werror,-Wframe-larger-than=..."
CONFIG_FRAME_WARN=0

#
# Undefined config for Kernel SANitizers
#
# CONFIG_SLUB_DEBUG_PANIC_ON is not set
# CONFIG_UH is not set
# CONFIG_UH_RKP is not set
# CONFIG_RKP_TEST is not set
# CONFIG_RKP_KDP is not set
# CONFIG_KDP_TEST is not set
# CONFIG_RKP_NS_PROT is not set
# CONFIG_RKP_DMAP_PROT is not set

# CONFIG_RKP_CFP_JOPP is not set
# CONFIG_RKP_CFP_ROPP is not set
# CONFIG_RKP_CFP_ROPP_SYSREGKEY is not set
# CONFIG_RANDOMIZE_BASE is not set
#
# Undefined to reduce vmlinux size
#
# vmlinux reduce by a few MB
# CONFIG_DYNAMIC_DEBUG is not set
# early_log is about 1MB
# CONFIG_DEBUG_KMEMLEAK is not set

#
# DO NOT REMOVE THE LAST BLANK LINE
#
```

## arch/arm64/configs/vendor/m42q/atoll_sec_m42q_eur_open_defconfig
```kconfig
# sm7125_sec_m42q_eur_open_defconfig

CONFIG_SEC_M42Q_PROJECT=y
CONFIG_SEC_M42Q_EUR_OPEN=y

#Camera
CONFIG_SAMSUNG_REAR_TRIPLE=y
CONFIG_SAMSUNG_MULTI_CAMERA=y
CONFIG_CAMERA_SYSFS_V2=y
CONFIG_USE_CAMERA_HW_BIG_DATA=y
CONFIG_SAMSUNG_REAR_QUAD=y
CONFIG_LEDS_SM5714=y
CONFIG_MCLK_I2C_DELAY=y
CONFIG_SAMSUNG_CAMERA_OTP=y
CONFIG_S5K4HA_SENSOR=y
CONFIG_SAMSUNG_CAMERA_OTP_UW=y
CONFIG_GC5035_SENSOR=y
CONFIG_SAMSUNG_CAMERA_OTP_MACRO=y
CONFIG_SAMSUNG_HW_SOFTLANDING=y

#freecess
CONFIG_SAMSUNG_FREECESS=y

#Display
CONFIG_PANEL_EA8076GA_AMS638VL01_FHD=y
CONFIG_PANEL_S6E3FC3_AMS638YQ01_FHD=y

#SystemInput
CONFIG_INPUT_TOUCHSCREEN_TCLMV2=y
CONFIG_TOUCHSCREEN_STM_FTS5CU56A=y
CONFIG_INPUT_SEC_SECURE_TOUCH=y

# NFC ESE
CONFIG_SEC_NFC_V2=y
# CONFIG_ESE_P3_V2_LSI is not set
# CONFIG_ESE_SECURE is not set
# CONFIG_ESE_SPI_GPIO_START is not set
# CONFIG_ESE_SPI_GPIO_END is not set
# CONFIG_ESE_SPI_NUMBER is not set
CONFIG_SEC_NFC_LOGGER=y

# PDIC
CONFIG_USB_TYPEC_MANAGER_NOTIFIER=y
CONFIG_IF_CB_MANAGER=y
CONFIG_PDIC_NOTIFIER=y
CONFIG_PDIC_SM5714=y
CONFIG_SM5714_FACTORY_MODE=y
CONFIG_VBUS_NOTIFIER=y
CONFIG_USE_PDIC_LEGO=y

#AUDIO
CONFIG_SND_SOC_SAMSUNG_AUDIO=y
CONFIG_SND_SOC_SAMSUNG_MBHC_SUPPORT=y
CONFIG_SND_SOC_SAMSUNG_JACK=y

#MFD
CONFIG_MFD_SM5714=y

# FINGERPRINT SENSOR
CONFIG_SENSORS_FINGERPRINT=y
CONFIG_SENSORS_ET5XX=y
CONFIG_SENSORS_FP_SPI_NUMBER=6
CONFIG_SENSORS_FP_SPI_GPIO_START=59
CONFIG_SENSORS_FP_SPI_GPIO_END=62

#MUIC
CONFIG_USE_MUIC=y
CONFIG_USE_MUIC_LEGO=y
CONFIG_MUIC_NOTIFIER=y
CONFIG_MUIC_HV=y
CONFIG_MUIC_SUPPORT_PDIC=y
CONFIG_MUIC_SM5714=y
CONFIG_MUIC_BCD_RESCAN=y

# BATTERY
CONFIG_FUELGAUGE_SM5714=y
CONFIG_CHARGER_SM5714=y
CONFIG_BATTERY_SAMSUNG=y
CONFIG_BATTERY_SAMSUNG_LEGO_STYLE=y
CONFIG_BATTERY_AGE_FORECAST=y
CONFIG_BATTERY_CISD=y
CONFIG_AFC_CHARGER_MODE=y
CONFIG_BATTERY_NOTIFIER=y
CONFIG_BATTERY_SWELLING=y
CONFIG_CALC_TIME_TO_FULL=y
CONFIG_STEP_CHARGING=y
CONFIG_DIRECT_CHARGING=y
CONFIG_CHARGER_SM5440=y
CONFIG_PDIC_PD30=y
CONFIG_SUPPORT_HV_CTRL=y

# QCA Wi-Fi feature
CONFIG_QCA_CLD_WLAN=y
CONFIG_ICNSS=y
CONFIG_ICNSS_QMI=y
CONFIG_WCNSS_MEM_PRE_ALLOC=y
CONFIG_CLD_LL_CORE=y
CONFIG_CNSS_GENL=y

# SENSOR
CONFIG_SENSORS=y
CONFIG_SENSORS_SSC=y
CONFIG_ADSP_FACTORY=y
CONFIG_LSM6DSM_FACTORY=y
CONFIG_AK09918_FACTORY=y
CONFIG_STK31610_FACTORY=y
CONFIG_NOT_SUPPORT_PROX_FACTORY=y

# GRIP_SENSOR
CONFIG_SENSORS_ISG5320A=y
CONFIG_SENSORS_ISG5320A_SUB=y

#MOTOR
CONFIG_SS_VIBRATOR=y
CONFIG_LEDS_QPNP_VIBRATOR_LDO=y
CONFIG_MSM_VIBRATOR=y

# CAMERA PMIC
CONFIG_REGULATOR_S2MPB03=y

#EPDG
CONFIG_NET_CLS_BASIC=y

# SEC Connector detector driver
CONFIG_SEC_CONNECTOR_DETECTOR=y
```

## arch/arm64/mach-exynos/Kconfig
```kconfig
# arch/arm/mach-exynos/Kconfig
#
# Copyright (c) 2010-2011 Samsung Electronics Co., Ltd.
#		http://www.samsung.com/
#
# Licensed under GPLv2

# Configuration options for the EXYNOS4

if ARCH_EXYNOS

menu "SAMSUNG EXYNOS SoCs Support"

config ARCH_EXYNOS5
	bool "SAMSUNG EXYNOS5"
	select HAVE_ARM_SCU if SMP
	select HAVE_SMP
	select HAVE_EXYNOS5_HSI2C if I2C
	help
	  Samsung EXYNOS5 (Cortex-A53/A57) SoC based systems

config ARCH_EXYNOS7
	bool "SAMSUNG EXYNOS7"
	select HAVE_ARM_SCU if SMP
	select HAVE_SMP
	select HAVE_EXYNOS5_HSI2C if I2C
	select PM_GENERIC_DOMAINS if PM
	help
	  Samsung EXYNOS7 (Cortex-A57/A53) SoC based systems

config SOC_EXYNOS7420
	bool "SAMSUNG EXYNOS7420"
	depends on ARCH_EXYNOS7
	select SAMSUNG_DMADEV
	select CAL_SYS_PWRDOWN
	select EXYNOS_SPI_RESET_DURING_DSTOP if CPU_IDLE
	help
	  Enable EXYNOS7420 SoC support

config SOC_EXYNOS7420_EVT_0
	bool "SAMSUNG EXYNOS7420 EVT0"
	depends on SOC_EXYNOS7420
	select CAL_SYS_PWRDOWN
	help
	  Enable EXYNOS7420 EVT0 SoC support

config SOC_EXYNOS7580
	bool "SAMSUNG EXYNOS7580"
	depends on ARCH_EXYNOS7
	select SAMSUNG_DMADEV
	select CAL_SYS_PWRDOWN
	select ARCH_HAS_OPP
	select ARCH_HAS_BANDGAP
	select EXYNOS_I2C_RESET_DURING_DSTOP if CPU_IDLE
	select EXYNOS_SPI_RESET_DURING_DSTOP if CPU_IDLE
	select EXYNOS_HSI2C_RESET_DURING_DSTOP if CPU_IDLE
	select SECCOMP
	help
	  Enable EXYNOS7580 SoC support

config SOC_EXYNOS5433
	bool "SAMSUNG EXYNOS5433"
	default n
	depends on ARCH_EXYNOS5
	select PM_GENERIC_DOMAINS if PM
	select S5P_PM if PM
	select S5P_SLEEP if SUSPEND
	select SAMSUNG_DMADEV
	select EXYNOS_HSI2C_RESET_DURING_DSTOP if CPU_IDLE
	select EXYNOS_SPI_RESET_DURING_DSTOP if CPU_IDLE
	select CAL_SYS_PWRDOWN
	help
	  Enable EXYNOS5433 SoC support

config EXYNOS_ASV
	bool "ENABLE EXYNOS ASV"
	default n
	depends on ARCH_EXYNOS

config EXYNOS_ASV_DYNAMIC_ABB
	bool "Enable Dynamic ABB"
	default n
	depends on EXYNOS_ASV

config EXYNOS_ASV_SUPPORT_RCC
	bool "Support RCC Table"
	default n
	depends on EXYNOS_ASV

config EXYNOS_ASV_MARGIN_TEST
	bool "Enable Margin Test"
	default n
	depends on EXYNOS_ASV

config SKIP_HW_BREAKPOINT
	bool "support skip hw breakpoint"
	default n
	help
	  Support early param for T32 onchip breakpoint

config CAL_SYS_PWRDOWN
	bool "Enable CAL for system level power down"

config EXYNOS7580_QUAD
	bool "Exynos7580 Quad core"
	default n

config EXYNOS_ATAGS
	def_bool "ATAGS based boot for EXYNOS (deprecated)"
	depends on !ARCH_MULTIPLATFORM
	depends on ATAGS
	help
	  The EXYNOS platform is moving towards being completely probed
	  through device tree. This enables support for board files using
	  the traditional ATAGS boot format.
	  Note that this option is not available for multiplatform builds.

config EXYNOS5_DYNAMIC_CPU_HOTPLUG
	bool "Dynamic CPU Hotplug support"
	depends on !SOC_EXYNOS7580
	depends on CPU_FREQ
	help
		Enable Dynamic CPU Hotplug

config EXYNOS7580_DYNAMIC_CLUSTER_HOTPLUG
	bool "Dynamic CLUSTER Hotplug support"
	depends on SOC_EXYNOS7580
	depends on CPU_FREQ
	help
		Enable Dynamic CLUSTER Hotplug

config EXYNOS_CONTENT_PATH_PROTECTION
	bool "Exynos Content Path Protection"
	depends on ARM_TRUSTZONE
	default n
	help
	  Enable content path protection of EXYNOS.

config EXYNOS5_SETUP_MIPIPHY
	bool
	depends on (VIDEO_EXYNOS_FIMC_IS || DECON_MIPI_DSI || EXYNOS_MIPI_DSI)
	default y
	help
	  Compile in common setup code for MIPI-CSIS devices

config SAMSUNG_PRODUCT_SHIP
	bool "set up for product shipping"
	default n

if EXYNOS_ATAGS

config EXYNOS_DEV_DMA
	bool
	help
	  Compile in amba device definitions for DMA controller

config EXYNOS4_DEV_AHCI
	bool
	help
	  Compile in platform device definitions for AHCI

config EXYNOS4_SETUP_FIMD0
	bool
	help
	  Common setup code for FIMD0.

config EXYNOS4_DEV_USB_OHCI
	bool
	help
	  Compile in platform device definition for USB OHCI

config EXYNOS4_SETUP_I2C1
	bool
	help
	  Common setup code for i2c bus 1.

config EXYNOS4_SETUP_I2C2
	bool
	help
	  Common setup code for i2c bus 2.

config EXYNOS4_SETUP_I2C3
	bool
	help
	  Common setup code for i2c bus 3.

config EXYNOS4_SETUP_I2C4
	bool
	help
	  Common setup code for i2c bus 4.

config EXYNOS4_SETUP_I2C5
	bool
	help
	  Common setup code for i2c bus 5.

config EXYNOS4_SETUP_I2C6
	bool
	help
	  Common setup code for i2c bus 6.

config EXYNOS4_SETUP_I2C7
	bool
	help
	  Common setup code for i2c bus 7.

config EXYNOS4_SETUP_KEYPAD
	bool
	help
	  Common setup code for keypad.

config EXYNOS4_SETUP_SDHCI
	bool
	select EXYNOS4_SETUP_SDHCI_GPIO
	help
	  Internal helper functions for EXYNOS4 based SDHCI systems.

config EXYNOS4_SETUP_SDHCI_GPIO
	bool
	help
	  Common setup code for SDHCI gpio.

config EXYNOS4_SETUP_FIMC
	bool
	help
	  Common setup code for the camera interfaces.

config EXYNOS4_SETUP_USB_PHY
	bool
	help
	  Common setup code for USB PHY controller

config EXYNOS_SETUP_SPI
	bool
	help
	  Common setup code for SPI GPIO configurations.

endif

comment "Flattened Device Tree based board for EXYNOS SoCs"

config MACH_UNIVERSAL5433
	bool "SAMSUNG UNIVERSAL5433 Machine using device tree"
	default y
	depends on ARCH_EXYNOS5 && SOC_EXYNOS5433
	select ARM_AMBA
	select CLKSRC_OF
	select PINCTRL
	select PINCTRL_EXYNOS
	select USE_OF
	select MIGHT_HAVE_PCI
	select PCI_DOMAINS if PCI
	help
	  Machine support for Samsung EXYNOS5433 machine with device tree enabled.
	  Select this if a fdt blob is available for the EXYNOS5433 SoC based board.

config MACH_ESPRESSO7420
	bool "SAMSUNG ESPRESSO7420 Machine using device tree"
	select ARM_AMBA
	select CLKSRC_OF
	select USE_OF
	select PINCTRL
	select PINCTRL_EXYNOS
	select S3C_DEV_RTC
	select MIGHT_HAVE_PCI
	select PCI_DOMAINS if PCI
	help
	  Machine support for Samsung EXYNOS7420 machine with device tree enabled.
	  Select this if a fdt blob is available for the EXYNOS7420 SoC based board.

config MACH_UNIVERSAL7420
	bool "SAMSUNG UNIVERSAL7420 Machine using device tree"
	select ARM_AMBA
	select CLKSRC_OF
	select USE_OF
	select PINCTRL
	select PINCTRL_EXYNOS
	select S3C_DEV_RTC
	select MIGHT_HAVE_PCI
	select PCI_DOMAINS if PCI
	help
	  Machine support for Samsung EXYNOS7420 machine with device tree enabled.
	  Select this if a fdt blob is available for the EXYNOS7420 SoC based board.

config MACH_SMDK7580
	bool "SAMSUNG SMDK7580 Machine using device tree"
	select ARM_AMBA
	select USE_OF
	select PINCTRL
	select PINCTRL_EXYNOS
	help
	  Machine support for Samsung EXYNOS7580 machine with device tree enabled.
	  Select this if a fdt blob is available for the EXYNOS7580 SoC based board.

config MACH_UNIVERSAL7580
	bool "SAMSUNG UNIVERSAL7580 Machine using device tree"
	select ARM_AMBA
	select USE_OF
	select PINCTRL
	select PINCTRL_EXYNOS
	select PM_OPP
	help
	  Machine support for Samsung EXYNOS7580 machine with device tree enabled.
	  Select this if a fdt blob is available for the EXYNOS7580 SoC based board.

config SEC_FACTORY
	bool "SAMSUNG Factory build option"
	default n
	help
	  Include some codes for Factory binary.

endmenu

# Reset IPs during LPA/DSTOP
config EXYNOS_SPI_RESET_DURING_DSTOP
	bool

config EXYNOS_I2C_RESET_DURING_DSTOP
	bool

config EXYNOS_HSI2C_RESET_DURING_DSTOP
	bool

endif

config TIMA
	bool "Enable TIMA(Trustzone based Integrity Measurement Archtecture feature"
	default n

config TIMA_LKMAUTH
	bool "Enable LKM authentication by TIMA"
	help
	  TIMA authenticates loaded kernel modules. Disable it if you don't
	  want TIMA enabled.

config TIMA_RKP
	bool "Enable RKP (Realtime Kernel Protection) TIMA feature"
	depends on TIMA
	default n

config RKP_KDP
	bool "Protection for cred structure"
	depends on TIMA_RKP
	default n
	help
		Prevents unauthorized cred modification.

config RKP_DMAP_PROT
	bool "Page Double Mapping protection"
	depends on (TIMA_RKP && RKP_KDP)
	default n
	help
		Prevents unauthorized cred modification.

config TIMA_TEST_INFRA
	tristate "Testing infrastructure for TIMA"
	default n
	help
	  Kernel bits of the TIMA test infrastructure
```
