## arch/arm64/configs/vendor/lito_sec_defconfig
```kconfig
##############################################################
# Samusng LITO(SM7250) project(based on lito-perf_defconfig) #
##############################################################

CONFIG_NO_HZ=y
CONFIG_HIGH_RES_TIMERS=y
CONFIG_PREEMPT=y
CONFIG_IRQ_TIME_ACCOUNTING=y
CONFIG_SCHED_WALT=y
CONFIG_TASKSTATS=y
CONFIG_TASK_XACCT=y
CONFIG_TASK_IO_ACCOUNTING=y
CONFIG_PSI=y
CONFIG_RCU_EXPERT=y
CONFIG_RCU_FAST_NO_HZ=y
CONFIG_RCU_NOCB_CPU=y
CONFIG_IKCONFIG=y
CONFIG_IKCONFIG_PROC=y
CONFIG_LOG_CPU_MAX_BUF_SHIFT=17
CONFIG_MEMCG=y
CONFIG_MEMCG_SWAP=y
CONFIG_BLK_CGROUP=y
CONFIG_RT_GROUP_SCHED=y
CONFIG_CGROUP_FREEZER=y
CONFIG_CPUSETS=y
CONFIG_CGROUP_CPUACCT=y
CONFIG_CGROUP_BPF=y
CONFIG_SCHED_CORE_CTL=y
CONFIG_NAMESPACES=y
CONFIG_UTS_NS=y
# CONFIG_PID_NS is not set
CONFIG_SCHED_AUTOGROUP=y
CONFIG_SCHED_TUNE=y
CONFIG_BLK_DEV_INITRD=y
# CONFIG_RD_XZ is not set
# CONFIG_RD_LZO is not set
# CONFIG_RD_LZ4 is not set
# CONFIG_FHANDLE is not set
CONFIG_KALLSYMS_ALL=y
CONFIG_BPF_SYSCALL=y
CONFIG_EMBEDDED=y
CONFIG_SLUB_DEBUG=y
# CONFIG_COMPAT_BRK is not set
# CONFIG_SLAB_FREELIST_RANDOM is not set
# CONFIG_SLAB_FREELIST_HARDENED is not set
CONFIG_PROFILING=y
# CONFIG_ZONE_DMA32 is not set
CONFIG_ARCH_QCOM=y
CONFIG_ARCH_LITO=y
CONFIG_PCI=y
CONFIG_SCHED_MC=y
CONFIG_NR_CPUS=8
CONFIG_SECCOMP=y
# CONFIG_UNMAP_KERNEL_AT_EL0 is not set
CONFIG_ARM64_SSBD=y
CONFIG_ARMV8_DEPRECATED=y
CONFIG_SWP_EMULATION=y
CONFIG_CP15_BARRIER_EMULATION=y
CONFIG_SETEND_EMULATION=y
# CONFIG_ARM64_VHE is not set
CONFIG_RANDOMIZE_BASE=y
# CONFIG_EFI is not set
CONFIG_BUILD_ARM64_UNCOMPRESSED_KERNEL=y
CONFIG_COMPAT=y
CONFIG_PM_WAKELOCKS=y
CONFIG_PM_WAKELOCKS_LIMIT=0
# CONFIG_PM_WAKELOCKS_GC is not set
CONFIG_ENERGY_MODEL=y
CONFIG_CPU_IDLE=y
CONFIG_ARM_CPUIDLE=y
CONFIG_CPU_FREQ=y
CONFIG_CPU_FREQ_TIMES=y
CONFIG_CPU_FREQ_GOV_POWERSAVE=y
CONFIG_CPU_FREQ_GOV_USERSPACE=y
CONFIG_CPU_FREQ_GOV_ONDEMAND=y
CONFIG_CPU_FREQ_GOV_CONSERVATIVE=y
CONFIG_CPU_BOOST=y
CONFIG_CPU_FREQ_GOV_SCHEDUTIL=y
CONFIG_ARM_QCOM_CPUFREQ_HW=y
CONFIG_ARM_QCOM_CPUFREQ_HW_DEBUG=y
CONFIG_MSM_TZ_LOG=y
CONFIG_ARM64_CRYPTO=y
CONFIG_CRYPTO_SHA1_ARM64_CE=y
CONFIG_CRYPTO_SHA2_ARM64_CE=y
# CONFIG_CRYPTO_GHASH_ARM64_CE is not set
CONFIG_CRYPTO_AES_ARM64_CE_CCM=y
CONFIG_CRYPTO_AES_ARM64_CE_BLK=y
# CONFIG_CRYPTO_AES_ARM64_NEON_BLK is not set
CONFIG_PANIC_ON_REFCOUNT_ERROR=y
CONFIG_MODULES=y
CONFIG_MODULE_UNLOAD=y
CONFIG_MODULE_FORCE_UNLOAD=y
CONFIG_MODVERSIONS=y
CONFIG_MODULE_SIG=y
CONFIG_MODULE_SIG_FORCE=y
CONFIG_MODULE_SIG_SHA512=y
# CONFIG_BLK_DEV_BSG is not set
CONFIG_BLK_INLINE_ENCRYPTION=y
CONFIG_BLK_INLINE_ENCRYPTION_FALLBACK=y
CONFIG_PARTITION_ADVANCED=y
# CONFIG_IOSCHED_DEADLINE is not set
CONFIG_CFQ_GROUP_IOSCHED=y
CONFIG_IOSCHED_BFQ=y
CONFIG_BFQ_GROUP_IOSCHED=y
# CONFIG_CORE_DUMP_DEFAULT_ELF_HEADERS is not set
CONFIG_CMA=y
CONFIG_ZSMALLOC=y
CONFIG_BALANCE_ANON_FILE_RECLAIM=y
CONFIG_HAVE_USERSPACE_LOW_MEMORY_KILLER=y
CONFIG_NET=y
CONFIG_PACKET=y
CONFIG_UNIX=y
CONFIG_XFRM_USER=y
CONFIG_XFRM_INTERFACE=y
CONFIG_XFRM_STATISTICS=y
CONFIG_NET_KEY=y
CONFIG_INET=y
CONFIG_IP_MULTICAST=y
CONFIG_IP_ADVANCED_ROUTER=y
CONFIG_IP_MULTIPLE_TABLES=y
CONFIG_IP_ROUTE_VERBOSE=y
CONFIG_IP_PNP=y
CONFIG_IP_PNP_DHCP=y
CONFIG_NET_IPGRE_DEMUX=y
CONFIG_SYN_COOKIES=y
CONFIG_NET_IPVTI=y
CONFIG_INET_AH=y
CONFIG_INET_ESP=y
CONFIG_INET_IPCOMP=y
CONFIG_INET_UDP_DIAG=y
CONFIG_INET_DIAG=y
CONFIG_INET_DIAG_DESTROY=y
CONFIG_INET_XFRM_MODE_TUNNEL=y
CONFIG_INET_XFRM_MODE_TRANSPORT=y
CONFIG_IPV6_ROUTER_PREF=y
CONFIG_IPV6_ROUTE_INFO=y
CONFIG_IPV6_OPTIMISTIC_DAD=y
CONFIG_INET6_AH=y
CONFIG_INET6_ESP=y
CONFIG_INET6_IPCOMP=y
CONFIG_INET6_XFRM_MODE_BEET=y
CONFIG_IPV6_MIP6=y
CONFIG_IPV6_VTI=y
CONFIG_IPV6_MULTIPLE_TABLES=y
CONFIG_IPV6_SUBTREES=y
CONFIG_NETFILTER=y
CONFIG_NF_CONNTRACK=y
CONFIG_NF_CONNTRACK_SECMARK=y
CONFIG_NF_CONNTRACK_EVENTS=y
CONFIG_NF_CONNTRACK_AMANDA=y
CONFIG_NF_CONNTRACK_FTP=y
CONFIG_NF_CONNTRACK_H323=y
CONFIG_NF_CONNTRACK_IRC=y
CONFIG_NF_CONNTRACK_NETBIOS_NS=y
CONFIG_NF_CONNTRACK_PPTP=y
CONFIG_NF_CONNTRACK_SANE=y
CONFIG_NF_CONNTRACK_TFTP=y
CONFIG_NF_CONNTRACK_IPV6=y
CONFIG_NF_CT_NETLINK=y
CONFIG_NETFILTER_XT_TARGET_CLASSIFY=y
CONFIG_NETFILTER_XT_TARGET_CONNMARK=y
CONFIG_NETFILTER_XT_TARGET_CONNSECMARK=y
CONFIG_NETFILTER_XT_TARGET_IDLETIMER=y
CONFIG_NETFILTER_XT_TARGET_HARDIDLETIMER=y
CONFIG_NETFILTER_XT_TARGET_LOG=y
CONFIG_NETFILTER_XT_TARGET_MARK=y
CONFIG_NETFILTER_XT_TARGET_NFLOG=y
CONFIG_NETFILTER_XT_TARGET_NFQUEUE=y
CONFIG_NETFILTER_XT_TARGET_NOTRACK=y
CONFIG_NETFILTER_XT_TARGET_TEE=y
CONFIG_NETFILTER_XT_TARGET_TPROXY=y
CONFIG_NETFILTER_XT_TARGET_TRACE=y
CONFIG_NETFILTER_XT_TARGET_SECMARK=y
CONFIG_NETFILTER_XT_TARGET_TCPMSS=y
CONFIG_NETFILTER_XT_TARGET_CT=y
CONFIG_NETFILTER_XT_MATCH_BPF=y
CONFIG_NETFILTER_XT_MATCH_COMMENT=y
CONFIG_NETFILTER_XT_MATCH_CONNLIMIT=y
CONFIG_NETFILTER_XT_MATCH_CONNMARK=y
CONFIG_NETFILTER_XT_MATCH_CONNTRACK=y
CONFIG_NETFILTER_XT_MATCH_DSCP=y
CONFIG_NETFILTER_XT_MATCH_ESP=y
CONFIG_NETFILTER_XT_MATCH_HASHLIMIT=y
CONFIG_NETFILTER_XT_MATCH_HELPER=y
CONFIG_NETFILTER_XT_MATCH_IPRANGE=y
# CONFIG_NETFILTER_XT_MATCH_L2TP is not set
CONFIG_NETFILTER_XT_MATCH_LENGTH=y
CONFIG_NETFILTER_XT_MATCH_LIMIT=y
CONFIG_NETFILTER_XT_MATCH_MAC=y
CONFIG_NETFILTER_XT_MATCH_MARK=y
CONFIG_NETFILTER_XT_MATCH_MULTIPORT=y
CONFIG_NETFILTER_XT_MATCH_OWNER=y
CONFIG_NETFILTER_XT_MATCH_POLICY=y
CONFIG_NETFILTER_XT_MATCH_PKTTYPE=y
CONFIG_NETFILTER_XT_MATCH_QUOTA=y
CONFIG_NETFILTER_XT_MATCH_QUOTA2=y
CONFIG_NETFILTER_XT_MATCH_QUOTA2_LOG=y
# CONFIG_NETFILTER_XT_MATCH_SCTP is not set
CONFIG_NETFILTER_XT_MATCH_SOCKET=y
CONFIG_NETFILTER_XT_MATCH_STATE=y
CONFIG_NETFILTER_XT_MATCH_STATISTIC=y
CONFIG_NETFILTER_XT_MATCH_STRING=y
CONFIG_NETFILTER_XT_MATCH_TIME=y
CONFIG_NETFILTER_XT_MATCH_U32=y
CONFIG_IP_NF_IPTABLES=y
CONFIG_IP_NF_MATCH_AH=y
CONFIG_IP_NF_MATCH_ECN=y
CONFIG_IP_NF_MATCH_RPFILTER=y
CONFIG_IP_NF_MATCH_TTL=y
CONFIG_IP_NF_FILTER=y
CONFIG_IP_NF_TARGET_REJECT=y
CONFIG_IP_NF_NAT=y
CONFIG_IP_NF_TARGET_MASQUERADE=y
CONFIG_IP_NF_TARGET_NETMAP=y
CONFIG_IP_NF_TARGET_REDIRECT=y
CONFIG_IP_NF_MANGLE=y
CONFIG_IP_NF_RAW=y
CONFIG_IP_NF_SECURITY=y
CONFIG_IP_NF_ARPTABLES=y
CONFIG_IP_NF_ARPFILTER=y
CONFIG_IP_NF_ARP_MANGLE=y
CONFIG_IP6_NF_IPTABLES=y
CONFIG_IP6_NF_MATCH_RPFILTER=y
CONFIG_IP6_NF_FILTER=y
CONFIG_IP6_NF_TARGET_REJECT=y
CONFIG_IP6_NF_MANGLE=y
CONFIG_IP6_NF_RAW=y
CONFIG_IP6_NF_NAT=y
CONFIG_BRIDGE_NF_EBTABLES=y
CONFIG_BRIDGE_EBT_BROUTE=y
CONFIG_IP_SCTP=y
CONFIG_L2TP=y
CONFIG_L2TP_V3=y
CONFIG_L2TP_IP=y
CONFIG_L2TP_ETH=y
CONFIG_BRIDGE=y
CONFIG_NET_SCHED=y
CONFIG_NET_SCH_HTB=y
CONFIG_NET_SCH_PRIO=y
CONFIG_NET_SCH_MULTIQ=y
CONFIG_NET_SCH_NETEM=y
CONFIG_NET_SCH_INGRESS=y
CONFIG_NET_CLS_FW=y
CONFIG_NET_CLS_U32=y
CONFIG_CLS_U32_MARK=y
CONFIG_NET_CLS_FLOW=y
CONFIG_NET_CLS_BPF=y
CONFIG_NET_EMATCH=y
CONFIG_NET_EMATCH_CMP=y
CONFIG_NET_EMATCH_NBYTE=y
CONFIG_NET_EMATCH_U32=y
CONFIG_NET_EMATCH_META=y
CONFIG_NET_EMATCH_TEXT=y
CONFIG_NET_CLS_ACT=y
CONFIG_NET_ACT_GACT=y
CONFIG_NET_ACT_MIRRED=y
CONFIG_NET_ACT_SKBEDIT=y
CONFIG_NET_ACT_POLICE=y
CONFIG_DNS_RESOLVER=y
CONFIG_QRTR=y
CONFIG_QRTR_SMD=y
CONFIG_QRTR_MHI=y
CONFIG_SOCKEV_NLMCAST=y
CONFIG_BT=y
CONFIG_MSM_BT_POWER=y
CONFIG_BTFM_SLIM_WCN3990=y
CONFIG_CFG80211=y
CONFIG_CFG80211_INTERNAL_REGDB=y
CONFIG_RFKILL=y
#CONFIG_NFC_NQ is not set
CONFIG_FW_LOADER_USER_HELPER=y
CONFIG_FW_LOADER_USER_HELPER_FALLBACK=y
CONFIG_REGMAP_WCD_IRQ=y
CONFIG_REGMAP_ALLOW_WRITE_DEBUGFS=y
CONFIG_DMA_CMA=y
CONFIG_MHI_BUS=y
CONFIG_ZRAM=y
CONFIG_ZRAM_DEDUP=y
CONFIG_BLK_DEV_LOOP=y
CONFIG_BLK_DEV_LOOP_MIN_COUNT=16
CONFIG_BLK_DEV_RAM=y
CONFIG_BLK_DEV_RAM_SIZE=8192
CONFIG_HDCP_QSEECOM=y
CONFIG_QSEECOM=y
CONFIG_UID_SYS_STATS=y
CONFIG_SCSI=y
CONFIG_BLK_DEV_SD=y
CONFIG_CHR_DEV_SG=y
CONFIG_CHR_DEV_SCH=y
CONFIG_SCSI_CONSTANTS=y
CONFIG_SCSI_LOGGING=y
CONFIG_SCSI_SCAN_ASYNC=y
CONFIG_SCSI_UFSHCD=y
CONFIG_SCSI_UFSHCD_PLATFORM=y
CONFIG_SCSI_UFS_QCOM=y
CONFIG_SCSI_UFSHCD_CMD_LOGGING=y
CONFIG_SCSI_UFS_CRYPTO=y
CONFIG_SCSI_UFS_CRYPTO_QTI=y
CONFIG_UFS_DATA_LOG=y
CONFIG_UFS_DATA_LOG_MAGIC_CODE=y
CONFIG_MD=y
CONFIG_BLK_DEV_DM=y
CONFIG_DM_CRYPT=y
CONFIG_DM_DEFAULT_KEY=y
CONFIG_DM_UEVENT=y
CONFIG_DM_VERITY=y
CONFIG_DM_VERITY_FEC=y
CONFIG_DM_ANDROID_VERITY_AT_MOST_ONCE_DEFAULT_ENABLED=y
CONFIG_NETDEVICES=y
CONFIG_BONDING=y
CONFIG_DUMMY=y
CONFIG_TUN=y
CONFIG_RMNET=y
CONFIG_PHYLIB=y
CONFIG_PPP=y
CONFIG_PPP_BSDCOMP=y
CONFIG_PPP_DEFLATE=y
CONFIG_PPP_FILTER=y
CONFIG_PPP_MPPE=y
CONFIG_PPP_MULTILINK=y
CONFIG_PPPOE=y
CONFIG_PPTP=y
CONFIG_PPPOL2TP=y
CONFIG_PPP_ASYNC=y
CONFIG_PPP_SYNC_TTY=y
CONFIG_USB_RTL8152=y
CONFIG_WCNSS_MEM_PRE_ALLOC=y
CONFIG_CLD_LL_CORE=y
CONFIG_CNSS_GENL=y
CONFIG_INPUT_EVDEV=y
CONFIG_KEYBOARD_GPIO=y
# CONFIG_INPUT_MOUSE is not set
CONFIG_INPUT_JOYSTICK=y
CONFIG_JOYSTICK_XPAD=y
CONFIG_JOYSTICK_XPAD_FF=y
CONFIG_JOYSTICK_XPAD_LEDS=y
CONFIG_INPUT_TABLET=y
CONFIG_TABLET_USB_ACECAD=y
CONFIG_TABLET_USB_AIPTEK=y
CONFIG_TABLET_USB_GTCO=y
CONFIG_TABLET_USB_HANWANG=y
CONFIG_TABLET_USB_KBTAB=y
CONFIG_INPUT_TOUCHSCREEN=y
CONFIG_SECURE_TOUCH_SYNAPTICS_DSX=y
CONFIG_INPUT_MISC=y
CONFIG_INPUT_QPNP_POWER_ON=y
CONFIG_INPUT_UINPUT=y
# CONFIG_SERIO_SERPORT is not set
# CONFIG_VT is not set
# CONFIG_LEGACY_PTYS is not set
# CONFIG_DEVMEM is not set
CONFIG_SERIAL_MSM_GENI=y
CONFIG_SERIAL_MSM_GENI_HALF_SAMPLING=y
CONFIG_TTY_PRINTK=y
CONFIG_HW_RANDOM=y
CONFIG_HW_RANDOM_MSM_LEGACY=y
# CONFIG_DEVPORT is not set
CONFIG_DIAG_CHAR=y
CONFIG_MSM_FASTCVPD=y
CONFIG_MSM_ADSPRPC=y
CONFIG_MSM_RDBG=m
CONFIG_I2C_CHARDEV=y
CONFIG_I2C_QCOM_GENI=y
CONFIG_SPI=y
CONFIG_SPI_QCOM_GENI=y
CONFIG_SPI_SPIDEV=y
CONFIG_SPMI=y
CONFIG_PINCTRL_QCOM_SPMI_PMIC=y
CONFIG_PINCTRL_LITO=y
CONFIG_GPIO_SYSFS=y
CONFIG_POWER_RESET_QCOM=y
CONFIG_POWER_RESET_XGENE=y
CONFIG_POWER_RESET_SYSCON=y
# CONFIG_QPNP_SMB5 is not set
# CONFIG_SMB1390_CHARGE_PUMP_PSY is not set
# CONFIG_SMB1355_SLAVE_CHARGER is not set
# CONFIG_QPNP_QG is not set
# CONFIG_SMB1398_CHARGER is not set
CONFIG_THERMAL=y
CONFIG_THERMAL_STATISTICS=y
CONFIG_THERMAL_WRITABLE_TRIPS=y
CONFIG_THERMAL_GOV_USER_SPACE=y
CONFIG_THERMAL_GOV_LOW_LIMITS=y
CONFIG_CPU_THERMAL=y
CONFIG_DEVFREQ_THERMAL=y
CONFIG_QCOM_SPMI_TEMP_ALARM=y
CONFIG_THERMAL_TSENS=y
CONFIG_QTI_ADC_TM=y
CONFIG_QTI_VIRTUAL_SENSOR=y
CONFIG_QTI_QMI_SENSOR=y
CONFIG_QTI_BCL_PMIC5=y
CONFIG_QTI_BCL_SOC_DRIVER=y
CONFIG_QTI_QMI_COOLING_DEVICE=y
CONFIG_QTI_THERMAL_LIMITS_DCVS=y
CONFIG_QTI_AOP_REG_COOLING_DEVICE=y
CONFIG_QTI_CPU_ISOLATE_COOLING_DEVICE=y
CONFIG_QTI_LMH_CPU_VDD_COOLING_DEVICE=y
CONFIG_QTI_LIMITS_ISENSE_CDSP=y
CONFIG_QTI_CX_IPEAK_COOLING_DEVICE=y
CONFIG_MFD_I2C_PMIC=y
CONFIG_MFD_SPMI_PMIC=y
CONFIG_REGULATOR=y
CONFIG_REGULATOR_FIXED_VOLTAGE=y
CONFIG_REGULATOR_PROXY_CONSUMER=y
CONFIG_REGULATOR_QCOM_RPMH=y
CONFIG_REGULATOR_QCOM_SPMI=y
CONFIG_REGULATOR_QPNP_AMOLED=y
CONFIG_REGULATOR_QPNP_LCDB=y
CONFIG_REGULATOR_REFGEN=y
CONFIG_REGULATOR_RPMH=y
CONFIG_REGULATOR_STUB=y
CONFIG_REGULATOR_PM8008=y
CONFIG_MEDIA_SUPPORT=y
CONFIG_MEDIA_CAMERA_SUPPORT=y
CONFIG_MEDIA_DIGITAL_TV_SUPPORT=y
CONFIG_MEDIA_CONTROLLER=y
CONFIG_VIDEO_V4L2_SUBDEV_API=y
CONFIG_VIDEO_ADV_DEBUG=y
CONFIG_VIDEO_FIXED_MINOR_RANGES=y
CONFIG_V4L_PLATFORM_DRIVERS=y
CONFIG_SPECTRA_CAMERA=y
CONFIG_MSM_NPU=y
CONFIG_DVB_MPQ=m
CONFIG_DVB_MPQ_DEMUX=m
CONFIG_DVB_MPQ_SW=y
CONFIG_VIDEO_V4L2_VIDEOBUF2_CORE=y
CONFIG_DRM=y
# CONFIG_DRM_MSM is not set
CONFIG_FB_VIRTUAL=y
CONFIG_BACKLIGHT_LCD_SUPPORT=y
CONFIG_BACKLIGHT_CLASS_DEVICE=y
CONFIG_BACKLIGHT_QCOM_SPMI_WLED=y
CONFIG_LOGO=y

CONFIG_DISPLAY_SAMSUNG=y
CONFIG_LCD_CLASS_DEVICE=y

# CONFIG_LOGO_LINUX_MONO is not set
# CONFIG_LOGO_LINUX_VGA16 is not set
CONFIG_SOUND=y
CONFIG_SND=y
CONFIG_SND_DYNAMIC_MINORS=y
CONFIG_SND_USB_AUDIO=y
CONFIG_SND_USB_AUDIO_QMI=y
CONFIG_SND_SOC=y
CONFIG_UHID=y
CONFIG_HID_APPLE=y
CONFIG_HID_ELECOM=y
CONFIG_HID_MAGICMOUSE=y
CONFIG_HID_MICROSOFT=y
CONFIG_HID_MULTITOUCH=y
CONFIG_HID_NINTENDO=y
CONFIG_HID_PLANTRONICS=y
CONFIG_HID_SAMSUNG=y
CONFIG_HID_SONY=y
CONFIG_USB_HIDDEV=y
CONFIG_USB_ANNOUNCE_NEW_DEVICES=y
CONFIG_USB_XHCI_HCD=y
CONFIG_USB_EHCI_HCD=y
CONFIG_USB_EHCI_HCD_PLATFORM=y
CONFIG_USB_OHCI_HCD=y
CONFIG_USB_OHCI_HCD_PLATFORM=y
CONFIG_USB_STORAGE=y
CONFIG_USB_DWC3=y
CONFIG_USB_DWC3_MSM=y
CONFIG_USB_ISP1760=y
CONFIG_USB_ISP1760_HOST_ROLE=y
CONFIG_USB_EHSET_TEST_FIXTURE=y
CONFIG_USB_LINK_LAYER_TEST=y
CONFIG_NOP_USB_XCEIV=y
CONFIG_USB_MSM_SSPHY_QMP=y
CONFIG_MSM_QUSB_PHY=y
CONFIG_MSM_HSUSB_PHY=y
CONFIG_USB_QCOM_EMU_PHY=y
CONFIG_USB_GADGET=y
CONFIG_USB_GADGET_VBUS_DRAW=900
CONFIG_USB_CONFIGFS=y
CONFIG_USB_CONFIGFS_UEVENT=y
CONFIG_USB_CONFIGFS_NCM=y
CONFIG_USB_CONFIGFS_MASS_STORAGE=y
CONFIG_USB_CONFIGFS_F_FS=y
CONFIG_USB_CONFIGFS_F_ACC=y
CONFIG_USB_CONFIGFS_F_AUDIO_SRC=y
CONFIG_USB_CONFIGFS_F_MIDI=y
CONFIG_USB_CONFIGFS_F_HID=y
CONFIG_USB_CONFIGFS_F_DIAG=y
CONFIG_USB_CONFIGFS_F_CDEV=y
CONFIG_USB_CONFIGFS_F_CCID=y
CONFIG_USB_CONFIGFS_F_QDSS=y
CONFIG_USB_CONFIGFS_F_GSI=y
CONFIG_USB_CONFIGFS_F_MTP=y
CONFIG_USB_CONFIGFS_F_PTP=y
CONFIG_USB_CHARGING_EVENT=y
CONFIG_USB_DUN_SUPPORT=y
CONFIG_USB_CONFIGFS_ACM=y
CONFIG_USB_CONFIGFS_F_CONN_GADGET=y
CONFIG_TYPEC=y
CONFIG_USB_PD_POLICY=y
CONFIG_QPNP_USB_PDPHY=y
CONFIG_MMC=y
CONFIG_MMC_BLOCK_MINORS=32
CONFIG_MMC_BLOCK_DEFERRED_RESUME=y
CONFIG_MMC_TEST=y
CONFIG_MMC_SDHCI=y
CONFIG_MMC_SDHCI_PLTFM=y
CONFIG_MMC_SDHCI_MSM=y
CONFIG_MMC_CQHCI_CRYPTO=y
CONFIG_MMC_CQHCI_CRYPTO_QTI=y
CONFIG_NEW_LEDS=y
CONFIG_LEDS_CLASS=y
CONFIG_LEDS_QTI_TRI_LED=y
CONFIG_LEDS_QPNP_FLASH_V2=y
CONFIG_LEDS_QPNP_VIBRATOR_LDO=y
CONFIG_LEDS_TRIGGER_TIMER=y
CONFIG_RTC_CLASS=y
CONFIG_RTC_DRV_PM8XXX=y
CONFIG_DMADEVICES=y
CONFIG_QCOM_GPI_DMA=y
CONFIG_UIO=y
CONFIG_UIO_MSM_SHAREDMEM=y
CONFIG_STAGING=y
CONFIG_ASHMEM=y
CONFIG_ION=y
CONFIG_ION_POOL_AUTO_REFILL=y
CONFIG_QPNP_REVID=y
CONFIG_SPS=y
CONFIG_SPS_SUPPORT_NDP_BAM=y
CONFIG_GSI_REGISTER_VERSION_2=y
CONFIG_IPA3=y
CONFIG_IPA_WDI_UNIFIED_API=y
CONFIG_RMNET_IPA3=y
CONFIG_RNDIS_IPA=y
CONFIG_IPA_UT=y
CONFIG_QCOM_GENI_SE=y
# CONFIG_QCOM_A53PLL is not set
CONFIG_QCOM_CLK_RPMH=y
CONFIG_SPMI_PMIC_CLKDIV=y
CONFIG_MSM_CLK_AOP_QMP=y
CONFIG_SM_GCC_LITO=y
CONFIG_SM_VIDEOCC_LITO=y
CONFIG_SM_CAMCC_LITO=y
CONFIG_SM_DISPCC_LITO=y
CONFIG_SM_GPUCC_LITO=y
CONFIG_SM_NPUCC_LITO=y
CONFIG_SM_DEBUGCC_LITO=y
# CONFIG_SDM_CAMCC_LAGOON is not set
# CONFIG_SDM_DEBUGCC_LAGOON is not set
# CONFIG_SDM_DISPCC_LAGOON is not set
# CONFIG_SDM_GPUCC_LAGOON is not set
# CONFIG_SDM_NPUCC_LAGOON is not set
# CONFIG_SDM_VIDEOCC_LAGOON is not set
CONFIG_HWSPINLOCK=y
CONFIG_HWSPINLOCK_QCOM=y
CONFIG_MAILBOX=y
CONFIG_MSM_QMP=y
CONFIG_IOMMU_IO_PGTABLE_FAST=y
CONFIG_ARM_SMMU=y
CONFIG_QCOM_LAZY_MAPPING=y
CONFIG_IOMMU_DEBUG=y
CONFIG_IOMMU_TESTS=y
CONFIG_RPMSG_CHAR=y
CONFIG_RPMSG_QCOM_GLINK_SMEM=y
CONFIG_RPMSG_QCOM_GLINK_SPSS=y
CONFIG_QCOM_COMMAND_DB=y
CONFIG_QCOM_CPUSS_DUMP=y
CONFIG_QCOM_RUN_QUEUE_STATS=y
CONFIG_QCOM_IPCC=y
CONFIG_QCOM_LLCC=y
CONFIG_QCOM_LITO_LLCC=y
# CONFIG_QCOM_LAGOON_LLCC is not set
CONFIG_QCOM_LLCC_PERFMON=m
CONFIG_QCOM_MDT_LOADER=y
CONFIG_QCOM_QMI_HELPERS=y
CONFIG_QCOM_QMI_RMNET=y
CONFIG_QCOM_QMI_DFC=y
CONFIG_QCOM_QMI_POWER_COLLAPSE=y
CONFIG_QCOM_RPMH=y
CONFIG_QCOM_SMEM=y
CONFIG_QCOM_EARLY_RANDOM=y
CONFIG_QCOM_MEMORY_DUMP_V2=y
CONFIG_QCOM_SMP2P=y
CONFIG_SETUP_SSR_NOTIF_TIMEOUTS=y
CONFIG_SSR_SYSMON_NOTIF_TIMEOUT=20000
CONFIG_SSR_SUBSYS_NOTIF_TIMEOUT=20000
CONFIG_PANIC_ON_SSR_NOTIF_TIMEOUT=y
CONFIG_QCOM_SECURE_BUFFER=y
CONFIG_MSM_SERVICE_LOCATOR=y
CONFIG_MSM_SERVICE_NOTIFIER=y
CONFIG_MSM_SUBSYSTEM_RESTART=y
CONFIG_MSM_PIL=y
CONFIG_MSM_SYSMON_QMI_COMM=y
CONFIG_MSM_PIL_SSR_GENERIC=y
CONFIG_MSM_BOOT_STATS=y
CONFIG_QCOM_DCC_V2=y
CONFIG_QCOM_EUD=y
#CONFIG_QCOM_MINIDUMP is not set
CONFIG_QCOM_FSA4480_I2C=y
CONFIG_QCOM_WATCHDOG_V2=y
CONFIG_QCOM_FORCE_WDOG_BITE_ON_PANIC=y
CONFIG_QCOM_BUS_SCALING=y
CONFIG_QCOM_BUS_CONFIG_RPMH=y
CONFIG_QCOM_GLINK=y
CONFIG_QCOM_GLINK_PKT=y
CONFIG_QCOM_SMP2P_SLEEPSTATE=y
CONFIG_MSM_CDSP_LOADER=y
CONFIG_QCOM_SMCINVOKE=y
CONFIG_MSM_EVENT_TIMER=y
CONFIG_MSM_PM=y
CONFIG_QTI_RPM_STATS_LOG=y
CONFIG_QTI_DDR_STATS_LOG=y
CONFIG_QTEE_SHM_BRIDGE=y
CONFIG_MEM_SHARE_QMI_SERVICE=y
CONFIG_MSM_PERFORMANCE=y
CONFIG_QMP_DEBUGFS_CLIENT=y
CONFIG_QCOM_CDSP_RM=y
CONFIG_QCOM_QHEE_ENABLE_MEM_PROTECTION=y
CONFIG_QTI_CRYPTO_COMMON=y
CONFIG_QTI_CRYPTO_TZ=y
CONFIG_ICNSS=y
CONFIG_ICNSS_QMI=y
CONFIG_DEVFREQ_GOV_PASSIVE=y
CONFIG_QCOM_BIMC_BWMON=y
CONFIG_ARM_MEMLAT_MON=y
CONFIG_DEVFREQ_GOV_QCOM_BW_HWMON=y
CONFIG_DEVFREQ_GOV_MEMLAT=y
CONFIG_DEVFREQ_GOV_CDSPL3=y
CONFIG_ARM_QCOM_DEVFREQ_FW=y
CONFIG_DEVFREQ_SIMPLE_DEV=y
CONFIG_QCOM_DEVFREQ_DEVBW=y
CONFIG_IIO=y
CONFIG_QCOM_SPMI_ADC5=y
CONFIG_PWM=y
CONFIG_PWM_QTI_LPG=y
CONFIG_ARM_GIC_V3_ACL=y
CONFIG_QCOM_PDC=y
CONFIG_PHY_XGENE=y
CONFIG_QCOM_LLCC_PMU=y
CONFIG_RAS=y
CONFIG_ANDROID=y
CONFIG_ANDROID_BINDER_IPC=y
# CONFIG_NVMEM_SYSFS is not set
CONFIG_QCOM_QFPROM=y
CONFIG_NVMEM_SPMI_SDAM=y
CONFIG_SLIMBUS_MSM_NGD=y
CONFIG_QCOM_KGSL=y
CONFIG_EXT4_FS=y
CONFIG_EXT4_FS_SECURITY=y
CONFIG_F2FS_FS=y
CONFIG_F2FS_FS_SECURITY=y
CONFIG_FS_ENCRYPTION=y
CONFIG_FS_ENCRYPTION_INLINE_CRYPT=y
CONFIG_QUOTA=y
CONFIG_QUOTA_NETLINK_INTERFACE=y
CONFIG_QFMT_V2=y
CONFIG_FUSE_FS=y
CONFIG_OVERLAY_FS=y
CONFIG_MSDOS_FS=y
CONFIG_VFAT_FS=y
CONFIG_TMPFS=y
CONFIG_TMPFS_POSIX_ACL=y
CONFIG_ECRYPT_FS_MESSAGING=y
CONFIG_SDCARD_FS=y
# CONFIG_NETWORK_FILESYSTEMS is not set
CONFIG_NLS_CODEPAGE_437=y
CONFIG_NLS_ISO8859_1=y
CONFIG_SECURITY_PERF_EVENTS_RESTRICT=y
CONFIG_SECURITY=y
CONFIG_HARDENED_USERCOPY=y
CONFIG_HARDENED_USERCOPY_PAGESPAN=y
CONFIG_FORTIFY_SOURCE=y
CONFIG_SECURITY_SMACK=y
CONFIG_CRYPTO_GCM=y
CONFIG_CRYPTO_XCBC=y
CONFIG_CRYPTO_MD4=y
CONFIG_CRYPTO_TWOFISH=y
CONFIG_CRYPTO_ANSI_CPRNG=y
CONFIG_CRYPTO_DEV_QCOM_MSM_QCE=y
CONFIG_CRYPTO_DEV_QCRYPTO=y
CONFIG_CRYPTO_DEV_QCEDEV=y
CONFIG_STACK_HASH_ORDER_SHIFT=12
CONFIG_CRYPTO_NULL=y
CONFIG_PRINTK_TIME=y
CONFIG_DEBUG_INFO=y
CONFIG_PAGE_OWNER=y
# CONFIG_SECTION_MISMATCH_WARN_ONLY is not set
CONFIG_MAGIC_SYSRQ=y
CONFIG_PANIC_TIMEOUT=-1
CONFIG_SCHEDSTATS=y
# CONFIG_DEBUG_PREEMPT is not set
CONFIG_IPC_LOGGING=y
CONFIG_DEBUG_ALIGN_RODATA=y
CONFIG_ARM64_STRICT_BREAK_BEFORE_MAKE=y
CONFIG_CORESIGHT=y
CONFIG_CORESIGHT_LINK_AND_SINK_TMC=y
CONFIG_CORESIGHT_DYNAMIC_REPLICATOR=y
CONFIG_CORESIGHT_STM=y
CONFIG_CORESIGHT_CTI=y
CONFIG_CORESIGHT_TPDA=y
CONFIG_CORESIGHT_TPDM=y
CONFIG_CORESIGHT_HWEVENT=y
CONFIG_CORESIGHT_DUMMY=y
CONFIG_CORESIGHT_REMOTE_ETM=y
CONFIG_CORESIGHT_TGU=y

# Camera
CONFIG_SAMSUNG_REAR_TRIPLE=y
#CONFIG_SAMSUNG_REAR_QUAD=y

#
## Samsung Debugging Feature
##
CONFIG_SEC_DEBUG=y
CONFIG_SEC_LOG_BUF=y
CONFIG_SEC_LOG_BUF_NO_CONSOLE=y
# CONFIG_SEC_LOG_BUF_CONSOLE is not set
CONFIG_SEC_LOG_LAST_KMSG=y
CONFIG_SEC_LOG_STORE_LAST_KMSG=y
CONFIG_SEC_DEBUG_SCHED_LOG=y
# CONFIG_SEC_DEBUG_MSG_LOG is not set
# CONFIG_SEC_DEBUG_DCVS_LOG is not set
# CONFIG_SEC_DEBUG_POWER_LOG is not set
# CONFIG_SEC_DEBUG_FUELGAUGE_LOG is not set
CONFIG_SEC_DEBUG_SUMMARY=y
# CONFIG_SEC_DEBUG_LOW_LOG is not set
CONFIG_SEC_USER_RESET_DEBUG=y
CONFIG_SEC_PERIPHERAL_SECURE_CHK=y
CONFIG_SEC_SSR_DEBUG_LEVEL_CHK=y
# CONFIG_SEC_DEBUG_PWDT is not set
CONFIG_SEC_DEBUG_DUMP_TASK_STACK=y
CONFIG_SEC_DEBUG_MDM_FILE_INFO=y
# CONFIG_SEC_DEBUG_DOUBLE_FREE is not set
# CONFIG_SEC_FILE_LEAK_DEBUG is not set
CONFIG_KERNEL_MODE_NEON_DEBUG=y
CONFIG_SEC_SLUB_DEBUG=y
CONFIG_SEC_BOOTSTAT=y
CONFIG_ARGOS=y
CONFIG_SEC_MISC=y
CONFIG_SEC_SMEM=y
CONFIG_VBUS_NOTIFIER_MODULE=y
CONFIG_SEC_DEBUG_APPS_CLK_LOGGING=y
CONFIG_SEC_DEBUG_FPUT_WATCHDOG=y
CONFIG_PANIC_ON_OOPS=y

CONFIG_WATCHDOG=y
CONFIG_WATCHDOG_CORE=y
CONFIG_SOFT_WATCHDOG=y

CONFIG_QCOM_RTB=y
CONFIG_QCOM_RTB_SEPARATE_CPUS=y

CONFIG_DPM_WATCHDOG=y
CONFIG_DPM_WATCHDOG_TIMEOUT=5

CONFIG_EDAC=y
CONFIG_EDAC_KRYO_ARM64=y
CONFIG_EDAC_KRYO_ARM64_PANIC_ON_UE=y
CONFIG_EDAC_QCOM=y
CONFIG_EDAC_QCOM_LLCC_PANIC_ON_UE=y

CONFIG_DRV_SAMSUNG=y
CONFIG_SEC_PARAM=y

CONFIG_PSTORE=y
CONFIG_PSTORE_CONSOLE=y
CONFIG_PSTORE_RAM=y
CONFIG_PSTORE_PMSG=y
CONFIG_PSTORE_PMSG_SSPLOG=y

CONFIG_I2C_GPIO=y

CONFIG_USB_G_ANDROID=y
CONFIG_USB_ANDROID_SAMSUNG_COMPOSITE=y

CONFIG_USB_STORAGE_DETECT=y
CONFIG_USB_HOST_NOTIFY=y
CONFIG_USB_NOTIFY_LAYER=y
CONFIG_USB_NOTIFIER=y
CONFIG_USB_EXTERNAL_NOTIFY=y
CONFIG_USB_NOTIFY_PROC_LOG=y
CONFIG_USB_DEBUG_DETAILED_LOG=y
CONFIG_USB_HW_PARAM=y
CONFIG_USB_HOST_SAMSUNG_FEATURE=y
CONFIG_USB_INTERFACE_LPM_LIST=y

# BATTERY
CONFIG_BATTERY_SAMSUNG_LEGO_STYLE=y

# [ SEC_SELINUX_PORTING_COMMON
CONFIG_EXT4_FS_XATTR=y
CONFIG_EXT4_FS_SECURITY=y
CONFIG_JOURNAL_DATA_TAG=y
CONFIG_AUDIT=y
CONFIG_LSM_MMAP_MIN_ADDR=4096
CONFIG_SECURITY_SELINUX=y
CONFIG_DEFAULT_SECURITY_SELINUX=y
CONFIG_NETFILTER_ADVANCED=y
CONFIG_AUDITSYSCALL=y
CONFIG_PROC_AVC=y
CONFIG_SDCARD_FS_XATTR=y
CONFIG_ECRYPT_FS_VIRTUAL_FAT_XATTR=y
CONFIG_FAT_VIRTUAL_XATTR=y
CONFIG_EXFAT_VIRTUAL_XATTR=y
# ] SEC_SELINUX_PORTING_COMMON

# Micro Hypervisor
CONFIG_UH=y
CONFIG_UH_RKP=y
CONFIG_RKP_TEST=y
CONFIG_KDP_CRED=y
CONFIG_KDP_DMAP=y
CONFIG_KDP_NS=y
CONFIG_KDP_TEST=y
CONFIG_UH_LKM_BLOCK=y

# Power Feature
CONFIG_SEC_PM=y
CONFIG_SEC_PM_DEBUG=y
CONFIG_CPU_FREQ_LIMIT=y
CONFIG_CPU_FREQ_LIMIT_USERSPACE=y

# Power On Alarm
CONFIG_RTC_AUTO_PWRON=y
CONFIG_RTC_AUTO_PWRON_PARAM=y

# TCP congestion algorithm
CONFIG_TCP_CONG_ADVANCED=y
CONFIG_TCP_CONG_BIC=y
CONFIG_DEFAULT_BIC=y
CONFIG_DEFAULT_TCP_CONG="bic"

# CP Dynamic reserved memmory
CONFIG_CP_DYNAMIC_MEM_RESERVE=y

# Hall ic
CONFIG_SENSORS_HALL=y
CONFIG_CERTIFY_HALL=y

# EPDG
CONFIG_NET_CORE=y
CONFIG_NET_CLS_BASIC=y
CONFIG_NET_CLS=y

# Switch
CONFIG_SWITCH=y
CONFIG_SWITCH_GPIO=y

# ODE and Sd Card Encryption
CONFIG_KEYS=y
# CONFIG_KEYS_DEBUG_PROC_KEYS is not set
CONFIG_CRYPTO=y
CONFIG_CRYPTO_AES=y
CONFIG_CRYPTO_CBC=y
CONFIG_CRYPTO_SHA1=y
CONFIG_CRYPTO_SHA256=y
# CONFIG_FS_CRYPTO_SEC_EXTENSION is not set
CONFIG_ECRYPT_FS=y
CONFIG_WTL_ENCRYPTION_FILTER=y
CONFIG_KEYS_DEBUG_PROC_KEYS=y
CONFIG_ECRYPTFS_FEK_INTEGRITY=y
# UFS Write Booster
CONFIG_BLK_IO_VOLUME=y
CONFIG_BLK_TURBO_WRITE=y

# SWAP
CONFIG_ZSMALLOC=y
CONFIG_PGTABLE_MAPPING=y
CONFIG_ZRAM=y
CONFIG_CRYPTO_LZ4=y
# QUEST
CONFIG_SEC_QUEST=y
CONFIG_SEC_QUEST_UEFI=y
CONFIG_SEC_QUEST_UEFI_ENHANCEMENT=y
CONFIG_SEC_QUEST_HLOS_DUMMY_SMD=y
# CONFIG_SEC_QUEST_CAL_HLOS_SUPPORT_FUSION is not set

# SDP
CONFIG_SDP=y
CONFIG_FSCRYPT_SDP=y

#FreeCess
CONFIG_SAMSUNG_FREECESS=y

# SYSTEM PARTITION UPDATE
CONFIG_SEC_SYSUP=y

# RMNET Built-in module
CONFIG_RMNET_SHS=y
CONFIG_RMNET_PERF=y

# FIPS
CONFIG_CRYPTO_FIPS=y
CONFIG_CRYPTO_KBKDF_CTR_HMAC_SHA512=y

# SPU SIGN VERIFY
CONFIG_SPU_VERIFY=y

# OLOG
CONFIG_KPERFMON=y

  # ADDED BY LEGO AUTOMATICALLY: DO NOT SUBMIT
CONFIG_ICD=y  # ADDED BY LEGO AUTOMATICALLY: DO NOT SUBMIT
CONFIG_PDIC_SLSI_NON_MCU=y  # ADDED BY LEGO AUTOMATICALLY: DO NOT SUBMIT
CONFIG_PDIC_PD30=y  # ADDED BY LEGO AUTOMATICALLY: DO NOT SUBMIT
CONFIG_PDIC_S2MU107=y  # ADDED BY LEGO AUTOMATICALLY: DO NOT SUBMIT
CONFIG_DEV_RIL_BRIDGE=y  # ADDED BY LEGO AUTOMATICALLY: DO NOT SUBMIT
CONFIG_SECURITY_DEFEX=y  # ADDED BY LEGO AUTOMATICALLY: DO NOT SUBMIT
CONFIG_PROCA=y  # ADDED BY LEGO AUTOMATICALLY: DO NOT SUBMIT
CONFIG_SENSORS=y  # ADDED BY LEGO AUTOMATICALLY: DO NOT SUBMIT
CONFIG_SENSORS_SSC=y  # ADDED BY LEGO AUTOMATICALLY: DO NOT SUBMIT
# CONFIG_SENSORS_HUB is not set  # ADDED BY LEGO AUTOMATICALLY: DO NOT SUBMIT
CONFIG_SEC_VIBRATOR=y  # ADDED BY LEGO AUTOMATICALLY: DO NOT SUBMIT
CONFIG_SEC_LABO=y  # ADDED BY LEGO AUTOMATICALLY: DO NOT SUBMIT
CONFIG_SEC_NFC_LOGGER=y  # ADDED BY LEGO AUTOMATICALLY: DO NOT SUBMIT
CONFIG_SECURITY_DSMS=y  # ADDED BY LEGO AUTOMATICALLY: DO NOT SUBMIT
CONFIG_SEC_STI=y  # ADDED BY LEGO AUTOMATICALLY: DO NOT SUBMIT
CONFIG_SEC_AUTO_INPUT=y  # ADDED BY LEGO AUTOMATICALLY: DO NOT SUBMIT
CONFIG_KUNIT_TEST=y  # ADDED BY LEGO AUTOMATICALLY: DO NOT SUBMIT
CONFIG_KUNIT_EXAMPLE_TEST=y  # ADDED BY LEGO AUTOMATICALLY: DO NOT SUBMIT
CONFIG_PLATFORM_MOCK=y  # ADDED BY LEGO AUTOMATICALLY: DO NOT SUBMIT
CONFIG_KUNIT_MANAGER=y  # ADDED BY LEGO AUTOMATICALLY: DO NOT SUBMIT
CONFIG_TZIC=y  # ADDED BY LEGO AUTOMATICALLY: DO NOT SUBMIT
# CONFIG_FIVE is not set  # ADDED BY LEGO AUTOMATICALLY: DO NOT SUBMIT
CONFIG_USE_MUIC=y  # ADDED BY LEGO AUTOMATICALLY: DO NOT SUBMIT
CONFIG_MUIC_NOTIFIER=y  # ADDED BY LEGO AUTOMATICALLY: DO NOT SUBMIT
CONFIG_VBUS_NOTIFIER=y  # ADDED BY LEGO AUTOMATICALLY: DO NOT SUBMIT
CONFIG_MUIC_CORE=y  # ADDED BY LEGO AUTOMATICALLY: DO NOT SUBMIT
CONFIG_MUIC_MANAGER=y  # ADDED BY LEGO AUTOMATICALLY: DO NOT SUBMIT
CONFIG_MUIC_SUPPORT_PDIC=y  # ADDED BY LEGO AUTOMATICALLY: DO NOT SUBMIT
CONFIG_MUIC_SUPPORT_PRSWAP=y  # ADDED BY LEGO AUTOMATICALLY: DO NOT SUBMIT
CONFIG_MUIC_SYSFS=y  # ADDED BY LEGO AUTOMATICALLY: DO NOT SUBMIT
CONFIG_MUIC_HV=y  # ADDED BY LEGO AUTOMATICALLY: DO NOT SUBMIT
CONFIG_HV_MUIC_VOLTAGE_CTRL=y  # ADDED BY LEGO AUTOMATICALLY: DO NOT SUBMIT
CONFIG_MUIC_SUPPORT_POWERMETER=y  # ADDED BY LEGO AUTOMATICALLY: DO NOT SUBMIT
CONFIG_SENSORS_FINGERPRINT=y  # ADDED BY LEGO AUTOMATICALLY: DO NOT SUBMIT
CONFIG_PDIC_S2MU106=y  # ADDED BY LEGO AUTOMATICALLY: DO NOT SUBMIT
CONFIG_USB_TYPEC_MANAGER_NOTIFIER=y  # ADDED BY LEGO AUTOMATICALLY: DO NOT SUBMIT
CONFIG_IF_CB_MANAGER=y  # ADDED BY LEGO AUTOMATICALLY: DO NOT SUBMIT
CONFIG_PDIC_NOTIFIER=y  # ADDED BY LEGO AUTOMATICALLY: DO NOT SUBMIT
CONFIG_SEC_ABC=y  # ADDED BY LEGO AUTOMATICALLY: DO NOT SUBMIT
CONFIG_SEC_ABC_HUB=y  # ADDED BY LEGO AUTOMATICALLY: DO NOT SUBMIT
CONFIG_SEC_ABC_HUB_BOOTC=y  # ADDED BY LEGO AUTOMATICALLY: DO NOT SUBMIT
CONFIG_SENSORS_ET7XX=y  # ADDED BY LEGO AUTOMATICALLY: DO NOT SUBMIT
CONFIG_FINGERPRINT_SECURE=y  # ADDED BY LEGO AUTOMATICALLY: DO NOT SUBMIT
CONFIG_I2C_GPIO=y  # ADDED BY LEGO AUTOMATICALLY: DO NOT SUBMIT
CONFIG_SEC_DETECT_CONN=y  # ADDED BY LEGO AUTOMATICALLY: DO NOT SUBMIT
CONFIG_PWM_GPCLK=y  # ADDED BY LEGO AUTOMATICALLY: DO NOT SUBMIT
CONFIG_ISA1000_VIBRATOR=y  # ADDED BY LEGO AUTOMATICALLY: DO NOT SUBMIT
CONFIG_CHARGER_PCA9468=y  # ADDED BY LEGO AUTOMATICALLY: DO NOT SUBMIT
CONFIG_SEND_PDMSG_IN_PPS_REQUEST_WORK=y  # ADDED BY LEGO AUTOMATICALLY: DO NOT SUBMIT
CONFIG_MST_LDO=y  # ADDED BY LEGO AUTOMATICALLY: DO NOT SUBMIT
CONFIG_MST_ARCH_QCOM=y  # ADDED BY LEGO AUTOMATICALLY: DO NOT SUBMIT
CONFIG_MST_LPM_DISABLE=y  # ADDED BY LEGO AUTOMATICALLY: DO NOT SUBMIT
CONFIG_MFD_S2MU106=y  # ADDED BY LEGO AUTOMATICALLY: DO NOT SUBMIT
CONFIG_REGULATOR_FIXED_VOLTAGE=y  # ADDED BY LEGO AUTOMATICALLY: DO NOT SUBMIT
CONFIG_VIBRATOR_S2MU106=y  # ADDED BY LEGO AUTOMATICALLY: DO NOT SUBMIT
CONFIG_VIBRATOR_S2MU106_VOLTAGE_3P3=y  # ADDED BY LEGO AUTOMATICALLY: DO NOT SUBMIT
CONFIG_SENSORS_SX9360=y  # ADDED BY LEGO AUTOMATICALLY: DO NOT SUBMIT
# CONFIG_SENSORS_SX9360_SUB is not set  # ADDED BY LEGO AUTOMATICALLY: DO NOT SUBMIT
CONFIG_REGULATOR_S2MPB03=y  # ADDED BY LEGO AUTOMATICALLY: DO NOT SUBMIT
CONFIG_MUIC_S2MU106=y  # ADDED BY LEGO AUTOMATICALLY: DO NOT SUBMIT
CONFIG_HV_MUIC_S2MU106_AFC=y  # ADDED BY LEGO AUTOMATICALLY: DO NOT SUBMIT
CONFIG_MUIC_S2MU106_RID=y  # ADDED BY LEGO AUTOMATICALLY: DO NOT SUBMIT
CONFIG_MFD_S2MU107=y  # ADDED BY LEGO AUTOMATICALLY: DO NOT SUBMIT
CONFIG_INPUT_HALL_IC=y  # ADDED BY LEGO AUTOMATICALLY: DO NOT SUBMIT
CONFIG_SENSORS_SEC_THERMISTOR=y  # ADDED BY LEGO AUTOMATICALLY: DO NOT SUBMIT
CONFIG_FUELGAUGE_S2MU106=y  # ADDED BY LEGO AUTOMATICALLY: DO NOT SUBMIT
CONFIG_FUELGAUGE_S2MU106_USE_5MILLIOHM=y  # ADDED BY LEGO AUTOMATICALLY: DO NOT SUBMIT
CONFIG_NFC_PN547=y  # ADDED BY LEGO AUTOMATICALLY: DO NOT SUBMIT
CONFIG_NFC_PN547_ESE_SUPPORT=y  # ADDED BY LEGO AUTOMATICALLY: DO NOT SUBMIT
CONFIG_ESE_SECURE=y  # ADDED BY LEGO AUTOMATICALLY: DO NOT SUBMIT
#CONFIG_ESE_USE_TZ_API is not set  # ADDED BY LEGO AUTOMATICALLY: DO NOT SUBMIT
CONFIG_PM_S2MU106=y  # ADDED BY LEGO AUTOMATICALLY: DO NOT SUBMIT
CONFIG_CHARGER_S2MU106=y  # ADDED BY LEGO AUTOMATICALLY: DO NOT SUBMIT
CONFIG_LSI_IFPMIC=y  # ADDED BY LEGO AUTOMATICALLY: DO NOT SUBMIT
CONFIG_MUIC_S2MU107=y  # ADDED BY LEGO AUTOMATICALLY: DO NOT SUBMIT
CONFIG_HV_MUIC_S2MU107_AFC=y  # ADDED BY LEGO AUTOMATICALLY: DO NOT SUBMIT
CONFIG_MUIC_S2MU107_RID=y  # ADDED BY LEGO AUTOMATICALLY: DO NOT SUBMIT
CONFIG_FUELGAUGE_S2MU107=y  # ADDED BY LEGO AUTOMATICALLY: DO NOT SUBMIT
CONFIG_FUELGAUGE_S2MU107_BATCAP_LRN=y  # ADDED BY LEGO AUTOMATICALLY: DO NOT SUBMIT
CONFIG_FUELGAUGE_S2MU107_TEMP_COMPEN=y  # ADDED BY LEGO AUTOMATICALLY: DO NOT SUBMIT
CONFIG_TOUCHSCREEN_SEC_TS_Y771=y  # ADDED BY LEGO AUTOMATICALLY: DO NOT SUBMIT
CONFIG_TOUCHSCREEN_SEC_TS_GLOVEMODE=y  # ADDED BY LEGO AUTOMATICALLY: DO NOT SUBMIT
CONFIG_PM_S2MU107=y  # ADDED BY LEGO AUTOMATICALLY: DO NOT SUBMIT
CONFIG_CHARGER_S2MU107=y  # ADDED BY LEGO AUTOMATICALLY: DO NOT SUBMIT
CONFIG_CHARGER_S2MU107_DIRECT=y  # ADDED BY LEGO AUTOMATICALLY: DO NOT SUBMIT
CONFIG_DIRECT_CHARGING=y  # ADDED BY LEGO AUTOMATICALLY: DO NOT SUBMIT
CONFIG_STEP_CHARGING=y  # ADDED BY LEGO AUTOMATICALLY: DO NOT SUBMIT
CONFIG_BATTERY_SAMSUNG=y  # ADDED BY LEGO AUTOMATICALLY: DO NOT SUBMIT
CONFIG_BATTERY_AGE_FORECAST=y  # ADDED BY LEGO AUTOMATICALLY: DO NOT SUBMIT
CONFIG_BATTERY_CISD=y  # ADDED BY LEGO AUTOMATICALLY: DO NOT SUBMIT
CONFIG_AFC_CHARGER_MODE=y  # ADDED BY LEGO AUTOMATICALLY: DO NOT SUBMIT
CONFIG_BATTERY_NOTIFIER=y  # ADDED BY LEGO AUTOMATICALLY: DO NOT SUBMIT


CONFIG_SAMSUNG_PRODUCT_SHIP=y


# CONFIG_SAMSUNG_USER_TRIAL is not set


# CONFIG_SEC_FACTORY is not set


# CONFIG_SEC_FACTORY_INTERPOSER is not set


# CONFIG_SEC_VTS_TEST is not set


# CONFIG_SEC_CP_SEPARATE_DEBUG is not set






CONFIG_F2FS_FS_ENCRYPTION=y


CONFIG_EXT4_FS_POSIX_ACL=y

CONFIG_FIVE=y
CONFIG_FIVE_SIGN_TA=y
CONFIG_FIVE_SIGNCLIENT_PATH="/home/dpi/qb5_8815/workspace/P4_1716/buildscript/tools/signclient.jar"
CONFIG_FIVE_PILSPLITTER_PATH="/home/dpi/qb5_8815/workspace/P4_1716/buildscript/tools/pil_splitter.py"




# CONFIG_FIVE_PA_FEATURE is not set


CONFIG_GAF_V6=y






# CONFIG_SEC_RESTRICT_ROOTING is not set
```
