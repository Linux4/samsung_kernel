## arch/arm64/mach/Kconfig
```kconfig
if ARCH_MMP

menu "Marvell PXA19x8 Implementations"

config MACH_PXA1908DKB
	bool "Marvell's PXA1908 DKB"
	help
	  Say 'Y' here if you want to support the Marvell PXA1908-based
	  DKB Board.

config MACH_PXA1936DKB
	bool "Marvell's PXA1936 DKB"
	help
	  Say 'Y' here if you want to support the Marvell PXA1936-based
	  DKB Board.

config MACH_J7MLTE
	bool "Samsung's PXA1936 J7 LTE Development Board"
	help
	  Say 'Y' here if you want to support the Samsung PXA1936-based
	  J7 LTE Development Board.

config MACH_XCOVER3LTE
	bool "Samsung's PXA1908 XCOVER3 LTE Development Board"
	help
	  Say 'Y' here if you want to support the Samsung PXA1908-based
	  XCOVER3LTE Development Board.

config MACH_COREPRIMEVELTE
    bool "Samsung's PXA1908 CORE PRIME VE LTE Development Board"
    help
      Say 'Y' here if you want to support the Samsung PXA1908-based
      CORE PRIME VE LTE Development Board.

config MACH_COREPRIMEVELTE_LTN
    bool "Samsung's PXA1908 CORE PRIME VE LTE LTN Development Board"
    depends on MACH_COREPRIMEVELTE
    default n
    help
      Say 'Y' here if you want to support the Samsung PXA1908-based
      CORE PRIME VE LTE LTN Development Board
      which has no nfc function.

config MACH_GRANDPRIMEVELTE
    bool "Samsung's PXA1908 GRAND PRIME VE LTE Development Board"
    help
      Say 'Y' here if you want to support the Samsung PXA1908-based
      GRAND PRIME VE LTE Development Board.

config MACH_GRANDPRIMEVELTE_LTN
    bool "Samsung's PXA1908 GRAND PRIME VE LTE LTN Development Board"
    depends on MACH_GRANDPRIMEVELTE
    default n
    help
      Say 'Y' here if you want to support the Samsung PXA1908-based
      GRAND PRIME VE LTE LTN Development Board
      which has no nfc function.

config MACH_J1ACELTE_LTN
    bool "Samsung's PXA1908 J1 ACE LTE LTN Development Board"
    help
      Say 'Y' here if you want to support the Samsung PXA1908-based
      J1 ACE LTE LTN Development Board.

config MACH_J7M3G
    bool "Samsung's PXA1936 J7 3G Development Board"
    help
      Say 'Y' here if you want to support the Samsung PXA1936-based
      J7 3G Development Board.

config SAMSUNG_PRODUCT_SHIP
    bool "set up for product shipping"
    default n

menuconfig SEC_TIMA
	bool "Samsung TIMA Feature"
	default n
	help
	  Samsung TIMA Feature.

if SEC_TIMA
config TIMA_LKMAUTH
    bool "Enable LKM authentication TIMA feature"
    default n
    help
      TIMA authenticates loaded kernel modules. Disable it if you don't
      want TIMA enabled.

config TIMA_PKM
    bool "Enable PKM virtual address store TIMA feature"
    default n
    help
      secure world cannot read physical address so storing virtual address

config TIMA_LKMAUTH_CODE_PROT
    bool
    depends on TIMA_LKMAUTH
    default y
    help
      When enabled, this feature will mark all Executable sections in an
      LKM as RO

config TIMA_UEVENT
    bool "Uevent message propagation for TIMA"
    default n
    help
      Uevent messages for TIMA PKM/LKM

config TIMA_LOG
    bool "Log dumping support for TIMA"
    default n
    help
      TIMA Log dumping support
endif

endmenu

endif
```

## arch/x86/configs/cuttlesec-sec_defconfig
```kconfig
#
# Please leave the first line blank
#

# SEC CONFIGS
CONFIG_SEC_REBOOT=m
CONFIG_SEC_KEY_NOTIFIER=m
CONFIG_SEC_PARAM=m
CONFIG_DRV_SAMSUNG=y
CONFIG_SEC_DEBUG_BASE=m

# USB Feature
CONFIG_GKI_USB=y

# Experimental Features
CONFIG_F2FS_FS_COMPRESSION=y

# not support jsqz driver
CONFIG_VIDEO_EXYNOS_JPEG_SQZ=n

# disable rbin patch in drivers/staging/android/ion/heaps/ion_rbin_heap.c
CONFIG_ION_RBIN_HEAP=n

# diable dmabuf_trace in drivers/dma-buf/dma-buf-trace.c
CONFIG_DMABUF_TRACE=n

# disable exy
CONFIG_VIDEO_EXYNOS_MC_FRC=n

#
# please don't remove new line on this file
#
```

## common/drivers/cpuhotplug/Kconfig
```kconfig
config SPRD_CPU_DYNAMIC_HOTPLUG
        bool "SPRD CPU hotplug policy"
        help
          SPRD CPU dynamical hotplug policy.

config NO_HOTPLUG_POLICY
        bool "NO automatic CPU hotplug policy"
        help
          PM hotplug policy
          Do not select an automatic hotplug policy
```

## common/drivers/input/touchscreen/melfas_mip4/Kconfig
```kconfig
#
# Kconfig for MELFAS MIP4 (MCS6000) Touchscreen Driver
#

if INPUT_TOUCHSCREEN

config TOUCHSCREEN_MELFAS_MCS6000
        tristate "MELFAS MCS6000 Touchscreen"
        depends on I2C
        help
          Say Y here if you have a MELFAS MCS6000 touchscreen device in your system.

          If unsure, say N.

          To compile this driver as a module, choose M here: the module will be called mip4_ts.

endif
```

## common/drivers/input/touchscreen/mms438/Kconfig
```kconfig
#
# Kconfig for MELFAS MIP4 Touchscreen Driver
#

if INPUT_TOUCHSCREEN

config TOUCHSCREEN_MELFAS_MMS438
        tristate "MELFAS MMS438 Touchscreen"
        depends on I2C
        help
          Say Y here if you have a MELFAS MMS438 touchscreen device in your system.

          If unsure, say N.

          To compile this driver as a module, choose M here: the module will be called mip4_ts.

config TOUCHSCREEN_MELFAS_MMS449
        tristate "MELFAS MMS449 Touchscreen"
        depends on I2C
        help
          Say Y here if you have a MELFAS MMS449 touchscreen device in your system.

          If unsure, say N.

          To compile this driver as a module, choose M here: the module will be called mip4_ts.

config TOUCHSCREEN_MELFAS_MMS458
        tristate "MELFAS MMS458 Touchscreen"
        depends on I2C
        help
          Say Y here if you have a MELFAS MMS458 touchscreen device in your system.

          If unsure, say N.

          To compile this driver as a module, choose M here: the module will be called mip4_ts.

config TOUCHSCREEN_MELFAS_MIT300
        tristate "MELFAS MIT300 Touchscreen"
        depends on I2C
        help
          Say Y here if you have a MELFAS MIT300 touchscreen device in your system.

          If unsure, say N.

          To compile this driver as a module, choose M here: the module will be called mip4_ts.

endif
```

## common/drivers/misc/bootperf/Kconfig
```kconfig
config BOOT_PERF
    bool "enable boot time reord and read"
    default n
    help
    enable boot time reord and read
```

## common/drivers/misc/gpsip/Kconfig
```kconfig
config CGX
	bool "Sprd gps"
	depends on SPRD_2351
	help
	  GPS can locate you position

config CGX_DRIVER
	tristate "Sprd gps driver"
	depends on CGX
	help
	  GPS can locate you position

config CGX_VIRTUALCOM
	tristate "Sprd gps virtual com"
	depends on CGX
	help
	  GPS can locate you position
```
