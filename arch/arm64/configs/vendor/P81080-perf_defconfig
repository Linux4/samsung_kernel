## arch/arm64/configs/vendor/a51xq/lito_sec_a51xq_jpn_kdi_defconfig
```kconfig
# lito_sec_a51xq_jpn_kdi_defconfig

CONFIG_SEC_A51XQ_PROJECT=y
CONFIG_MACH_A51XQ_JPN_KDI=y

#DISPLAY
CONFIG_PANEL_EA8076A_AMS646UJ10_FHD=y

# TSP
CONFIG_INPUT_TOUCHSCREEN_TCLMV2=y
CONFIG_TOUCHSCREEN_DUMP_MODE=y
CONFIG_SEC_DEBUG_TSP_LOG=y
CONFIG_INPUT_SEC_SECURE_TOUCH=y

# CAMERA
CONFIG_SAMSUNG_REAR_TRIPLE=y
CONFIG_SAMSUNG_MULTI_CAMERA=y
CONFIG_CAMERA_SYSFS_V2=y
CONFIG_SAMSUNG_REAR_QUAD=y
CONFIG_MCLK_I2C_DELAY=y
CONFIG_SAMSUNG_HW_SOFTLANDING=y
CONFIG_GC5035_MACRO_OTP_DD_AUTOLOAD=y

# USB
CONFIG_ENABLE_USB_SUSPEND_STATE=y

# MST
CONFIG_MST_LDO=y
CONFIG_MST_LPM_DISABLE=y
#CONFIG_MST_LPM_CONTROL=y

# WLAN
CONFIG_QCA_CLD_WLAN=y

#AUDIO
CONFIG_SND_SOC_SAMSUNG_AUDIO=y
CONFIG_SND_SOC_SAMSUNG_MBHC_SUPPORT=y
CONFIG_SND_SOC_SAMSUNG_JACK=y

#MOTOR
CONFIG_SS_VIBRATOR=y

#SENSOR
CONFIG_SENSORS=y
CONFIG_SENSORS_SSC=y
CONFIG_ADSP_FACTORY=y
CONFIG_ICM42605_FACTORY=y
CONFIG_STK33617_FACTORY=y
CONFIG_MMC5603X_FACTORY=y
CONFIG_SUPPORT_SSC_MODE=y
CONFIG_SUPPORT_SSC_MODE_FOR_MAG=y

# Grip sensor
#CONFIG_SENSORS_SX9360=y
```

## arch/arm64/configs/vendor/a52q/atoll_sec_a52q_ltn_open_defconfig
```kconfig
# sm7125_sec_a52q_ltn_open_defconfig

CONFIG_SEC_A52Q_PROJECT=y
CONFIG_SEC_A52Q_LTN_OPEN=y

#Camera
CONFIG_SAMSUNG_REAR_TRIPLE=y
CONFIG_SAMSUNG_MULTI_CAMERA=y
CONFIG_SAMSUNG_REAR_TRIPLE=y
CONFIG_CAMERA_SYSFS_V2=y
CONFIG_USE_CAMERA_HW_BIG_DATA=y
CONFIG_SAMSUNG_REAR_QUAD=y
CONFIG_LEDS_SM5714=y
CONFIG_MCLK_I2C_DELAY=y
CONFIG_SAMSUNG_OIS_MCU_STM32=y
CONFIG_SAMSUNG_CAMERA_OTP=y
CONFIG_GC5035_SENSOR=y
CONFIG_CAMERA_ADAPTIVE_MIPI=y
CONFIG_S5K3L6_SENSOR=y
CONFIG_HI1336_SENSOR=y
CONFIG_S5KGW1P_SENSOR=y
CONFIG_SAMSUNG_CAMERA_OTP_UW=y
CONFIG_SAMSUNG_CAMERA_OTP_MACRO=y
CONFIG_GC5035_MACRO_OTP_DD_AUTOLOAD=y

#Display
CONFIG_PANEL_S6E3FC3_AMS646YD04_FHD=y

#SystemInput
CONFIG_TOUCHSCREEN_ZINITIX_ZT7650=y
CONFIG_TOUCHSCREEN_STM_FTS5CU56A=y
CONFIG_INPUT_TOUCHSCREEN_TCLMV2=y
CONFIG_INPUT_SEC_SECURE_TOUCH=y

# NFC ESE
CONFIG_SEC_NFC_V2=y
# CONFIG_ESE_P3_V2_LSI is not set
# CONFIG_ESE_SECURE is not set
# CONFIG_ESE_SPI_GPIO_START is not set
# CONFIG_ESE_SPI_GPIO_END is not set
# CONFIG_ESE_SPI_NUMBER is not set
CONFIG_SEC_NFC_LOGGER=y

# PDIC
CONFIG_USB_TYPEC_MANAGER_NOTIFIER=y
CONFIG_IF_CB_MANAGER=y
CONFIG_PDIC_NOTIFIER=y
CONFIG_PDIC_SM5714=y
CONFIG_SM5714_FACTORY_MODE=y
CONFIG_VBUS_NOTIFIER=y
CONFIG_USE_PDIC_LEGO=y

CONFIG_SM5714_WATER_DETECTION_ENABLE=y
CONFIG_SM5714_SUPPORT_SBU=y

#AUDIO
CONFIG_SND_SOC_SAMSUNG_AUDIO=y
CONFIG_SND_SOC_SAMSUNG_MBHC_SUPPORT=y
CONFIG_SND_SOC_SAMSUNG_JACK=y

#MFD
CONFIG_MFD_SM5714=y

#MUIC
CONFIG_USE_MUIC=y
CONFIG_USE_MUIC_LEGO=y
CONFIG_MUIC_NOTIFIER=y
CONFIG_MUIC_HV=y
CONFIG_MUIC_SUPPORT_PDIC=y
CONFIG_MUIC_SM5714=y
CONFIG_MUIC_BCD_RESCAN=y
CONFIG_HICCUP_CHARGER=y


# BATTERY
CONFIG_FUELGAUGE_SM5714=y
CONFIG_CHARGER_SM5714=y
CONFIG_BATTERY_SAMSUNG=y
CONFIG_BATTERY_SAMSUNG_LEGO_STYLE=y
CONFIG_BATTERY_AGE_FORECAST=y
CONFIG_BATTERY_CISD=y
CONFIG_AFC_CHARGER_MODE=y
CONFIG_BATTERY_NOTIFIER=y
CONFIG_BATTERY_SWELLING=y
CONFIG_CALC_TIME_TO_FULL=y
CONFIG_STEP_CHARGING=y
CONFIG_DIRECT_CHARGING=y
CONFIG_CHARGER_PCA9468=y
CONFIG_PDIC_PD30=y
CONFIG_SUPPORT_HV_CTRL=y

# SENSOR
CONFIG_SENSORS=y
CONFIG_SENSORS_SSC=y
CONFIG_ADSP_FACTORY=y
CONFIG_LSM6DSO_FACTORY=y
CONFIG_AK09918_FACTORY=y
CONFIG_STK31610_FACTORY=y
CONFIG_NOT_SUPPORT_PROX_FACTORY=y
CONFIG_SLPI_MOTOR=y
CONFIG_FLIP_COVER_DETECTOR_FACTORY=y

#MOTOR
CONFIG_SS_VIBRATOR=y
CONFIG_LEDS_QPNP_VIBRATOR_LDO=y
CONFIG_MSM_VIBRATOR=y

#HALL
CONFIG_SENSORS_HALL=y
# CONFIG_CERTIFY_HALL is not set
CONFIG_SUPPORT_HALL_ABNORMAL_TEST=y

# Sub PMIC
CONFIG_REGULATOR_S2MPB03=y
# GRIP_SENSOR
CONFIG_SENSORS_SX9364=y

# QCA Wi-Fi feature
CONFIG_QCA_CLD_WLAN=y
CONFIG_ICNSS=y
CONFIG_ICNSS_QMI=y
CONFIG_WCNSS_MEM_PRE_ALLOC=y
CONFIG_CLD_LL_CORE=y
CONFIG_CNSS_GENL=y

# Fingerprint sensor
CONFIG_SENSORS_FINGERPRINT=y
CONFIG_SENSORS_GW9558X=y
CONFIG_SENSORS_FP_SPI_NUMBER=6
CONFIG_SENSORS_FP_SPI_GPIO_START=59
CONFIG_SENSORS_FP_SPI_GPIO_END=62

# KERNEL CORE MEMORY
CONFIG_PGTABLE_MAPPING=y
CONFIG_MMAP_READAROUND_LIMIT=8
CONFIG_FAULT_AROUND_4KB=y
CONFIG_ZRAM_WRITEBACK=y

#IMS
CONFIG_NET_CLS_BASIC=y
```

## arch/arm64/configs/vendor/a71xq/lito_sec_a71xq_usa_open_defconfig
```kconfig
# lito_sec_a71xq_usa_open_defconfig

CONFIG_SEC_A71XQ_PROJECT=y
CONFIG_MACH_A71XQ_USA_OPEN=y

#DISPLAY
CONFIG_PANEL_S6E3FA9_AMB667UM01_FHD=y

# BATTERY
# CONFIG_BATTERY_SAMSUNG_V2 is not set
CONFIG_BATTERY_SAMSUNG_LEGO_STYLE=y
CONFIG_CALC_TIME_TO_FULL=y
CONFIG_BATTERY_AGE_FORECAST=y
# CONFIG_ENABLE_100MA_CHARGING_BEFORE_USB_CONFIGURED is not set
CONFIG_BATTERY_CISD=y
CONFIG_STEP_CHARGING=y
CONFIG_DIRECT_CHARGING=y
CONFIG_PDIC_PD30=y
CONFIG_PM_S2MU107=y
CONFIG_CHARGER_S2MU107=y
CONFIG_CHARGER_S2MU107_DIRECT=y
CONFIG_FUELGAUGE_S2MU107=y
CONFIG_FUELGAUGE_S2MU107_BATCAP_LRN=y
CONFIG_FUELGAUGE_S2MU107_TEMP_COMPEN=y
CONFIG_TOUCHSCREEN_SEC_TS_Y771=y
CONFIG_INPUT_TOUCHSCREEN_TCLMV2=y
CONFIG_INPUT_SEC_SECURE_TOUCH=y

# USB
CONFIG_ENABLE_USB_SUSPEND_STATE=y

# CAMERA
CONFIG_SAMSUNG_REAR_TRIPLE=y
CONFIG_SAMSUNG_MULTI_CAMERA=y
CONFIG_SAMSUNG_REAR_TRIPLE=y
CONFIG_CAMERA_SYSFS_V2=y
CONFIG_SAMSUNG_REAR_QUAD=y
CONFIG_MCLK_I2C_DELAY=y
CONFIG_SAMSUNG_HW_SOFTLANDING=y
CONFIG_GC5035_MACRO_OTP_DD_AUTOLOAD=y

# WLAN
CONFIG_QCA_CLD_WLAN=y

#AUDIO
CONFIG_SND_SOC_SAMSUNG_AUDIO=y
CONFIG_SND_SOC_SAMSUNG_MBHC_SUPPORT=y
CONFIG_SND_SOC_SAMSUNG_JACK=y

#MOTOR
CONFIG_SS_VIBRATOR=y

#SENSOR
CONFIG_SENSORS=y
CONFIG_SENSORS_SSC=y
CONFIG_ADSP_FACTORY=y
CONFIG_ICM42605_FACTORY=y
CONFIG_STK33617_FACTORY=y
CONFIG_MMC5603X_FACTORY=y
CONFIG_SUPPORT_SSC_MODE=y
CONFIG_SUPPORT_SSC_MODE_FOR_MAG=y

# Grip sensor
CONFIG_SENSORS_SX9360=y
```

## arch/arm64/configs/vendor/a71xq/lito_sec_a71xq_usa_singlew_defconfig
```kconfig
# lito_sec_a71xq_usa_singlew_defconfig

CONFIG_SEC_A71XQ_PROJECT=y
CONFIG_MACH_A71XQ_USA_SINGLEW=y

#DISPLAY
CONFIG_PANEL_S6E3FA9_AMB667UM01_FHD=y

# USB
CONFIG_ENABLE_USB_SUSPEND_STATE=y

# TSP
CONFIG_INPUT_TOUCHSCREEN_TCLMV2=y
CONFIG_TOUCHSCREEN_DUMP_MODE=y
CONFIG_SEC_DEBUG_TSP_LOG=y
CONFIG_INPUT_SEC_SECURE_TOUCH=y

# CAMERA
CONFIG_SAMSUNG_REAR_TRIPLE=y
CONFIG_SAMSUNG_MULTI_CAMERA=y
CONFIG_SAMSUNG_REAR_TRIPLE=y
CONFIG_CAMERA_SYSFS_V2=y
CONFIG_SAMSUNG_REAR_QUAD=y
CONFIG_MCLK_I2C_DELAY=y
CONFIG_SAMSUNG_HW_SOFTLANDING=y
CONFIG_GC5035_MACRO_OTP_DD_AUTOLOAD=y

# WLAN
CONFIG_QCA_CLD_WLAN=y

#AUDIO
CONFIG_SND_SOC_SAMSUNG_AUDIO=y
CONFIG_SND_SOC_SAMSUNG_MBHC_SUPPORT=y
CONFIG_SND_SOC_SAMSUNG_JACK=y

#MOTOR
CONFIG_SS_VIBRATOR=y

#SENSOR
CONFIG_ADSP_FACTORY=y
CONFIG_ICM42605_FACTORY=y
CONFIG_STK33617_FACTORY=y
CONFIG_MMC5603X_FACTORY=y
CONFIG_SUPPORT_SSC_MODE=y
CONFIG_SUPPORT_SSC_MODE_FOR_MAG=y
```

## arch/arm64/configs/vendor/atoll_sec_userdebug_defconfig
```kconfig
# TODO: atoll_sec_userdebug_defconfig

# CONFIG_RKP_KDP is not set
CONFIG_DEBUG_FS=y
```

## arch/arm64/configs/vendor/gta4xlvewifi/atoll_sec_gta4xlvewifi_eur_open_defconfig
```kconfig
# atoll_sec_gta4xlvewifi_eur_open_defconfig

CONFIG_SEC_GTA4XLVE_PROJECT=y
CONFIG_SEC_GTA4XLVEWIFI_EUR_OPEN=y

#Camera
#CONFIG_SAMSUNG_REAR_TRIPLE=y
CONFIG_SAMSUNG_MULTI_CAMERA=y
CONFIG_CAMERA_SYSFS_V2=y
#CONFIG_USE_CAMERA_HW_BIG_DATA=y
#CONFIG_SAMSUNG_REAR_QUAD=y
#CONFIG_LEDS_SM5714=y
CONFIG_MCLK_I2C_DELAY=y
CONFIG_SAMSUNG_CAMERA_OTP=y
CONFIG_S5K4HA_SENSOR=y
#CONFIG_SAMSUNG_CAMERA_OTP_UW=y
CONFIG_GC5035_SENSOR=y
#CONFIG_SAMSUNG_CAMERA_OTP_MACRO=y
CONFIG_SAMSUNG_HW_SOFTLANDING=y
CONFIG_GC5035_MACRO_OTP_DD_AUTOLOAD=y
CONFIG_SAMSUNG_CAMERA_OTP_FRONT=y

#freecess
CONFIG_SAMSUNG_FREECESS=y

#Display
CONFIG_PANEL_HX83102_TV104WUM_WUXGA=y

#SystemInput
# CONFIG_TOUCHSCREEN_DUMP_MODE is not set
# CONFIG_SEC_DEBUG_TSP_LOG is not set
# CONFIG_INPUT_TOUCHSCREEN_SEC_CMD is not set
CONFIG_TOUCHSCREEN_HIMAX_CHIPSET=y
CONFIG_TOUCHSCREEN_HIMAX_COMMON=y
CONFIG_TOUCHSCREEN_HIMAX_INCELL=y
CONFIG_TOUCHSCREEN_HIMAX_DEBUG=y
CONFIG_TOUCHSCREEN_HIMAX_INSPECT=y
CONFIG_TOUCHSCREEN_HIMAX_SPI=y
CONFIG_TOUCHSCREEN_HIMAX_IC_HX83102=y
CONFIG_INPUT_SEC_INPUT_LEGO=y
CONFIG_SEC_DEBUG_TSP_LOG_LEGO=y
CONFIG_EPEN_WACOM_WEZ01=y
CONFIG_EPEN_WACOM_W9019=y
CONFIG_INPUT_HALL_IC=y

# NFC ESE
CONFIG_SEC_NFC_V2=y
# CONFIG_ESE_P3_V2_LSI is not set
# CONFIG_ESE_SECURE is not set
# CONFIG_ESE_SPI_GPIO_START is not set
# CONFIG_ESE_SPI_GPIO_END is not set
# CONFIG_ESE_SPI_NUMBER is not set
CONFIG_SEC_NFC_LOGGER=y

# PDIC
CONFIG_USB_TYPEC_MANAGER_NOTIFIER=y
CONFIG_IF_CB_MANAGER=y
CONFIG_PDIC_NOTIFIER=y
CONFIG_PDIC_SM5714=y
CONFIG_SM5714_FACTORY_MODE=y
CONFIG_VBUS_NOTIFIER=y
CONFIG_USE_PDIC_LEGO=y
CONFIG_SM5714_SUPPORT_SBU=y

#AUDIO
CONFIG_SND_SOC_SAMSUNG_AUDIO=y
CONFIG_SND_SOC_SAMSUNG_MBHC_SUPPORT=y
CONFIG_SND_SOC_SAMSUNG_JACK=y
CONFIG_SND_SOC_DBMDX=y
CONFIG_SND_SOC_DBMD4_SPI=y
CONFIG_SND_SOC_DBMDX_SND_CAPTURE=y
CONFIG_SND_SOC_DBMDX_VA_NS_SUPPORT=y

#MFD
CONFIG_MFD_SM5714=y

#MUIC
CONFIG_USE_MUIC=y
CONFIG_USE_MUIC_LEGO=y
CONFIG_MUIC_NOTIFIER=y
CONFIG_MUIC_HV=y
CONFIG_MUIC_SUPPORT_PDIC=y
CONFIG_MUIC_SM5714=y
CONFIG_MUIC_BCD_RESCAN=y

# BATTERY
CONFIG_FUELGAUGE_SM5714=y
CONFIG_CHARGER_SM5714=y
CONFIG_BATTERY_SAMSUNG=y
CONFIG_BATTERY_SAMSUNG_LEGO_STYLE=y
CONFIG_BATTERY_AGE_FORECAST=y
CONFIG_BATTERY_CISD=y
CONFIG_AFC_CHARGER_MODE=y
CONFIG_BATTERY_NOTIFIER=y
CONFIG_BATTERY_SWELLING=y
CONFIG_CALC_TIME_TO_FULL=y
CONFIG_STEP_CHARGING=y
CONFIG_SUPPORT_HV_CTRL=y

# QCA Wi-Fi feature
CONFIG_QCA_CLD_WLAN=y
CONFIG_ICNSS=y
CONFIG_ICNSS_QMI=y
CONFIG_WCNSS_MEM_PRE_ALLOC=y
CONFIG_CLD_LL_CORE=y
CONFIG_CNSS_GENL=y

# KERNEL CORE MEMORY
CONFIG_MMAP_READAROUND_LIMIT=8

# SENSOR
CONFIG_SENSORS=y
CONFIG_SENSORS_SSC=y
CONFIG_ADSP_FACTORY=y
CONFIG_LSM6DSO_FACTORY=y
CONFIG_VEML3328_FACTORY=y
CONFIG_NOT_SUPPORT_PROX_FACTORY=y
CONFIG_SLPI_MOTOR=y

# GRIP_SENSOR
CONFIG_SENSORS_ISG6320=y
CONFIG_SENSORS_ISG6320_WIFI=y
CONFIG_USE_MULTI_CHANNEL=y
CONFIG_USE_SINGLE_IRQ_B=y

#MOTOR
# CONFIG_SS_VIBRATOR is not set
# CONFIG_LEDS_QPNP_VIBRATOR_LDO is not set
# CONFIG_MSM_VIBRATOR is not set

# CAMERA PMIC
CONFIG_REGULATOR_S2MPB03=y

#EPDG
CONFIG_NET_CLS_BASIC=y
```

## arch/arm64/configs/vendor/kona_sec_userdebug_defconfig
```kconfig
# kona_sec_userdebug_defconfig
CONFIG_HPB_DEBUG_SYSFS=y

# KDP
# CONFIG_KDP_CRED is not set
# CONFIG_KDP_NS is not set
# CONFIG_KDP_DMAP is not set
# CONFIG_KDP_TEST is not set

# SDP KeyManagement Test for MDFPP evaluation
CONFIG_SDP_KEY_DUMP=y

# streamline
CONFIG_PROFILING=y
CONFIG_PERF_EVENTS=y
CONFIG_HIGH_RES_TIMERS=y
CONFIG_HW_PERF_EVENTS=y
CONFIG_LOCAL_TIMERS=y

CONFIG_GATOR=y

CONFIG_FIVE_DEBUG=y
CONFIG_FIVE_SIGN_TA=y
CONFIG_FIVE_SIGNCLIENT_PATH="/home/dpi/qb5_8815/workspace/P4_1716/buildscript/tools/signclient.jar"
CONFIG_FIVE_PILSPLITTER_PATH="/home/dpi/qb5_8815/workspace/P4_1716/buildscript/tools/pil_splitter.py"


CONFIG_PROCA=y


# CONFIG_FIVE_PA_FEATURE is not set


CONFIG_GAF_V6=y
```
