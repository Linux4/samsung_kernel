## arch/arm64/configs/exynos7580-base_defconfig
```kconfig
# CONFIG_LOCALVERSION_AUTO is not set
# CONFIG_SWAP is not set
CONFIG_SYSVIPC=y
CONFIG_NO_HZ=y
CONFIG_HIGH_RES_TIMERS=y
CONFIG_CGROUPS=y
CONFIG_CGROUP_DEBUG=y
CONFIG_CGROUP_FREEZER=y
CONFIG_CGROUP_CPUACCT=y
CONFIG_RESOURCE_COUNTERS=y
CONFIG_CGROUP_SCHED=y
CONFIG_RT_GROUP_SCHED=y
CONFIG_BLK_DEV_INITRD=y
CONFIG_CC_OPTIMIZE_FOR_SIZE=y
CONFIG_KALLSYMS_ALL=y
# CONFIG_COMPAT_BRK is not set
CONFIG_PROFILING=y
# CONFIG_BLK_DEV_BSG is not set
# CONFIG_IOSCHED_DEADLINE is not set
CONFIG_ARCH_EXYNOS=y
CONFIG_ARCH_EXYNOS7=y
CONFIG_SOC_EXYNOS7580=y
CONFIG_EXYNOS_ASV=y
CONFIG_EXYNOS_ASV_DYNAMIC_ABB=y
CONFIG_EXYNOS_ASV_MARGIN_TEST=y
CONFIG_EXYNOS7580_DYNAMIC_CLUSTER_HOTPLUG=y
CONFIG_MACH_UNIVERSAL7580=y
CONFIG_GPS_BCMxxxxx=y
CONFIG_GPS_BCM4752=y
CONFIG_GPIO_SYSFS=y
CONFIG_SEC_GPIO_DVS=y
CONFIG_SMP=y
CONFIG_SCHED_MC=y
CONFIG_SCHED_TRACER=y
# Wifi features (Broadcomm)
CONFIG_NET_CORE=y
CONFIG_WIRELESS=y
CONFIG_WIRELESS_EXT_SYSFS=y
CONFIG_WEXT_CORE=y
CONFIG_WEXT_PROC=y
CONFIG_CFG80211=y
CONFIG_CFG80211_DEFAULT_PS=y
CONFIG_CFG80211_ALLOW_RECONNECT=y
CONFIG_WLAN=y
CONFIG_WIFI_CONTROL_FUNC=y
# CONFIG_BCM43455 is not set
CONFIG_BCMDHD_FW_PATH="/system/etc/wifi/bcmdhd_sta.bin"
CONFIG_BCMDHD_NVRAM_PATH="/system/etc/wifi/nvram_net.txt"
CONFIG_BROADCOM_WIFI=y
CONFIG_BROADCOM_WIFI_RESERVED_MEM=y
CONFIG_WLAN_REGION_CODE=100
CONFIG_WIFI_BROADCOM_COB=y
CONFIG_PREEMPT=y
CONFIG_CMA_PINPAGE_MIGRATION=y
CONFIG_ARMV7_COMPAT=y
CONFIG_SECCOMP=y
CONFIG_CMDLINE="console=ttySAC1"
# CONFIG_CORE_DUMP_DEFAULT_ELF_HEADERS is not set
CONFIG_COMPAT=y
CONFIG_PM_AUTOSLEEP=y
CONFIG_PM_WAKELOCKS=y
CONFIG_PM_RUNTIME=y
CONFIG_PM_RUNTIME_TEST_SYSFS=y
CONFIG_CPU_FREQ=y
CONFIG_CPU_FREQ_DEFAULT_GOV_INTERACTIVE=y
CONFIG_ARM_EXYNOS_SMP_CPUFREQ=y
CONFIG_CPU_IDLE=y
CONFIG_OF_IDLE_STATES=y
CONFIG_CPU_IDLE_EXYNOS=y
CONFIG_NET=y
CONFIG_USB_USBNET=y
CONFIG_USB_NET_SMSC75XX=y
CONFIG_USB_NET_SMSC95XX=y
CONFIG_PACKET=y
CONFIG_UNIX=y
CONFIG_XFRM_USER=y
CONFIG_NET_KEY=y
CONFIG_INET=y
CONFIG_IP_MULTICAST=y
CONFIG_IP_ADVANCED_ROUTER=y
CONFIG_IP_MULTIPLE_TABLES=y
CONFIG_IP_PNP=y
CONFIG_IP_PNP_DHCP=y
CONFIG_IP_PNP_BOOTP=y
CONFIG_IP_PNP_RARP=y
CONFIG_INET_ESP=y
CONFIG_INET_XFRM_MODE_TUNNEL=y
# CONFIG_INET_XFRM_MODE_BEET is not set
# CONFIG_INET_LRO is not set
CONFIG_INET_DIAG=y
CONFIG_INET_DIAG_DESTROY=y
#TCP Congestion Control Change to BIC
CONFIG_TCP_CONG_ADVANCED=y
CONFIG_TCP_CONG_BIC=y
CONFIG_DEFAULT_BIC=y
CONFIG_DEFAULT_TCP_CONG="bic"
CONFIG_IPV6_PRIVACY=y
CONFIG_IPV6_ROUTER_PREF=y
CONFIG_IPV6_ROUTE_INFO=y
CONFIG_IPV6_OPTIMISTIC_DAD=y
CONFIG_INET6_AH=y
CONFIG_INET6_ESP=y
CONFIG_INET6_IPCOMP=y
CONFIG_IPV6_MIP6=y
CONFIG_IPV6_TUNNEL=y
CONFIG_IPV6_MULTIPLE_TABLES=y
CONFIG_NETFILTER=y
CONFIG_NF_CONNTRACK=y
CONFIG_NF_CONNTRACK_EVENTS=y
CONFIG_NF_CT_PROTO_DCCP=y
CONFIG_NF_CT_PROTO_SCTP=y
CONFIG_NF_CT_PROTO_UDPLITE=y
CONFIG_NF_CONNTRACK_AMANDA=y
CONFIG_NF_CONNTRACK_FTP=y
CONFIG_NF_CONNTRACK_H323=y
CONFIG_NF_CONNTRACK_IRC=y
CONFIG_NF_CONNTRACK_NETBIOS_NS=y
CONFIG_NF_CONNTRACK_PPTP=y
CONFIG_NF_CONNTRACK_SANE=y
CONFIG_NF_CONNTRACK_TFTP=y
CONFIG_NF_CT_NETLINK=y
CONFIG_NETFILTER_TPROXY=y
CONFIG_NETFILTER_XT_TARGET_CLASSIFY=y
CONFIG_NETFILTER_XT_TARGET_CONNMARK=y
CONFIG_NETFILTER_XT_TARGET_IDLETIMER=y
CONFIG_NETFILTER_XT_TARGET_MARK=y
CONFIG_NETFILTER_XT_TARGET_NFLOG=y
CONFIG_NETFILTER_XT_TARGET_NFQUEUE=y
CONFIG_NETFILTER_XT_TARGET_TPROXY=y
CONFIG_NETFILTER_XT_TARGET_TRACE=y
CONFIG_NETFILTER_XT_TARGET_TCPMSS=y
CONFIG_NETFILTER_XT_MATCH_COMMENT=y
CONFIG_NETFILTER_XT_MATCH_CONNBYTES=y
CONFIG_NETFILTER_XT_MATCH_CONNLABEL=y
CONFIG_NETFILTER_XT_MATCH_CONNLIMIT=y
CONFIG_NETFILTER_XT_MATCH_CONNMARK=y
CONFIG_NETFILTER_XT_MATCH_CONNTRACK=y
CONFIG_NETFILTER_XT_MATCH_HASHLIMIT=y
CONFIG_NETFILTER_XT_MATCH_HELPER=y
CONFIG_NETFILTER_XT_MATCH_IPRANGE=y
CONFIG_NETFILTER_XT_MATCH_LENGTH=y
CONFIG_NETFILTER_XT_MATCH_LIMIT=y
CONFIG_NETFILTER_XT_MATCH_MAC=y
CONFIG_NETFILTER_XT_MATCH_MARK=y
CONFIG_NETFILTER_XT_MATCH_POLICY=y
CONFIG_NETFILTER_XT_MATCH_PKTTYPE=y
CONFIG_NETFILTER_XT_MATCH_QTAGUID=y
CONFIG_NETFILTER_XT_MATCH_QUOTA=y
CONFIG_NETFILTER_XT_MATCH_QUOTA2=y
CONFIG_NETFILTER_XT_MATCH_QUOTA2_LOG=y
CONFIG_NETFILTER_XT_MATCH_QUOTA2_LOG_32BIT=y
CONFIG_NETFILTER_XT_MATCH_SCTP=y
CONFIG_NETFILTER_XT_MATCH_SOCKET=y
CONFIG_NETFILTER_XT_MATCH_STATE=y
CONFIG_NETFILTER_XT_MATCH_STATISTIC=y
CONFIG_NETFILTER_XT_MATCH_STRING=y
CONFIG_NETFILTER_XT_MATCH_TIME=y
CONFIG_NETFILTER_XT_MATCH_U32=y
CONFIG_NF_CONNTRACK_IPV4=y
CONFIG_IP_NF_IPTABLES=y
CONFIG_IP_NF_MATCH_AH=y
CONFIG_IP_NF_MATCH_ECN=y
CONFIG_IP_NF_MATCH_TTL=y
CONFIG_IP_NF_FILTER=y
CONFIG_IP_NF_TARGET_REJECT=y
CONFIG_IP_NF_TARGET_REJECT_SKERR=y
CONFIG_NF_NAT_IPV4=y
CONFIG_IP_NF_TARGET_MASQUERADE=y
CONFIG_IP_NF_TARGET_NETMAP=y
CONFIG_IP_NF_TARGET_REDIRECT=y
CONFIG_IP_NF_MANGLE=y
CONFIG_IP_NF_RAW=y
CONFIG_IP_NF_ARPTABLES=y
CONFIG_IP_NF_ARPFILTER=y
CONFIG_IP_NF_ARP_MANGLE=y
CONFIG_NF_CONNTRACK_IPV6=y
CONFIG_IP6_NF_IPTABLES=y
CONFIG_IP6_NF_FILTER=y
CONFIG_IP6_NF_TARGET_REJECT=y
CONFIG_IP6_NF_TARGET_REJECT_SKERR=y
CONFIG_IP6_NF_MANGLE=y
CONFIG_IP6_NF_RAW=y
CONFIG_PHONET=y
CONFIG_NET_SCHED=y
CONFIG_NET_SCH_HTB=y
CONFIG_NET_SCH_INGRESS=y
CONFIG_NET_CLS_U32=y
CONFIG_NET_EMATCH=y
CONFIG_NET_EMATCH_U32=y
CONFIG_NET_CLS_ACT=y
CONFIG_NET_ACT_POLICE=y
CONFIG_NET_ACT_GACT=y
CONFIG_NET_ACT_MIRRED=y
CONFIG_UEVENT_HELPER_PATH="/sbin/hotplug"
CONFIG_DEVTMPFS=y
CONFIG_DMA_CMA=y
CONFIG_CMA_SIZE_MBYTES=0
CONFIG_BLK_DEV_LOOP=y
CONFIG_BLK_DEV_RAM=y
CONFIG_BLK_DEV_RAM_COUNT=1
CONFIG_BLK_DEV_RAM_SIZE=16384
CONFIG_USE_MUIC=y
CONFIG_MUIC_NOTIFIER=y
CONFIG_VBUS_NOTIFIER=y
CONFIG_MUIC_S2MM001=y
CONFIG_SCSI=y
CONFIG_FMP=y
# CONFIG_SCSI_PROC_FS is not set
CONFIG_BLK_DEV_SD=y
CONFIG_SCSI_MULTI_LUN=y
# CONFIG_SCSI_LOWLEVEL is not set
CONFIG_MD=y
CONFIG_BLK_DEV_DM=y
CONFIG_DM_CRYPT=y
CONFIG_NETDEVICES=y
CONFIG_USB_PEGASUS=y
CONFIG_TUN=y
CONFIG_PPP=y
CONFIG_PPP_DEFLATE=y
CONFIG_PPP_BSDCOMP=y
CONFIG_PPP_MPPE=y
CONFIG_CRYPTO_GCM=y
CONFIG_INET_AH=y
CONFIG_INET_IPCOMP=y
CONFIG_INET_XFRM_MODE_TRANSPORT=y
CONFIG_INET_XFRM_MODE_BEET=y
CONFIG_INET6_XFRM_MODE_TRANSPORT=y
CONFIG_INET6_XFRM_MODE_TUNNEL=y
CONFIG_INET6_XFRM_MODE_BEET=y
CONFIG_IPV6=y
CONFIG_NETFILTER_XTABLES=y
CONFIG_PPPOLAC=y
CONFIG_PPPOPNS=y
CONFIG_INPUT_FLIP_COVER=y
CONFIG_INPUT_EVDEV=y
CONFIG_KEYBOARD_GPIO=y
# CONFIG_INPUT_MOUSE is not set
CONFIG_INPUT_TOUCHSCREEN=y
CONFIG_INPUT_MISC=y
CONFIG_INPUT_GPIO=y
# CONFIG_TOUCHSCREEN_SYNAPTICS_I2C_DSX is not set
CONFIG_INPUT_UINPUT=y
# CONFIG_SERIO_I8042 is not set
# CONFIG_SERIO_SERPORT is not set
CONFIG_LEGACY_PTY_COUNT=16
# CONFIG_DEVMEM is not set
# CONFIG_DEVKMEM is not set
CONFIG_SERIAL_SAMSUNG=y
CONFIG_SERIAL_SAMSUNG_CONSOLE=y
CONFIG_S3C_LOWLEVEL_UART_PORT=1
CONFIG_HW_RANDOM_EXYNOS_SWD=y
CONFIG_EXYRNG_FIPS_COMPLIANCE=y
CONFIG_EXYRNG_FAIL_POLICY_RESET=y
CONFIG_EXYRNG_USE_CRYPTOMANAGER=y
CONFIG_I2C=y
CONFIG_I2C_CHARDEV=y
CONFIG_I2C_EXYNOS5=y
CONFIG_I2C_GPIO=y
CONFIG_I2C_S3C2410=y
CONFIG_SPI=y
CONFIG_SPI_S3C64XX=y
CONFIG_THERMAL=y
CONFIG_CPU_THERMAL=y
CONFIG_GPU_THERMAL=y
CONFIG_THERMAL_EMULATION=y
CONFIG_EXYNOS_THERMAL=y
CONFIG_EXYNOS_SWTRIP=y
CONFIG_EXYNOS_THERMAL_CORE=y
CONFIG_WATCHDOG=y
CONFIG_S3C2410_WATCHDOG=y
CONFIG_MFD_SEC_CORE=y
CONFIG_MFD_S2MU003=y
CONFIG_REGULATOR=y
CONFIG_REGULATOR_FIXED_VOLTAGE=y
CONFIG_REGULATOR_GPIO=y
CONFIG_REGULATOR_S2MPU03=y
CONFIG_REGULATOR_S2MU003=y
CONFIG_MEDIA_SUPPORT=y
CONFIG_MEDIA_CAMERA_SUPPORT=y
CONFIG_V4L_PLATFORM_DRIVERS=y
# CONFIG_VIDEO_EXYNOS_HEVC is not set
CONFIG_ENABLE_HAL3_2_META_INTERFACE=y
CONFIG_VIDEO_EXYNOS_FIMC_IS=y
CONFIG_USE_VENDER_FEATURE=y
CONFIG_CSI_V3_4=y
CONFIG_FIMC_IS_V3_1_1=y
CONFIG_USE_HOST_FD_LIBRARY=y
CONFIG_DECON_LPD_DISPLAY_WITH_CAMERA=y
CONFIG_VIDEO_EXYNOS_SCALER=y
CONFIG_VIDEO_EXYNOS_HX_JPEG=y
CONFIG_V4L_MEM2MEM_DRIVERS=y
CONFIG_MALI_EXYNOS_TRACE=y
CONFIG_MALI_EXPERT=y
CONFIG_MALI_PLATFORM_THIRDPARTY_NAME="exynos"
CONFIG_MALI_DVFS=y
CONFIG_MALI_RT_PM=y
CONFIG_MALI_ENABLE_TRACE=y
CONFIG_MALI_DEBUG_SYS=y
CONFIG_MALI_DEBUG_KERNEL_SYSFS=y
CONFIG_MALI_MIDGARD=y
CONFIG_MALI_FENCE_DEBUG=y
CONFIG_EXYNOS_SOC_NAME="7580"
CONFIG_MALI_EXYNOS_SECURE_RENDERING=n
CONFIG_FB=y
CONFIG_USE_VSYNC_SKIP=y
CONFIG_FB_SIMPLE=y
CONFIG_EXYNOS_VIDEO=y
CONFIG_FB_WINDOW_UPDATE=y
CONFIG_EXYNOS_DECON_EXYNOS7580=y
CONFIG_EXYNOS_DECON_LCD=y
CONFIG_EXYNOS_DECON_LCD_SYSFS=y
CONFIG_DECON_DEVFREQ=y
CONFIG_BACKLIGHT_LCD_SUPPORT=y
CONFIG_DECON_MIPI_DSI_PKTGO=y
CONFIG_SOUND=y
CONFIG_SND=y
CONFIG_SND_USB_AUDIO=y
CONFIG_SND_SOC=y
CONFIG_SND_SOC_SAMSUNG=y
CONFIG_SND_SOC_SAMSUNG_UNIVERSAL7580_COD3022X=y
CONFIG_SND_SOC_DBMD2=y
CONFIG_SAMSUNG_JACK=y
CONFIG_JOYSTICK_XPAD=y
CONFIG_USB=y
CONFIG_USB_EHCI_HCD=y
CONFIG_USB_EHCI_S5P=y
CONFIG_USB_OHCI_HCD=y
CONFIG_USB_OHCI_EXYNOS=y
CONFIG_USB_STORAGE=y
CONFIG_USB_STORAGE_DETECT=y
CONFIG_USB_HOST_NOTIFY=y
CONFIG_USB_NOTIFY_LAYER=y
CONFIG_USB_EXTERNAL_NOTIFY=y
CONFIG_USB_NOTIFY_PROC_LOG=y
CONFIG_USB_NOTIFIER=y
CONFIG_USB_DEBUG=y
CONFIG_USB_DEBUG_DETAILED_LOG=y
CONFIG_USB_ANNOUNCE_NEW_DEVICES=y
CONFIG_USB_SERIAL=y
CONFIG_USB_SERIAL_FTDI_SIO=y
CONFIG_USB_EXYNOS_SWITCH=y
CONFIG_USB_PHY=y
# CONFIG_SAMSUNG_USB2PHY is not set
CONFIG_SAMSUNG_DWC_USB2PHY=y
CONFIG_SAMSUNG_USB2PHY_CAL=y
CONFIG_USB_GADGET=y
CONFIG_USB_S3C_OTGD=y
CONFIG_USB_G_ANDROID=y
CONFIG_USB_ANDROID_SAMSUNG_COMPOSITE=y
CONFIG_USB_DUN_SUPPORT=y
CONFIG_USB_ACM=y
CONFIG_USB_ANDROID_SAMSUNG_MTP=y
CONFIG_USB_NCM_SUPPORT_MTU_CHANGE=y
CONFIG_USB_RNDIS_MULTIPACKET=y
CONFIG_USB_LOCK_SUPPORT_FOR_MDM=y
CONFIG_MMC=y
CONFIG_MMC_UNSAFE_RESUME=y
CONFIG_MMC_CLKGATE=y
CONFIG_MMC_DW=y
CONFIG_MMC_DW_FMP_DM_CRYPT=y
CONFIG_MMC_DW_FMP_ECRYPT_FS=y
CONFIG_MMC_DW_IDMAC=y
CONFIG_MMC_DW_64_IDMAC=y
CONFIG_MMC_DW_EXYNOS=y
# CONFIG_MMC_DW_SKIP_CACHE_OP is not set
CONFIG_MMC_DW_DEBUG=y
CONFIG_MMC_DW_FORCE_32BIT_SFR_RW=y
CONFIG_MMC_SUPPORT_BKOPS_MODE=y
CONFIG_MMC_BKOPS_NODE_UID=1000
CONFIG_MMC_BKOPS_NODE_GID=1001
CONFIG_MMC_BLOCK_DEFERRED_RESUME=y
CONFIG_NEW_LEDS=y
CONFIG_LEDS_CLASS=y
CONFIG_LEDS_S2MU003=y
CONFIG_SWITCH=y
CONFIG_RTC_CLASS=y
CONFIG_RTC_DRV_SEC=y
CONFIG_VIRTIO_MMIO=y
CONFIG_STAGING=y
CONFIG_ANDROID=y
CONFIG_ANDROID_BINDER_IPC=y
CONFIG_ASHMEM=y
CONFIG_ANDROID_LOGGER=y
CONFIG_ANDROID_LOW_MEMORY_KILLER=y
CONFIG_ANDROID_INTF_ALARM_DEV=y
CONFIG_SYNC=y
CONFIG_SW_SYNC=y
CONFIG_ION=y
CONFIG_ION_EXYNOS=y
CONFIG_ION_EXYNOS_OF=y
CONFIG_SEC_EXT=y
CONFIG_SEC_SYSFS=y
CONFIG_SEC_DEBUG=y

# SEC BSP
CONFIG_SEC_BSP=y

CONFIG_DEFERRED_INITCALLS=y

CONFIG_EXYNOS_IOMMU_V6=y
CONFIG_PM_DEVFREQ=y
CONFIG_IIO=y
CONFIG_EXYNOS_ADC=y
CONFIG_SENSORS_SEC_THERMISTOR=y
CONFIG_PWM=y
CONFIG_PWM_SAMSUNG=y
CONFIG_MOBICORE_DRIVER=y
CONFIG_MOBICORE_API=y
CONFIG_BATTERY_SAMSUNG=y
CONFIG_CHARGER_S2MU003=y
CONFIG_EXYNOS_CORESIGHT=y
CONFIG_EXT2_FS=y
CONFIG_EXT3_FS=y
# CONFIG_EXT3_DEFAULTS_TO_ORDERED is not set
# CONFIG_EXT3_FS_XATTR is not set
CONFIG_EXT4_FS=y
CONFIG_FUSE_FS=y
CONFIG_CUSE=y
CONFIG_VFAT_FS=y
CONFIG_SDCARD_FS=y
CONFIG_EXFAT_FS=y
CONFIG_TMPFS=y
# CONFIG_ECRYPT_FS is set 'ODE and DIR Encryption'
CONFIG_CRAMFS=y
CONFIG_NLS_CODEPAGE_437=y
CONFIG_NLS_ISO8859_1=y
CONFIG_PRINTK_TIME=y
CONFIG_PRINTK_PROCESS=y
CONFIG_MAGIC_SYSRQ=y
CONFIG_DEBUG_KERNEL=y
CONFIG_LOCKUP_DETECTOR=y
CONFIG_BOOTPARAM_HARDLOCKUP_PANIC=y
CONFIG_BOOTPARAM_SOFTLOCKUP_PANIC=y
# CONFIG_DETECT_HUNG_TASK is not set
CONFIG_DEBUG_INFO=y
# CONFIG_FTRACE is not set
CONFIG_ATOMIC64_SELFTEST=y
# CONFIG_KEYS is set 'ODE and DIR Encryption'
CONFIG_FUELGAUGE_S2MU003=y
CONFIG_SEC_MODEM_V1=y
CONFIG_LEDS_KTD2026=y
CONFIG_ANDROID_TIMED_OUTPUT=y
#BT
CONFIG_BT=y
CONFIG_RFKILL=y
CONFIG_BT_BCM43455=y

#
# HID support
#
CONFIG_HID=y
CONFIG_UHID=y
CONFIG_BT_HIDP=y
CONFIG_HID_GENERIC=y

#
# Special HID drivers
#
CONFIG_HID_APPLE=y
CONFIG_HID_ELECOM=y
CONFIG_HID_MAGICMOUSE=y
CONFIG_HID_MICROSOFT=y
CONFIG_HID_MULTITOUCH=y
CONFIG_HID_A4TECH=y
CONFIG_HID_ACRUX=y
CONFIG_HID_ACRUX_FF=y
CONFIG_HID_BELKIN=y
CONFIG_HID_CHERRY=y
CONFIG_HID_CHICONY=y
CONFIG_HID_PRODIKEYS=y
CONFIG_HID_CYPRESS=y
CONFIG_HID_DRAGONRISE=y
CONFIG_HID_EMS_FF=y
CONFIG_HID_EZKEY=y
CONFIG_HID_HOLTEK=y
CONFIG_HID_KEYTOUCH=y
CONFIG_HID_KYE=y
CONFIG_HID_UCLOGIC=y
CONFIG_HID_WALTOP=y
CONFIG_HID_GYRATION=y
CONFIG_HID_TWINHAN=y
CONFIG_HID_KENSINGTON=y
CONFIG_HID_LCPOWER=y
CONFIG_HID_LOGITECH=y
CONFIG_HID_LOGITECH_DJ=y
CONFIG_HID_MONTEREY=y
CONFIG_HID_MULTITOUCH=y
CONFIG_HID_ORTEK=y
CONFIG_HID_PANTHERLORD=y
CONFIG_HID_PETALYNX=y
CONFIG_HID_PICOLCD=y
CONFIG_HID_PRIMAX=y
CONFIG_HID_ROCCAT=y
CONFIG_HID_SAITEK=y
CONFIG_HID_SAMSUNG=y
CONFIG_HID_SYNAPTICS_BT=y
CONFIG_HID_SONY=y
CONFIG_HID_SPEEDLINK=y
CONFIG_HID_SUNPLUS=y
CONFIG_HID_GREENASIA=y
CONFIG_HIDRAW=y
CONFIG_HID_SMARTJOYPLUS=y
CONFIG_HID_TIVO=y
CONFIG_HID_TOPSEED=y
CONFIG_HID_THRUSTMASTER=y
# CONFIG_HID_WACOM is not set
CONFIG_HID_WIIMOTE=y
CONFIG_HID_ZAGG=y
CONFIG_HID_ZEROPLUS=y
CONFIG_HID_ZYDACRON=y

# IRLED
CONFIG_IRLED=y
CONFIG_IRLED_WATCHON=y
CONFIG_ARGOS=y
CONFIG_PROC_DEVICETREE=y

#
# BlowFish TZDEV
#
# CONFIG_TZDEV is not set
CONFIG_TZDEV_32BIT_SECURE_KERNEL=y
CONFIG_TZDEV_USE_ARM_CALLING_CONVENTION=y
# CONFIG_TZDEV_CMA is not set
CONFIG_TZDEV_IWI_EVENT=446
CONFIG_TZDEV_IWI_PANIC=447
# CONFIG_TZDEV_SWD_PANIC_IS_CRITICAL is not set
# CONFIG_TZDEV_NWD_PANIC_ON_CLOSE is not set
CONFIG_TZLOG=y
# CONFIG_TZLOG_POLLING is not set
# CONFIG_TZLOG_POLLING_PERIOD is not set
CONFIG_TZLOG_PG_CNT=2
CONFIG_TZDEV_MULTI_CORE_AUX_CHANNELS=y
# CONFIG_TZDEV_MSM_CRYPTO_WORKAROUND is not set
# CONFIG_TZDEV_QC_CRYPTO_CLOCKS_MANAGEMENT is not set
# CONFIG_TZDEV_QC_CRYPTO_CLOCKS_USR_MNG is not set
CONFIG_ION_FD2PHYS=y
CONFIG_TZIRS=y
# CONFIG_QCOM_SCM_ARMV8 is not set
CONFIG_TZDEV_PAGE_MIGRATION=y

# Rooting prevention
#
CONFIG_SEC_RESTRICT_ROOTING=y
CONFIG_SEC_RESTRICT_SETUID=y
CONFIG_SEC_RESTRICT_FORK=y
CONFIG_SEC_RESTRICT_ROOTING_LOG=y

# SEC Param
CONFIG_SEC_PARAM=y
CONFIG_CM_OFFSET=7340596

# TIMA
#
CONFIG_SEC_DEBUG_TIMA_LOG=y
CONFIG_TIMA=y
# CONFIG_ARM_PATCH_PHYS_VIRT is not set
# CONFIG_FUNCTION_TRACER is not set
CONFIG_TIMA_RKP=y
CONFIG_RKP_KDP=y
CONFIG_RKP_DMAP_PROT=y

#TUI
CONFIG_TRUSTONIC_TRUSTED_UI=y

# KNOX KAP
CONFIG_KNOX_KAP=y


#
# IIO
#
CONFIG_IIO_BUFFER=y
CONFIG_IIO_KFIFO_BUF=y
CONFIG_IIO_TRIGGER=y

# [ SEC_SELINUX_PORTING_EXYNOS
CONFIG_EXT2_FS_XATTR=y
CONFIG_EXT2_FS_SECURITY=y
CONFIG_EXT4_FS_XATTR=y
CONFIG_EXT4_FS_SECURITY=y
CONFIG_AUDIT=y
CONFIG_SECURITY=y
CONFIG_LSM_MMAP_MIN_ADDR=4096
CONFIG_SECURITY_NETWORK=y
CONFIG_SECURITY_SELINUX=y
CONFIG_DEFAULT_SECURITY_SELINUX=y
CONFIG_NETWORK_SECMARK=y
CONFIG_NF_CONNTRACK_SECMARK=y
CONFIG_NETFILTER_XT_TARGET_CONNSECMARK=y
CONFIG_NETFILTER_XT_TARGET_SECMARK=y
CONFIG_NETFILTER_ADVANCED=y
CONFIG_IP_NF_SECURITY=y
CONFIG_AUDITSYSCALL=y
CONFIG_SEC_AVC_LOG=y
CONFIG_SDCARD_FS_XATTR=y
CONFIG_ECRYPT_FS_VIRTUAL_FAT_XATTR=y
CONFIG_FAT_VIRTUAL_XATTR=y
CONFIG_EXFAT_VIRTUAL_XATTR=y
# ] SEC_SELINUX_PORTING_EXYNOS

# DMVerity
CONFIG_DM_VERITY=y

# Do not edit below this line, we need a blank line at the end of file.

#
# ODE and DIR Encryption
#
CONFIG_CRYPTO=y
CONFIG_CRYPTO_SHA1=y
CONFIG_CRYPTO_SHA256=y
CONFIG_CRYPTO_AES=y
CONFIG_CRYPTO_TWOFISH=y
CONFIG_CRYPTO_CBC=y
CONFIG_ECRYPT_FS=y
CONFIG_CRYPTO_NULL=y
CONFIG_WTL_ENCRYPTION_FILTER=y
CONFIG_KEYS=y
CONFIG_KEYS_DEBUG_PROC_KEYS=y
CONFIG_ARM64_CRYPTO=y
CONFIG_CRYPTO_SHA1_ARM64_CE=y
CONFIG_CRYPTO_SHA2_ARM64_CE=y
CONFIG_CRYPTO_AES_ARM64_CE=y
CONFIG_CRYPTO_AES_ARM64_CE_BLK=y

# SEC OOM KILLER
CONFIG_SEC_OOM_KILLER=y

# KNOX SDP and DLP
CONFIG_SDP=y
CONFIG_DLP=y

# performance monitoring unit
CONFIG_PERF_EVENTS=y
CONFIG_HW_PERF_EVENTS=y
```
