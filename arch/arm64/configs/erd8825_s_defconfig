## arch/arm64/configs/msm8976_sec_a9xprolte_sea_defconfig
```kconfig
CONFIG_SEC_A9XPROLTE_PROJECT=y
CONFIG_MACH_A9XPROLTE_SEA_OPEN=y

#SKU theme
CONFIG_SKU_THEME=y

#
# MAX77843 IC
#
# CONFIG_EXTCON is not set
# CONFIG_EXTCON_MAX77843 is not set
# CONFIG_MFD_MAX77843 is not set

# MUIC
CONFIG_USE_MUIC=y
CONFIG_MUIC_NOTIFIER=y
CONFIG_MUIC_UNIVERSAL=y
CONFIG_MUIC_UNIVERSAL_SM5705=y
CONFIG_MUIC_UNIVERSAL_SM5705_AFC=y
CONFIG_MUIC_PINCTRL=y

CONFIG_USB_HOST_NOTIFY=y

# RUSTPROOF
CONFIG_MUIC_SUPPORT_RUSTPROOF=y

# VBUS_NOTI
CONFIG_VBUS_NOTIFIER=y

#HALL IC
CONFIG_SENSORS_HALL=y
CONFIG_CERTIFY_HALL=y

# Service LED
# CONFIG_LEDS_MAX77843_RGB is not set

#
# MOTOR
#
CONFIG_SS_VIBRATOR=y

#
# DISPLAY(MDSS)
#
CONFIG_PANEL_S6E3FA3_AMS598KH01_FHD=y

#FLASH
CONFIG_FLASHLIGHT=y
CONFIG_SM_FLASH_LED=y
CONFIG_LEDS_SM5705=y

#CAMERA
CONFIG_MSM_FRONT_EEPROM=y

# XO SHUTDOWN
CONFIG_UART3=y

#OIS
CONFIG_MSM_OIS=y
CONFIG_BU24219_OIS=y
CONFIG_CAM_EXTERNAL=y

# IPSec
CONFIG_CRYPTO_NULL=y

# BATTERY & Charger
# CONFIG_FUELGAUGE_MAX77843 is not set
# CONFIG_FUELGAUGE_MAX77843_COULOMB_COUNTING is not set
# CONFIG_CHARGER_MAX77843 is not set
CONFIG_SAMSUNG_LPM_MODE=y
CONFIG_BATTERY_SAMSUNG=y
CONFIG_AFC_CHARGER_MODE=y
CONFIG_PREVENT_SOC_JUMP=y
CONFIG_CHARGER_SM5705=y
CONFIG_FUELGAUGE_SM5705=y
CONFIG_SEC_MPP_SHARE=y
CONFIG_BATTERY_SWELLING=y
CONFIG_AFC_CHARGER_MODE=y
CONFIG_BATTERY_AGE_FORECAST=y

# Power off Alarm
# CONFIG_RTC_AUTO_PWRON is not set
# CONFIG_RTC_AUTO_PWRON_PARAM is not set

#
# InputDevice
#
CONFIG_TOUCHSCREEN_MELFAS_MMS449=y
CONFIG_KEYBOARD_TC300K=y
CONFIG_TOUCHKEY_GRIP=y
CONFIG_TOUCHSCREEN_DUMP_MODE=y
CONFIG_SECURE_TOUCH=y

# CONFIG_MFD_S2MPB02 is not set
# CONFIG_REGULATOR_S2MPB02 is not set
CONFIG_MFD_SM5705=y
CONFIG_REGULATOR_SM5705=y

# Finger print sensor
CONFIG_SENSORS_FINGERPRINT=y
CONFIG_SENSORS_FINGERPRINT_SYSFS=y
CONFIG_SENSORS_VFS7XXX=y
CONFIG_SENSORS_FP_SPI_NUMBER=4
CONFIG_SENSORS_FP_SPI_GPIO_START=12
CONFIG_SENSORS_FP_SPI_GPIO_END=15
CONFIG_SENSORS_FP_LOCKSCREEN_MODE=y


#
# Sensor
#
CONFIG_SENSORS=y
CONFIG_SENSORS_CORE=y
CONFIG_SENSORS_SSC=y
CONFIG_SENSORS_BHI=y
CONFIG_IIO_BUFFER=y
CONFIG_IIO=y
CONFIG_IIO_KFIFO_BUF=y
CONFIG_IIO_TRIGGER=y
CONFIG_IIO_ST_HWMON=y

CONFIG_SENSORS_CM36655=y
CONFIG_SENSORS_CM36655_LEDA_EN_GPIO=y
CONFIG_SENSORS_AK09916C=y
CONFIG_SENSORS_SW_RESET=y
#NFC
CONFIG_NFC=y
CONFIG_SEC_NFC=y
CONFIG_ESE_P3=y
CONFIG_ESE_SECURE=y
CONFIG_ESE_SECURE_SPI_PORT=0
CONFIG_ESE_SPI_GPIO_START=0
CONFIG_ESE_SPI_GPIO_END=3

#
# Audio
#
CONFIG_SND_SOC_MSM8X16_WCD=y
CONFIG_AUDIO_SPEAKER_OUT_NXP_AMP_ENABLE=y
# Earjack
CONFIG_SAMSUNG_JACK=y
CONFIG_INPUT_GPIO=y
CONFIG_SW_100K_TO_GND=y

#MST
CONFIG_MST_LDO=y
# CONFIG_SCHED_TASK_BEHAVIOR is not set

# SSWAP
CONFIG_SWAP=y
CONFIG_FRONTSWAP=y
CONFIG_ZSMALLOC=y
CONFIG_ZSMALLOC_STAT=y
CONFIG_ZSMALLOC_OBJ_SEQ=n
CONFIG_PGTABLE_MAPPING=y
CONFIG_ZSWAP=y
CONFIG_ZSWAP_ENABLE_WRITEBACK=n
CONFIG_ZSWAP_COMPACTION=y
CONFIG_ZPOOL=y
CONFIG_DIRECT_RECLAIM_FILE_PAGES_ONLY=y
CONFIG_INCREASE_MAXIMUM_SWAPPINESS=y
CONFIG_FIX_INACTIVE_RATIO=y
CONFIG_TIGHT_PGDAT_BALANCE=y
CONFIG_VNSWAP=y
CONFIG_SWAP_ENABLE_READAHEAD=n

CONFIG_ANDROID_INTF_ALARM_DEV=y

# SECURITY
CONFIG_FIPS_ENABLE=n

#WLAN Built-in driver
CONFIG_PRONTO_WLAN=y
CONFIG_PRIMA_WLAN_BTAMP=n
CONFIG_PRIMA_WLAN_LFR=y
CONFIG_PRIMA_WLAN_11AC_HIGH_TP=y
CONFIG_QCOM_TDLS=y
CONFIG_QCOM_VOWIFI_11R=y
CONFIG_ENABLE_LINUX_REG=y
CONFIG_WLAN_OFFLOAD_PACKETS=y
CONFIG_QCOM_ESE=n
CONFIG_QCOM_ESE_UPLOAD=n
CONFIG_WLAN_FEATURE_11W=y

# EPDG
CONFIG_NET_CORE=y
CONFIG_NET_SCH_PRIO=y
CONFIG_NET_SCHED=y   #depends on CONFIG_NET  which is enabled by default.. coz not seeing in the config file
CONFIG_NET_CLS_BASIC=y # required if basic is being used as a filter. depends on CONFIG_NET_CLS so enabling it by default
CONFIG_NET_CLS=y
CONFIG_NET_CLS_ACT=y # for enabling the action target.
CONFIG_NET_ACT_MIRRED=y  # for enabling the mirred target for redirecting the packet between the devices.
CONFIG_NET_EMATCH=y   #basic uses extended matches so this has to be present
CONFIG_NET_SCH_INGRESS=y # classifier for ingress packet
```

## arch/arm64/configs/msm8976_sec_c9lte_chn_defconfig
```kconfig
CONFIG_SEC_C9LTE_PROJECT=y
CONFIG_MACH_C9LTE_CHN_OPEN=y

#
# MAX77843 IC
#
# CONFIG_EXTCON is not set
# CONFIG_EXTCON_MAX77843 is not set
# CONFIG_MFD_MAX77843 is not set

# MUIC
CONFIG_USE_MUIC=y
CONFIG_MUIC_NOTIFIER=y
CONFIG_MUIC_UNIVERSAL=y
CONFIG_MUIC_UNIVERSAL_SM5705=y
CONFIG_MUIC_UNIVERSAL_SM5705_AFC=y
CONFIG_MUIC_PINCTRL=y

CONFIG_USB_HOST_NOTIFY=y

# RUSTPROOF
CONFIG_MUIC_SUPPORT_RUSTPROOF=y

# VBUS_NOTI
CONFIG_VBUS_NOTIFIER=y

#HALL IC
CONFIG_SENSORS_HALL=y
CONFIG_CERTIFY_HALL=y

# Service LED
# CONFIG_LEDS_MAX77843_RGB is not set

#
# MOTOR
#
CONFIG_SS_VIBRATOR=y

#
# DISPLAY(MDSS)
#
CONFIG_PANEL_S6E3FA3_AMS598KH01_FHD=y

#FLASH
CONFIG_FLASHLIGHT=y
CONFIG_SM_FLASH_LED=y
CONFIG_LEDS_SM5705=y

#CAMERA
CONFIG_MSM_FRONT_EEPROM=y

# XO SHUTDOWN
CONFIG_UART3=y

#OIS
CONFIG_MSM_OIS=y
CONFIG_BU24219_OIS=y
CONFIG_CAM_EXTERNAL=y

# BATTERY & Charger
# CONFIG_FUELGAUGE_MAX77843 is not set
# CONFIG_FUELGAUGE_MAX77843_COULOMB_COUNTING is not set
# CONFIG_CHARGER_MAX77843 is not set
CONFIG_SAMSUNG_LPM_MODE=y
CONFIG_BATTERY_SAMSUNG=y
CONFIG_AFC_CHARGER_MODE=y
CONFIG_PREVENT_SOC_JUMP=y
CONFIG_CHARGER_SM5705=y
CONFIG_FUELGAUGE_SM5705=y
CONFIG_SEC_MPP_SHARE=y
CONFIG_SW_SELF_DISCHARGING=y
CONFIG_BATTERY_SWELLING=y
CONFIG_AFC_CHARGER_MODE=y
CONFIG_STEP_CHARGING=y
CONFIG_MULTI_CHARGING=y
CONFIG_BATTERY_SAMSUNG_V2_FOLDER=y
CONFIG_BATTERY_NOTIFIER=y
# CONFIG_CHARGER_BQ25898S is not set (for EVB REV00)
# DA9155 for EVB REV01
CONFIG_CHARGER_DA9155=y

#Power off Alarm
CONFIG_RTC_AUTO_PWRON=y
CONFIG_RTC_AUTO_PWRON_PARAM=y

#
# InputDevice
#
CONFIG_TOUCHSCREEN_MELFAS_MMS449=y
CONFIG_KEYBOARD_ABOV_TOUCH_18XX=y
CONFIG_TOUCHSCREEN_DUMP_MODE=y
CONFIG_SECURE_TOUCH=y

# CONFIG_MFD_S2MPB02 is not set
# CONFIG_REGULATOR_S2MPB02 is not set
CONFIG_MFD_SM5705=y
CONFIG_REGULATOR_SM5705=y

# Finger print sensor
CONFIG_SENSORS_FINGERPRINT=y
CONFIG_SENSORS_FINGERPRINT_SYSFS=y
CONFIG_SENSORS_VFS7XXX=y
CONFIG_SENSORS_FP_SPI_NUMBER=4
CONFIG_SENSORS_FP_SPI_GPIO_START=12
CONFIG_SENSORS_FP_SPI_GPIO_END=15
CONFIG_SENSORS_FP_LOCKSCREEN_MODE=y


#
# Sensor
#
CONFIG_SENSORS=y
CONFIG_SENSORS_CORE=y
CONFIG_SENSORS_SSC=y
CONFIG_SENSORS_BHI=y
CONFIG_IIO_BUFFER=y
CONFIG_IIO=y
CONFIG_IIO_KFIFO_BUF=y
CONFIG_IIO_TRIGGER=y
CONFIG_IIO_ST_HWMON=y

CONFIG_SENSORS_CM36655=y
CONFIG_SENSORS_CM36655_LEDA_EN_GPIO=y
CONFIG_SENSORS_AK09916C=y
CONFIG_SENSORS_SW_RESET=y
#NFC
CONFIG_NFC=y
CONFIG_SEC_NFC=y
CONFIG_ESE_P3=y
CONFIG_ESE_SECURE=y
CONFIG_ESE_SECURE_SPI_PORT=0
CONFIG_ESE_SPI_GPIO_START=0
CONFIG_ESE_SPI_GPIO_END=3

# GPIO EXPANDER
CONFIG_GPIO_PCAL6416A=y

#
# Audio
#
CONFIG_SND_SOC_MSM8X16_WCD=y
CONFIG_AUDIO_SPEAKER_OUT_NXP_AMP_ENABLE=y
# Earjack
CONFIG_SAMSUNG_JACK=y
CONFIG_INPUT_GPIO=y
CONFIG_SW_100K_TO_GND=y

#MST
# CONFIG_MST_LDO is not set
# CONFIG_SCHED_TASK_BEHAVIOR is not set

# SSWAP
CONFIG_SWAP=y
CONFIG_FRONTSWAP=y
CONFIG_ZSMALLOC=y
CONFIG_ZSMALLOC_STAT=y
CONFIG_ZSMALLOC_OBJ_SEQ=n
CONFIG_PGTABLE_MAPPING=y
CONFIG_ZSWAP=y
CONFIG_ZSWAP_ENABLE_WRITEBACK=n
CONFIG_ZSWAP_COMPACTION=y
CONFIG_ZPOOL=y
CONFIG_DIRECT_RECLAIM_FILE_PAGES_ONLY=y
CONFIG_INCREASE_MAXIMUM_SWAPPINESS=y
CONFIG_FIX_INACTIVE_RATIO=y
CONFIG_TIGHT_PGDAT_BALANCE=y
CONFIG_VNSWAP=y
CONFIG_SWAP_ENABLE_READAHEAD=n

CONFIG_ANDROID_INTF_ALARM_DEV=y

# SECURITY
CONFIG_FIPS_ENABLE=n
```

## arch/arm64/configs/msm8976_sec_eng_defconfig
```kconfig
CONFIG_CGROUP_DEBUG=y
CONFIG_LIMITS_MONITOR=y
CONFIG_LIMITS_LITE_HW=y
CONFIG_CORESIGHT=n
CONFIG_CORESIGHT_EVENT=n
CONFIG_CORESIGHT_FUSE=n
CONFIG_CORESIGHT_CTI=n
CONFIG_CORESIGHT_CTI_SAVE_DISABLE=n
CONFIG_CORESIGHT_TMC=n
CONFIG_CORESIGHT_TPIU=n
CONFIG_CORESIGHT_FUNNEL=n
CONFIG_CORESIGHT_REPLICATOR=n
CONFIG_CORESIGHT_STM=n
CONFIG_CORESIGHT_HWEVENT=n
CONFIG_CORESIGHT_TPDA=n
CONFIG_CORESIGHT_TPDM=n
CONFIG_CORESIGHT_ETMV4=n
CONFIG_CORESIGHT_DBGUI=n
CONFIG_CORESIGHT_REMOTE_ETM=n
CONFIG_CORESIGHT_QPDI=n
CONFIG_CP_ACCESS64=y
CONFIG_MSM_GLADIATOR_ERP=y
CONFIG_MSM_SMD_DEBUG=y
CONFIG_MSM_DCC=y
CONFIG_MSM_DEBUG_LAR_UNLOCK=y
# CONFIG_MSM_FORCE_WDOG_BITE_ON_PANIC is not set
# CONFIG_CORESIGHT_CTI_SAVE_DISABLE is not set
CONFIG_MSM_OCMEM_DEBUG=y
CONFIG_MSM_OCMEM_NONSECURE=y
CONFIG_MSM_XPU_ERR_FATAL=y
CONFIG_LOCKUP_DETECTOR=y
CONFIG_BOOTPARAM_SOFTLOCKUP_PANIC=y
# CONFIG_DETECT_HUNG_TASK is not set
CONFIG_PANIC_ON_RECURSIVE_FAULT=y
CONFIG_DEBUG_OBJECTS=y
CONFIG_DEBUG_OBJECTS_FREE=y
CONFIG_DEBUG_OBJECTS_TIMERS=y
CONFIG_DEBUG_OBJECTS_WORK=y
CONFIG_DEBUG_OBJECTS_RCU_HEAD=y
CONFIG_DEBUG_OBJECTS_PERCPU_COUNTER=y
CONFIG_DEBUG_KMEMLEAK=y
CONFIG_DEBUG_KMEMLEAK_DEFAULT_OFF=y
CONFIG_DEBUG_KMEMLEAK_EARLY_LOG_SIZE=4000
CONFIG_DEBUG_TASK_STACK_SCAN_OFF=y
CONFIG_DEBUG_MODULE_SCAN_OFF=y

# BluesMan: MCS queuing does not work if
# DEBUGGING stuffs are enabled. So, disable it.
# With this disabling, _all_ builds will honour
# MCS algorithm.
CONFIG_DEBUG_SPINLOCK=y
CONFIG_DEBUG_MUTEXES=y
# CONFIG_DEBUG_LOCK_ALLOC is not set
# CONFIG_PROVE_LOCKING is not set
# CONFIG_DEBUG_RT_MUTEXES is not set

CONFIG_DEBUG_ATOMIC_SLEEP=y
CONFIG_DEBUG_STACK_USAGE=y
CONFIG_DEBUG_MEMORY_INIT=y
CONFIG_DEBUG_LIST=y
CONFIG_FAULT_INJECTION=y
CONFIG_FAIL_PAGE_ALLOC=y
CONFIG_FAULT_INJECTION_DEBUG_FS=y
CONFIG_FAULT_INJECTION_STACKTRACE_FILTER=y
CONFIG_BLK_DEV_IO_TRACE=y
CONFIG_DYNAMIC_DEBUG=y
CONFIG_PANIC_ON_DATA_CORRUPTION=y
CONFIG_STRICT_MEMORY_RWX=y
# CONFIG_MSM_BUSPM_DEV is not set
CONFIG_DEBUG_PREEMPT=y
CONFIG_DEBUG_BUGVERBOSE=y
CONFIG_SCHED_DEBUG=y
CONFIG_EDAC=y
CONFIG_EDAC_MM_EDAC=y
CONFIG_EDAC_CORTEX_ARM64=y
CONFIG_EDAC_CORTEX_ARM64_PANIC_ON_UE=y
CONFIG_CHECK_GPT=y
CONFIG_SEC_DEBUG_SEC_WDOG_BITE=y
CONFIG_USER_RESET_DEBUG_TEST=y
# CONFIG_PAGE_OWNER is not set
CONFIG_SLUB_DEBUG=y
CONFIG_SLUB_DEBUG_ON=y
CONFIG_SLABINFO=y 
CONFIG_DEBUG_PAGEALLOC=y 
CONFIG_SEC_PMIC_DUMP=y
CONFIG_DEBUG_THERMAL=y

# Rooting Prevention
# CONFIG_SEC_RESTRICT_ROOTING is not set
# CONFIG_SEC_RESTRICT_SETUID is not set
# CONFIG_SEC_RESTRICT_FORK is not set
# CONFIG_SEC_RESTRICT_ROOTING_LOG is not set

#flags to check the corruption
CONFIG_FORCE_PAGES=y
CONFIG_FREE_PAGES_RDONLY=y
CONFIG_KERNEL_TEXT_RDONLY=y

# GPIO DVS feature
CONFIG_SEC_GPIO_DVS=y

# TRUSTONIC feature
CONFIG_MOBICORE_SUPPORT=y
CONFIG_MOBICORE_API=y
CONFIG_TRUSTONIC_TEE_DEBUG=y
```

## arch/arm64/configs/msm8976_sec_gts210vewifi_eur_defconfig
```kconfig
CONFIG_PROJECT_GTS210VE=y
CONFIG_SEC_GTS210VEWIFI_PROJECT=y
CONFIG_MACH_GTS210VEWIFI_EUR_OPEN=y
CONFIG_PROC_DEVICETREE=y

#
# MAX77843 IC
#
# CONFIG_EXTCON is not set
# CONFIG_EXTCON_MAX77843 is not set
# CONFIG_MFD_MAX77843 is not set

# MUIC
CONFIG_USE_MUIC=y
CONFIG_MUIC_NOTIFIER=y
CONFIG_MUIC_UNIVERSAL=y
CONFIG_MUIC_UNIVERSAL_SM5703=y
CONFIG_MUIC_UNIVERSAL_SM5705=y
# CONFIG_MUIC_UNIVERSAL_SM5705_AFC is not set
CONFIG_MUIC_PINCTRL=y
CONFIG_SM5705_SUPPORT_LANHUB=y

CONFIG_USB_HOST_NOTIFY=y

# RUSTPROOF
CONFIG_MUIC_SUPPORT_RUSTPROOF=y

# VBUS_NOTI
CONFIG_VBUS_NOTIFIER=y

#HALL IC
CONFIG_SENSORS_HALL=y
# CONFIG_CERTIFY_HALL is not set

# Service LED
# CONFIG_LEDS_MAX77843_RGB is not set

#
# MOTOR
#
# CONFIG_SS_VIBRATOR is not set

#
# DISPLAY(MDSS)
#
CONFIG_PANEL_ANA38401_AMS968HH01_QXGA=y

#FLASH
#CONFIG_FLASHLIGHT is not set
#CONFIG_SM_FLASH_LED is not set
#CONFIG_LEDS_SM5705 is not set

#CAMERA
CONFIG_S5K6B2YX=y
#CONFIG_MSM_FRONT_EEPROM is not set

# XO SHUTDOWN
CONFIG_UART3=y

#OIS
#CONFIG_MSM_OIS=y
#CONFIG_BU24219_OIS=y
#CONFIG_CAM_EXTERNAL=y

# BATTERY & Charger
# CONFIG_FUELGAUGE_MAX77843 is not set
# CONFIG_FUELGAUGE_MAX77843_COULOMB_COUNTING is not set
# CONFIG_CHARGER_MAX77843 is not set
CONFIG_SAMSUNG_LPM_MODE=y
CONFIG_BATTERY_SAMSUNG=y
CONFIG_PREVENT_SOC_JUMP=y
CONFIG_CHARGER_SM5705=y
CONFIG_FUELGAUGE_SM5705=y
CONFIG_CHARGER_SM5703=y
CONFIG_FUELGAUGE_SM5703=y
CONFIG_CHARGER_SM5703_DUALPATH=y
CONFIG_SEC_MPP_SHARE=y
CONFIG_SW_SELF_DISCHARGING=y
CONFIG_BATTERY_SWELLING=y
# CONFIG_AFC_CHARGER_MODE is not set
CONFIG_BATTERY_SWELLING_SELF_DISCHARGING=y
CONFIG_MUIC_SUPPORT_MULTIMEDIA_DOCK=y
CONFIG_MULTIBATT_SUPPORT=y
CONFIG_INBATVOLT_FG=y
CONFIG_BATTERY_AGE_FORECAST=y

#Power off Alarm
# CONFIG_RTC_AUTO_PWRON is not set
# CONFIG_RTC_AUTO_PWRON_PARAM is not set

#
# InputDevice
#
# CONFIG_TOUCHSCREEN_DUMP_MODE is not set
# CONFIG_SECURE_TOUCH is not set
CONFIG_TOUCHSCREEN_SYNAPTICS_I2C_DSX2=y
CONFIG_KEYBOARD_TC350K=y


# CONFIG_MFD_S2MPB02 is not set
# CONFIG_REGULATOR_S2MPB02 is not set
CONFIG_MFD_SM5705=y
CONFIG_MFD_SM5703=y
CONFIG_REGULATOR_SM5705=y
CONFIG_REGULATOR_SM5703=y

# Finger print sensor
CONFIG_SENSORS_FINGERPRINT=y
CONFIG_SENSORS_FINGERPRINT_SYSFS=y
CONFIG_SENSORS_VFS7XXX=y
CONFIG_SENSORS_FP_SPI_NUMBER=4
CONFIG_SENSORS_FP_SPI_GPIO_START=12
CONFIG_SENSORS_FP_SPI_GPIO_END=15
CONFIG_SENSORS_FP_LOCKSCREEN_MODE=y

#
# Sensor
#
CONFIG_IIO=y
CONFIG_SENSORS=y
CONFIG_SENSORS_CORE=y
CONFIG_IIO_BUFFER_CB=y
CONFIG_IIO_TRIGGERED_BUFFER=y
CONFIG_ST_LSM6DS3_IIO=y
CONFIG_SENSORS_YAS_IIO_MAGNETOMETER=y
CONFIG_SENSORS_CS5032_IIO=y
CONFIG_SENSORS_SX9310_WIFI=y
CONFIG_SENSORS_SX9310_WIFI_DEFENCE_CODE_FOR_TA_NOISE=y
CONFIG_SENSORS_SX9310_WIFI_DEFENCE_CODE_FOR_DAMAGE=y

#NFC
#CONFIG_NFC=y
#CONFIG_SEC_NFC=y
#CONFIG_ESE_P3=y
#CONFIG_ESE_SECURE=y
#CONFIG_ESE_SECURE_SPI_PORT=0
#CONFIG_ESE_SPI_GPIO_START=0
#CONFIG_ESE_SPI_GPIO_END=3

# Bluetooth
CONFIG_MSM_BT_POWER=y

#
# Audio
#
CONFIG_SND_SOC_MSM8X16_WCD=y
# CONFIG_AUDIO_SPEAKER_OUT_NXP_AMP_ENABLE is not set
CONFIG_SND_SOC_MSM8X16_RT5659=y
CONFIG_SND_SOC_SECONDARY_AUXPCM=y

# Earjack
CONFIG_SAMSUNG_JACK=y
CONFIG_INPUT_GPIO=y
CONFIG_SW_100K_TO_GND=y

#MST
# CONFIG_MST_LDO is not set

#Scheduler
CONFIG_SCHED_TASK_BEHAVIOR=y



# SSWAP
CONFIG_SWAP=y
CONFIG_FRONTSWAP=y
CONFIG_ZSMALLOC=y
CONFIG_ZSMALLOC_STAT=y
CONFIG_ZSMALLOC_OBJ_SEQ=n
CONFIG_PGTABLE_MAPPING=y
CONFIG_ZSWAP=y
CONFIG_ZSWAP_ENABLE_WRITEBACK=n
CONFIG_ZSWAP_COMPACTION=y
CONFIG_ZPOOL=y
CONFIG_DIRECT_RECLAIM_FILE_PAGES_ONLY=y
CONFIG_INCREASE_MAXIMUM_SWAPPINESS=y
CONFIG_FIX_INACTIVE_RATIO=y
CONFIG_TIGHT_PGDAT_BALANCE=y
CONFIG_VNSWAP=y
CONFIG_SWAP_ENABLE_READAHEAD=n

# MMAP READAROUND
CONFIG_MMAP_READAROUND_LIMIT=16

# Add Qualcomm Wifi features
CONFIG_NETDEVICES=y
CONFIG_WIRELESS=y
CONFIG_CNSS=y
CONFIG_CNSS_SDIO=y
CONFIG_CLD_HL_SDIO_CORE=y
CONFIG_CLD_DEBUG=y
CONFIG_CLD_LL_CORE=y
CONFIG_WCNSS_MEM_PRE_ALLOC=y
CONFIG_CNSS_MAC_BUG=y
CONFIG_WEXT_CORE=y
CONFIG_WEXT_PROC=y
CONFIG_CFG80211=y
CONFIG_CFG80211_WEXT=y
CONFIG_CFG80211_DEFAULT_PS=y
CONFIG_CFG80211_ALLOW_RECONNECT=y
CONFIG_WLAN=y
CONFIG_CNSS_CRYPTO=y
CONFIG_QCA_CLD_WLAN=y
CONFIG_QCACLD_WLAN_LFR3=y
CONFIG_PRIMA_WLAN_OKC=y
CONFIG_PRIMA_WLAN_11AC_HIGH_TP=y
CONFIG_WLAN_FEATURE_11W=y
CONFIG_WLAN_FEATURE_LPSS=y
CONFIG_QCOM_VOWIFI_11R=y
CONFIG_WLAN_FEATURE_NAN=y
CONFIG_WLAN_FEATURE_NAN_DATAPATH=y
CONFIG_QCOM_TDLS=y
CONFIG_QCOM_LTE_COEX=y
CONFIG_WLAN_FEATURE_MEMDUMP=y
CONFIG_WLAN_OFFLOAD_PACKETS=y
CONFIG_QCA_WIFI_AUTOMOTIVE_CONC=y
CONFIG_WLAN_FEATURE_RX_WAKELOCK=y

#SECDEBUG
CONFIG_DEBUG_NOTIFIERS=y

# EXTEND SERIAL NUM LENGTH
CONFIG_EXTEND_SERIAL_NUM_16=y
```
