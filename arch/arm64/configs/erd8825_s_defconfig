## arch/arm64/configs/exynos9825-eng_defconfig
```kconfig
CONFIG_DEBUG_SNAPSHOT_USER_MODE=n
CONFIG_DEBUG_LIST=n
#
# Memory Debugging
#
CONFIG_DEBUG_PAGEALLOC=y
CONFIG_DEBUG_PAGEALLOC_ENABLE_DEFAULT=y
CONFIG_PAGE_POISONING=y
CONFIG_PAGE_POISONING_ZERO=y
CONFIG_DEBUG_RODATA_TEST=y
CONFIG_SLUB_DEBUG_ON=y
CONFIG_DEBUG_KMEMLEAK=y
CONFIG_DEBUG_MEMORY_INIT=y
CONFIG_DEBUG_PER_CPU_MAPS=y

#
# Lock Debugging (spinlocks, mutexes, etc...)
#
# CONFIG_DEBUG_LOCK_ALLOC=y

#
# Runtime Testing
#
CONFIG_ATOMIC64_SELFTEST=y

#
# ETC (LSI code sync)
#
CONFIG_CGROUP_DEBUG=y
CONFIG_CMA_DEBUGFS=y
CONFIG_PM_DEBUG=y
CONFIG_CMUCAL_DEBUG=y
CONFIG_DEBUG_ATOMIC_SLEEP=y
CONFIG_BUG_ON_DATA_CORRUPTION=y
CONFIG_WQ_WATCHDOG=y
CONFIG_VISION_UNITTEST=y

# ABC Hub bootc eng mode
CONFIG_SEC_ABC_HUB_BOOTC_ENG=y

#
# GPIO verification
#
CONFIG_SEC_GPIO_DVS=y

# UH
# CONFIG_RKP_FIMC_CHECK is not set
# CONFIG_KDP is not set

#
# Battery driver
#
CONFIG_ENG_BATTERY_CONCEPT=y

# EPDG
CONFIG_NET_CORE=y
CONFIG_NET_SCH_PRIO=y
CONFIG_NET_SCHED=y
CONFIG_NET_CLS_BASIC=y
CONFIG_NET_CLS=y
CONFIG_NET_CLS_ACT=y
CONFIG_NET_ACT_MIRRED=y
CONFIG_NET_EMATCH=y
CONFIG_NET_SCH_INGRESS=y
# EPDG

# SDP KeyManagement Test for MDFPP evaluation
CONFIG_SDP_KEY_DUMP=y

#
# DO NOT REMOVE THE LAST BLANK LINE
#
```

## arch/arm64/configs/exynos9825-userdebug_defconfig
```kconfig
CONFIG_DEBUG_SNAPSHOT_USER_MODE=n
#
# ETC (LSI code sync)
#
CONFIG_DEBUG_SNAPSHOT_MINIMIZED_MODE=y
CONFIG_CMUCAL_DEBUG=y

#
# GPIO verification
#
CONFIG_SEC_GPIO_DVS=y

# UH
# CONFIG_RKP_FIMC_CHECK is not set
# CONFIG_KDP is not set

# SDP KeyManagement Test for MDFPP evaluation
CONFIG_SDP_KEY_DUMP=y

#
# DO NOT REMOVE THE LAST BLANK LINE
#
```

## arch/arm64/configs/gki_tmp_allowed_defconfig
```kconfig
# gki_tmp_allowed_defconfig
#   Configs to temporaly allow to change gki_defconfig

# CONFIG_LTO_CLANG_FULL is not set
# CONFIG_TRANSPARENT_HUGEPAGE_MADVISE is not set

CONFIG_HWMON=m
CONFIG_USB_NET_AX8817X=m
CONFIG_USB_NET_AX88179_178A=m
CONFIG_USB_NET_NET1080=m
CONFIG_USB_NET_CDC_SUBSET=m
CONFIG_USB_NET_ZAURUS=m
```
