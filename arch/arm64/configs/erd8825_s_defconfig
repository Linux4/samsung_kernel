## arch/arm64/configs/msm8976_sec_msm8976lte_eur_defconfig
```kconfig
CONFIG_SEC_MSM8976LTE_PROJECT=y
CONFIG_MACH_MSM8976LTE_EUR_OPEN=y
CONFIG_DRV_SAMSUNG=y

#
# MAX77843 IC
#
CONFIG_EXTCON=y
CONFIG_EXTCON_MAX77843=y
CONFIG_MFD_MAX77843=y

#HALL IC
CONFIG_SENSORS_HALL=y
CONFIG_CERTIFY_HALL=y

# Service LED
CONFIG_LEDS_MAX77843_RGB=y

#
# DISPLAY(MDSS)
#
CONFIG_PANEL_S6E3HA2_AMS509ES01_WQHD=y

# BATTERY & Charger
CONFIG_FUELGAUGE_MAX77843=y
CONFIG_FUELGAUGE_MAX77843_COULOMB_COUNTING=y
CONFIG_CHARGER_MAX77843=y
CONFIG_SAMSUNG_LPM_MODE=y
CONFIG_BATTERY_SAMSUNG=y
CONFIG_BATTERY_SAMSUNG_DATA_FILE="tr_battery_data.h"
CONFIG_AFC_CHARGER_MODE=y
#
# InputDevice
#
CONFIG_TOUCHSCREEN_STM=y
CONFIG_KEYBOARD_CYPRESS_TOUCHKEY=y

CONFIG_MFD_S2MPB02=y
CONFIG_REGULATOR_S2MPB02=y

# Finger print sensor
CONFIG_SENSORS_FINGERPRINT=y
CONFIG_SENSORS_FINGERPRINT_SYSFS=y
CONFIG_SENSORS_VFS7XXX=y
CONFIG_SENSORS_FP_SPI_NUMBER=4
CONFIG_SENSORS_FP_SPI_GPIO_START=12
CONFIG_SENSORS_FP_SPI_GPIO_END=15

# HRM Sensor
CONFIG_SENSORS_MAX86902=y
CONFIG_SENSORS_MAX_NOTCHFILTER=y

#NFC
CONFIG_NFC=y
CONFIG_SEC_NFC=y
CONFIG_SEC_NFC_IF_I2C=y
CONFIG_SEC_NFC_PRODUCT_N5=y

#
# Sensor hub
#
CONFIG_SENSORS_SSP=y
CONFIG_SENSORS_SSP_SENSORHUB=y
CONFIG_SENSORS_SYSFS=y
CONFIG_SENSORS_SSP_STM=y
CONFIG_SENSORS_SSP_ATUC128L5HAR=y
CONFIG_SENSORS_SSP_FACTORY=y
#CONFIG_SENSORS_SSP_MPU6500=y
CONFIG_SENSORS_SSP_K6DS3TR=y
CONFIG_SENSORS_SSP_AK09911=y
CONFIG_SENSORS_SSP_BMP280=y
#CONFIG_SENSORS_SSP_LPS25H=y
#CONFIG_SENSORS_SSP_MOBEAM=y
CONFIG_SENSORS_SSP_TMD4903=y
#CONFIG_SENSORS_SSP_MAX88922=y
CONFIG_SENSORS_SSP_INTERRUPT_GYRO_SENSOR=y
CONFIG_AVERAGE=y
CONFIG_SENSORS_ADPD142=y
CONFIG_IIO_BUFFER=y
CONFIG_IIO=y
CONFIG_IIO_KFIFO_BUF=y
CONFIG_IIO_TRIGGER=y
CONFIG_IIO_ST_HWMON=y
CONFIG_ESE_P3=y
CONFIG_ESE_P3_PVDD_EN_CONTROL=y
```

## arch/arm64/configs/msm8996_sec_aeroqlte_vzw_defconfig
```kconfig
# msm8996_sec_aeroqlte_vzw_defconfig
CONFIG_SEC_AEROQLTE_PROJECT=y
CONFIG_MACH_AEROQLTE_VZW=y
CONFIG_BATTERY_SAMSUNG=y
CONFIG_MULTI_CHARGING=y
CONFIG_AFC_CHARGER_MODE=y
CONFIG_CHARGER_MAX77833=y
CONFIG_FUELGAUGE_MAX77833=y
CONFIG_CHARGER_MAX77854=y
CONFIG_FUELGAUGE_MAX77854=y
CONFIG_CHARGER_DA9155=y
CONFIG_WIRELESS_CHARGER_P9220=y
CONFIG_WIRELESS_CHARGER_HIGH_VOLTAGE=y
CONFIG_WIRELESS_FIRMWARE_UPDATE=y
CONFIG_SAMSUNG_LPM_MODE=y
CONFIG_BATTERY_SWELLING=y
CONFIG_SW_SELF_DISCHARGING=y
CONFIG_CALC_TIME_TO_FULL=y
CONFIG_CHARGING_VZWCONCEPT=y
CONFIG_LEDS_MAX77833_RGB=y
CONFIG_MOTOR_DRV_MAX77833=y
CONFIG_SS_VIBRATOR=y
# CONFIG_QPNP_HAPTIC is not set

# MAX77838 Display SUB PMIC
CONFIG_REGULATOR_MAX77838=y
# S2MPB02 Camera SUB PMIC
CONFIG_LEDS_S2MPB02=y
CONFIG_MFD_S2MPB02=y
CONFIG_REGULATOR_S2MPB02=y

# Input Device
CONFIG_TOUCHSCREEN_STM=y
CONFIG_TOUCHSCREEN_SEC_TS=y
CONFIG_KEYBOARD_CYPRESS_TOUCHKEY=y
CONFIG_KEYBOARD_ABOV_TOUCH_FT16XX=y

# display
CONFIG_PANEL_S6E3HA2_AMS509ES01_WQHD=y
CONFIG_PANEL_S6E3HA3_AMS567JA01_WQHD=y
CONFIG_PANEL_S6E3HF4_AMB526JS01_WQHD=y

# Finger print sensor
CONFIG_SENSORS_FINGERPRINT=y
CONFIG_SENSORS_FINGERPRINT_SYSFS=y
CONFIG_SENSORS_VFS7XXX=y
CONFIG_SENSORS_FP_SPI_NUMBER=6
CONFIG_SENSORS_FP_SPI_GPIO_START=25
CONFIG_SENSORS_FP_SPI_GPIO_END=28
#CONFIG_SENSORS_FP_MASTER_ID=86

#NFC
CONFIG_SAMSUNG_NFC=y
CONFIG_NFC_PN547=y
CONFIG_NFC_PN547_ESE_SUPPORT=y
CONFIG_NFC_PM_BBCLK2=y
CONFIG_ESE_SECURE=y
CONFIG_ESE_SPI_GPIO_START=58
CONFIG_ESE_SPI_GPIO_END=61
CONFIG_ESE_SECURE_SPI_PORT=11

#MST
CONFIG_MST_LDO=y

#
# DSM Solution
#
CONFIG_SND_SOC_MAX98506=y
CONFIG_SND_SOC_MAXIM_DSM=y
CONFIG_SND_SOC_MAXIM_DSM_CAL=y

# Audio
CONFIG_SND_SOC_PRIMARY_MI2S=y
CONFIG_SND_SOC_TERTIARY_AUXPCM=y
CONFIG_SND_SOC_ALWAYS_ON_MIC=y
CONFIG_SND_SOC_WCD_MBHC_ADC=y

# Sensor
CONFIG_SENSORS_MAX86902=y
CONFIG_AVERAGE=y
# CONFIG_BMI168_FACTORY is not set
CONFIG_K6DS3_FACTORY=y
CONFIG_AK09911C_FACTORY=y
CONFIG_BMP280_FACTORY=y
CONFIG_TMD490X_FACTORY=y
# CONFIG_SENSORS_SX9310 is not set
# CONFIG_SENSORS_SX9310_NORMAL_TOUCH_THRESHOLD is not set

# CAMERA
CONFIG_COMPANION2=y
CONFIG_COMPANION3=y
#CONFIG_CAMERA_SYSFS_V2=y
#CONFIG_MSM_FRONT_EEPROM=y
CONFIG_SAMSUNG_OIS=y
CONFIG_SENSOR_RETENTION=y

# USB
CONFIG_USB_RNDIS_VZW_REQ=y

# RADIO
CONFIG_VIDEO_V4L2=y
CONFIG_RADIO_RTC6213N=y
CONFIG_I2C_RTC6213N=y

# SECURITY
CONFIG_VPNCLIENT_SECURITY=y

# EPDG
CONFIG_NET_CORE=y
CONFIG_NET_SCH_PRIO=y
CONFIG_NET_SCHED=y   #depends on CONFIG_NET  which is enabled by default.. coz not seeing in the config file
CONFIG_NET_CLS_BASIC=y # required if basic is being used as a filter. depends on CONFIG_NET_CLS so enabling it by default
CONFIG_NET_CLS=y
CONFIG_NET_CLS_ACT=y # for enabling the action target.
CONFIG_NET_ACT_MIRRED=y  # for enabling the mirred target for redirecting the packet between the devices.
CONFIG_NET_EMATCH=y   #basic uses extended matches so this has to be present
CONFIG_NET_SCH_INGRESS=y # classifier for ingress packet

# KASLR
# CONFIG_RELOCATABLE_KERNEL is not set
```
