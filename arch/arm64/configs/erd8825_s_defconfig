## arch/arm64/configs/lego_defconfig
```kconfig
CONFIG_MTK_CHARGER=y
# CONFIG_ICD is not set
# CONFIG_SECURITY_DEFEX is not set
# CONFIG_PROCA is not set
CONFIG_SEC_VIBRATOR=y
CONFIG_SEC_VIB_NOTIFIER=y
CONFIG_SEC_NFC_LOGGER=y
# CONFIG_SECURITY_DSMS is not set
# CONFIG_FIVE_TEE_DRIVER is not set
CONFIG_FUELGAUGE_MTK=y
CONFIG_SEC_ABC=y
CONFIG_SEC_ABC_HUB=y
CONFIG_SEC_ABC_COMMON=y
# CONFIG_SEC_ABC_MOTTO is not set
CONFIG_SEC_ABC_HUB_CORE=y
# CONFIG_SEC_ABC_HUB_COND is not set
CONFIG_SEC_ABC_HUB_BOOTC=y
CONFIG_USE_MUIC=y
CONFIG_MUIC_NOTIFIER=y
CONFIG_VBUS_NOTIFIER=y
CONFIG_SEC_STI=y
CONFIG_SEC_AUTO_INPUT=y
CONFIG_SEC_INPUT_BOOSTER=y
CONFIG_SEC_INPUT_BOOSTER_MTK=y
# CONFIG_TZIC is not set
CONFIG_SENSORS_FINGERPRINT=y
CONFIG_USB_TYPEC_MANAGER_NOTIFIER=y
CONFIG_IF_CB_MANAGER=y
CONFIG_PDIC_NOTIFIER=y
CONFIG_SEC_DETECT_CONN=y
CONFIG_QCOM_SEC_DETECT=m
CONFIG_INPUT_HALL_IC=y
CONFIG_SENSORS_SEC_THERMISTOR=y
CONFIG_SHUB_MODULE=y
CONFIG_SHUB_PM_WAKEUP_LINUX_VER_5_4=y
CONFIG_SHUB_AP_STATUS_CMD=y
CONFIG_SHUB_MTK=y
# CONFIG_SHUB_FIRMWARE_DOWNLOAD is not set
CONFIG_BATTERY_SAMSUNG=y
CONFIG_BATTERY_AGE_FORECAST=y
CONFIG_BATTERY_CISD=y
CONFIG_BATTERY_NOTIFIER=y
CONFIG_USB_FACTORY_MODE=y
CONFIG_AFC_CHARGER_MODE=y
CONFIG_SUPPORT_HV_CTRL=y
CONFIG_DISCRETE_CHARGER=y
CONFIG_DC_VIBRATOR=y
# CONFIG_MTK_VIBRATOR is not set
CONFIG_IIO=y
CONFIG_IIO_BUFFER=y
CONFIG_IIO_KFIFO_BUF=y
CONFIG_SHUB=y
CONFIG_SENSORS_ET5XX=y
CONFIG_FINGERPRINT_SECURE=y
CONFIG_SENSORS_FINGERPRINT_MTK=y
CONFIG_SEC_NFC=y
#CONFIG_ESE_P3_LSI is not set
#CONFIG_ESE_SECURE is not set
```
