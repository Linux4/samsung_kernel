## arch/arm64/configs/erd8825_s_defconfig
```kconfig
CONFIG_CMDLINE_EXTEND=y
CONFIG_TOUCHSCREEN_SEC_TS=m

CONFIG_KEYBOARD_S2MPU13=m
CONFIG_MFD_S2MPU13=m
CONFIG_MFD_S2MPU14=m
CONFIG_MFD_S2MPB02=m
CONFIG_REGULATOR_S2MPU13=m
CONFIG_REGULATOR_S2MPU14=m
CONFIG_REGULATOR_S2MPB02=m
CONFIG_REGULATOR_S2MPB03=m
CONFIG_REGULATOR_S2DOS05=m
CONFIG_RTC_DRV_S2MPU13=m
CONFIG_S2MPU13_ADC=m
CONFIG_PINCTRL_SAMSUNG_S2MPU13=m
CONFIG_PINCTRL_SAMSUNG_S2MPU14=m
CONFIG_SND_SOC_SAMSUNG_EXYNOS_CS35L41_I2C=m
CONFIG_SND_SOC_SAMSUNG_EXYNOS8825_SOUND=m
CONFIG_SND_SOC_SAMSUNG_EXYNOS8825_S5M3700X_I2C=m
CONFIG_SND_SOC_S5M3700X=m
CONFIG_SND_SOC_S5M3700X_DUMP=m
CONFIG_SND_SOC_S5M3700X_VTS=m
CONFIG_SSND_SOC_S5M3700X_HIFI=m

CONFIG_USE_S2M_MUIC=m
CONFIG_MUIC_SYSFS=y
CONFIG_MUIC_CORE=y
CONFIG_MUIC_MANAGER=y
CONFIG_MUIC_S2MF301=m
CONFIG_MUIC_SUPPORT_CCIC=y
CONFIG_S2MF301_MUIC_SDP_OVP_OFF=y

CONFIG_USE_S2M_PDIC=m
CONFIG_PDIC_S2MF301=y
CONFIG_PDIC_AUDIO_ACC=y
CONFIG_CHECK_CTYPE_SIDE=y
CONFIG_SUPPORT_USB_TYPEC_OPS=y
CONFIG_PDIC_SUPPORT_DP=y
CONFIG_PDIC_PD30=y

CONFIG_IFCONN_NOTIFIER_MODULE=m
CONFIG_IFCONN_NOTIFIER=y
CONFIG_IFCONN_MANAGER=y

CONFIG_FUELGAUGE_S2MF301=m
CONFIG_CHARGER_S2MF301=m
CONFIG_MFD_S2MF301=m
CONFIG_LEDS_S2MF301_FLASH=m
CONFIG_PM_S2MF301=m
CONFIG_MANAGER_S2M_CHARGER=m
CONFIG_S2M_THERMAL=m
CONFIG_TOP_S2MF301=m
CONFIG_TOP_S2MF301_SUPPORT_S2MC501=y
CONFIG_CHARGER_S2MC501=m
CONFIG_DIRECT_CHARGER=n

CONFIG_USB_NOTIFY_LAYER_LSI=y
CONFIG_USB_NOTIFY_LAYER_MODULE=m
CONFIG_USB_NOTIFIER=m

CONFIG_OTG_CDP_SUPPORT=y

CONFIG_DRM_PANEL_SAMSUNG_S6E3HAB=m
CONFIG_EXYNOS_BTS=m
CONFIG_DRM_SAMSUNG_DOZE=y
CONFIG_EXYNOS_PLL_SLEEP=y
CONFIG_EXYNOS_CMD_SVSYNC=y

CONFIG_CAMERA_CIS_2L4_OBJ=m
CONFIG_CAMERA_CIS_3M5_OBJ=m
CONFIG_CAMERA_CIS_3P9_OBJ=m
CONFIG_CAMERA_CIS_3H1_OBJ=m
CONFIG_CAMERA_FLASH_S2MF301_OBJ=m
CONFIG_CAMERA_ACT_AK737X_OBJ=m

CONFIG_SENSOR_DRV=y

# SECNFC
CONFIG_SEC_NFC=m
CONFIG_SEC_NFC_PRODUCT_N5=y
CONFIG_SEC_NFC_IF_I2C=y
CONFIG_SEC_NFC_GPIO_CLK=y
CONFIG_SEC_NFC_DEDICATED_CLK=y
CONFIG_SEC_NFC_PMIC_LDO=y

CONFIG_HWMON=m
CONFIG_SENSORS_EXYNOS_NTC_THERMISTOR=m

CONFIG_MODEM_IF_LEGACY_QOS=m
CONFIG_CH_EXTENSION=m
```

## arch/arm64/configs/erd9925_evt0_s5300_s_defconfig
```kconfig
CONFIG_CMDLINE="panic_on_warn=0 "
CONFIG_CMDLINE_EXTEND=y
CONFIG_KEYBOARD_S2MPS25=m
CONFIG_MFD_S2MPS25=m
CONFIG_MFD_S2MPS26=m
CONFIG_MFD_S2MPB02=m
CONFIG_MFD_S2MPM07=m
CONFIG_REGULATOR_S2MPS25=m
CONFIG_REGULATOR_S2MPS26=m
CONFIG_REGULATOR_S2MPM07=m
CONFIG_REGULATOR_S2MPB02=m
CONFIG_REGULATOR_S2MPB03=m
CONFIG_REGULATOR_S2DOS05=m
CONFIG_RTC_DRV_S2MPS25=m
CONFIG_S2MPS25_ADC=m
CONFIG_PINCTRL_SAMSUNG_S2MPS26=m
CONFIG_PINCTRL_SAMSUNG_S2MPM07=m
CONFIG_TOUCHSCREEN_SEC_TS=m
CONFIG_SND_SOC_SAMSUNG_EXYNOS_CS35L41_I2C=m
CONFIG_SND_SOC_SAMSUNG_EXYNOS9925_SOUND=m

CONFIG_USE_S2M_MUIC=m
CONFIG_MUIC_SYSFS=y
CONFIG_MUIC_CORE=y
CONFIG_MUIC_MANAGER=y
CONFIG_MUIC_S2MU106=m
CONFIG_MUIC_SUPPORT_CCIC=y

CONFIG_USE_S2M_PDIC=m
CONFIG_PDIC_S2MU106=y
CONFIG_PDIC_AUDIO_ACC=y
CONFIG_CHECK_CTYPE_SIDE=y
CONFIG_SUPPORT_USB_TYPEC_OPS=y
CONFIG_PDIC_SUPPORT_DP=y

CONFIG_IFCONN_NOTIFIER_MODULE=m
CONFIG_IFCONN_NOTIFIER=y
CONFIG_IFCONN_MANAGER=y

CONFIG_USB_NOTIFY_LAYER_LSI=y
CONFIG_USB_NOTIFY_LAYER_MODULE=m
CONFIG_USB_NOTIFIER=m

CONFIG_FUELGAUGE_S2MU106=m
CONFIG_CHARGER_S2MU106=m
CONFIG_MFD_S2MU106=m
CONFIG_LEDS_S2MU106_FLASH=m
CONFIG_PM_S2MU106=m
CONFIG_MANAGER_S2M_CHARGER=m
CONFIG_S2M_THERMAL=m
CONFIG_SWITCHING_S2ASL01=m

CONFIG_CAMERA_CIS_2LD_OBJ=m
CONFIG_CAMERA_CIS_GW2_OBJ=m
CONFIG_CAMERA_CIS_2LA_OBJ=m
CONFIG_CAMERA_CIS_3H1_OBJ=m

CONFIG_CAMERA_FLASH_S2MU106_OBJ=m
CONFIG_CAMERA_ACT_AK737X_OBJ=m

CONFIG_DRM_SAMSUNG_DP=y
CONFIG_DRM_PANEL_SAMSUNG_S6E3HAB=m

CONFIG_EXYNOS_EL2=m
CONFIG_EXYNOS_S2MPU=m

CONFIG_SENSOR_DRV=y

# CONFIG_SEC_MODEM_S5000AP is not set
# CONFIG_EXYNOS_CPIF_IOMMU is not set
# CONFIG_HW_REV_DETECT is not set
# CONFIG_REINIT_VSS is not set
# CONFIG_VERIFY_VSS is not set
# CONFIG_CPIF_DIRECT_DM is not set
# CONFIG_GNSS_PMUCAL is not set
# CONFIG_EXYNOS_GNSS_IF is not set
# CONFIG_CP_UART_NOTI is not set

CONFIG_SEC_MODEM_S5100=m
CONFIG_SHM_IPC=m
CONFIG_MODEM_IF_QOS=m
CONFIG_PCI_EXYNOS_S5E9925_S5300=m
# CONFIG_PCI_EXYNOS_S5E9925 is not set
CONFIG_LINK_DEVICE_PCIE_IOMMU=y
# CONFIG_SUSPEND_DURING_VOICE_CALL is not set
# CONFIG_CPIF_DIRECT_DM is not set
# CONFIG_CPIF_VENDOR_HOOK is not set
```

## arch/arm64/configs/erd9925_s_defconfig
```kconfig
CONFIG_CMDLINE="panic_on_warn=0 "
CONFIG_CMDLINE_EXTEND=y
CONFIG_KEYBOARD_S2MPS25=m
CONFIG_MFD_S2MPS25=m
CONFIG_MFD_S2MPS26=m
CONFIG_MFD_S2MPB02=m
CONFIG_MFD_S2MPM07=m
CONFIG_REGULATOR_S2MPS25=m
CONFIG_REGULATOR_S2MPS26=m
CONFIG_REGULATOR_S2MPM07=m
CONFIG_REGULATOR_S2MPB02=m
CONFIG_REGULATOR_S2MPB03=m
CONFIG_REGULATOR_S2DOS05=m
CONFIG_RTC_DRV_S2MPS25=m
CONFIG_S2MPS25_ADC=m
CONFIG_PINCTRL_SAMSUNG_S2MPS26=m
CONFIG_PINCTRL_SAMSUNG_S2MPM07=m
CONFIG_TOUCHSCREEN_SEC_TS=m
CONFIG_SND_SOC_SAMSUNG_EXYNOS_CS35L41_I2C=m
CONFIG_SND_SOC_SAMSUNG_EXYNOS9925_SOUND=m

CONFIG_USE_S2M_MUIC=m
CONFIG_MUIC_SYSFS=y
CONFIG_MUIC_CORE=y
CONFIG_MUIC_MANAGER=y
CONFIG_MUIC_S2MU106=m

CONFIG_USE_S2M_PDIC=m
CONFIG_PDIC_S2MU106=y
CONFIG_PDIC_AUDIO_ACC=y
CONFIG_CHECK_CTYPE_SIDE=y
CONFIG_SUPPORT_USB_TYPEC_OPS=y
CONFIG_PDIC_SUPPORT_DP=y

CONFIG_IFCONN_NOTIFIER_MODULE=m
CONFIG_IFCONN_NOTIFIER=y
CONFIG_IFCONN_MANAGER=y

CONFIG_USB_NOTIFY_LAYER_LSI=y
CONFIG_USB_NOTIFY_LAYER_MODULE=m
CONFIG_USB_NOTIFIER=m

CONFIG_FUELGAUGE_S2MU106=m
CONFIG_CHARGER_S2MU106=m
CONFIG_MFD_S2MU106=m
CONFIG_LEDS_S2MU106_FLASH=m
CONFIG_PM_S2MU106=m
CONFIG_MANAGER_S2M_CHARGER=m
CONFIG_S2M_THERMAL=m
CONFIG_SWITCHING_S2ASL01=m

CONFIG_CAMERA_CIS_2LD_OBJ=m
CONFIG_CAMERA_CIS_GW2_OBJ=m
CONFIG_CAMERA_CIS_2LA_OBJ=m
CONFIG_CAMERA_CIS_3H1_OBJ=m

CONFIG_CAMERA_FLASH_S2MU106_OBJ=m
CONFIG_CAMERA_ACT_AK737X_OBJ=m

CONFIG_DRM_SAMSUNG_DP=y
CONFIG_DRM_PANEL_SAMSUNG_S6E3HAB=m
CONFIG_DRM_SAMSUNG_DOZE=y

CONFIG_SENSOR_DRV=y
CONFIG_NANOHUB=m

# NPU
CONFIG_VISION_CORE=y
CONFIG_VISION_SUPPORT=y
CONFIG_EXYNOS_NPU=m
CONFIG_NPU_MAILBOX_VERSION=9
CONFIG_NPU_COMMAND_VERSION=10
CONFIG_NPU_INTERFACE=y
CONFIG_NPU_HARDWARE=y
CONFIG_NPU_USE_IMB_ALLOCATOR=y
CONFIG_NPU_USE_MAILBOX_GROUP=n
CONFIG_NPU_USE_HW_DEVICE=y
CONFIG_NPU_USE_BOOT_IOCTL=y
CONFIG_DSP_USE_VS4L=y
#CONFIG_NPU_USE_VOTF=y

CONFIG_EXYNOS_CMD_SVSYNC=y
```

## arch/arm64/configs/exynos-eng_defconfig
```kconfig
#
# Kernel Performance Events and Counters
#
CONFIG_SLUB_DEBUG=y
CONFIG_PROFILING=y

#
# SAMSUNG EXYNOS SoCs Support
#
CONFIG_EXYNOS_ASV_MARGIN_TEST=y

#
# Kernel hacking
#
CONFIG_SLUB_DEBUG_ON=y
# CONFIG_DEBUG_KMEMLEAK is not set
CONFIG_DEBUG_PREEMPT=y
CONFIG_DEBUG_RT_MUTEXES=y
CONFIG_DEBUG_PI_LIST=y
CONFIG_DEBUG_SPINLOCK=y
CONFIG_DEBUG_MUTEXES=y
CONFIG_DEBUG_LOCK_ALLOC=y
CONFIG_PROVE_LOCKING=y
CONFIG_DEBUG_ATOMIC_SLEEP=y
CONFIG_DEBUG_STACK_USAGE=y
CONFIG_DEBUG_MEMORY_INIT=y
CONFIG_DEBUG_LIST=y
CONFIG_DEBUG_SG=y

#
# RCU Debugging
#
# CONFIG_DEBUG_PAGEALLOC is not set
CONFIG_ATOMIC64_SELFTEST=y
```

## arch/arm64/configs/exynos-userdebug_defconfig
```kconfig
#
# Kernel Performance Events and Counters
#
# CONFIG_SLUB_DEBUG is not set
# CONFIG_PROFILING is not set

#
# SAMSUNG EXYNOS SoCs Support
#
# CONFIG_EXYNOS_ASV_MARGIN_TEST is not set

#
# Kernel hacking
#
# CONFIG_SLUB_DEBUG_ON is not set
# CONFIG_DEBUG_KMEMLEAK is not set
# CONFIG_DEBUG_PREEMPT is not set
# CONFIG_DEBUG_RT_MUTEXES is not set
# CONFIG_DEBUG_PI_LIST is not set
# CONFIG_DEBUG_SPINLOCK is not set
# CONFIG_DEBUG_MUTEXES is not set
# CONFIG_DEBUG_LOCK_ALLOC is not set
# CONFIG_PROVE_LOCKING is not set
# CONFIG_DEBUG_ATOMIC_SLEEP is not set
# CONFIG_DEBUG_STACK_USAGE is not set
# CONFIG_DEBUG_LIST is not set
# CONFIG_DEBUG_SG is not set

#
# RCU Debugging
#
# CONFIG_DEBUG_PAGEALLOC is not set
# CONFIG_ATOMIC64_SELFTEST is not set

CONFIG_SYSFS=y
CONFIG_BLOCK=y
CONFIG_TRACING_SUPPORT=y
CONFIG_FTRACE=y
# mmc_add_trace() is not defined
# CONFIG_BLK_DEV_IO_TRACE is not set
CONFIG_FUNCTION=y
CONFIG_FUNCTION_GRAPH=y
```

## arch/arm64/configs/exynos2100-base_defconfig
```kconfig
CONFIG_ARCH_EXYNOS=y
CONFIG_SERIAL_SAMSUNG=y
CONFIG_SERIAL_SAMSUNG_CONSOLE=y
CONFIG_SERIAL_EXYNOS=m
CONFIG_I2C_CHARDEV=m
CONFIG_I2C_EXYNOS5=m
CONFIG_SPI_S3C64XX=m
CONFIG_SPI_SPIDEV=m
CONFIG_PINCTRL_SAMSUNG=m
CONFIG_SND_SOC_SAMSUNG=m
CONFIG_SND_SOC_SAMSUNG_EXYNOS2100=m
CONFIG_SND_SOC_SAMSUNG_ABOX_DEBUG=y
CONFIG_MALI_DDK_VALHALL_R26P0=y
CONFIG_MALI_MIDGARD=m
CONFIG_MALI_EXPERT=y
CONFIG_MALI_DEBUG_SYS=y
CONFIG_MALI_DEBUG_KERNEL_SYSFS=y
CONFIG_MALI_RT_PM=y
CONFIG_MALI_DVFS=y
CONFIG_MALI_PM_QOS=y
CONFIG_MALI_COHERENCY=n
# CONFIG_MALI_KUTF is not set
CONFIG_SOC_EXYNOS2100=y
CONFIG_EXYNOS_CHIPID_V2=m
# CONFIG_RUNTIME_TESTING_MENU is not set
CONFIG_SCHED_EMS=m
CONFIG_CPU_IDLE=y
CONFIG_CPU_IDLE_GOV_TEO=y
CONFIG_EXYNOS_CPUHP=m
CONFIG_ARM_EXYNOS_ACME=m
CONFIG_ARM_FREQ_QOS_TRACER=m
CONFIG_ARM_EXYNOS_DSU_FREQ=m
CONFIG_EXYNOS_AFM=m
CONFIG_SCHED_EMS=m
CONFIG_SCHED_EMS_TUNE=y
CONFIG_SCHED_USE_FLUID_RT=y
CONFIG_CPU_FREQ_GOV_ENERGYSTEP=y
CONFIG_VENDOR_NR_CPUS=8
# CONFIG_PM_DEVFREQ is not set
CONFIG_COMMON_CLK_SAMSUNG=m
CONFIG_DEBUG_FS=y
CONFIG_EXYNOS_PMU_IF=m
CONFIG_CAL_IF=m
CONFIG_CMUCAL_DEBUG=y
CONFIG_EXYNOS_PD=m
CONFIG_EXYNOS_PD_DBG=m
CONFIG_EXYNOS_EL2=m
CONFIG_EXYNOS_EL2_ENABLE_CHECK=m
CONFIG_EXYNOS_S2MPU=m
CONFIG_EXYNOS_ACPM=m
CONFIG_EXYNOS_ACPM_MFD_BUS=m
CONFIG_S3C2410_WATCHDOG=m
CONFIG_S3C2410_SHUTDOWN_REBOOT=y
CONFIG_EXYNOS_MODEM_IF=m
CONFIG_SEC_MODEM_S5000AP=m
CONFIG_CP_PKTPROC=m
CONFIG_CP_BTL=m
CONFIG_HW_REV_DETECT=m
CONFIG_CPIF_TP_MONITOR=m
CONFIG_CP_LLC=m
CONFIG_EXYNOS_DIT=m
CONFIG_REINIT_VSS=m
CONFIG_VERIFY_VSS=m
CONFIG_PWM_SAMSUNG=m
CONFIG_CLKSRC_EXYNOS_MCT=m
CONFIG_SAMSUNG_IOMMU=m
CONFIG_DRV_SAMSUNG_PMIC=m
CONFIG_SCSI_UFS_EXYNOS=m
CONFIG_SCSI_UFS_EXYNOS_FMP=y
CONFIG_UFS_SRPMB=m
CONFIG_SCSI_UFS_EXYNOS_SRPMB=y
CONFIG_FB=m
CONFIG_PHY_EXYNOS_MIPI=m
CONFIG_PHY_EXYNOS_MIPI_DSIM=m
CONFIG_EXYNOS_DPU30=m
CONFIG_FB_MODE_HELPERS=y
CONFIG_EXTCON=m
# CONFIG_EXYNOS_DISPLAYPORT is not set
# CONFIG_EXYNOS_DISPLAYPORT_MODULE is not set
CONFIG_EXYNOS_WINDOW_UPDATE=y
CONFIG_EXYNOS_HIBERNATION=y
CONFIG_EXYNOS_HIBERNATION_EARLY_WAKEUP=y
CONFIG_EXYNOS_SBWC_LIBREQ=y
CONFIG_DECON_BTS_LEGACY=y
CONFIG_EXYNOS_FREQ_HOP=y
CONFIG_EXYNOS_PLL_SLEEP=y
CONFIG_EXYNOS_EWR=y
CONFIG_EXYNOS_COMMON_PANEL=y
CONFIG_EXYNOS_SUPPORT_READBACK=y
CONFIG_EXYNOS_SUPPORT_WB=y
# CONFIG_EXYNOS_SUPPORT_HWFC is not set
CONFIG_EXYNOS_SUPPORT_VOTF_IN=y
CONFIG_EXYNOS_MULTIRESOLUTION=y
CONFIG_EXYNOS_DOZE=y
CONFIG_EXYNOS_CURSOR=y
CONFIG_EXYNOS_SUPPORT_8K_SPLIT=y
CONFIG_EXYNOS_DECON_DQE=y
CONFIG_BACKLIGHT_LCD_SUPPORT=y
CONFIG_EXYNOS_FPS_CHANGE_NOTIFY=y
CONFIG_EXYNOS_DMA_DSIMFC=y
CONFIG_VIDEO_EXYNOS_MFC=m
CONFIG_EXYNOS_DEBUG=y
CONFIG_DEBUG_SNAPSHOT=m
CONFIG_DEBUG_SNAPSHOT_SFRDUMP=m
CONFIG_DEBUG_SNAPSHOT_QUICKDUMP=m
CONFIG_EXYNOS_DEBUG_TEST=m
CONFIG_EXYNOS_ADV_TRACER=m
CONFIG_EXYNOS_ADV_TRACER_S2D=m
CONFIG_POWER_RESET_EXYNOS=m
CONFIG_EXYNOS_CHIPID_V2=m
CONFIG_USB_XHCI_ALLOC_FROM_DMA_POOL=y
CONFIG_USB_DWC3=y
CONFIG_USB_DWC3_MODULE=m
CONFIG_SND_EXYNOS_USB_AUDIO=y
CONFIG_USB_DWC3_GADGET=y
CONFIG_USB_PORT_POWER_OPTIMIZATION=y
CONFIG_USB_RNDIS_MULTIPACKET=y
CONFIG_USB_DWC3_EXYNOS=m
CONFIG_USB_XHCI_EXYNOS=m
CONFIG_USB_XHCI_HCD=m
CONFIG_USB_PRINTER=m
CONFIG_SND_EXYNOS_USB_AUDIO_MODULE=m
CONFIG_USB_CONFIGFS_F_DM=m
CONFIG_USB_CONFIGFS_F_MTP=m
CONFIG_USB_CONFIGFS_F_PTP=m
CONFIG_DMABUF_SAMSUNG_HEAPS=m
CONFIG_DMABUF_HEAPS_SAMSUNG_CMA=y
CONFIG_DMABUF_HEAPS_SAMSUNG_CARVEOUT=y
CONFIG_DMABUF_HEAPS_SAMSUNG_SYSTEM=y
CONFIG_EXYNOS_CORESIGHT=m
CONFIG_EXYNOS_ECC_HANDLER=m
CONFIG_EXYNOS_MEMORY_LOGGER=m
CONFIG_EXYNOS_SYSTEM_EVENT=m
CONFIG_EXYNOS_IMGLOADER=m
CONFIG_EXYNOS_HARDLOCKUP_WATCHDOG=m
CONFIG_EXYNOS_ITMON=m
CONFIG_ECT=m
CONFIG_EXYNOS_DVFS_MANAGER=m
CONFIG_ACPM_DVFS=m
CONFIG_EXYNOS_PM_QOS=m
CONFIG_ARM_EXYNOS_DEVFREQ=m
CONFIG_EXYNOS_ALT_DVFS=m
CONFIG_ARM_EXYNOS_DEVFREQ_DEBUG=m
CONFIG_EXYNOS_DEBUG_FREQ=m
CONFIG_EXYNOS_THERMAL_V2=m
CONFIG_EXYNOS_ACPM_THERMAL=m
CONFIG_EXYNOS_CPU_THERMAL=m
CONFIG_ISP_THERMAL=m
# CONFIG_GPU_THERMAL is not set
CONFIG_DEV_THERMAL=m
CONFIG_THERMAL_EMULATION=y
CONFIG_THERMAL_GOV_POWER_ALLOCATOR=y
CONFIG_THERMAL_STATISTICS=y
CONFIG_EXYNOS_MCINFO=m
CONFIG_MCINFO_SYSFS=y
CONFIG_EXYNOS_BTS=m
CONFIG_EXYNOS_SCI=m
CONFIG_EXYNOS_SCI_DBG=m
CONFIG_EXYNOS_BCM_DBG=m
CONFIG_EXYNOS_PM=m
CONFIG_EXYNOS_FLEXPMU_DBG=m
CONFIG_VIDEO_EXYNOS_SMFC=m
CONFIG_VIDEO_EXYNOS_SCALER=m
CONFIG_VIDEO_EXYNOS_REPEATER=m
CONFIG_VIDEO_EXYNOS_TSMUX=m
```
