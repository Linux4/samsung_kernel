## arch/arm64/configs/m53x_00_defconfig
```kconfig
# CONFIG_LOCALVERSION_AUTO is not set
CONFIG_PREEMPT=y
CONFIG_IKHEADERS=m
CONFIG_LOG_BUF_SHIFT=19
CONFIG_UCLAMP_TASK=y
CONFIG_BLK_CGROUP=y
CONFIG_UCLAMP_TASK_GROUP=y
CONFIG_CPUSETS=y
CONFIG_SCHED_TUNE=y
# CONFIG_RD_BZIP2 is not set
# CONFIG_RD_LZMA is not set
# CONFIG_RD_XZ is not set
# CONFIG_RD_LZO is not set
# CONFIG_RD_LZ4 is not set
CONFIG_SYSCTL_SYSCALL=y
# CONFIG_FHANDLE is not set
CONFIG_KALLSYMS_ALL=y
# CONFIG_KALLSYMS_BASE_RELATIVE is not set
CONFIG_MTK_SCHED_EXTENSION=y
CONFIG_MTK_IDLE_BALANCE_ENHANCEMENT=y
CONFIG_MTK_SCHED_INTEROP=y
CONFIG_MTK_SCHED_LB_ENHANCEMENT=y
CONFIG_MTK_SCHED_TRACERS=y
CONFIG_MTK_SCHED_CPU_PREFER=y
CONFIG_MTK_SCHED_BIG_TASK_MIGRATE=y
CONFIG_SLUB_DEBUG=y
CONFIG_ARCH_MEDIATEK=y
CONFIG_MACH_MT6877=y
CONFIG_SCHED_MC=y
CONFIG_NR_CPUS=8
CONFIG_ARM64_DMA_USE_IOMMU=y
CONFIG_RANDOMIZE_BASE=y
CONFIG_CMDLINE="console=tty0 console=ttyMT3,921600n1 root=/dev/ram vmalloc=496M slub_max_order=0 "
# CONFIG_EFI is not set
CONFIG_PM_DEBUG=y
CONFIG_WQ_POWER_EFFICIENT_DEFAULT=y
CONFIG_ENERGY_MODEL=y
CONFIG_CPU_FREQ=y
CONFIG_CPU_FREQ_STAT=y
CONFIG_CPU_FREQ_DEFAULT_GOV_SCHEDUTIL=y
CONFIG_CPU_FREQ_GOV_POWERSAVE=y
CONFIG_CPU_FREQ_GOV_USERSPACE=y
CONFIG_CPU_FREQ_GOV_ONDEMAND=y
CONFIG_KPROBES=y
CONFIG_MODULE_SRCVERSION_ALL=y
# CONFIG_BLK_DEV_BSG is not set
CONFIG_BLK_INLINE_ENCRYPTION=y
CONFIG_BLK_INLINE_ENCRYPTION_FALLBACK=y
CONFIG_CFQ_GROUP_IOSCHED=y
# CONFIG_CORE_DUMP_DEFAULT_ELF_HEADERS is not set
CONFIG_ZSMALLOC=y
CONFIG_RBIN=y
CONFIG_XFRM_MIGRATE=y
CONFIG_SYN_COOKIES=y
CONFIG_VLAN_8021Q=y
CONFIG_CLS_U32_PERF=y
CONFIG_CLS_U32_MARK=y
CONFIG_BT=y
CONFIG_CFG80211=y
CONFIG_NL80211_TESTMODE=y
CONFIG_CFG80211_DEVELOPER_WARNINGS=y
# CONFIG_CFG80211_DEFAULT_PS is not set
# CONFIG_UEVENT_HELPER is not set
CONFIG_EXTRA_FIRMWARE="valhall-1691526.wa"
CONFIG_EXTRA_FIRMWARE_DIR="firmware"
CONFIG_FW_LOADER_USER_HELPER=y
CONFIG_FW_LOADER_USER_HELPER_FALLBACK=y
# CONFIG_FW_CACHE is not set
CONFIG_ZRAM=y
CONFIG_BLK_DEV_LOOP_MIN_COUNT=16
CONFIG_ANDROID_DEFAULT_SETTING=y
CONFIG_MTK_ANDROID_DEFAULT_SETTING=y
CONFIG_MTK_TC10_FEATURE=y
CONFIG_MTK_PLATFORM="mt6853"
CONFIG_ARCH_MTK_PROJECT="k6877v1_64_titan_syberian_tiger"
CONFIG_NONLINEAR_FREQ_CTL=y
CONFIG_MTK_PTPOD=y
CONFIG_MTK_STATIC_POWER=y
CONFIG_MTK_UNIFY_POWER=y
CONFIG_MTK_APUSYS_SUPPORT=y
CONFIG_MTK_APUSYS_RT_SUPPORT=y
CONFIG_MTK_APUSYS_MDLA_SUPPORT=y
CONFIG_MTK_CPU_FREQ=y
CONFIG_MTK_PTPOD_GPU=y
CONFIG_MTK_PBM=y
CONFIG_MTK_PMIC_NEW_ARCH=y
CONFIG_MTK_PMIC_COMMON=y
CONFIG_MTK_PMIC_CHIP_MT6359P=y
CONFIG_MTK_EXTERNAL_CHARGER_TYPE_DETECT=y
CONFIG_MTK_NO_USE_BATON=y
CONFIG_MFD_MT6360_PMU=y
CONFIG_MT6360_PMU_CHARGER=y
CONFIG_MT6360_PMU_FLED=y
CONFIG_MT6360_PMIC=y
CONFIG_MT6360_LDO=y
CONFIG_MTK_SEC_VIDEO_PATH_SUPPORT=y
CONFIG_MTK_SVP_ON_MTEE_SUPPORT=y
CONFIG_MTK_DRM_KEY_MNG_SUPPORT=y
CONFIG_CUSTOM_KERNEL_IMGSENSOR="s5khm6_mipi_raw imx616_mipi_raw imx355_mipi_raw gc02m1b_mipi_raw gc02m1_mipi_raw"
CONFIG_MTK_SYNC=y
CONFIG_MTK_LCM_PHYSICAL_ROTATION="0"
CONFIG_LCM_HEIGHT="2400"
CONFIG_MTK_AAL_SUPPORT=y
CONFIG_MTK_PQ_COLOR_MODE="DISP_MDP"
CONFIG_MTK_PSEUDO_M4U=y
CONFIG_MTK_FLASHLIGHT=y
CONFIG_MTK_FLASHLIGHT_MT6360=y
CONFIG_MTK_FLASHLIGHT_PT=y
CONFIG_MTK_FLASHLIGHT_PT_STRICT=y
CONFIG_MTK_FLASHLIGHT_DLPT=y
CONFIG_MTK_IMGSENSOR=y
CONFIG_IMGSENSOR_SYSFS=y
CONFIG_MTK_LENS=y
CONFIG_MTK_CAM_CAL=y
CONFIG_MTK_CMDQ=y
CONFIG_MTK_CMDQ_MBOX_EXT=y
CONFIG_MTK_VPU_SUPPORT=y
CONFIG_MTK_SMI_EXT=y
CONFIG_MTK_CCU=y
CONFIG_MTK_CAM_SECURITY_SUPPORT=y
CONFIG_MTK_CAM_GENIEZONE_SUPPORT=y
CONFIG_NANOHUB=y
CONFIG_NANOHUB_MTK_IPI=y
CONFIG_MTK_CCCI_DEVICES=y
CONFIG_MTK_MD1_SUPPORT=25
CONFIG_MTK_ECCCI_DRIVER=y
CONFIG_MTK_ECCCI_C2K=y
CONFIG_MTK_SRIL_SUPPORT=y
CONFIG_DEV_RIL_BRIDGE=y
CONFIG_NET_SUPPORT_DROPDUMP=y
CONFIG_INET6_AH=y
CONFIG_IP_NF_MATCH_AH=y
CONFIG_NET_ACT_POLICE=y
CONFIG_IP_NF_MATCH_RPFILTER=y
CONFIG_MTK_BTIF=y
CONFIG_MTK_COMBO=y
CONFIG_MTK_COMBO_CHIP_CONSYS_6877=y
CONFIG_MTK_COMBO_GPS=y
CONFIG_MTK_COMBO_WIFI=y
CONFIG_MTK_DHCPV6C_WIFI=y
CONFIG_MTK_GPS_SUPPORT=y
CONFIG_MTK_GPS_EMI=y
CONFIG_MTK_FMRADIO=y
CONFIG_MTK_FM_CHIP="MT6635_FM"
CONFIG_MTK_CONNSYS_DEDICATED_LOG_PATH=y
CONFIG_MTK_MDDP_SUPPORT=y
CONFIG_MTK_TEE_GP_SUPPORT=y
CONFIG_HAVE_MTK_ENABLE_GENIEZONE=y
CONFIG_MTK_ENABLE_GENIEZONE=y
CONFIG_MTK_GZ_MAIN=y
CONFIG_MTK_GZ_LOG=y
CONFIG_MTK_GZ_VIRTIO=y
CONFIG_MTK_GZ_VIRTIO_IPC=y
CONFIG_MTK_GZ_IRQ=y
CONFIG_HAVE_MTK_GZ_LOG=y
CONFIG_EXTCON_MTK_USB=y
CONFIG_MTK_USB_TYPEC_U3_MUX_V2=y
CONFIG_TCPC_CLASS=y
CONFIG_TCPC_MT6360=y
CONFIG_USB_POWER_DELIVERY=y
CONFIG_MTK_GATE_IC=y
CONFIG_RT4831A_I2C=y
CONFIG_MTK_PWM=y
CONFIG_MTK_AURISYS_PHONE_CALL_SUPPORT=y
CONFIG_MTK_AUDIODSP_SUPPORT=y
CONFIG_MTK_RTC=y
CONFIG_MTK_PERF_COMMON=y
CONFIG_MTK_PERF_TRACKER=y
# CONFIG_MTK_LOAD_TRACKER is not set
# CONFIG_MTK_CPU_CTRL_CFP is not set
CONFIG_MTK_PERF_OBSERVER=y
CONFIG_MTK_RESYM=y
# CONFIG_MTK_FPSGO_V3 is not set
CONFIG_MTK_TASK_TURBO=y
CONFIG_MTK_TINYSYS_SCP_SUPPORT=y
CONFIG_MTK_TINYSYS_SSPM_SUPPORT=y
CONFIG_MTK_TINYSYS_SSPM_V2=y

CONFIG_MTK_HIGH_FRAME_RATE=y
CONFIG_MTK_MET_PLF=m
CONFIG_MTPROF=y
CONFIG_MTK_AEE_HANGDET=y
CONFIG_MTK_CM_MGR_LEGACY=y
CONFIG_MTK_VIBRATOR=y
CONFIG_MTK_LEGACY_THERMAL=y
CONFIG_MTK_THERMAL_PA_VIA_ATCMD=y
CONFIG_MTK_CAMERA_ISP_RSC_SUPPORT=y
CONFIG_MTK_CAMERA_ISP_WPE_SUPPORT=y
CONFIG_MTK_CAMERA_ISP_DPE_SUPPORT=y
CONFIG_MTK_CAMERA_ISP_MFB_SUPPORT=y
CONFIG_MTK_CAMERA_ISP_FD_SUPPORT=y
CONFIG_MTK_TINYSYS_MCUPM_SUPPORT=y
CONFIG_MTK_DRAM_LOG_STORE=y
CONFIG_MTK_DRAM_LOG_STORE_ADDR=0x0011DF00
CONFIG_MTK_DRAM_LOG_STORE_SIZE=0x100
CONFIG_MTK_VOW_DSP_VERSION="ver02"
CONFIG_MTK_FREQ_HOPPING=y
CONFIG_SCSI=y
CONFIG_BLK_DEV_SD=y
CONFIG_SCSI_SCAN_ASYNC=y
CONFIG_SCSI_UFSHCD=y
CONFIG_SCSI_UFSHCD_PLATFORM=y
CONFIG_SCSI_UFS_MEDIATEK=y
CONFIG_SCSI_UFS_FEATURE=y
CONFIG_SCSI_UFS_TW=y
CONFIG_SCSI_UFS_CRYPTO=y
CONFIG_BLK_IO_VOLUME=y
CONFIG_BLK_TURBO_WRITE=y
CONFIG_DM_CRYPT=y
CONFIG_DM_DEFAULT_KEY=y
CONFIG_DM_UEVENT=y
CONFIG_DM_VERITY_FEC=y
CONFIG_IFB=y
# CONFIG_ETHERNET is not set
CONFIG_PPP_FILTER=y
CONFIG_PPP_MULTILINK=y
CONFIG_PPPOE=y
CONFIG_PPP_ASYNC=y
CONFIG_PPP_SYNC_TTY=y
CONFIG_USB_USBNET=y
# CONFIG_KEYBOARD_ATKBD is not set
CONFIG_KEYBOARD_MTK=y
CONFIG_TWOKEY_REBOOT_NORMAL_MODE=y
CONFIG_TWOKEY_REBOOT_OTHER_MODE=y
CONFIG_KPD_PWRKEY_USE_PMIC=y
# CONFIG_INPUT_MOUSE is not set
CONFIG_INPUT_TOUCHSCREEN=y
CONFIG_INPUT_MISC=y
CONFIG_INPUT_UINPUT=y
# CONFIG_VT is not set
CONFIG_LEGACY_PTY_COUNT=16
# CONFIG_DEVMEM is not set
CONFIG_SERIAL_8250=y
CONFIG_SERIAL_8250_CONSOLE=y
CONFIG_SERIAL_8250_NR_UARTS=2
CONFIG_SERIAL_8250_RUNTIME_UARTS=2
CONFIG_SERIAL_8250_MT6577=y
CONFIG_I2C_MTK=y
CONFIG_SPI=y
CONFIG_SPI_MT65XX=y
CONFIG_SPMI=y
CONFIG_MTK_PMIF=y
CONFIG_MTK_CHARGER=y
CONFIG_MTK_KERNEL_POWER_OFF_CHARGING=y
CONFIG_MTK_GAUGE_VERSION=30
CONFIG_HWMON=y
CONFIG_THERMAL=y
CONFIG_THERMAL_DEFAULT_GOV_BACKWARD_COMPATIBLE=y
CONFIG_WATCHDOG=y
CONFIG_MEDIATEK_WATCHDOG=y
CONFIG_WATCHDOG_CORE=y
CONFIG_SOFT_WATCHDOG=y
CONFIG_SEC_DEBUG_SOFTDOG_PWDT=y
CONFIG_MFD_MT6358=y
CONFIG_MT6358_MISC=y
CONFIG_MTK_MFD_SPMI_PMIC=y
CONFIG_REGULATOR_MT6315=y
CONFIG_REGULATOR_MT6359P=y
CONFIG_REGULATOR_RT5133=y
CONFIG_MEDIA_SUPPORT=y
CONFIG_MEDIA_CAMERA_SUPPORT=y
CONFIG_VIDEO_V4L2_SUBDEV_API=y
CONFIG_V4L2_FLASH_LED_CLASS=y
CONFIG_V4L_PLATFORM_DRIVERS=y
CONFIG_V4L_MEM2MEM_DRIVERS=y
CONFIG_VIDEO_MEDIATEK_JPEG=y
CONFIG_VIDEO_MEDIATEK_VCODEC=y
CONFIG_DRM=y
CONFIG_DRM_MEDIATEK=y
CONFIG_MTK_GPU_SUPPORT=y
CONFIG_MTK_GPU_VERSION="mali valhall r32p1"
CONFIG_MTK_GPU_COMMON_DVFS_SUPPORT=y
CONFIG_FB_MODE_HELPERS=y
CONFIG_FB_TILEBLITTING=y
CONFIG_LOGO=y
CONFIG_SND_HRTIMER=y
CONFIG_SND_DYNAMIC_MINORS=y
CONFIG_SND_VERBOSE_PRINTK=y
CONFIG_SND_DEBUG=y
CONFIG_SND_DEBUG_VERBOSE=y
CONFIG_SND_PCM_XRUN_DEBUG=y
CONFIG_SND_SEQUENCER=y
CONFIG_SND_SEQ_DUMMY=y
CONFIG_SND_USB_AUDIO=y
CONFIG_SND_SOC=y
CONFIG_SND_SOC_MT6877_MT6359=y
CONFIG_SND_SOC_MTK_BTCVSD=y
CONFIG_SND_SOC_MTK_AUDIO_DSP=y
CONFIG_SND_SOC_RT5512=y
CONFIG_HIDRAW=y
CONFIG_HID_A4TECH=y
CONFIG_HID_APPLE=y
CONFIG_HID_BELKIN=y
CONFIG_HID_CHERRY=y
CONFIG_HID_CHICONY=y
CONFIG_HID_CYPRESS=y
CONFIG_HID_DRAGONRISE=y
CONFIG_HID_EZKEY=y
CONFIG_HID_KYE=y
CONFIG_HID_GYRATION=y
CONFIG_HID_TWINHAN=y
CONFIG_HID_KENSINGTON=y
CONFIG_HID_LOGITECH=y
CONFIG_HID_MAGICMOUSE=y
CONFIG_HID_MICROSOFT=y
CONFIG_HID_MONTEREY=y
CONFIG_HID_PANTHERLORD=y
CONFIG_HID_PETALYNX=y
CONFIG_HID_SAMSUNG=y
CONFIG_HID_SUNPLUS=y
CONFIG_HID_GREENASIA=y
CONFIG_HID_SMARTJOYPLUS=y
CONFIG_HID_TOPSEED=y
CONFIG_HID_THRUSTMASTER=y
CONFIG_HID_ZEROPLUS=y
CONFIG_USB_HIDDEV=y
CONFIG_HID_WALTOP=y
CONFIG_HID_BATTERY_STRENGTH=y
CONFIG_HID_HOLTEK=y
CONFIG_HID_EMS_FF=y
CONFIG_HID_UCLOGIC=y
CONFIG_HID_ACRUX=y
CONFIG_HID_ELECOM=y
CONFIG_HID_PRODIKEYS=y
CONFIG_HID_LCPOWER=y
CONFIG_HID_PICOLCD=y
CONFIG_HID_ROCCAT=y
CONFIG_HID_SPEEDLINK=y
CONFIG_HID_NTRIG=y
CONFIG_PLAYSTATION_FF=y
CONFIG_HID_LOGITECH_DJ=y
CONFIG_HID_TIVO=y
CONFIG_HID_PLANTRONICS=y
CONFIG_HID_WACOM=y
CONFIG_HID_KEYTOUCH=y
CONFIG_HID_ORTEK=y
CONFIG_HID_PLAYSTATION=y
CONFIG_HID_MULTITOUCH=y
CONFIG_HID_WIIMOTE=y
CONFIG_HID_ACRUX_FF=y
CONFIG_HID_PRIMAX=y
CONFIG_HID_STEAM=y
CONFIG_HID_ZYDACRON=y
CONFIG_HID_SAITEK=y
CONFIG_LOGITECH_FF=y
CONFIG_LOGIG940_FF=y
CONFIG_LOGIRUMBLEPAD2_FF=y
CONFIG_JOYSTICK_XPAD_FF=y
CONFIG_SMARTJOYPLUS_FF=y
CONFIG_DRAGONRISE_FF=y
CONFIG_PANTHERLORD_FF=y
CONFIG_GREENASIA_FF=y
CONFIG_SONY_FF=y
CONFIG_JOYSTICK_XPAD_LEDS=y
CONFIG_INPUT_TABLET=y
CONFIG_TABLET_USB_GTCO=y
CONFIG_TABLET_USB_KBTAB=y
CONFIG_TABLET_USB_ACECAD=y
CONFIG_TABLET_USB_HANWANG=y
CONFIG_TABLET_USB_AIPTEK=y
CONFIG_TABLET_USB_WACOM=y
CONFIG_USB_RTL8150=y
CONFIG_USB_RTL8152=y
CONFIG_USB_NET_CDC_EEM=y
CONFIG_USB_NET_SMSC75XX=y
CONFIG_USB_NET_SMSC95XX=y
CONFIG_USB_NET_CDC_MBIM=y
CONFIG_USB_PRINTER=y
CONFIG_USB_ACM=y
CONFIG_USB_SERIAL=y
CONFIG_USB_ANNOUNCE_NEW_DEVICES=y
CONFIG_USB_DEBUG_DETAILED_LOG=y
CONFIG_USB_OTG=y
CONFIG_USB_XHCI_HCD=y
CONFIG_USB_STORAGE=y
CONFIG_USB_STORAGE_DATAFAB=y
CONFIG_USB_STORAGE_FREECOM=y
CONFIG_USB_STORAGE_ISD200=y
CONFIG_USB_STORAGE_USBAT=y
CONFIG_USB_STORAGE_SDDR09=y
CONFIG_USB_STORAGE_SDDR55=y
CONFIG_USB_STORAGE_JUMPSHOT=y
CONFIG_USB_STORAGE_ALAUDA=y
CONFIG_USB_STORAGE_ONETOUCH=y
CONFIG_USB_STORAGE_KARMA=y
CONFIG_USB_STORAGE_CYPRESS_ATACB=y
CONFIG_USB_MTU3=y
CONFIG_NOP_USB_XCEIV=y
CONFIG_USB_GADGET_VBUS_DRAW=500
CONFIG_SWITCH=y
CONFIG_USB_NOTIFY_LAYER=y
CONFIG_USB_HOST_NOTIFY=y
CONFIG_USB_NOTIFY_PROC_LOG=y
CONFIG_USB_AUDIO_ENHANCED_DETECT_TIME=y
CONFIG_USB_EXTERNAL_NOTIFY=y
CONFIG_USB_NOTIFIER=y
CONFIG_USB_HW_PARAM=y
CONFIG_CABLE_TYPE_NOTIFIER=y
CONFIG_USB_CONFIGFS_SERIAL=y
CONFIG_USB_CONFIGFS_ACM=y
CONFIG_USB_CONFIGFS_RNDIS=y
CONFIG_USB_CONFIGFS_MASS_STORAGE=y
CONFIG_USB_CONFIGFS_MTK_FASTMETA=y
CONFIG_USB_CONFIGFS_F_HID=y
CONFIG_USB_CONFIGFS_F_DM=y
CONFIG_USB_CONFIGFS_F_CONN_GADGET=y
CONFIG_USB_CONFIGFS_F_SS_MON_GADGET=y
CONFIG_SAMSUNG_PHY_TUNE=y
CONFIG_MMC=y
CONFIG_MMC_BLOCK_MINORS=32
CONFIG_MMC_CRYPTO=y
CONFIG_MTK_EMMC_SUPPORT_OTP=y
CONFIG_MMC_CQHCI=y
CONFIG_MMC_MTK=y
CONFIG_NEW_LEDS=y
CONFIG_LEDS_CLASS=y
CONFIG_LEDS_CLASS_FLASH=y
CONFIG_LEDS_TRIGGERS=y
CONFIG_LEDS_TRIGGER_TIMER=y
# CONFIG_RTC_SYSTOHC is not set
CONFIG_RTC_DRV_MT6358=y
CONFIG_DMADEVICES=y
CONFIG_MTK_UART_APDMA=y
CONFIG_ANDROID_INTF_ALARM_DEV=y
CONFIG_ION=y
CONFIG_MTK_ION=y
CONFIG_COMMON_CLK_MT6877_APU=y
CONFIG_COMMON_CLK_MT6877_AUDIOSYS=y
CONFIG_COMMON_CLK_MT6877_CAM=y
CONFIG_COMMON_CLK_MT6877_IMG=y
CONFIG_COMMON_CLK_MT6877_I2C=y
CONFIG_COMMON_CLK_MT6877_IPESYS=y
CONFIG_COMMON_CLK_MT6877_MDPSYS=y
CONFIG_COMMON_CLK_MT6877_MFGCFG=y
CONFIG_COMMON_CLK_MT6877_DISPSYS=y
CONFIG_COMMON_CLK_MT6877_MSDC=y
CONFIG_COMMON_CLK_MT6877_SCP_ADSP=y
CONFIG_COMMON_CLK_MT6877_VDE=y
CONFIG_COMMON_CLK_MT6877_VEN=y
CONFIG_MTK_IOMMU_V2=y
CONFIG_MTK_IOMMU_PGTABLE_EXT=34
CONFIG_RPMSG_MTK=y
CONFIG_MTK_PMIC_WRAP=y
CONFIG_MTK_IPI=y
CONFIG_MTK_MBOX=y
CONFIG_IIO=y
CONFIG_IIO_BUFFER=y
CONFIG_IIO_KFIFO_BUF=y
CONFIG_MEDIATEK_MT6577_AUXADC=y
CONFIG_MT635X_AUXADC=y
CONFIG_PWM=y
CONFIG_PWM_MTK_DISP=y
CONFIG_PHY_MTK_TPHY=y
CONFIG_MTK_DEVINFO=y
CONFIG_TEE=y
CONFIG_TZDEV=y
CONFIG_TZDEV_IWI_EVENT=338
CONFIG_TZDEV_IWI_PANIC=339
CONFIG_TZDEV_SWD_PANIC_IS_CRITICAL=y
CONFIG_TZLOG=y
CONFIG_TZLOG_PG_CNT=8
CONFIG_TZDEV_SK_MULTICORE=y
CONFIG_TZIRS=y
CONFIG_TZ_BOOT_LOG=y
CONFIG_TEEGRIS_VERSION=4
CONFIG_TEEGRIS_VERSION_STRING="4.2.1"
CONFIG_TEEGRIS_TEE_SUPPORT=y
CONFIG_SAMSUNG_TUI=y
CONFIG_FS_ENCRYPTION_INLINE_CRYPT=y
CONFIG_QUOTA_NETLINK_INTERFACE=y
CONFIG_INCREMENTAL_FS=y
CONFIG_ISO9660_FS=y
CONFIG_JOLIET=y
CONFIG_ZISOFS=y
CONFIG_MSDOS_FS=y
CONFIG_VFAT_FS=y
CONFIG_SDCARD_FS=y
CONFIG_PSTORE=y
CONFIG_PSTORE_CONSOLE=y
CONFIG_PSTORE_PMSG=y
CONFIG_PSTORE_RAM=y
# CONFIG_NETWORK_FILESYSTEMS is not set
CONFIG_NLS_CODEPAGE_437=y
CONFIG_NLS_CODEPAGE_950=y
CONFIG_NLS_ASCII=y
CONFIG_NLS_ISO8859_1=y
CONFIG_NLS_UTF8=y
CONFIG_STATIC_USERMODEHELPER=y
CONFIG_STATIC_USERMODEHELPER_PATH="/system_ext/bin/aee_core_forwarder"
# CONFIG_SECURITY_SELINUX_DEVELOP is not set
CONFIG_CRYPTO_TWOFISH=y

# Power configs
CONFIG_SEC_PM=y
CONFIG_CPU_FREQ_LIMIT=y
CONFIG_SEC_THERMAL_LOG=y
CONFIG_FOTA_LIMIT=y
CONFIG_MTK_SEC_VFE28_CONTROL_ENABLE=y

# CONFIG_CRYPTO_HW is not set
CONFIG_PRINTK_TIME=y
CONFIG_DYNAMIC_DEBUG=y
CONFIG_DEBUG_INFO=y
CONFIG_FRAME_WARN=3600
CONFIG_DEBUG_SECTION_MISMATCH=y
CONFIG_SECTION_MISMATCH_WARN_ONLY=y
CONFIG_PANIC_ON_OOPS=y
CONFIG_PANIC_TIMEOUT=1
CONFIG_SCHEDSTATS=y
# CONFIG_DEBUG_PREEMPT is not set
CONFIG_RCU_CPU_STALL_TIMEOUT=60
CONFIG_FAULT_INJECTION=y
CONFIG_CM_OFFSET=3146292
CONFIG_FMM_LOCK_OFFSET=3146356

# TEEgris
CONFIG_TZDEV_USE_ARM_CALLING_CONVENTION=y
CONFIG_TZDEV=y
CONFIG_TZDEV_IWI_EVENT=338
CONFIG_TZDEV_IWI_PANIC=339
CONFIG_TZDEV_KTHREADS_SMPBOOT=y
CONFIG_TZDEV_SK_MULTICORE=y
CONFIG_ION_FD2PHYS=y
CONFIG_ION_FD2PHYS_USE_ION_FROM_STAGING=y
CONFIG_TZIRS=y
CONFIG_TZLOG=y
CONFIG_TZLOG_PG_CNT=8
CONFIG_TZ_BOOT_LOG=y
CONFIG_TZ_BOOT_LOG_PG_CNT=1
CONFIG_TZ_TRANSPORT=y
CONFIG_TZ_TRANSPORT_PG_CNT=2
CONFIG_TZDEV_SWD_PANIC_IS_CRITICAL=y
CONFIG_TEEGRIS_VERSION=4

# [ SEC_SELINUX_PORTING_COMMON
CONFIG_EXT4_FS_XATTR=y
CONFIG_EXT4_FS_SECURITY=y
CONFIG_JOURNAL_DATA_TAG=y
CONFIG_AUDIT=y
CONFIG_LSM_MMAP_MIN_ADDR=4096
CONFIG_SECURITY_SELINUX=y
CONFIG_DEFAULT_SECURITY_SELINUX=y
CONFIG_NETFILTER_ADVANCED=y
CONFIG_NETFILTER_XT_TARGET_LOG=y
CONFIG_SECURITY_SELINUX_DEVELOP=y
CONFIG_AUDITSYSCALL=y
CONFIG_PROC_AVC=y
CONFIG_SDCARD_FS_XATTR=y
CONFIG_ECRYPT_FS_VIRTUAL_FAT_XATTR=y
CONFIG_FAT_VIRTUAL_XATTR=y
CONFIG_EXFAT_VIRTUAL_XATTR=y
# ] SEC_SELINUX_PORTING_COMMON

#RKP
CONFIG_UH=y
CONFIG_UH_DEBUG=y
CONFIG_RKP=y
CONFIG_KDP=y
CONFIG_KDP_CRED=y
CONFIG_KDP_NS=y
CONFIG_RKP_TEST=y
CONFIG_KDP_TEST=y

# ePDG
CONFIG_NET_CORE=y
CONFIG_NET_SCH_PRIO=y
CONFIG_NET_CLS_BASIC=y # required if basic is being used as a filter. depends on CONFIG_NET_CLS so enabling it by default
CONFIG_NET_CLS=y

# TCP congestion algorithm
CONFIG_TCP_CONG_ADVANCED=y
CONFIG_TCP_CONG_BIC=y
CONFIG_DEFAULT_BIC=y
CONFIG_DEFAULT_TCP_CONG="bic"
####[LEGO-START] DO NOT SUBMIT

CONFIG_SECURITY_DEFEX=y
CONFIG_PROCA=y
CONFIG_SEC_VIBRATOR=y
CONFIG_SEC_NFC_LOGGER=y
CONFIG_SECURITY_DSMS=y
CONFIG_MUIC_NOTIFIER=y
CONFIG_USE_MUIC=y
CONFIG_SEC_STI=y
CONFIG_SEC_INPUT_BOOSTER=y
CONFIG_SEC_INPUT_BOOSTER_MTK=y
CONFIG_SB_CORE=y
CONFIG_SB_PQUEUE=y
CONFIG_SB_NOTIFY=y
CONFIG_SB_SYSFS=y
CONFIG_SB_VOTE=y
CONFIG_KPERFMON=y
CONFIG_KPERFMON_BUILD=m
CONFIG_VIBRATOR_VIB_INFO=y
CONFIG_INPUT_SEC_INPUT=y
CONFIG_SEC_DEBUG_TSP_LOG=y
# CONFIG_INPUT_SEC_SECURE_TOUCH is not set
CONFIG_TOUCHSCREEN_DUMP_MODE=y
CONFIG_INPUT_TOUCHSCREEN_TCLMV2=y
# CONFIG_TOUCHSCREEN_DUAL_FOLDABLE is not set
# CONFIG_INPUT_SEC_NOTIFIER is not set
CONFIG_VBUS_NOTIFIER=y
CONFIG_SENSORS_FINGERPRINT=y
CONFIG_USB_TYPEC_MANAGER_NOTIFIER=y
CONFIG_IF_CB_MANAGER=y
CONFIG_MTK_CHARGER=y
CONFIG_FUELGAUGE_MTK=y
CONFIG_SEC_ABC_SPEC_TYPE1=y
CONFIG_PDIC_NOTIFIER=y
CONFIG_SEC_ABC=y
CONFIG_SEC_ABC_HUB=y
CONFIG_SEC_ABC_COMMON=y
CONFIG_SEC_ABC_HUB_CORE=y
CONFIG_SEC_ABC_HUB_BOOTC=y
# CONFIG_SEC_ABC_MOTTO is not set
CONFIG_I2C_GPIO=y
CONFIG_CHARGER_SM5451=y
CONFIG_SEC_PM_THERMISTOR=y
CONFIG_SENSORS_ET5XX=y
CONFIG_FINGERPRINT_SECURE=y
CONFIG_SENSORS_FINGERPRINT_MTK=y
CONFIG_SENSORS_SUPPORT_MTK=y
CONFIG_SENSORS_ISG6320=y
CONFIG_SENSORS_ISG6320_SUB=y
# CONFIG_SENSORS_ISG6320_WIFI is not set
CONFIG_SENSORS_ISG5320A=y
CONFIG_SENSORS_ISG5320A_SUB=y
# CONFIG_TEST_FOR_GRIP is not set
# CONFIG_SENSORS_CORE_AP is not set
CONFIG_SHUB_MODULE=y
CONFIG_SHUB_PM_WAKEUP_LINUX_VER_5_4=y
CONFIG_SHUB_AP_STATUS_CMD=y
CONFIG_SHUB_MTK=y
# CONFIG_SHUB_FIRMWARE_DOWNLOAD is not set
CONFIG_SAMSUNG_NFC=y
CONFIG_NFC_ST21NFC=y
# CONFIG_NFC_ST54SPI_ESE_SUPPORT is not set
CONFIG_MTK_NFC_CLKBUF_ENABLE=y
CONFIG_DC_VIBRATOR=y
# CONFIG_MTK_VIBRATOR is not set
CONFIG_REGULATOR_S2MPB03=y
CONFIG_DIRECT_CHARGING=y
CONFIG_IIO=y
CONFIG_IIO_BUFFER=y
CONFIG_IIO_KFIFO_BUF=y
CONFIG_SHUB=y
CONFIG_TOUCHSCREEN_SYNAPTICS=y
CONFIG_BATTERY_SAMSUNG=y
CONFIG_SEC_PD=y
CONFIG_BATTERY_GKI=y
CONFIG_BATTERY_AGE_FORECAST=y
CONFIG_BATTERY_CISD=y
CONFIG_AFC_CHARGER_MODE=y
CONFIG_STEP_CHARGING=y
CONFIG_SUPPORT_HV_CTRL=y
CONFIG_USB_FACTORY_MODE=y
####[LEGO-END] DO NOT SUBMIT
# CONFIG_MTK_LEDS is not set
# CONFIG_LEDS_MTK_I2C is not set
CONFIG_REGULATOR_FIXED_VOLTAGE=y
# CONFIG_DRM_PANEL_BOE_SW83109_CMD is not set
CONFIG_SMCDSD_PANEL=y
CONFIG_SMCDSD_DPUI=y
CONFIG_SMCDSD_MDNIE=y
CONFIG_SMCDSD_DOZE=y
CONFIG_SMCDSD_DYNAMIC_MIPI=y
CONFIG_SMCDSD_PANEL_M53X=y
CONFIG_BACKLIGHT_LCD_SUPPORT=y
CONFIG_LCD_CLASS_DEVICE=y
CONFIG_BACKLIGHT_CLASS_DEVICE=y
# CONFIG_BACKLIGHT_GENERIC is not set
CONFIG_SND_SOC_CS35L41=y
CONFIG_SND_SOC_CS35L41_I2C=y
CONFIG_SND_SOC_CIRRUS_AMP=y
CONFIG_SND_SOC_WM_ADSP_ANDROID_R=y
CONFIG_SND_SOC_SAMSUNG_AUDIO=y
CONFIG_IMGSENSOR_CUSTOM_CAMERA=y
CONFIG_CAMERA_MMV_V53X=y
CONFIG_CAMERA_SAMSUNG_MODEL_NAME="mmv_v53x"
CONFIG_CAMERA_SENSOR0="s5khm6_mipi_raw"
CONFIG_CAMERA_SENSOR1="imx616_mipi_raw"
CONFIG_CAMERA_SENSOR2="imx355_mipi_raw"
CONFIG_CAMERA_SENSOR3="gc02m1b_mipi_raw"
CONFIG_CAMERA_SENSOR4="gc02m1_mipi_raw"
#CONFIG_CAMERA_ADAPTIVE_MIPI=y
CONFIG_KEYBOARD_GPIO=y
CONFIG_AFC_CHARGER=y
CONFIG_FAULT_AROUND_4KB=n
CONFIG_MMAP_READAROUND_LIMIT=0
CONFIG_SEC_AUTO_INPUT=y
CONFIG_EROFS_FS=y
CONFIG_SAMSUNG_PRODUCT_SHIP=y


CONFIG_FIVE=y




CONFIG_PROCA_S_OS=y


# CONFIG_FIVE_TEE_DRIVER is not set


# CONFIG_FIVE_PA_FEATURE is not set


CONFIG_GAF=y


CONFIG_GAF_V6=y






CONFIG_F2FS_FS=y


CONFIG_F2FS_FS_SECURITY=y


CONFIG_F2FS_FS_ENCRYPTION=y


CONFIG_F2FS_FS_COMPRESSION=y


CONFIG_EXT4_FS_POSIX_ACL=y


CONFIG_NTFS_FS=y


CONFIG_NTFS_DEBUG=y


CONFIG_NLS=y
```
