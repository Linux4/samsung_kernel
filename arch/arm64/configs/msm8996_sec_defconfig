## arch/arm64/configs/s5e8825-eng_defconfig
```kconfig
# fs-verity
CONFIG_FS_VERITY_DEBUG=y

#Sensor Hub
CONFIG_SHUB_DEBUG=y

# Power Management
CONFIG_PINCTRL_SEC_GPIO_DVS=m

# ABC driver bootc eng option
CONFIG_SEC_ABC_HUB_BOOTC_ENG=y

# Pablo Obte support
CONFIG_PABLO_OBTE_SUPPORT=m

# SDP KeyManagement Test for MDFPP evaluation
CONFIG_SDP_KEY_DUMP=y

# Micro Hypervisor
# CONFIG_RKP_FIMC_CHECK is not set
# CONFIG_KDP is not set
# CONFIG_KDP_CRED is not set
# CONFIG_KDP_NS is not set
# CONFIG_KDP_TEST is not set

CONFIG_LOG_BUF_SHIFT=21

#
# please don't remove new line on this file
#
```

## arch/arm64/configs/s5e8825-sec_defconfig
```kconfig
#
# Please leave the first line blank
#

# SEC CONFIGS
CONFIG_SEC_DEBUG=m
CONFIG_LOG_BUF_SHIFT=18
CONFIG_SEC_REBOOT=m
CONFIG_SEC_KEY_NOTIFIER=m
CONFIG_SEC_PMIC_PWRKEY_DTNAME="s2mpu13-keys"
CONFIG_SEC_BOOTSTAT=m
CONFIG_SEC_MPARAM=m
CONFIG_DRV_SAMSUNG=m
CONFIG_SEC_WAKEUP_CPU_ALLOCATOR=m

# Samsung Mobile Power Management
CONFIG_PM_DEBUG=y
CONFIG_SEC_PM=y
CONFIG_SEC_PM_DEBUG=m
CONFIG_SEC_PM_THERMISTOR=m

# Network Feature
CONFIG_INET6_AH=y
CONFIG_IP_NF_MATCH_AH=y
CONFIG_TCP_CONG_ADVANCED=y
CONFIG_TCP_CONG_BIC=y
CONFIG_DEFAULT_BIC=y
CONFIG_DEFAULT_TCP_CONG="bic" 
CONFIG_IP_NF_MATCH_RPFILTER=y

# GKI: Allow KMI symbol list
CONFIG_KMI_SYMBOL_LISTS="android/abi_gki_aarch64 android/abi_gki_aarch64_core android/abi_gki_aarch64_db845c android/abi_gki_aarch64_exynos android/abi_gki_aarch64_generic android/abi_gki_aarch64_hikey960 android/abi_gki_aarch64_qcom android/abi_gki_aarch64_virtual_device android/abi_gki_aarch64_galaxy android/abi_gki_aarch_galaxy_presubmit abi_greylist"

# printk and dmesg options
CONFIG_PRINTK_PROCESS=y

# USB Feature
CONFIG_USB_HOST_NOTIFY=y
CONFIG_USB_NOTIFY_LAYER=m
CONFIG_USB_NOTIFIER=m
CONFIG_USB_DEBUG_DETAILED_LOG=y
CONFIG_USB_EXTERNAL_NOTIFY=y
CONFIG_USB_NOTIFY_PROC_LOG=y
CONFIG_USB_HOST_SAMSUNG_FEATURE=y
CONFIG_USB_HW_PARAM=y
CONFIG_USB_INTERFACE_LPM_LIST=y
CONFIG_USB_AUDIO_ENHANCED_DETECT_TIME=y
CONFIG_USB_HOST_CERTI=y
CONFIG_USB_HOST_CERTIFICATION=y
CONFIG_ANDROID_SWITCH=m

# USB Host Test
CONFIG_USB_LINK_LAYER_TEST=m
CONFIG_USB_EHSET_TEST_FIXTURE=m

# USB modularization
CONFIG_USB_CONFIGFS_F_SS_MON_GADGET=m

# USB Accessories
CONFIG_USB_PRINTER=m
CONFIG_USB_SERIAL=m
CONFIG_USB_ARMLINUX=y
CONFIG_USB_NET_CDC_MBIM=m
CONFIG_USB_NET_SMSC95XX=m
CONFIG_USB_NET_SMSC75XX=m
CONFIG_USB_NET_AX8817X=m
CONFIG_USB_NET_AX88179_178A=m

CONFIG_HID_MONTEREY=m
CONFIG_HID_ZYDACRON=m
CONFIG_HID_PRIMAX=m
CONFIG_HID_GREENASIA=m
CONFIG_HID_KEYTOUCH=m
CONFIG_HID_GYRATION=m
CONFIG_HID_TIVO=m
CONFIG_HID_CYPRESS=m
CONFIG_HID_CHERRY=m
CONFIG_HID_NTRIG=m
CONFIG_HID_CHICONY=m
CONFIG_HID_LCPOWER=m
CONFIG_HID_WALTOP=m
CONFIG_HID_BELKIN=m
CONFIG_HID_TOPSEED=m
CONFIG_HID_A4TECH=m
CONFIG_HID_PANTHERLORD=m
CONFIG_HID_EZKEY=m
CONFIG_HID_ZEROPLUS=m
CONFIG_HID_THRUSTMASTER=m
CONFIG_HID_SAMSUNG=y
CONFIG_HID_SPEEDLINK=m
CONFIG_HID_HOLTEK=m
CONFIG_HID_SUNPLUS=m
CONFIG_USB_BELKIN=y
CONFIG_USB_ARMLINUX=y
CONFIG_HID_ACRUX_FF=y
CONFIG_HID_ACRUX=m
CONFIG_HID_DRAGONRISE=m
CONFIG_HID_EMS_FF=m
CONFIG_HID_KENSINGTON=m
CONFIG_HID_TWINHAN=m
CONFIG_HID_ORTEK=m
CONFIG_HID_PETALYNX=m
CONFIG_HID_SMARTJOYPLUS=m
CONFIG_HID_SAITEK=m
CONFIG_LOGITECH_FF=y
CONFIG_JOYSTICK_XPAD_LEDS=y
CONFIG_JOYSTICK_XPAD_FF=y
CONFIG_DRAGONRISE_FF=y
CONFIG_GREENASIA_FF=y
CONFIG_SMARTJOYPLUS_FF=y
CONFIG_LOGIRUMBLEPAD2_FF=y
CONFIG_PANTHERLORD_FF=y

CONFIG_INPUT_TABLET=y
CONFIG_TABLET_USB_KBTAB=m
CONFIG_TABLET_USB_HANWANG=m
CONFIG_TABLET_USB_GTCO=m
CONFIG_TABLET_USB_AIPTEK=m
CONFIG_TABLET_USB_ACECAD=m

# UFS
CONFIG_SEC_UFS_FEATURE=y

# KNOX DAR
CONFIG_SDP=y
CONFIG_FSCRYPT_SDP=y

# Block layer modules
CONFIG_MQ_IOSCHED_SSG=m
CONFIG_BLK_SEC_STATS=m
CONFIG_MQ_IOSCHED_SSG_CGROUP=m

# AIR
CONFIG_SEC_AUTO_INPUT=m

# MMC/SD
CONFIG_SEC_MMC_FEATURE=y

# Debug Snapshot
CONFIG_DEBUG_SNAPSHOT_API=y

# uH
CONFIG_UH=y
CONFIG_RKP=y
CONFIG_KDP=y
CONFIG_KDP_CRED=y
CONFIG_KDP_NS=y
CONFIG_KDP_TEST=y
CONFIG_RKP_TEST=y

# SPU SIGN VERIFY
CONFIG_SPU_VERIFY=m

# DM-Verity
CONFIG_DM_ANDROID_VERITY_AT_MOST_ONCE_DEFAULT_ENABLED=y

#ASEC
CONFIG_CRYPTO_TWOFISH=y

# FIPS
CONFIG_CRYPTO_FIPS=y

#NFC
CONFIG_SEC_NFC_LOGGER_ADD_ACPM_LOG=y
CONFIG_SEC_NFC_LOGGER_RTC_REG_ADDR=0x11A20090

# Argos
CONFIG_ARGOS=m

#
# please don't remove new line on this file
#
```

## arch/arm64/configs/s5e8825-userdebug_defconfig
```kconfig
# fs-verity
CONFIG_FS_VERITY_DEBUG=y

#Sensor Hub
CONFIG_SHUB_DEBUG=y

# Power Management
CONFIG_PINCTRL_SEC_GPIO_DVS=m

# Pablo Obte support
CONFIG_PABLO_OBTE_SUPPORT=m

# SDP KeyManagement Test for MDFPP evaluation
CONFIG_SDP_KEY_DUMP=y

# Micro Hypervisor
# CONFIG_RKP_FIMC_CHECK is not set
# CONFIG_KDP is not set
# CONFIG_KDP_CRED is not set
# CONFIG_KDP_NS is not set
# CONFIG_KDP_TEST is not set

#
# please don't remove new line on this file
#
```

## arch/arm64/configs/s5e9925-base_defconfig
```kconfig
CONFIG_ARCH_EXYNOS=y
CONFIG_SERIAL_SAMSUNG=y
CONFIG_SERIAL_SAMSUNG_CONSOLE=y
CONFIG_SERIAL_EXYNOS=m
CONFIG_I2C_CHARDEV=m
CONFIG_I2C_EXYNOS5=m
CONFIG_SPI_S3C64XX=m
CONFIG_PCI_EXYNOS=m
CONFIG_PCI_EXYNOS_S5E9925=m
CONFIG_EXYNOS_PCIE_IOMMU=m
# CONFIG_PCIE_IOMMU_HISTORY_LOG=m
CONFIG_SPI_SPIDEV=m
CONFIG_USI_V2=m
CONFIG_SOC_S5E9925=y
CONFIG_DEBUG_LOCK_ALLOC=y
CONFIG_PINCTRL_SAMSUNG=m
CONFIG_EXYNOS_CHIPID_V2=m
CONFIG_HPA=y
CONFIG_DMABUF_SYSFS_STATS=y
CONFIG_DMABUF_SAMSUNG_HEAPS=m
CONFIG_DMABUF_HEAPS_SAMSUNG_CMA=y
CONFIG_DMABUF_HEAPS_SAMSUNG_CARVEOUT=y
CONFIG_DMABUF_HEAPS_SAMSUNG_SYSTEM=y
CONFIG_DMABUF_HEAPS_SAMSUNG_CHUNK=y
CONFIG_DMABUF_HEAPS_SAMSUNG_HPA=y
CONFIG_POWER_RESET_EXYNOS=m
CONFIG_CLKSRC_EXYNOS_MCT_V2=m
CONFIG_ARM_GIC_V3_VENDORHOOK=m
CONFIG_SND_SOC_SAMSUNG=m
CONFIG_SND_SOC_SAMSUNG_ABOX_DEBUG=y
# CONFIG_MMC_DW is not set
# CONFIG_MMC_DW_IDMAC is not set
# CONFIG_MMC_DW_64BIT_DESC is not set
# CONFIG_MMC_DW_EXYNOS is not set
# CONFIG_MMC_DW_FORCE_32BIT_SFR_RW is not set
CONFIG_EXYNOS_PERF=m
CONFIG_EXYNOS_AFM=m
CONFIG_EXYNOS_MIGOV=m
CONFIG_EXYNOS_CPU_PROFILER=m
CONFIG_EXYNOS_GPU_PROFILER=m
CONFIG_EXYNOS_MIF_PROFILER=m
CONFIG_DEBUG_FS=y
CONFIG_INCREMENTAL_FS=y
CONFIG_COMMON_CLK_SAMSUNG=m
CONFIG_EXYNOS_PMU_IF=m
CONFIG_CMU_EWF=m
CONFIG_CAL_IF=m
CONFIG_CMUCAL_DEBUG=y
CONFIG_EXYNOS_PD=m
CONFIG_EXYNOS_PD_DBG=m
CONFIG_PMUCAL_DBG=m
CONFIG_PMUCAL_CMU_INIT=y
CONFIG_EXYNOS_ACPM=m
CONFIG_EXYNOS_ACPM_PLGDBG=m
CONFIG_EXYNOS_ACPM_MFD_BUS=m
CONFIG_EXYNOS_MFD_SPMI=y
CONFIG_EXYNOS_PM=m
CONFIG_EXYNOS_FLEXPMU_DBG=m
# ARM_EXYNOS_DEVFREQ is not set
CONFIG_EXYNOS_ALT_DVFS=m
CONFIG_EXYNOS_BTS=m
CONFIG_EXYNOS_BCM_DBG=m
CONFIG_EXYNOS_SCI=m
CONFIG_EXYNOS_SCI_DBG=m
CONFIG_ARM64_PTR_AUTH=y
CONFIG_CPU_IDLE_GOV_TEO=y
CONFIG_EXYNOS_CPUHP=m
CONFIG_ARM_EXYNOS_ACME=m
CONFIG_ARM_FREQ_QOS_TRACER=m
CONFIG_ARM_EXYNOS_DSU_FREQ=m
CONFIG_EXYNOS_UFCC=m
CONFIG_SCHED_EMS=m
CONFIG_SCHED_EMS_TUNE=y
CONFIG_CPU_FREQ_GOV_ENERGYSTEP=y
CONFIG_CPU_FREQ_GOV_ENERGYAWARE=y
# CONFIG_EXYNOS_MSN is not set
CONFIG_EXYNOS_SSP=m
CONFIG_EXYNOS_EL2=m
CONFIG_EXYNOS_S2MPU=m
CONFIG_EXYNOS_PPMPU_FAIL_DETECTOR=m
CONFIG_EXYNOS_SECURE_LOG=m
CONFIG_EXYNOS_SEH=m
CONFIG_EXYNOS_TZASC_FAIL_DETECTOR=m
CONFIG_HW_RANDOM_EXYNOS_SWD=m
CONFIG_FB=m
CONFIG_FB_MODE_HELPERS=y
CONFIG_PCI=y
CONFIG_DRM=y
CONFIG_DRM_SGPU=m
CONFIG_DRM_SGPU_EXYNOS=y
CONFIG_DRM_SGPU_BPMD=y
CONFIG_DRM_SGPU_BPMD_OUTPUT_DEFAULT="/data/local/tmp/"
CONFIG_DRM_SGPU_BUILTIN_FIRMWARE=n
CONFIG_DRM_AMDGPU_USERPTR=y
# CONFIG_GNSS is not set
CONFIG_SAMSUNG_IOMMU=m
CONFIG_DRM_SAMSUNG_DPU=m
CONFIG_PHY_EXYNOS_MIPI=m
CONFIG_PHY_EXYNOS_MIPI_DSIM=m
CONFIG_DRM_PANEL_SAMSUNG_COMMON=m
CONFIG_DRM_PANEL_SAMSUNG_EMUL=m
CONFIG_EXYNOS_FREQ_HOP=m
CONFIG_EXYNOS_DMA_DSIMFC=y
CONFIG_DRM_SAMSUNG_HIBERNATION_EARLY_WAKEUP=y
CONFIG_EXYNOS_PLL_SLEEP=y
CONFIG_VIDEO_EXYNOS_JPEG_SQZ=m
CONFIG_VIDEO_EXYNOS_SMFC=m
CONFIG_VIDEO_EXYNOS_REPEATER=m
CONFIG_VIDEO_EXYNOS_MFC=m
CONFIG_VIDEO_EXYNOS_TSMUX=m
CONFIG_USB_DWC3_EXYNOS_MODULE=m
CONFIG_EXYNOS_USBDRD_PHY30=y
CONFIG_USB_XHCI_EXYNOS=m
CONFIG_USB_CONFIGFS_F_DM=m
CONFIG_USB_CONFIGFS_F_CONN_GADGET=m
CONFIG_USB_USE_IOCOHERENCY=m
CONFIG_SND_EXYNOS_USB_AUDIO=y
CONFIG_SND_EXYNOS_USB_AUDIO_MODULE=m
CONFIG_USB_EXYNOS_TPMON_MODULE=m
CONFIG_PHY_EXYNOS_USBDRD_EUSB=m
CONFIG_PHY_SAMSUNG_USB_CAL=y

CONFIG_VIDEO_EXYNOS_PABLO_ISP=m
CONFIG_VIDEO_EXYNOS_CAMERA_POSTPROCESS=m
CONFIG_VIDEO_EXYNOS_CAMERA_POSTPROCESS_GDC=m
CONFIG_CAMERA_PP_GDC_V10_0_0_OBJ=m
CONFIG_VIDEO_EXYNOS_CAMERA_POSTPROCESS_VOTF=m
CONFIG_CAMERA_DVFS_V2=y

CONFIG_VIDEO_EXYNOS_SCALER=m
CONFIG_SCSI_UFS_EXYNOS=m
CONFIG_SCSI_UFS_EXYNOS_SRPMB=y
CONFIG_SCSI_UFS_EXYNOS_FMP=y

CONFIG_UFS_SRPMB=m
CONFIG_EXYNOS_FMP=m

CONFIG_EXYNOS_DVFS_MANAGER=m
CONFIG_ACPM_DVFS=m
CONFIG_ECT=m
CONFIG_EXYNOS_MEMORY_LOGGER=m
CONFIG_EXYNOS_SYSTEM_EVENT=m
CONFIG_EXYNOS_IMGLOADER=m
CONFIG_EXYNOS_PM_QOS=m

CONFIG_DRV_SAMSUNG_PMIC=m
CONFIG_EXYNOS_DEBUG=y
CONFIG_DEBUG_SNAPSHOT=m
CONFIG_DEBUG_SNAPSHOT_SFRDUMP=m
CONFIG_DEBUG_SNAPSHOT_QUICKDUMP=m
CONFIG_DEBUG_SNAPSHOT_DEBUG_KINFO=m
CONFIG_EXYNOS_DEBUG_TEST=m
CONFIG_EXYNOS_CORESIGHT=m
CONFIG_EXYNOS_ECC_HANDLER=m
CONFIG_EXYNOS_HARDLOCKUP_WATCHDOG=m
CONFIG_EXYNOS_ADV_TRACER=m
CONFIG_EXYNOS_ADV_TRACER_S2D=m
CONFIG_EXYNOS_ITMON=m
CONFIG_EXYNOS_EHLD=m
CONFIG_EXYNOS_SSLD=m

CONFIG_LTO_CLANG_THIN=y
CONFIG_CFI_CLANG=y
CONFIG_PWM_SAMSUNG=m
CONFIG_S3C2410_WATCHDOG=m
CONFIG_S3C2410_SHUTDOWN_REBOOT=y
CONFIG_EXYNOS_THERMAL_V2=m
CONFIG_EXYNOS_ACPM_THERMAL=m
CONFIG_EXYNOS_CPU_THERMAL=m
CONFIG_ISP_THERMAL=m
CONFIG_GPU_THERMAL=m
CONFIG_DEV_THERMAL=m
CONFIG_THERMAL_EMULATION=y
CONFIG_THERMAL_GOV_POWER_ALLOCATOR=y
CONFIG_THERMAL_STATISTICS=y
CONFIG_EXYNOS_MCINFO=m
CONFIG_MCINFO_SYSFS=y
CONFIG_EXYNOS_AMB_CONTROL=m

CONFIG_EXYNOS_MODEM_IF=m
CONFIG_LINK_DEVICE_WITH_SBD_ARCH=m
CONFIG_SEC_MODEM_S5000AP=m
CONFIG_EXYNOS_CPIF_IOMMU=m
CONFIG_CP_PKTPROC=m
CONFIG_CP_PKTPROC_UL=m
CONFIG_CP_BTL=m
CONFIG_CP_LLC=m
CONFIG_HW_REV_DETECT=m
CONFIG_CPIF_TP_MONITOR=m
CONFIG_REINIT_VSS=m
CONFIG_VERIFY_VSS=m
CONFIG_CPIF_DIRECT_DM=m
CONFIG_CPIF_VENDOR_HOOK=m
CONFIG_GNSS_PMUCAL=m
CONFIG_EXYNOS_GNSS_IF=m
CONFIG_CP_UART_NOTI=m
CONFIG_CP_PKTPROC_CLAT=y
CONFIG_CHUB_PMUCAL=m
CONFIG_PMU_UART_SWITCH=m
CONFIG_PERF_EVENTS=y

# NPU
CONFIG_VISION_CORE=y
CONFIG_VISION_SUPPORT=y
CONFIG_EXYNOS_NPU=m
CONFIG_NPU_MAILBOX_VERSION=9
CONFIG_NPU_COMMAND_VERSION=10
CONFIG_NPU_NCP_VERSION=25
CONFIG_NPU_INTERFACE=y
CONFIG_NPU_HARDWARE=y
CONFIG_NPU_USE_MAILBOX_GROUP=n
CONFIG_NPU_USE_HW_DEVICE=y
CONFIG_NPU_USE_BOOT_IOCTL=y
CONFIG_NPU_USE_LLC=y
CONFIG_NPU_USE_LLC_PRESET=y
CONFIG_NPU_USE_PI_DTM=y
CONFIG_NPU_SET_DNC_FREQ=y
CONFIG_DSP_USE_VS4L=y
#CONFIG_NPU_USE_VOTF=y
CONFIG_NPU_STM=y
CONFIG_NPU_USE_UTIL_STATS=y
CONFIG_NPU_USE_IMB_ALLOCATOR=y
CONFIG_NPU_NUM_CORES=2
CONFIG_NPU_IMB_THRESHOLD=y
CONFIG_NPU_USE_FENCE_SYNC=y
CONFIG_NPU_USE_ASYNC=y

CONFIG_CORESIGHT=y
CONFIG_CORESIGHT_LINKS_AND_SINKS=y
CONFIG_CORESIGHT_LINK_AND_SINK_TMC=y
CONFIG_CORESIGHT_CATU=y
CONFIG_CORESIGHT_SINK_TPIU=y
CONFIG_CORESIGHT_SINK_ETBV10=y
CONFIG_CORESIGHT_STM=y
CONFIG_STM_PROTO_BASIC=y

CONFIG_I3C_HCI_EXYNOS=m

# Touch
CONFIG_INPUT_SEC_NOTIFIER=m

CONFIG_ZSMALLOC=m
CONFIG_ZRAM=m

# CONFIG_PRINTK_CALLER is not set
CONFIG_PRINTK_PROCESS=y
CONFIG_DEBUG_NOTIFIERS=y

# MPAM prototype
CONFIG_SEC_MPAM=m

CONFIG_SLUB_DEBUG_ON=y
CONFIG_S3C2410_BUILTIN_WATCHDOG=y


CONFIG_F2FS_ML_BASED_STREAM_SEPARATION=y
CONFIG_F2FS_ML_STREAMID_FORCE_COLD=y
#CONFIG_F2FS_CHECK_CACHE_ML=y
```

## arch/arm64/configs/s5e9925-eng_defconfig
```kconfig
# Battery driver
CONFIG_ENG_BATTERY_CONCEPT=y

# Power Management
CONFIG_PINCTRL_SEC_GPIO_DVS=m

# fs-verity
CONFIG_FS_VERITY_DEBUG=y

# Memory Debugging
CONFIG_SLUB_DEBUG_ON=y

# Lock Debugging (spinlocks, mutexes, etc...)
CONFIG_DEBUG_PREEMPT=y
CONFIG_DEBUG_RWSEMS=y
CONFIG_DEBUG_ATOMIC_SLEEP=y

# SDP KeyManagement Test for MDFPP evaluation
CONFIG_SDP_KEY_DUMP=y

# Displayport test
CONFIG_SEC_DISPLAYPORT_SELFTEST=y
CONFIG_SEC_DISPLAYPORT_DBG=y

# SDP KeyManagement Test for MDFPP evaluation
CONFIG_SDP_KEY_DUMP=y

# Pablo Obte support
CONFIG_PABLO_OBTE_SUPPORT=m

# ABC driver bootc eng option
CONFIG_SEC_ABC_HUB_BOOTC_ENG=m

# Micro Hypervisor
# CONFIG_RKP_FIMC_CHECK is not set
# CONFIG_KDP_CRED is not set
# CONFIG_KDP_NS is not set

# USB Host Test
CONFIG_USB_LINK_LAYER_TEST=m
CONFIG_USB_EHSET_TEST_FIXTURE=m

# CAMERA
# CONFIG_USE_SIGNED_BINARY is not set

#
# please don't remove new line on this file
#
```
