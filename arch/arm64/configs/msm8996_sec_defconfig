## arch/arm64/configs/s5e9925-sec_defconfig
```kconfig
#
# Please leave the first line blank
#

# SEC CONFIGS
CONFIG_SEC_REBOOT=m
CONFIG_SEC_KEY_NOTIFIER=m
CONFIG_LOG_BUF_SHIFT=21
CONFIG_SEC_PMIC_PWRKEY_DTNAME="s2mps25-keys"
CONFIG_SEC_BOOTSTAT=m
CONFIG_SEC_WAKEUP_CPU_ALLOCATOR=m

# USB modularization
CONFIG_USB_CONFIGFS_F_SS_MON_GADGET=m

# Samsung Mobile Power Management
CONFIG_PM_DEBUG=y
CONFIG_SEC_PM=y
CONFIG_SEC_PM_DEBUG=m
CONFIG_SEC_PM_THERMISTOR=m
CONFIG_SEC_PM_CPUFREQ=m
CONFIG_REGULATOR_S2MPB03=m
CONFIG_FOTA_LIMIT=y

# HDM
CONFIG_HDM=m

# Kernel Core Memory
CONFIG_ZRAM=m
CONFIG_ZSMALLOC=m

# UFS
CONFIG_SEC_UFS_FEATURE=y

# KNOX DAR
CONFIG_DDAR=y
CONFIG_SDP=y
CONFIG_FSCRYPT_SDP=y

# Firmware Loader
CONFIG_FW_LOADER_USER_HELPER_FALLBACK=y

# uH
CONFIG_UH=y
CONFIG_RKP=y
CONFIG_KDP=y
CONFIG_KDP_CRED=y
CONFIG_KDP_NS=y
CONFIG_KDP_TEST=y
CONFIG_RKP_TEST=y

# SPU SGIN VERIFY
CONFIG_SPU_VERIFY=m

# DM-Verity
CONFIG_DM_ANDROID_VERITY_AT_MOST_ONCE_DEFAULT_ENABLED=y

# GKI: Allow KMI symbol list
CONFIG_KMI_SYMBOL_LISTS="android/abi_gki_aarch64 android/abi_gki_aarch64_core android/abi_gki_aarch64_db845c android/abi_gki_aarch64_exynos android/abi_gki_aarch64_exynosauto android/abi_gki_aarch64_generic android/abi_gki_aarch64_hikey960 android/abi_gki_aarch64_qcom android/abi_gki_aarch64_virtual_device android/abi_gki_aarch64_galaxy android/abi_gki_aarch_galaxy_presubmit abi_greylist"

# printk and dmesg options
CONFIG_PRINTK_PROCESS=y

# Block layer modules
CONFIG_MQ_IOSCHED_SSG=m
CONFIG_BLK_SEC_STATS=m
CONFIG_MQ_IOSCHED_SSG_CGROUP=m

#Displayport
CONFIG_SEC_DISPLAYPORT=y
CONFIG_DRM_SAMSUNG_DP=y
CONFIG_USE_DISPLAYPORT_PDIC_EVENT_QUEUE=y
CONFIG_HDCP2_FUNC_TEST_MODE=y
CONFIG_SEC_DISPLAYPORT_EXT_FUNCTION=m
CONFIG_SEC_DISPLAYPORT_LOGGER=y
CONFIG_SEC_DISPLAYPORT_BIGDATA=y

#NFC
CONFIG_SEC_NFC_LOGGER_ADD_ACPM_LOG=y
CONFIG_SEC_NFC_LOGGER_RTC_REG_ADDR=0x15920090

# USB Feature
CONFIG_USB_HOST_SAMSUNG_FEATURE=y
CONFIG_USB_AUDIO_ENHANCED_DETECT_TIME=y
CONFIG_USB_DEBUG_DETAILED_LOG=y
CONFIG_USB_HOST_CERTIFICATION=y

# USB Accessories
CONFIG_USB_PRINTER=m
CONFIG_USB_SERIAL=m
CONFIG_USB_ARMLINUX=y
CONFIG_USB_NET_CDC_MBIM=m
CONFIG_USB_NET_SMSC95XX=m
CONFIG_USB_NET_SMSC75XX=m

CONFIG_HID_MONTEREY=m
CONFIG_HID_ZYDACRON=m
CONFIG_HID_PRIMAX=m
CONFIG_HID_GREENASIA=m
CONFIG_HID_KEYTOUCH=m
CONFIG_HID_GYRATION=m
CONFIG_HID_TIVO=m
CONFIG_HID_CYPRESS=m
CONFIG_HID_CHERRY=m
CONFIG_HID_NTRIG=m
CONFIG_HID_CHICONY=m
CONFIG_HID_LCPOWER=m
CONFIG_HID_WALTOP=m
CONFIG_HID_BELKIN=m
CONFIG_HID_TOPSEED=m
CONFIG_HID_A4TECH=m
CONFIG_HID_PANTHERLORD=m
CONFIG_HID_EZKEY=m
CONFIG_HID_ZEROPLUS=m
CONFIG_HID_THRUSTMASTER=m
CONFIG_HID_SAMSUNG=y
CONFIG_HID_SPEEDLINK=m
CONFIG_HID_HOLTEK=m
CONFIG_HID_SUNPLUS=m
CONFIG_USB_BELKIN=y
CONFIG_USB_ARMLINUX=y
CONFIG_HID_ACRUX_FF=y
CONFIG_HID_ACRUX=m
CONFIG_HID_DRAGONRISE=m
CONFIG_HID_EMS_FF=m
CONFIG_HID_KENSINGTON=m
CONFIG_HID_TWINHAN=m
CONFIG_HID_ORTEK=m
CONFIG_HID_PETALYNX=m
CONFIG_HID_SMARTJOYPLUS=m
CONFIG_HID_SAITEK=m
CONFIG_LOGITECH_FF=y
CONFIG_JOYSTICK_XPAD_LEDS=y
CONFIG_JOYSTICK_XPAD_FF=y
CONFIG_DRAGONRISE_FF=y
CONFIG_GREENASIA_FF=y
CONFIG_SMARTJOYPLUS_FF=y
CONFIG_LOGIRUMBLEPAD2_FF=y
CONFIG_PANTHERLORD_FF=y

CONFIG_INPUT_TABLET=y
CONFIG_TABLET_USB_KBTAB=m
CONFIG_TABLET_USB_HANWANG=m
CONFIG_TABLET_USB_GTCO=m
CONFIG_TABLET_USB_AIPTEK=m
CONFIG_TABLET_USB_ACECAD=m

# Debug Oops, Lockups and Hangs
CONFIG_WQ_WATCHDOG=y

#CFG80211
CONFIG_CFG80211=m

# Network Feature
CONFIG_INET6_AH=y
CONFIG_IP_NF_MATCH_AH=y
CONFIG_TCP_CONG_ADVANCED=y
CONFIG_TCP_CONG_BIC=y
CONFIG_DEFAULT_BIC=y
CONFIG_DEFAULT_TCP_CONG="bic"
CONFIG_IP_NF_MATCH_RPFILTER=y

# Crypto 
CONFIG_CRYPTO_SHA1_ARM64_CE=y 
CONFIG_CRYPTO_AES_ARM64=y

# Debug Snapshot
CONFIG_DEBUG_SNAPSHOT_API=y

# Memory Debugging
# CONFIG_SLUB_DEBUG_ON is not set

# CLDVFS
CONFIG_ARM_EXYNOS_CLDVFS_SYSFS=y

# CAMERA
CONFIG_USE_SIGNED_BINARY=y

#FreeCess
CONFIG_SAMSUNG_FREECESS=y

# Argos
CONFIG_ARGOS=m
CONFIG_ARGOS_CLUSTER_NUM=3

# FIPS
CONFIG_CRYPTO_FIPS=y

#
# please don't remove new line on this file
#
```

## arch/arm64/configs/s5e9925-userdebug_defconfig
```kconfig
# Power Management
CONFIG_PINCTRL_SEC_GPIO_DVS=m

# fs-verity
CONFIG_FS_VERITY_DEBUG=y

# SDP KeyManagement Test for MDFPP evaluation
CONFIG_SDP_KEY_DUMP=y

# Displayport test
CONFIG_SEC_DISPLAYPORT_SELFTEST=y
CONFIG_SEC_DISPLAYPORT_DBG=y

# SDP KeyManagement Test for MDFPP evaluation
CONFIG_SDP_KEY_DUMP=y

# ABox debug
CONFIG_SND_SOC_SAMSUNG_ABOX_DEBUG=y

# Pablo Obte support
CONFIG_PABLO_OBTE_SUPPORT=m

# Micro Hypervisor
# CONFIG_RKP_FIMC_CHECK is not set
# CONFIG_KDP_CRED is not set
# CONFIG_KDP_NS is not set

# USB Host Test
CONFIG_USB_LINK_LAYER_TEST=m
CONFIG_USB_EHSET_TEST_FIXTURE=m

# CAMERA
# CONFIG_USE_SIGNED_BINARY is not set

#
# please don't remove new line on this file
#
```

## arch/arm64/configs/samsung/a01q/sdm439_sec_a01q_ltn_open_defconfig
```kconfig
CONFIG_SEC_A01Q_PROJECT=y
CONFIG_MACH_A01Q_LTN_OPEN=y
CONFIG_CRYPTO_ZSTD=y
CONFIG_PAGE_BOOST=y
```
