## arch/arm64/configs/msm8996_sec_eng_defconfig
```kconfig
CONFIG_CGROUP_DEBUG=y
CONFIG_ARCH_MSMCOBALT=y
CONFIG_NETFILTER_XT_TARGET_HARDIDLETIMER=y
CONFIG_NETFILTER_XT_TARGET_SECMARK=y
CONFIG_REGULATOR_STUB=y
CONFIG_REGULATOR_PROXY_CONSUMER=y
CONFIG_REGULATOR_MEM_ACC=y
CONFIG_MSM_VIDC_GOVERNORS=y
CONFIG_FB_MSM_MDSS_XLOG_DEBUG=y
CONFIG_MSM_AVTIMER=y
#CONFIG_MSM_CPUSS_DUMP is not set
CONFIG_MSM_COMMON_LOG=y
CONFIG_MSM_DDR_HEALTH=y
CONFIG_MSM_FORCE_WDOG_BITE_ON_PANIC=y
CONFIG_MSM_DCC=y
CONFIG_MSM_PIL_MSS_QDSP6V5=y
CONFIG_MSM_SYSMON_GLINK_COMM=y
# CONFIG_CORESIGHT_ETMV4 is not set
CONFIG_MSM_TZ_LOG=y
CONFIG_LOG_BUF_MAGIC=y
CONFIG_DYNAMIC_DEBUG=y
CONFIG_DEBUG_OBJECTS=y
CONFIG_DEBUG_OBJECTS_FREE=y
CONFIG_DEBUG_OBJECTS_TIMERS=y
CONFIG_DEBUG_OBJECTS_WORK=y
CONFIG_DEBUG_OBJECTS_RCU_HEAD=y
CONFIG_DEBUG_OBJECTS_PERCPU_COUNTER=y
CONFIG_DEBUG_KMEMLEAK=y
CONFIG_DEBUG_KMEMLEAK_DEFAULT_OFF=y
CONFIG_DEBUG_STACK_USAGE=y
# CONFIG_DEBUG_VM is not set
# CONFIG_DEBUG_VM_RB is not set
CONFIG_DEBUG_MEMORY_INIT=y
CONFIG_LOCKUP_DETECTOR=y
CONFIG_BOOTPARAM_SOFTLOCKUP_PANIC=y
# CONFIG_DETECT_HUNG_TASK is not set
CONFIG_DEBUG_SPINLOCK=y
CONFIG_DEBUG_MUTEXES=y
CONFIG_DEBUG_ATOMIC_SLEEP=y
CONFIG_DEBUG_LIST=y
CONFIG_SEC_FILE_LEAK_DEBUG=y
CONFIG_FAULT_INJECTION=y
CONFIG_FAIL_PAGE_ALLOC=y
CONFIG_UFS_FAULT_INJECTION=y
CONFIG_FAULT_INJECTION_DEBUG_FS=y
CONFIG_FAULT_INJECTION_STACKTRACE_FILTER=y
CONFIG_BLK_DEV_IO_TRACE=y
CONFIG_LSM_MMAP_MIN_ADDR=4096
CONFIG_HW_RANDOM_MSM_LEGACY=y
CONFIG_GPIO_QPNP_PIN_DEBUG=y
CONFIG_SEC_GPIO_DVS=y
CONFIG_SLUB_DEBUG=y
CONFIG_SLUB_DEBUG_ON=y
CONFIG_PAGE_OWNER=y
CONFIG_PM_DEBUG=y
# CONFIG_SUSPEND_TIME is not set
CONFIG_IOMMU_DEBUG_TRACKING=y
CONFIG_IOMMU_IO_PGTABLE_FAST_SELFTEST=y
CONFIG_IOMMU_DEBUG=y
CONFIG_IOMMU_TESTS=y
CONFIG_IRQSOFF_TRACER=y
CONFIG_PREEMPT_TRACER=y
CONFIG_PANIC_ON_DATA_CORRUPTION=y
CONFIG_ARM64_PTDUMP=y
#CONFIG_FREE_PAGES_RDONLY is not set
#CONFIG_KERNEL_TEXT_RDONLY is not set
CONFIG_SEC_DEBUG_SEC_WDOG_BITE=y
CONFIG_USER_RESET_DEBUG_TEST=y
CONFIG_SLABINFO=y
CONFIG_DEBUG_PAGEALLOC=y
CONFIG_SLUB_DEBUG_PANIC_ON=y
#
# DS5 Streamline v22
#
CONFIG_HW_PERF_EVENTS=y
CONFIG_PROFILING=y
CONFIG_PERF_EVENTS=y
CONFIG_FTRACE=y
CONFIG_HIGH_RES_TIMERS=y
CONFIG_HW_PERF_EVENTS=y
CONFIG_LOCAL_TIMERS=y
CONFIG_LOCAL_TIMERS=y
CONFIG_GATOR=m
#CONFIG_GATOR=y

# Rooting Prevention
# CONFIG_SEC_RESTRICT_ROOTING is not set
# CONFIG_SEC_RESTRICT_SETUID is not set
# CONFIG_SEC_RESTRICT_FORK is not set
# CONFIG_SEC_RESTRICT_ROOTING_LOG is not set

# SDP KeyManagement Test for MDFPP evaluation
CONFIG_SDP_KEY_DUMP=y

#knox test
CONFIG_KNOX_TEST=y

# UFS Journal Data Tag Debug
CONFIG_JOURNAL_DATA_TAG_DEBUG=y

#
# TIMA RKP
#
# CONFIG_RKP_KDP is not set
# CONFIG_RKP_NS_PROT is not set

CONFIG_DEBUG_BUS_VOTER=y
CONFIG_SAMSUNG_BATTERY_ENG_TEST=y
CONFIG_CCIC_MANUAL_UPDATE=y
```

## arch/arm64/configs/msm8996_sec_graceqlte_usa_spr_defconfig
```kconfig
# msm8996_sec_graceqlte_spr_defconfig
CONFIG_SEC_GRACEQLTE_PROJECT=y
CONFIG_MACH_GRACEQLTE_SPR=y
CONFIG_BATTERY_SAMSUNG=y
CONFIG_BATTERY_SAMSUNG_V2=y
CONFIG_BATTERY_NOTIFIER=y
CONFIG_MULTI_CHARGING=y
CONFIG_AFC_CHARGER_MODE=y
CONFIG_CHARGER_MAX77854=y
CONFIG_FUELGAUGE_MAX77854=y
CONFIG_CHARGER_DA9155=y
CONFIG_CHARGER_BQ25898S=y
CONFIG_WIRELESS_CHARGER_P9220=y
CONFIG_WIRELESS_CHARGER_HIGH_VOLTAGE=y
CONFIG_WIRELESS_FIRMWARE_UPDATE=y
CONFIG_SAMSUNG_LPM_MODE=y
CONFIG_BATTERY_SWELLING=y
CONFIG_SW_SELF_DISCHARGING=y
CONFIG_BATTERY_AGE_FORECAST=y
CONFIG_UPDATE_BATTERY_DATA=y
CONFIG_CALC_TIME_TO_FULL=y
CONFIG_STEP_CHARGING=y

CONFIG_LEDS_MAX77854_RGB=y
CONFIG_MOTOR_DRV_MAX77854=y
CONFIG_MUIC_SUPPORT_VZW_ACC=y
CONFIG_SS_VIBRATOR=y
CONFIG_GPIO_PCAL6416A=y
# CONFIG_QPNP_HAPTIC is not set

# MAX77838 Display SUB PMIC
CONFIG_REGULATOR_MAX77838=y
# S2MPB02 Camera SUB PMIC
CONFIG_LEDS_S2MPB02=y
CONFIG_MFD_S2MPB02=y
CONFIG_REGULATOR_S2MPB02=y

# Input Device
CONFIG_TOUCHSCREEN_STM=y
CONFIG_TOUCHSCREEN_SEC_TS=y
CONFIG_TOUCHSCREEN_ATMEL_MXT748U=y
CONFIG_TOUCHSCREEN_DUMP_MODE=y
CONFIG_TOUCHSCREEN_SUPPORT_MULTIMEDIA=y
CONFIG_KEYBOARD_CYPRESS_TOUCHKEY=y
CONFIG_INPUT_WACOM=y
CONFIG_EPEN_WACOM_W9018=y

# display
CONFIG_PANEL_S6E3HA5_AMB567MK01_WQHD=y
CONFIG_PANEL_S6E3HF4_AMB526JS01_WQHD=y

# Finger print sensor
CONFIG_SENSORS_FINGERPRINT=y
CONFIG_SENSORS_FINGERPRINT_SYSFS=y
CONFIG_SENSORS_VFS7XXX=y
CONFIG_SENSORS_FP_SPI_NUMBER=6
CONFIG_SENSORS_FP_SPI_GPIO_START=25
CONFIG_SENSORS_FP_SPI_GPIO_END=28
#CONFIG_SENSORS_FP_MASTER_ID=86
CONFIG_SENSORS_FP_LOCKSCREEN_MODE=y

#NFC
CONFIG_SAMSUNG_NFC=y
CONFIG_NFC_PN547=y
CONFIG_NFC_PN547_ESE_SUPPORT=y
CONFIG_NFC_PM_BBCLK2=y
CONFIG_ESE_SECURE=y
CONFIG_ESE_SPI_GPIO_START=58
CONFIG_ESE_SPI_GPIO_END=61
CONFIG_ESE_SECURE_SPI_PORT=11

#MST
CONFIG_MST_LDO=y

#TBASE TUI
CONFIG_TRUSTONIC_TRUSTED_UI=y

# IRIS
CONFIG_IRIS_I2C_GPIO_START=45
CONFIG_IRIS_I2C_GPIO_END=48

#
# DSM Solution
#
CONFIG_SND_SOC_MAX98506=y
CONFIG_SND_SOC_MAXIM_DSM=y
CONFIG_SND_SOC_MAXIM_DSM_CAL=y

# Audio
CONFIG_SND_SOC_PRIMARY_MI2S=y
CONFIG_SND_SOC_TERTIARY_AUXPCM=y
CONFIG_SND_SOC_ALWAYS_ON_MIC=y
CONFIG_SND_SOC_WCD_MBHC_ADC=y
CONFIG_SND_SOC_WCD_MBHC_SLOW_DET=y

# Sensor
CONFIG_SENSORS_HRMSENSOR=y
CONFIG_SENSORS_HRM_MAX86902=y
CONFIG_AVERAGE=y
# CONFIG_BMI168_FACTORY is not set
CONFIG_K6DS3_FACTORY=y
CONFIG_AK09916C_FACTORY=y
CONFIG_BMP280_FACTORY=y
CONFIG_TMD490X_FACTORY=y
CONFIG_SUPPORT_TMD4904_FACTORY=y
CONFIG_SUPPORT_PROX_AUTO_CAL=y
CONFIG_SUPPORT_HIDDEN_HOLE=y
CONFIG_SLPI_MOTOR=y
CONFIG_SENSORS_SX9320=y

# CAMERA
CONFIG_COMPANION2=y
CONFIG_COMPANION3=y
CONFIG_CAMERA_SYSFS_V2=y
#CONFIG_MSM_FRONT_EEPROM=y
CONFIG_SAMSUNG_OIS=y
CONFIG_SENSOR_RETENTION=y
CONFIG_SAMSUNG_SECURE_CAMERA=y

# USB
CONFIG_USB_SAMSUNG_ENHANCED_SS=y

# RADIO
CONFIG_VIDEO_V4L2=y
CONFIG_RADIO_RTC6213N=y
CONFIG_I2C_RTC6213N=y

# SECURITY
CONFIG_VPNCLIENT_SECURITY=y

# EPDG
CONFIG_NET_CORE=y
CONFIG_NET_SCH_PRIO=y
CONFIG_NET_SCHED=y   #depends on CONFIG_NET  which is enabled by default.. coz not seeing in the config file
CONFIG_NET_CLS_BASIC=y # required if basic is being used as a filter. depends on CONFIG_NET_CLS so enabling it by default
CONFIG_NET_CLS=y
CONFIG_NET_CLS_ACT=y # for enabling the action target.
CONFIG_NET_ACT_MIRRED=y  # for enabling the mirred target for redirecting the packet between the devices.
CONFIG_NET_EMATCH=y   #basic uses extended matches so this has to be present
CONFIG_NET_SCH_INGRESS=y # classifier for ingress packet

#Barcode Print
CONFIG_BARCODE_PAINTER=y

# SSWAP
CONFIG_SWAP=y
CONFIG_FRONTSWAP=y
CONFIG_ZSMALLOC=y
CONFIG_ZSMALLOC_STAT=y
CONFIG_ZSMALLOC_OBJ_SEQ=n
CONFIG_PGTABLE_MAPPING=y
CONFIG_ZSWAP=y
CONFIG_ZSWAP_ENABLE_WRITEBACK=n
# CONFIG_ZSWAP_COMPACTION is not set
CONFIG_ZPOOL=y
CONFIG_DIRECT_RECLAIM_FILE_PAGES_ONLY=y
CONFIG_INCREASE_MAXIMUM_SWAPPINESS=y
CONFIG_FIX_INACTIVE_RATIO=y
CONFIG_TIGHT_PGDAT_BALANCE=y
CONFIG_VNSWAP=y
CONFIG_SWAP_ENABLE_READAHEAD=n

# MMAP READAROUND
CONFIG_MMAP_READAROUND_LIMIT=32

# MODEM SECURE CHECK
CONFIG_SEC_PERIPHERAL_SECURE_CHK=y

# CCIC
CONFIG_CCIC_NOTIFIER=y
CONFIG_CCIC_S2MM003=y
CONFIG_CCIC_S2MM005=y
CONFIG_CCIC_ALTERNATE_MODE=y
CONFIG_MUIC_SUPPORT_CCIC=y
CONFIG_USB_TYPEC_MANAGER_NOTIFIER=y
CONFIG_CCIC_LPM_ENABLE=y
CONFIG_DUAL_ROLE_USB_INTF=y

CONFIG_MUIC_HV_12V=y
```

## arch/arm64/configs/msm8996_sec_gts3llte_kor_open_defconfig
```kconfig
# msm8996_sec_gts2llte_vzw_defconfig
CONFIG_SEC_GTS3LLTE_PROJECT=y
CONFIG_MACH_GTS3LLTE_KX=y
CONFIG_BATTERY_SAMSUNG=y
# CONFIG_MFD_MAX77833 is not set
# CONFIG_MUIC_MAX77833 is not set
# CONFIG_HV_MUIC_MAX77833_AFC is not set
# CONFIG_MUIC_HV is not set
# CONFIG_MFD_MAX77854 is not set
# CONFIG_MUIC_MAX77854 is not set
# CONFIG_HV_MUIC_MAX77854_AFC is not set
# CONFIG_MUIC_UNIVERSAL_MAX77854 is not set
# CONFIG_MUIC_ADCMODE_SWITCH_WA is not set
CONFIG_MFD_SM5705=y
CONFIG_MUIC_UNIVERSAL_SM5705=y
CONFIG_MUIC_UNIVERSAL_SM5705_AFC=y
CONFIG_MUIC_SM5705_SWITCH_CONTROL=y
CONFIG_MUIC_SUPPORT_KEYBOARDDOCK=y
CONFIG_SAMSUNG_LPM_MODE=y
CONFIG_CHARGER_SM5705=y
CONFIG_FUELGAUGE_SM5705=y
CONFIG_BATTERY_SWELLING=y
# CONFIG_SW_SELF_DISCHARGING is not set
CONFIG_BATTERY_SAMSUNG_V2=y
CONFIG_AFC_CHARGER_MODE=y
CONFIG_PREVENT_SOC_JUMP=y
CONFIG_BATTERY_NOTIFIER=y
CONFIG_STEP_CHARGING=y
CONFIG_INBATVOLT_FG=y
CONFIG_DISABLE_WATER_CONCEPT=y
# CONFIG_DISABLE_SAFETY_TIMER is not set
CONFIG_CHANGE_VBUS_VOLTAGE=y
CONFIG_BATTERY_AGE_FORECAST=y
# CONFIG_UPDATE_BATTERY_DATA is not set
# CONFIG_CALC_TIME_TO_FULL is not set
# CONFIG_LEDS_MAX77854_RGB is not set
# CONFIG_MOTOR_DRV_MAX77854 is not set
CONFIG_MUIC_SUPPORT_VZW_ACC=y
CONFIG_SS_VIBRATOR=y
# CONFIG_QPNP_HAPTIC is not set
# CONFIG_CERTIFY_HALL is not set

# MAX77838 Display SUB PMIC
CONFIG_REGULATOR_MAX77838=y

# Input Device
CONFIG_TOUCHSCREEN_SYNAPTICS_I2C_DSX2=y
CONFIG_KEYBOARD_TC3XXK=y
CONFIG_TOUCHKEY_GRIP=y
CONFIG_TOUCHKEY_GRIP_SENSOR_OFF=y
# CONFIG_TOUCHSCREEN_DUMP_MODE is not set
CONFIG_INPUT_WACOM_TAB=y
CONFIG_EPEN_WACOM_W9019=y
CONFIG_KEYBOARD_STMPE1801_POGO=y

# display
CONFIG_PANEL_ANA38401_AMS968HH01_QXGA=y

# Finger print sensor
CONFIG_SENSORS_FINGERPRINT=y
CONFIG_SENSORS_FINGERPRINT_SYSFS=y
CONFIG_SENSORS_ET5XX=y
CONFIG_SENSORS_FP_SPI_NUMBER=6
CONFIG_SENSORS_FP_SPI_GPIO_START=25
CONFIG_SENSORS_FP_SPI_GPIO_END=28
#CONFIG_SENSORS_FP_MASTER_ID=86

#NFC
# CONFIG_SAMSUNG_NFC is not set
# CONFIG_NFC_PN547 is not set
# CONFIG_NFC_PN547_ESE_SUPPORT is not set
# CONFIG_NFC_PM_BBCLK2 is not set
# CONFIG_ESE_SECURE is not set
# CONFIG_ESE_SPI_GPIO_START is not set
# CONFIG_ESE_SPI_GPIO_END is not set
# CONFIG_ESE_SECURE_SPI_PORT is not set

#
# DSM Solution
#
# CONFIG_SND_SOC_MAX98506 is not set
# CONFIG_SND_SOC_MAXIM_DSM is not set
# CONFIG_SND_SOC_MAXIM_DSM_CAL is not set

# Audio
CONFIG_SND_SOC_PRIMARY_MI2S=y
CONFIG_SND_SOC_QUAT_MI2S=y
CONFIG_SND_SOC_MI2S_TDM=y
CONFIG_SND_SOC_TERTIARY_AUXPCM=y
CONFIG_SND_SOC_WCD_MBHC_ADC=y
CONFIG_SND_SOC_WCD_MBHC_SLOW_DET=y
CONFIG_SND_SOC_SEC_AUDIO_EX=y
# CONFIG_MAINMIC_LDO is not set
CONFIG_SND_SOC_RT5508=y

# CONFIG_SND_SOC_DBMDX is not set
# CONFIG_SND_SOC_DBMDX_SND_CAPTURE is not set

# Sensor
CONFIG_AVERAGE=y
# CONFIG_BMI168_FACTORY is not set
CONFIG_K6DS3_FACTORY=y
# CONFIG_AK09911C_FACTORY is not set
CONFIG_AK09916C_FACTORY=y
# CONFIG_BMP280_FACTORY is not set
# CONFIG_CS5032_FACTORY is not set
CONFIG_CM3323_FACTORY=y
# CONFIG_TMD490X_FACTORY is not set
CONFIG_SENSORS_SX9310=y

# CAMERA
CONFIG_COMPANION2=n
CONFIG_COMPANION3=n
CONFIG_CAMERA_SYSFS_V2=y
#CONFIG_MSM_FRONT_EEPROM=y
CONFIG_MSM_OTP=y
CONFIG_MSM_REAR_ROM_TYPE_EEPROM=y
CONFIG_REAR_MODULE_ID_SUPPORT=y
CONFIG_SAMSUNG_OIS=n
CONFIG_SENSOR_RETENTION=y
CONFIG_LEDS_SM5705=y

# USB
CONFIG_USB_SAMSUNG_ENHANCED_SS=y

# RADIO
# CONFIG_VIDEO_V4L2 is not set
# CONFIG_RADIO_RTC6213N is not set
# CONFIG_I2C_RTC6213N  is not set

# SECURITY
CONFIG_VPNCLIENT_SECURITY=y

# EPDG
CONFIG_NET_CORE=y
CONFIG_NET_SCH_PRIO=y
CONFIG_NET_SCHED=y   #depends on CONFIG_NET  which is enabled by default.. coz not seeing in the config file
CONFIG_NET_CLS_BASIC=y # required if basic is being used as a filter. depends on CONFIG_NET_CLS so enabling it by default
CONFIG_NET_CLS=y
CONFIG_NET_CLS_ACT=y # for enabling the action target.
CONFIG_NET_ACT_MIRRED=y  # for enabling the mirred target for redirecting the packet between the devices.
CONFIG_NET_EMATCH=y   #basic uses extended matches so this has to be present
CONFIG_NET_SCH_INGRESS=y # classifier for ingress packet

#Barcode Print
CONFIG_BARCODE_PAINTER=y

# SSWAP
CONFIG_SWAP=y
CONFIG_FRONTSWAP=y
CONFIG_ZSMALLOC=y
CONFIG_ZSMALLOC_STAT=y
CONFIG_ZSMALLOC_OBJ_SEQ=n
CONFIG_PGTABLE_MAPPING=y
CONFIG_ZSWAP=y
CONFIG_ZSWAP_ENABLE_WRITEBACK=n
# CONFIG_ZSWAP_COMPACTION is not set
CONFIG_ZPOOL=y
CONFIG_DIRECT_RECLAIM_FILE_PAGES_ONLY=y
CONFIG_INCREASE_MAXIMUM_SWAPPINESS=y
CONFIG_FIX_INACTIVE_RATIO=y
CONFIG_TIGHT_PGDAT_BALANCE=y
CONFIG_VNSWAP=y
CONFIG_SWAP_ENABLE_READAHEAD=n

# MMAP READAROUND
CONFIG_MMAP_READAROUND_LIMIT=32

# MODEM SECURE CHECK
# CONFIG_SEC_PERIPHERAL_SECURE_CHK is not set

# BEGIN RKP_CFP
# CONFIG_RKP_CFP_ROPP is not set
# CONFIG_RKP_CFP_JOPP is not set
CONFIG_RKP_CFP_JOPP_MAGIC=0x00be7bad
# CONFIG_BPF_SYSCALL is not set
#
# END RKP_CFP
#

# CCIC
CONFIG_CCIC_NOTIFIER=y
CONFIG_CCIC_S2MM003=y
CONFIG_CCIC_S2MM005=y
CONFIG_CCIC_ALTERNATE_MODE=y
CONFIG_MUIC_SUPPORT_CCIC=y
CONFIG_USB_TYPEC_MANAGER_NOTIFIER=y
CONFIG_CCIC_LPM_ENABLE=y
CONFIG_DUAL_ROLE_USB_INTF=y

# Broadcom WiFi disable
# CONFIG_BROADCOM_WIFI is not set
# CONFIG_NL80211_TESTMODE is not set
# CONFIG_BCM4359 is not set
# CONFIG_BCMDHD_FW_PATH is not set
# CONFIG_BCMDHD_NVRAM_PATH is not set
# CONFIG_WIRELESS_EXT_SYSFS is not set
# CONFIG_WIFI_CONTROL_FUNC is not set
# CONFIG_BROADCOM_WIFI_RESERVED_MEM is not set
# CONFIG_CFG80211_REG_NOT_UPDATED is not set
# CONFIG_WIFI_MULTICAST_LOG is not set
# CONFIG_BCMDHD_PCIE is not set
# CONFIG_BCMDHD_PREALLOC_MEMDUMP is not set
# CONFIG_BCMDHD_PREALLOC_PKTIDMAP is not set

# Add Qualcomm Wifi features

CONFIG_NETDEVICES=y
CONFIG_WIRELESS=y
CONFIG_CNSS=y
CONFIG_WCNSS_MEM_PRE_ALLOC=y
CONFIG_CNSS_MAC_BUG=y
CONFIG_WEXT_CORE=y
CONFIG_WEXT_PROC=y
CONFIG_CFG80211=y
CONFIG_CFG80211_WEXT=y
CONFIG_CFG80211_DEFAULT_PS=y
CONFIG_CFG80211_ALLOW_RECONNECT=y
CONFIG_WLAN=y
CONFIG_CNSS_CRYPTO=y
CONFIG_QCA_CLD_WLAN=y
CONFIG_QCACLD_WLAN_LFR3=y
CONFIG_PRIMA_WLAN_OKC=y
CONFIG_PRIMA_WLAN_11AC_HIGH_TP=y
CONFIG_WLAN_FEATURE_11W=y
CONFIG_WLAN_FEATURE_LPSS=y
CONFIG_QCOM_VOWIFI_11R=y
CONFIG_WLAN_FEATURE_NAN=y
CONFIG_WLAN_FEATURE_NAN_DATAPATH=y
CONFIG_QCOM_TDLS=y
CONFIG_QCOM_LTE_COEX=y
CONFIG_WLAN_FEATURE_MEMDUMP=y
CONFIG_WLAN_OFFLOAD_PACKETS=y
CONFIG_QCA_WIFI_AUTOMOTIVE_CONC=y
CONFIG_WLAN_FEATURE_RX_WAKELOCK=y

# eMMC enable
CONFIG_MMC=y
CONFIG_MMC_PERF_PROFILING=y
CONFIG_MMC_CLKGATE=y
# CONFIG_MMC_PARANOID_SD_INIT is not set
CONFIG_MMC_BLOCK_MINORS=32
CONFIG_MMC_TEST=m
CONFIG_MMC_SDHCI=y
CONFIG_MMC_SDHCI_PLTFM=y
CONFIG_MMC_SDHCI_MSM=y
CONFIG_MMC_SDHCI_MSM_ICE=y
CONFIG_MMC_BLOCK_DEFERRED_RESUME=y
CONFIG_MMC_CQ_HCI=y

# UFS disable
# CONFIG_SCSI_UFSHCD is not set
# CONFIG_SCSI_UFSHCD_PLATFORM is not set
# CONFIG_SCSI_UFS_QCOM is not set
# CONFIG_SCSI_UFS_QCOM_ICE is not set
# CONFIG_UFS_UN_18DIGITS is not set

# Qualcomm BT
# CONFIG_BT_BCM4359 is not set
# CONFIG_BT_BLUESLEEP is not set
CONFIG_MSM_BT_POWER=y

# Qualcomm AES-256 ICE (Samsung ODE)
CONFIG_AES_256_ICE=y
```
