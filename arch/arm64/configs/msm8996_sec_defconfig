## arch/arm64/configs/msm8998_sec_dreamqlte_usa_single_defconfig
```kconfig
# msm8998_sec_dreamqlte_single_defconfig

CONFIG_SEC_DREAMQLTE_PROJECT=y
CONFIG_MACH_DREAMQLTE_SINGLE=y

CONFIG_BATTERY_SAMSUNG=y
CONFIG_BATTERY_SAMSUNG_V2=y
CONFIG_BATTERY_NOTIFIER=y
#CONFIG_MULTI_CHARGING=y
CONFIG_AFC_CHARGER_MODE=y
#CONFIG_CHARGER_MAX77854=y
#CONFIG_FUELGAUGE_MAX77854=y
CONFIG_CHARGER_SM5720=y
CONFIG_FUELGAUGE_SM5720=y
#CONFIG_CHARGER_DA9155=y
CONFIG_WIRELESS_CHARGER_MFC=y
CONFIG_WIRELESS_FIRMWARE_UPDATE=y
CONFIG_SAMSUNG_LPM_MODE=y
CONFIG_BATTERY_SWELLING=y
#CONFIG_SW_SELF_DISCHARGING=y
CONFIG_BATTERY_AGE_FORECAST=y
CONFIG_UPDATE_BATTERY_DATA=y
CONFIG_CALC_TIME_TO_FULL=y
CONFIG_BATTERY_CISD=y
CONFIG_AFC_CURR_CONTROL_BY_TEMP=y
CONFIG_LIMIT_CHARGING_DURING_CALL=y
#CONFIG_STEP_CHARGING=y
CONFIG_WIRELESS_CHARGER_HIGH_VOLTAGE=y
CONFIG_ENABLE_100MA_CHARGING_BEFORE_USB_CONFIGURED=y
CONFIG_LEDS_SM5720_RGB=y

#DISPLAY PORT
CONFIG_FB_MSM_MDSS_DP_PANEL=y
CONFIG_SEC_DISPLAYPORT=y
CONFIG_SEC_DISPLAYPORT_LOGGER=y
CONFIG_SEC_DISPLAYPORT_BIGDATA=y

# MUIC configs
CONFIG_MFD_CORE=y
CONFIG_USE_MUIC=y
CONFIG_USE_SAFEOUT=y
CONFIG_MUIC_UNIVERSAL=y
CONFIG_MUIC_NOTIFIER=y
CONFIG_AFC_CHARGER_MODE=y
CONFIG_MFD_SM5720=y
CONFIG_MUIC_UNIVERSAL_SM5720=y
CONFIG_MUIC_SUPPORT_RUSTPROOF=y
CONFIG_VBUS_NOTIFIER=y
CONFIG_VBUS_NOTIFIER_WORK=y
CONFIG_MUIC_SUPPORT_CCIC=y
CONFIG_MUIC_HV=y

# BLUETOOTH
CONFIG_BT=y
CONFIG_BT_BCM4361=y
CONFIG_BT_BLUESLEEP=y
CONFIG_RFKILL=y

# gpio expander
CONFIG_GPIO_PCAL6524=y

# Display
CONFIG_PANEL_S6E3HA6_AMB577MQ01_WQHD=y
CONFIG_SUPPORT_POC_FLASH=y

# Display SUB PMIC
CONFIG_REGULATOR_S2DOS03=y
# CONFIG_REGULATOR_MAX77838 is not set

# S2MPB02 Camera SUB PMIC
CONFIG_LEDS_S2MPB02=y
CONFIG_MFD_S2MPB02=y
CONFIG_REGULATOR_S2MPB02=y

# BuckBoost SUB PMIC
CONFIG_REGULATOR_S2ABB01=y

# Audio
CONFIG_SND_SOC_WCD_MBHC_ADC=y
CONFIG_SND_SOC_WCD_MBHC_SLOW_DET=y

# FM radio
CONFIG_MEDIA_RADIO_SUPPORT=y
CONFIG_I2C_RTC6213N=y
CONFIG_RADIO_RTC6213N=y

# IRIS
CONFIG_IRIS_I2C_START=10
CONFIG_IRIS_I2C_END=11
CONFIG_IRIS_GPIO_START=41
CONFIG_IRIS_GPIO_END=42

# DSM Solution
CONFIG_SND_SOC_MAX98506=y
CONFIG_SND_SOC_MAXIM_DSM=y
CONFIG_SND_SOC_MAXIM_DSM_CAL=y
CONFIG_SEC_SND_ADAPTATION=y

# input
CONFIG_TOUCHSCREEN_FTS=y
CONFIG_TOUCHSCREEN_SEC_TS=y
CONFIG_TOUCHSCREEN_DUMP_MODE=y

#motor
# CONFIG_MOTOR_DRV_MAX77854 is not set
CONFIG_MOTOR_DRV_SM5720=y
CONFIG_SS_VIBRATOR=y
CONFIG_MOTOR_DRV2624=y
CONFIG_BOOST_POWER_SHARE=y

#sensor
# CONFIG_BMI168_FACTORY is not set
CONFIG_LSM6DSL_FACTORY=y
CONFIG_AK09916C_FACTORY=y
CONFIG_LPS22HB_FACTORY=y
CONFIG_TMD490X_FACTORY=y
CONFIG_SUPPORT_TMD4906_FACTORY=y
CONFIG_SUPPORT_PROX_AUTO_CAL=y
CONFIG_SUPPORT_HIDDEN_HOLE=y
CONFIG_SLPI_MOTOR=y
CONFIG_SENSORS_SX9320=y
CONFIG_SENSORS_HRMSENSOR=y
CONFIG_SENSORS_HRM_MAX86902=y
CONFIG_SENSORS_HRM_MAX869_ENHANCED_EOL=y

# Finger print sensor
CONFIG_SENSORS_FINGERPRINT=y
CONFIG_SENSORS_VFS8XXX=y
CONFIG_SENSORS_FP_SPI_NUMBER=12
CONFIG_SENSORS_FP_SPI_GPIO_START=81
CONFIG_SENSORS_FP_SPI_GPIO_END=84

#ccic
CONFIG_CCIC_S2MM003=y
CONFIG_CCIC_S2MM005=y

#NFC eSE
CONFIG_SAMSUNG_NFC=y
CONFIG_NFC_PN547=y
CONFIG_NFC_PN547_ESE_SUPPORT=y
CONFIG_ESE_SECURE=y
CONFIG_ESE_SPI_GPIO_START=0
CONFIG_ESE_SPI_GPIO_END=3
CONFIG_ESE_SECURE_SPI_PORT=1
CONFIG_SEC_NFC_LOGGER=y

# CAMERA
CONFIG_COMPANION3=y
CONFIG_CAMERA_SYSFS_V2=y
#CONFIG_MSM_FRONT_EEPROM=y
CONFIG_SAMSUNG_OIS_RUMBA_S4=y
#CONFIG_SAMSUNG_OIS_RUMBA_S6=y
CONFIG_SENSOR_RETENTION=y
CONFIG_SAMSUNG_SECURE_CAMERA=y
#CONFIG_SAMSUNG_MULTI_CAMERA=y
CONFIG_USE_CAMERA_HW_BIG_DATA=y

# EPDG
CONFIG_NET_CORE=y
CONFIG_NET_SCH_PRIO=y
CONFIG_NET_SCHED=y   #depends on CONFIG_NET  which is enabled by default.. coz not seeing in the config file
CONFIG_NET_CLS_BASIC=y # required if basic is being used as a filter. depends on CONFIG_NET_CLS so enabling it by default
CONFIG_NET_CLS=y
CONFIG_NET_CLS_ACT=y # for enabling the action target.
CONFIG_NET_ACT_MIRRED=y  # for enabling the mirred target for redirecting the packet between the devices.
CONFIG_NET_EMATCH=y   #basic uses extended matches so this has to be present
CONFIG_NET_SCH_INGRESS=y # classifier for ingress packet

# SSWAP
CONFIG_SWAP=y
CONFIG_FRONTSWAP=y
CONFIG_ZSMALLOC=y
CONFIG_ZSMALLOC_STAT=y
CONFIG_PGTABLE_MAPPING=y
CONFIG_ZSWAP=y
CONFIG_ZSWAP_MIGRATION_SUPPORT=y
CONFIG_ZSWAP_ENABLE_WRITEBACK=n
CONFIG_ZSWAP_SAME_PAGE_SHARING=n
CONFIG_ZPOOL=y
CONFIG_DIRECT_RECLAIM_FILE_PAGES_ONLY=y
CONFIG_INCREASE_MAXIMUM_SWAPPINESS=y
CONFIG_FIX_INACTIVE_RATIO=y
CONFIG_TIGHT_PGDAT_BALANCE=y
CONFIG_VNSWAP=y
CONFIG_SWAP_ENABLE_READAHEAD=n

# MMAP READAROUND
CONFIG_MMAP_READAROUND_LIMIT=32

#Freecess
CONFIG_SAMSUNG_FREECESS=y
```
