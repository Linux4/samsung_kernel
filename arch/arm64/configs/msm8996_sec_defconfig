## arch/arm64/configs/o8_debug_defconfig
```kconfig
CONFIG_PREEMPT=y
CONFIG_IKHEADERS=m
# A14 code for SR-AL6528A-01-90 by gaochao at 20220829 start
CONFIG_LOG_BUF_SHIFT=21
# A14 code for SR-AL6528A-01-90 by gaochao at 20220829 end
CONFIG_UCLAMP_TASK=y
CONFIG_UCLAMP_TASK_GROUP=y
CONFIG_CPUSETS=y
CONFIG_SCHED_TUNE=y
# CONFIG_RD_BZIP2 is not set
# CONFIG_RD_LZMA is not set
# CONFIG_RD_XZ is not set
# CONFIG_RD_LZO is not set
# CONFIG_RD_LZ4 is not set
CONFIG_SYSCTL_SYSCALL=y
# CONFIG_FHANDLE is not set
# CONFIG_KALLSYMS_BASE_RELATIVE is not set
CONFIG_MTK_SCHED_EXTENSION=y
CONFIG_MTK_IDLE_BALANCE_ENHANCEMENT=y
CONFIG_MTK_SCHED_INTEROP=y
CONFIG_MTK_SCHED_LB_ENHANCEMENT=y
CONFIG_MTK_SCHED_TRACERS=y
CONFIG_MTK_SCHED_CPU_PREFER=y
CONFIG_MTK_SCHED_BIG_TASK_MIGRATE=y
CONFIG_MACH_MT6768=y
CONFIG_SCHED_MC=y
CONFIG_NR_CPUS=8
CONFIG_RANDOMIZE_BASE=y
CONFIG_CMDLINE="console=tty0 console=ttyMT3,921600n1 root=/dev/ram vmalloc=496M slub_max_order=0 slub_debug=O "
# CONFIG_EFI is not set
CONFIG_WQ_POWER_EFFICIENT_DEFAULT=y
CONFIG_ENERGY_MODEL=y
CONFIG_CPU_FREQ=y
CONFIG_CPU_FREQ_STAT=y
CONFIG_CPU_FREQ_DEFAULT_GOV_SCHEDUTIL=y
CONFIG_CPU_FREQ_GOV_POWERSAVE=y
CONFIG_CPU_FREQ_GOV_USERSPACE=y
CONFIG_CPU_FREQ_GOV_ONDEMAND=y
CONFIG_MODULE_SRCVERSION_ALL=y
# CONFIG_BLK_DEV_BSG is not set
CONFIG_BLK_INLINE_ENCRYPTION=y
CONFIG_BLK_INLINE_ENCRYPTION_FALLBACK=y
# CONFIG_CORE_DUMP_DEFAULT_ELF_HEADERS is not set
CONFIG_ZSMALLOC=y
CONFIG_XFRM_MIGRATE=y
CONFIG_SYN_COOKIES=y
CONFIG_VLAN_8021Q=y
CONFIG_CLS_U32_PERF=y
CONFIG_CLS_U32_MARK=y
CONFIG_CFG80211=y
CONFIG_NL80211_TESTMODE=y
CONFIG_CFG80211_DEVELOPER_WARNINGS=y
# CONFIG_CFG80211_DEFAULT_PS is not set
CONFIG_CFG80211_DEBUGFS=y
# CONFIG_UEVENT_HELPER is not set
CONFIG_FW_LOADER_USER_HELPER=y
CONFIG_FW_LOADER_USER_HELPER_FALLBACK=y
# CONFIG_FW_CACHE is not set
CONFIG_ZRAM=y
CONFIG_BLK_DEV_LOOP_MIN_COUNT=16
CONFIG_ANDROID_DEFAULT_SETTING=y
CONFIG_MTK_ANDROID_DEFAULT_SETTING=y
CONFIG_USB_MTK_HDRC=y
CONFIG_MTK_MUSB_QMU_SUPPORT=y
CONFIG_MTK_MUSB_QMU_PURE_ZLP_SUPPORT=y
CONFIG_MTK_MUSB_DRV_36BIT=y
CONFIG_USB_MTK_OTG=y
CONFIG_MTK_MUSB_DUAL_ROLE=y
CONFIG_MTK_PLATFORM="mt6768"
CONFIG_ARCH_MTK_PROJECT="o8"
CONFIG_MTK_ENG_BUILD=y
CONFIG_NONLINEAR_FREQ_CTL=y
CONFIG_PMIC_LBAT_SERVICE=y
CONFIG_MTK_PTPOD=y
CONFIG_MTK_STATIC_POWER=y
CONFIG_MTK_UNIFY_POWER=y
CONFIG_MTK_CPU_FREQ=y
CONFIG_MTK_PBM=y
CONFIG_MTK_PMIC_NEW_ARCH=y
CONFIG_MTK_PMIC_COMMON=y
CONFIG_MTK_PMIC_CHIP_MT6358=y
CONFIG_MTK_EXTERNAL_CHARGER_TYPE_DETECT=y
# hs14 code for SR-AL6528A-01-307 by wenyaqi at 2022/08/30 start
# CONFIG_MFD_MT6370_PMU is not set
# CONFIG_MT6370_PMU_CHARGER is not set
# CONFIG_MT6370_PMU_FLED is not set
# CONFIG_MT6370_PMU_BLED is not set
# CONFIG_MT6370_PMU_LDO is not set
# CONFIG_MT6370_PMU_DSV is not set
CONFIG_MTK_PMIC_WRAP_HAL=y
CONFIG_MTK_SEC_VIDEO_PATH_SUPPORT=y
CONFIG_MTK_DRM_KEY_MNG_SUPPORT=y
#hs14 code for AL6528ADEU-2675 by pengxutao at 2022/11/18 start
CONFIG_CUSTOM_KERNEL_IMGSENSOR="a1401backs5kjn1hlt_mipi_raw a1401fronts5k3l6ly_mipi_raw a1401widehi556wly_mipi_raw a1401macroov02b10ly_mipi_raw a1402backhi5022qxl_mipi_raw a1402frontgc13a0xl_mipi_raw a1402widesc520cstxd_mipi_raw a1402macrosc202cscxt_mipi_raw a1403backhi5022qly_mipi_raw a1403frontsc1301cstxd_mipi_raw a1403wideov05ahlt_mipi_raw a1403macrogc02m1hlt_mipi_raw a1404backs5kjn1txd_mipi_raw"
#hs14 code for AL6528ADEU-2675 by pengxutao at 2022/11/18 end
CONFIG_MTK_LCM=y
# a06 code for AL7160A-5 by wenghailong at 20240313 start
CONFIG_CUSTOM_KERNEL_LCM="lcd_hx83108b_xx_hkc_mipi_hd_video lcd_default_mipi_fhd_video"
# a06 code for AL7160A-5 by wenghailong at 20240313 end
# hs14 code for SR-AL6528A-01-784 by fengzhigang at 20221201 start
CONFIG_SWITCH=y
# hs14 code for SR-AL6528A-01-784 by fengzhigang at 20221201 end
CONFIG_HQ_SET_LCD_BIAS=y
CONFIG_HQ_EXT_LCD_BIAS=y
CONFIG_MTK_SYNC=y
CONFIG_MTK_FB=y
CONFIG_MTK_LCM_PHYSICAL_ROTATION="0"
CONFIG_LCM_HEIGHT="2160"
# hs14 code for AL6528A-170 by tangzhen at 20220927 start
# CONFIG_MTK_AAL_SUPPORT is not set
# hs14 code for AL6528A-170 by tangzhen at 20220927 end
CONFIG_MTK_M4U=y
CONFIG_MTK_FLASHLIGHT=y
# CONFIG_MTK_FLASHLIGHT_MT6370 is not set
#hs14 code for AL6528A-258 by xutengtao at 2022-10-10 start*/
#CONFIG_MTK_FLASHLIGHT_PT=y
#CONFIG_MTK_FLASHLIGHT_PT_STRICT=y
#CONFIG_MTK_FLASHLIGHT_DLPT=y
#hs14 code for AL6528A-258 by xutengtao at 2022-10-10 end*/
CONFIG_RT_FLASHLIGHT=y
# hs14 code for SR-AL5628-01-161 by lisizhou at 2022-9-21 start
CONFIG_MTK_FLASHLIGHT_SGM3785_GPIO=y
CONFIG_MTK_PWM=y
# hs14 code for SR-AL5628-01-161 by lisizhou at 2022-9-21 end
CONFIG_MTK_IMGSENSOR=y
CONFIG_MTK_LENS=y
CONFIG_MTK_CAM_CAL=y
CONFIG_MTK_CMDQ_V3=y
CONFIG_MTK_CMDQ=y
CONFIG_MTK_SMI_EXT=y
CONFIG_MTK_JPEG=y
CONFIG_MTK_CCU=y
CONFIG_MTK_CAM_SECURITY_SUPPORT=y
CONFIG_MTK_CAM_GENIEZONE_SUPPORT=y
CONFIG_MTK_SENSOR_SUPPORT=y
CONFIG_MTK_SENSOR_ARCHITECTURE="1.0"
CONFIG_CUSTOM_KERNEL_ACCELEROMETER=y
CONFIG_MTK_ACCELHUB=y
CONFIG_CUSTOM_KERNEL_ALSPS=y
CONFIG_MTK_ALSPSHUB=y
# hs14 code for SR-AL6528A-01-387 by houxin at 2022/10/17 start
# CONFIG_CUSTOM_KERNEL_GYROSCOPE is not set
# CONFIG_MTK_GYROHUB is not set
CONFIG_CUSTOM_KERNEL_MAGNETOMETER=y
CONFIG_MTK_MAGHUB=y
CONFIG_MTK_HWMON=y
# CONFIG_CUSTOM_KERNEL_BAROMETER is not set
# ONFIG_MTK_BAROHUB is not set
CONFIG_CUSTOM_KERNEL_STEP_COUNTER=y
CONFIG_MTK_STEPSIGNHUB=y
CONFIG_CUSTOM_KERNEL_SITUATION=y
CONFIG_MTK_STATHUB=y
#hs14 code for SR-AL6528A-01-779 by xiongxiaoliang at 2022/11/23 start
# CONFIG_MTK_WAKEHUB is not set
CONFIG_MTK_WAKE_UP_MOTION=y
#hs14 code for SR-AL6528A-01-779 by xiongxiaoliang at 2022/11/23 end
CONFIG_MTK_GLGHUB=y
CONFIG_MTK_PICKUPHUB=y
#hs14 code for P221101-08528 by lichang at 2022/11/02 start
#CONFIG_MTK_DEVICE_ORIENTATION_HUB is not set
CONFIG_MTK_MOTION_DETECT_HUB=y
CONFIG_MTK_TILTDETECTHUB=y
#hs14 code for SR-AL6528A-01-778 by xiongxiaoliang at 2022/11/26 start
CONFIG_MTK_SMARTALERT_HUB=y
#hs14 code for SR-AL6528A-01-778 by xiongxiaoliang at 2022/11/26 end
CONFIG_CUSTOM_KERNEL_SENSORHUB=y
CONFIG_NANOHUB=y
CONFIG_NANOHUB_MTK_IPI=y
# hs14 code for AL6528A-543 by xiongxiaoliang at 2022/11/06 start
#CONFIG_CUSTOM_KERNEL_SENSOR_FUSION is not set
# hs14 code for AL6528A-543 by xiongxiaoliang at 2022/11/06 end
CONFIG_CUSTOM_KERNEL_GRV_SENSOR=y
CONFIG_CUSTOM_KERNEL_GMRV_SENSOR=y
CONFIG_CUSTOM_KERNEL_RV_SENSOR=y
CONFIG_CUSTOM_KERNEL_LINEARACCEL_SENSOR=y
CONFIG_CUSTOM_KERNEL_GRAVITY_SENSOR=y
#CONFIG_CUSTOM_KERNEL_UNCALI_ACC_SENSOR is not set
# CONFIG_CUSTOM_KERNEL_UNCALI_GYRO_SENSOR is not set
#CONFIG_CUSTOM_KERNEL_UNCALI_MAG_SENSOR is not set
#hs14 code for SR-AL6528A-01-376 by xiongxiaoliang at 2022/09/02 start
CONFIG_CUSTOM_KERNEL_SAR_SENSOR=y
CONFIG_INPUT_SX933x=y
#hs14 code for SR-AL6528A-01-376 by xiongxiaoliang at 2022/09/02 end
#CONFIG_MTK_UNCALI_MAGHUB is not set
# CONFIG_MTK_UNCALI_GYROHUB is not set
# hs14 code for SR-AL6528A-01-387 by houxin at 2022/10/17 end
#CONFIG_MTK_UNCALI_ACCHUB is not set
#hs14 code for P221101-08528 by lichang at 2022/11/02 end
CONFIG_MTK_CCCI_DEVICES=y
# hs14 code for AL6528A-48 by yangxinpeng at 2022/9/20 start
CONFIG_MTK_MD1_SUPPORT=9
# hs14 code for AL6528A-48 by yangxinpeng at 2022/9/20 end
CONFIG_MTK_ECCCI_DRIVER=y
CONFIG_MTK_ECCCI_C2K=y
CONFIG_MTK_BTIF=y
CONFIG_MTK_COMBO=y
CONFIG_MTK_COMBO_CHIP_CONSYS_6768=y
CONFIG_MTK_COMBO_GPS=y
CONFIG_MTK_COMBO_WIFI=y
CONFIG_MTK_DHCPV6C_WIFI=y
CONFIG_MTK_GPS_SUPPORT=y
CONFIG_MTK_FMRADIO=y
CONFIG_MTK_FM_CHIP="MT6631_FM"
CONFIG_MTK_CONNSYS_DEDICATED_LOG_PATH=y
CONFIG_MTK_TEE_GP_SUPPORT=y
CONFIG_HAVE_MTK_ENABLE_GENIEZONE=y
CONFIG_MTK_ENABLE_GENIEZONE=y
CONFIG_MTK_GZ_MAIN=y
CONFIG_MTK_GZ_LOG=y
CONFIG_MTK_GZ_VIRTIO=y
CONFIG_MTK_GZ_VIRTIO_IPC=y
CONFIG_MTK_GZ_IRQ=y
CONFIG_HAVE_MTK_GZ_LOG=y
CONFIG_EXTCON_MTK_USB=y
CONFIG_MTK_USB_TYPEC_U3_MUX=y
CONFIG_TCPC_CLASS=y
# CONFIG_TCPC_MT6370 is not set
CONFIG_USB_POWER_DELIVERY=y
CONFIG_MTK_LEDS=y
CONFIG_MTK_PWM=y
CONFIG_MTK_ACCDET=y
CONFIG_ACCDET_EINT_IRQ=y
CONFIG_ACCDET_SUPPORT_EINT0=y
CONFIG_MTK_RTC=y
CONFIG_MTK_PERF_COMMON=y
CONFIG_MTK_PERF_TRACKER=y
CONFIG_MTK_LOAD_TRACKER=y
CONFIG_MTK_CPU_CTRL_CFP=y
CONFIG_MTK_PERF_OBSERVER=y
CONFIG_MTK_RESYM=y
CONFIG_MTK_FPSGO_V3=y
CONFIG_MTK_TASK_TURBO=y
CONFIG_MTK_TINYSYS_SCP_SUPPORT=y
CONFIG_MTK_TINYSYS_SSPM_SUPPORT=y
CONFIG_MTK_TINYSYS_SSPM_VERSION="v1"

CONFIG_MTK_MET_PLF=m
CONFIG_MTPROF=y
CONFIG_MTK_SCHED_MONITOR=y
CONFIG_MTK_IRQ_COUNT_TRACER=y
CONFIG_MTK_IRQ_OFF_TRACER=y
CONFIG_MTK_PREEMPT_TRACER=y
CONFIG_MTK_AEE_UT=y
CONFIG_MTK_AEE_HANGDET=y
CONFIG_MTK_CM_MGR_LEGACY=y
CONFIG_MTK_VIBRATOR=y
CONFIG_MTK_LEGACY_THERMAL=y
CONFIG_MTK_THERMAL_PA_VIA_ATCMD=y
CONFIG_MTK_CAMERA_ISP_RSC_SUPPORT=y
CONFIG_MTK_CAMERA_ISP_WPE_SUPPORT=y
CONFIG_MTK_CAMERA_ISP_DPE_SUPPORT=y
CONFIG_MTK_CAMERA_ISP_FD_SUPPORT=y
CONFIG_MTK_SELINUX_AEE_WARNING=y
CONFIG_MTK_DRAM_LOG_STORE=y
CONFIG_MTK_DRAM_LOG_STORE_ADDR=0x10E700
CONFIG_MTK_DRAM_LOG_STORE_SIZE=0x100
CONFIG_MTK_FREQ_HOPPING=y
CONFIG_SCSI=y
CONFIG_BLK_DEV_SD=y
CONFIG_SCSI_SCAN_ASYNC=y
# CONFIG_SCSI_LOWLEVEL is not set
CONFIG_DM_DEBUG=y
CONFIG_DM_CRYPT=y
CONFIG_DM_DEFAULT_KEY=y
CONFIG_DM_UEVENT=y
CONFIG_DM_VERITY_AVB=y
CONFIG_DM_VERITY_FEC=y
CONFIG_DM_BOW=y
CONFIG_IFB=y
# CONFIG_ETHERNET is not set
CONFIG_PPP_FILTER=y
CONFIG_PPP_MULTILINK=y
CONFIG_PPPOE=y
CONFIG_PPP_ASYNC=y
CONFIG_PPP_SYNC_TTY=y
CONFIG_USB_USBNET=y
# CONFIG_KEYBOARD_ATKBD is not set
CONFIG_KEYBOARD_MTK=y
# hs14 code for SR-AL6528A-01-402 by hehaoran5 at 20220921 start
# CONFIG_ONEKEY_REBOOT_NORMAL_MODE is not set
CONFIG_TWOKEY_REBOOT_NORMAL_MODE=y
# hs14 code for SR-AL6528A-01-402 by hehaoran5 at 20220921 end
CONFIG_ONEKEY_REBOOT_OTHER_MODE=y
CONFIG_KPD_PWRKEY_USE_PMIC=y
CONFIG_MTK_MRDUMP_KEY=y
# CONFIG_INPUT_MOUSE is not set
CONFIG_INPUT_TOUCHSCREEN=y
CONFIG_TOUCHSCREEN_MTK_TOUCH="GT9886"
CONFIG_TOUCHSCREEN_MTK=y
# a06 code for AL7160A-5 by wenghailong at 20240313 start
CONFIG_ODM_SEC_COMMON=y
# a06 code for AL7160A-5 by wenghailong at 20240313 end
# a06 code for AL7160A-5 by wenghailong at 20240313 start
CONFIG_TOUCHSCREEN_HX83108B_CHIPSET_O8=y
CONFIG_TOUCHSCREEN_HIMAX_IC_HX83108A=y
CONFIG_TOUCHSCREEN_HIMAX_INSPECT=y
CONFIG_TOUCHSCREEN_HIMAX_DEBUG=y
CONFIG_TOUCHSCREEN_HIMAX_COMMON=y
# a06 code for AL7160A-5 by wenghailong at 20240313 end

CONFIG_INPUT_MISC=y
CONFIG_INPUT_UINPUT=y
# CONFIG_SERIO is not set
# CONFIG_VT is not set
CONFIG_LEGACY_PTY_COUNT=16
# CONFIG_DEVMEM is not set
CONFIG_SERIAL_8250=y
CONFIG_SERIAL_8250_CONSOLE=y
CONFIG_SERIAL_8250_NR_UARTS=2
CONFIG_SERIAL_8250_RUNTIME_UARTS=2
CONFIG_SERIAL_8250_MT6577=y
CONFIG_RPMB=y
CONFIG_I2C_MTK=y
CONFIG_SPI=y
CONFIG_SPI_MT65XX=y
CONFIG_MTK_CHARGER=y
CONFIG_MTK_KERNEL_POWER_OFF_CHARGING=y
CONFIG_MTK_GAUGE_VERSION=30
# CONFIG_HWMON is not set
CONFIG_THERMAL=y
CONFIG_THERMAL_DEFAULT_GOV_BACKWARD_COMPATIBLE=y
CONFIG_WATCHDOG=y
CONFIG_MEDIATEK_WATCHDOG=y
CONFIG_MT6358_MISC=y
CONFIG_REGULATOR_MT6358=y
CONFIG_MEDIA_SUPPORT=y
CONFIG_MEDIA_CAMERA_SUPPORT=y
CONFIG_V4L_PLATFORM_DRIVERS=y
CONFIG_V4L_MEM2MEM_DRIVERS=y
CONFIG_VIDEO_MEDIATEK_VCU_WO_FUSE=y
CONFIG_VIDEO_MEDIATEK_VCODEC=y
CONFIG_MTK_GPU_SUPPORT=y
CONFIG_MTK_GPU_VERSION="mali valhall r32p1"
CONFIG_MTK_GPU_COMMON_DVFS_SUPPORT=y
CONFIG_FB_MODE_HELPERS=y
CONFIG_FB_TILEBLITTING=y
CONFIG_LOGO=y
CONFIG_SND_HRTIMER=y
CONFIG_SND_DYNAMIC_MINORS=y
CONFIG_SND_VERBOSE_PRINTK=y
CONFIG_SND_DEBUG=y
CONFIG_SND_DEBUG_VERBOSE=y
CONFIG_SND_PCM_XRUN_DEBUG=y
CONFIG_SND_SEQUENCER=y
CONFIG_SND_SEQ_DUMMY=y
# CONFIG_SND_SPI is not set
CONFIG_SND_USB_AUDIO=y
CONFIG_SND_SOC=y
CONFIG_SND_SOC_MT6768_MT6358=y
CONFIG_SND_SOC_MTK_BTCVSD=y
CONFIG_SND_SOC_MT6660=y
CONFIG_HIDRAW=y
CONFIG_HID_A4TECH=y
CONFIG_HID_APPLE=y
CONFIG_HID_BELKIN=y
CONFIG_HID_CHERRY=y
CONFIG_HID_CHICONY=y
CONFIG_HID_CYPRESS=y
CONFIG_HID_DRAGONRISE=y
CONFIG_HID_EZKEY=y
CONFIG_HID_KYE=y
CONFIG_HID_GYRATION=y
CONFIG_HID_TWINHAN=y
CONFIG_HID_KENSINGTON=y
CONFIG_HID_LOGITECH=y
CONFIG_HID_MAGICMOUSE=y
CONFIG_HID_MICROSOFT=y
CONFIG_HID_MONTEREY=y
CONFIG_HID_PANTHERLORD=y
CONFIG_HID_PETALYNX=y
CONFIG_HID_SAMSUNG=y
CONFIG_HID_SUNPLUS=y
CONFIG_HID_GREENASIA=y
CONFIG_HID_SMARTJOYPLUS=y
CONFIG_HID_TOPSEED=y
CONFIG_HID_THRUSTMASTER=y
CONFIG_HID_ZEROPLUS=y
CONFIG_USB_STORAGE=y
CONFIG_USB_STORAGE_DATAFAB=y
CONFIG_USB_STORAGE_FREECOM=y
CONFIG_USB_STORAGE_ISD200=y
CONFIG_USB_STORAGE_USBAT=y
CONFIG_USB_STORAGE_SDDR09=y
CONFIG_USB_STORAGE_SDDR55=y
CONFIG_USB_STORAGE_JUMPSHOT=y
CONFIG_USB_STORAGE_ALAUDA=y
CONFIG_USB_STORAGE_ONETOUCH=y
CONFIG_USB_STORAGE_KARMA=y
CONFIG_USB_STORAGE_CYPRESS_ATACB=y
CONFIG_USB_TRANCEVIBRATOR=y
CONFIG_NOP_USB_XCEIV=y
CONFIG_USB_GADGET_VBUS_DRAW=500
CONFIG_USB_CONFIGFS_SERIAL=y
CONFIG_USB_CONFIGFS_ACM=y
CONFIG_USB_CONFIGFS_RNDIS=y
CONFIG_USB_CONFIGFS_MASS_STORAGE=y
CONFIG_USB_CONFIGFS_MTK_FASTMETA=y
CONFIG_USB_CONFIGFS_F_HID=y
CONFIG_MMC=y
CONFIG_MMC_BLOCK_MINORS=32
CONFIG_MMC_CRYPTO=y
CONFIG_MTK_EMMC_SUPPORT_OTP=y
CONFIG_MMC_CQHCI=y
CONFIG_MMC_MTK=y
CONFIG_NEW_LEDS=y
CONFIG_LEDS_CLASS=y
CONFIG_LEDS_TRIGGERS=y
CONFIG_LEDS_TRIGGER_TIMER=y
# CONFIG_RTC_SYSTOHC is not set
CONFIG_RTC_DRV_MT6358=y
CONFIG_DMADEVICES=y
CONFIG_MTK_UART_APDMA=y
CONFIG_SW_SYNC=y
CONFIG_ANDROID_INTF_ALARM_DEV=y
CONFIG_ION=y
CONFIG_MTK_ION=y
CONFIG_MTK_PMIC_WRAP=y
CONFIG_PM_DEVFREQ=y
CONFIG_IIO=y
CONFIG_MEDIATEK_MT6577_AUXADC=y
CONFIG_MT635X_AUXADC=y
CONFIG_PHY_MTK_TPHY=y
CONFIG_MTK_DEVINFO=y
CONFIG_TEE=y
CONFIG_TZDEV=y
CONFIG_TZDEV_IWI_EVENT=294
CONFIG_TZDEV_IWI_PANIC=295
CONFIG_TZDEV_SWD_PANIC_IS_CRITICAL=y
CONFIG_TZLOG=y
CONFIG_TZLOG_PG_CNT=8
CONFIG_TZDEV_SK_MULTICORE=y
CONFIG_ION_FD2PHYS_USE_ION_FROM_STAGING=y
CONFIG_TZIRS=y
# hs14 code for SR-AL6528A-01-129 by zhumengnan at 20221025 start
CONFIG_TZDEV_PAGE_MIGRATION=y
# hs14 code for SR-AL6528A-01-129 by zhumengnan at 20221025 end
CONFIG_TZ_BOOT_LOG=y
CONFIG_TEEGRIS_VERSION=4
CONFIG_TEEGRIS_TEE_SUPPORT=y
CONFIG_EXT4_DEBUG=y
CONFIG_FS_ENCRYPTION_INLINE_CRYPT=y
CONFIG_QUOTA_NETLINK_INTERFACE=y
CONFIG_INCREMENTAL_FS=y
CONFIG_ISO9660_FS=y
CONFIG_JOLIET=y
CONFIG_ZISOFS=y
CONFIG_MSDOS_FS=y
CONFIG_VFAT_FS=y
CONFIG_PSTORE=y
CONFIG_PSTORE_CONSOLE=y
CONFIG_PSTORE_PMSG=y
CONFIG_PSTORE_RAM=y
# CONFIG_NETWORK_FILESYSTEMS is not set
CONFIG_NLS_CODEPAGE_437=y
CONFIG_NLS_CODEPAGE_950=y
CONFIG_NLS_ASCII=y
CONFIG_NLS_ISO8859_1=y
CONFIG_NLS_UTF8=y
CONFIG_STATIC_USERMODEHELPER=y
CONFIG_STATIC_USERMODEHELPER_PATH="/system_ext/bin/aee_core_forwarder"
CONFIG_CRYPTO_TWOFISH=y
# CONFIG_CRYPTO_HW is not set
CONFIG_PRINTK_TIME=y
CONFIG_DYNAMIC_DEBUG=y
CONFIG_DEBUG_INFO=y
CONFIG_FRAME_WARN=2800
CONFIG_PAGE_OWNER=y
CONFIG_DEBUG_SECTION_MISMATCH=y
CONFIG_DEBUG_PAGEALLOC=y
CONFIG_DEBUG_PAGEALLOC_ENABLE_DEFAULT=y
CONFIG_SLUB_DEBUG_ON=y
CONFIG_DEBUG_KMEMLEAK=y
CONFIG_DEBUG_KMEMLEAK_EARLY_LOG_SIZE=6400
CONFIG_DEBUG_KMEMLEAK_DEFAULT_OFF=y
CONFIG_DEBUG_VIRTUAL=y
CONFIG_PANIC_ON_OOPS=y
CONFIG_PANIC_TIMEOUT=5
CONFIG_SCHEDSTATS=y
CONFIG_SCHED_STACK_END_CHECK=y
CONFIG_PROVE_LOCKING=y
CONFIG_DEBUG_LOCKDEP=y
CONFIG_DEBUG_ATOMIC_SLEEP=y
CONFIG_MTK_LOCKING_AEE=y
CONFIG_RCU_CPU_STALL_TIMEOUT=60
CONFIG_RCU_TRACE=y
CONFIG_FAULT_INJECTION=y
CONFIG_DMA_API_DEBUG=y
CONFIG_BUG_ON_DATA_CORRUPTION=y
CONFIG_KGDB=y
CONFIG_KGDB_KDB=y
CONFIG_HQ_PROJECT_O8=y
# hs14 code for SR-AL6528A-01-183 by gaochao at 20220908 start
CONFIG_F2FS_FS=y
CONFIG_F2FS_FS_SECURITY=y
CONFIG_F2FS_FS_ENCRYPTION=y
CONFIG_F2FS_STAT_FS=y
CONFIG_F2FS_FS_XATTR=y
CONFIG_F2FS_FS_POSIX_ACL=y
CONFIG_F2FS_CHECK_FS=y
# hs14 code for SR-AL6528A-01-183 by gaochao at 20220908 end
# A14 code for SR-AL6528A-01-90 by gaochao at 20220829 start
CONFIG_LOG_BUF_SHIFT=21
# A14 code for SR-AL6528A-01-90 by gaochao at 20220829 end
#for charger
CONFIG_CHARGER_SGM41513=y
# hs14 code for SR-AL6528A-01-305 by gaozhengwei at 2022/09/01 start
CONFIG_CHARGER_SC8960X=y
# hs14 code for SR-AL6528A-01-305 by gaozhengwei at 2022/09/01 end
# hs14 code for SR-AL6528A-01-304 by gaozhengwei at 2022/09/07 start
CONFIG_CHARGER_UPM6910=y
# hs14 code for SR-AL6528A-01-304 by gaozhengwei at 2022/09/07 end
#hs14 code for SR-AL6528A-01-305 by shanxinkai at 2022/09/19 start
CONFIG_CHARGER_VBUS=y
#hs14 code for SR-AL6528A-01-305 by shanxinkai at 2022/09/19 end
#for usb
CONFIG_TCPC_HUSB311=y
CONFIG_HUSB_REGMAP=y
#hs14 code for SR-AL6528A-01-253 by chengyuanhang at 2022/09/23 start
CONFIG_USB_PD_PR_SWAP=y
#hs14 code for SR-AL6528A-01-253 by chengyuanhang at 2022/09/23 end
# hs14 code for SR-AL6528A-01-307 by wenyaqi at 2022/08/30 end
# hs14 code for SR-AL6528A-01-309 by wenyaqi at 2022/09/11 start
CONFIG_TCPC_ET7304=y
CONFIG_ET_REGMAP=y
# hs14 code for SR-AL6528A-01-309 by wenyaqi at 2022/09/11 end
# hs14 code for SR-AL6528A-01-308 by wenyaqi at 2022/09/09 start
CONFIG_FUSB302_EXT=y
# hs14 code for SR-AL6528A-01-308 by wenyaqi at 2022/09/09 end
# hs14 code for  SR-AL6528A-01-313 by zhouyuhang at 20220907 start
CONFIG_BATTERY_ID_ADC=y
# hs14 code for  SR-AL6528A-01-313 by zhouyuhang at 20220907 end
# hs14 code for SR-AL6528A-01-321 by gaozhengwei at 2022/09/22 start
# for afc
CONFIG_AFC_CHARGER=y
# hs14 code for SR-AL6528A-01-321 by gaozhengwei at 2022/09/22 end
```
