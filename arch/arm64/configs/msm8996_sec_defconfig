## arch/arm64/configs/mt6757-eng_defconfig
```kconfig
CONFIG_IKCONFIG=y
CONFIG_IKCONFIG_PROC=y
CONFIG_CFG80211_DEBUGFS=y
CONFIG_MTK_NET_LOGGING=y
CONFIG_MTK_ENG_BUILD=y
CONFIG_MTK_MEMCFG=y
CONFIG_MTK_SCHED_MONITOR=y
CONFIG_MTK_LOCK_DEBUG=y
CONFIG_MTK_CPU_STRESS=y
CONFIG_PREEMPT_MONITOR=y
CONFIG_DEBUG_PREEMPT=y
CONFIG_MTK_WQ_DEBUG=y
CONFIG_MTK_RCU_MONITOR=y
CONFIG_MT_SCHED_TRACE=y
CONFIG_MT_RT_THROTTLE_MON=y
CONFIG_DM_DEBUG=y
CONFIG_EXT4_DEBUG=y
CONFIG_SLUB_DEBUG=y
CONFIG_SLUB_DEBUG_ON=y
CONFIG_DEBUG_KMEMLEAK=y
CONFIG_DEBUG_KMEMLEAK_EARLY_LOG_SIZE=3200
CONFIG_DEBUG_KMEMLEAK_DEFAULT_OFF=y
CONFIG_PROVE_LOCKING=y
CONFIG_DEBUG_LOCKDEP=y
CONFIG_DEBUG_ATOMIC_SLEEP=y
CONFIG_DEBUG_LIST=y
CONFIG_RCU_TRACE=y
CONFIG_MTK_FTRACE_DEFAULT_ENABLE=y
CONFIG_DMA_API_DEBUG=y
CONFIG_PROFILE_CPU=y
CONFIG_MTK_CPU_HOTPLUG_DEBUG_0=y
CONFIG_MTK_CPU_HOTPLUG_DEBUG_3=y
#GPIO DVS
CONFIG_SEC_GPIO_DVS=y
CONFIG_CMA_DEBUG=y

# Rooting prevention
#
# CONFIG_SEC_RESTRICT_ROOTING is not set
# CONFIG_SEC_RESTRICT_SETUID is not set
# CONFIG_SEC_RESTRICT_FORK is not set
# CONFIG_SEC_RESTRICT_ROOTING_LOG is not set
```
