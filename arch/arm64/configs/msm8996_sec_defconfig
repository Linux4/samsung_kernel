## arch/arm64/configs/msm8996_sec_hero2qlte_usa_usc_defconfig
```kconfig
# msm8996_sec_hero2qlte_usc_defconfig
CONFIG_SEC_HERO2QLTE_PROJECT=y
CONFIG_MACH_HERO2QLTE_USC=y
CONFIG_BATTERY_SAMSUNG=y
CONFIG_MULTI_CHARGING=y
CONFIG_AFC_CHARGER_MODE=y
CONFIG_CHARGER_MAX77854=y
CONFIG_FUELGAUGE_MAX77854=y
CONFIG_CHARGER_DA9155=y
CONFIG_WIRELESS_CHARGER_P9220=y
CONFIG_WIRELESS_CHARGER_HIGH_VOLTAGE=y
CONFIG_WIRELESS_FIRMWARE_UPDATE=y
CONFIG_SAMSUNG_LPM_MODE=y
CONFIG_BATTERY_SWELLING=y
CONFIG_BATTERY_AGE_FORECAST=y
CONFIG_UPDATE_BATTERY_DATA=y
CONFIG_CALC_TIME_TO_FULL=y
CONFIG_BATTERY_CISD=y
CONFIG_LEDS_MAX77854_RGB=y
CONFIG_MOTOR_DRV_MAX77854=y
CONFIG_SS_VIBRATOR=y
# CONFIG_QPNP_HAPTIC is not set

# MAX77838 Display SUB PMIC
CONFIG_REGULATOR_MAX77838=y
# S2MPB02 Camera SUB PMIC
CONFIG_LEDS_S2MPB02=y
CONFIG_MFD_S2MPB02=y
CONFIG_REGULATOR_S2MPB02=y

# Input Device
CONFIG_TOUCHSCREEN_STM=y
CONFIG_TOUCHSCREEN_SEC_TS=y
CONFIG_KEYBOARD_ABOV_TOUCH_FT16XX=y
CONFIG_TOUCHSCREEN_DUMP_MODE=y

# display
CONFIG_PANEL_S6E3HA2_AMS509ES01_WQHD=y
CONFIG_PANEL_S6E3HA3_AMS567JA01_WQHD=y
CONFIG_PANEL_S6E3HF4_AMB526JS01_WQHD=y

# Finger print sensor
CONFIG_SENSORS_FINGERPRINT=y
CONFIG_SENSORS_FINGERPRINT_SYSFS=y
CONFIG_SENSORS_VFS7XXX=y
CONFIG_SENSORS_ET320=y
CONFIG_SENSORS_FINGERPRINT_DUALIZATION=y
CONFIG_SENSORS_FP_SPI_NUMBER=6
CONFIG_SENSORS_FP_SPI_GPIO_START=25
CONFIG_SENSORS_FP_SPI_GPIO_END=28
#CONFIG_SENSORS_FP_MASTER_ID=86
CONFIG_SENSORS_FP_LOCKSCREEN_MODE=y

#NFC
CONFIG_SAMSUNG_NFC=y
CONFIG_NFC_PN547=y
CONFIG_NFC_PN547_ESE_SUPPORT=y
CONFIG_NFC_PM_BBCLK2=y
CONFIG_ESE_SECURE=y
CONFIG_ESE_SPI_GPIO_START=58
CONFIG_ESE_SPI_GPIO_END=61
CONFIG_ESE_SECURE_SPI_PORT=11

#MST
CONFIG_MST_LDO=y

#TBASE TUI
CONFIG_TRUSTONIC_TRUSTED_UI=y

#
# DSM Solution
#
CONFIG_SND_SOC_MAX98506=y
CONFIG_SND_SOC_MAXIM_DSM=y
CONFIG_SND_SOC_MAXIM_DSM_CAL=y

# Audio
CONFIG_SND_SOC_PRIMARY_MI2S=y
CONFIG_SND_SOC_TERTIARY_AUXPCM=y
CONFIG_SND_SOC_ALWAYS_ON_MIC=y
CONFIG_SND_SOC_WCD_MBHC_ADC=y
CONFIG_SND_SOC_WCD_MBHC_SLOW_DET=y

# Sensor
CONFIG_SENSORS_MAX86902=y
CONFIG_AVERAGE=y
# CONFIG_BMI168_FACTORY is not set
CONFIG_K6DS3_FACTORY=y
CONFIG_AK09911C_FACTORY=y
CONFIG_BMP280_FACTORY=y
CONFIG_TMD490X_FACTORY=y
# CONFIG_SENSORS_SX9310 is not set
# CONFIG_SENSORS_SX9310_NORMAL_TOUCH_THRESHOLD is not set

# CAMERA
CONFIG_COMPANION2=y
CONFIG_COMPANION3=y
CONFIG_CAMERA_SYSFS_V2=y
#CONFIG_MSM_FRONT_EEPROM=y
CONFIG_SAMSUNG_OIS=y
CONFIG_SENSOR_RETENTION=y

# RADIO
CONFIG_VIDEO_V4L2=y
CONFIG_RADIO_RTC6213N=y
CONFIG_I2C_RTC6213N=y

#Barcode Print
CONFIG_BARCODE_PAINTER=y

# SSWAP
CONFIG_SWAP=y
CONFIG_FRONTSWAP=y
CONFIG_ZSMALLOC=y
CONFIG_ZSMALLOC_STAT=y
CONFIG_ZSMALLOC_OBJ_SEQ=n
CONFIG_PGTABLE_MAPPING=y
CONFIG_ZSWAP=y
CONFIG_ZSWAP_ENABLE_WRITEBACK=n
# CONFIG_ZSWAP_COMPACTION is not set
CONFIG_ZPOOL=y
CONFIG_DIRECT_RECLAIM_FILE_PAGES_ONLY=y
CONFIG_INCREASE_MAXIMUM_SWAPPINESS=y
CONFIG_FIX_INACTIVE_RATIO=y
CONFIG_TIGHT_PGDAT_BALANCE=y
CONFIG_VNSWAP=y
CONFIG_SWAP_ENABLE_READAHEAD=n
CONFIG_RBIN=y

# MODEM SECURE CHECK
CONFIG_SEC_PERIPHERAL_SECURE_CHK=y
```

## arch/arm64/configs/msm8996_sec_userdebug_defconfig
```kconfig
# Overriding the rooting prevention feature as disable on ENG build
# CONFIG_SEC_RESTRICT_ROOTING is not set
# CONFIG_SEC_RESTRICT_SETUID is not set
# CONFIG_SEC_RESTRICT_FORK is not set
# CONFIG_SEC_RESTRICT_ROOTING_LOG is not set
CONFIG_IKCONFIG=y
CONFIG_IKCONFIG_PROC=y

CONFIG_DYNAMIC_DEBUG=y
#
# DS5 Streamline v22
#
CONFIG_HW_PERF_EVENTS=y
CONFIG_PROFILING=y
CONFIG_PERF_EVENTS=y
CONFIG_FTRACE=y
CONFIG_HIGH_RES_TIMERS=y
CONFIG_HW_PERF_EVENTS=y
CONFIG_LOCAL_TIMERS=y
CONFIG_LOCAL_TIMERS=y
CONFIG_GATOR=m
#CONFIG_GATOR=y
CONFIG_BLK_DEV_IO_TRACE=y

#
# Samsung Rooting Restriction Feature
#
# CONFIG_SEC_RESTRICT_ROOTING is not set
# CONFIG_SEC_RESTRICT_SETUID is not set
# CONFIG_SEC_RESTRICT_FORK is not set
# CONFIG_SEC_RESTRICT_ROOTING_LOG is not set

#
# TIMA RKP
#
# CONFIG_RKP_KDP is not set
# CONFIG_RKP_NS_PROT is not set
```
