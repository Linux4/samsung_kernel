## arch/arm64/configs/sm6150_sec_a70q_kor_single_defconfig
```kconfig
# sm6150_sec_a70q_kor_single_defconfig

CONFIG_SEC_A70Q_PROJECT=y
CONFIG_SEC_A70Q_KOR_PROJECT=y

# Display SUB PMIC
#CONFIG_REGULATOR_S2DOS03 is not used

# Display CAMERA PMIC
CONFIG_REGULATOR_S2MPB03=y

#DISPLAY
CONFIG_PANEL_S6E3FA7_AMS628RF05_FHD=y
CONFIG_PANEL_S6E3FC2_AMS670TA01_FHD=y
#CONFIG_SUPPORT_POC_FLASH=n

# TouchScreen
CONFIG_TOUCHSCREEN_IST40XX=y
CONFIG_INPUT_TOUCHSCREEN_TCLMV2=y
CONFIG_INPUT_SEC_SECURE_TOUCH=y

#Audio
CONFIG_SND_SOC_SAMSUNG_AUDIO=y
CONFIG_SND_SOC_SAMSUNG_MBHC_SUPPORT=y

#Camera
CONFIG_SAMSUNG_MULTI_CAMERA=y
CONFIG_SAMSUNG_REAR_TRIPLE=y
CONFIG_CAMERA_SYSFS_V2=y
CONFIG_USE_CAMERA_HW_BIG_DATA=y
CONFIG_MCLK_I2C_DELAY=y
CONFIG_MCLK_I2C_DELAY_FOR_CAM_POWERDOWN=y

#Actuator
CONFIG_SAMSUNG_HW_SOFTLANDING=y
CONFIG_SAMSUNG_ACTUATOR_FP5529=y

# BATTERY
CONFIG_QPNP_QG=y
CONFIG_QPNP_SMB5=y
CONFIG_SMB1390_CHARGE_PUMP_PSY=y
CONFIG_BATTERY_SAMSUNG=y
CONFIG_BATTERY_SAMSUNG_USING_QC=y
CONFIG_BATTERY_CISD=y
CONFIG_DIRECT_CHARGING=y
CONFIG_CALC_TIME_TO_FULL=y

# CONFIG_PM6150_SBU_VBUS_SHORT is not set
CONFIG_PM6150_CC_VBUS_SHORT=y
CONFIG_PM6150_WATER_DETECT=y

# USB Notifier
CONFIG_USB_STORAGE_DETECT=y
CONFIG_USB_HOST_NOTIFY=y
CONFIG_USB_NOTIFY_LAYER=y
CONFIG_USB_NOTIFIER=y
CONFIG_USB_EXTERNAL_NOTIFY=y
CONFIG_USB_NOTIFY_PROC_LOG=y
CONFIG_USB_HW_PARAM=y
CONFIG_USB_CCIC_NOTIFIER_USING_QC=y
CONFIG_USB_TYPEC_MANAGER_NOTIFIER=y
CONFIG_USE_CCIC=y
CONFIG_CCIC_NOTIFIER=y
CONFIG_CCIC_PM6150=y
CONFIG_PM6150_FACTORY_MODE=y
CONFIG_TYPEC=y
CONFIG_SEC_EXT=y
CONFIG_VBUS_NOTIFIER=y

# RID
CONFIG_RID_ADC=y
CONFIG_PM6150L_RID_ADC=y
CONFIG_PM6150_USB_FALSE_DETECTION_WA_BY_GND=y

#AFC
CONFIG_AFC=y
CONFIG_PM6150_AFC=y

# NFC & eSE
CONFIG_NFC_PN547=y
CONFIG_SEC_NFC_LOGGER=y
# CONFIG_NFC_PN547_ESE_SUPPORT is not set
# CONFIG_ESE_SECURE is not set
# CONFIG_ESE_SPI_NUMBER is not set
# CONFIG_ESE_SPI_GPIO_START is not set
# CONFIG_ESE_SPI_GPIO_END is not set

# TDMB
CONFIG_TDMB=y
CONFIG_TDMB_VENDOR_RAONTECH=y
CONFIG_TDMB_MTV319=y
CONFIG_TDMB_SPI=y
CONFIG_TDMB_QUALCOMM=y
CONFIG_TDMB_XTAL_FREQ=y

# SENSOR
CONFIG_SENSORS=y
CONFIG_SENSORS_SSC=y
CONFIG_SENSORS_A96T3X6=y
CONFIG_ADSP_FACTORY=y
CONFIG_LSM6DSM_FACTORY=y
CONFIG_TCS3701_FACTORY=y
CONFIG_STK3331_FACTORY=y
CONFIG_AK09918_FACTORY=y
CONFIG_SUPPORT_BHL_COMPENSATION_FOR_LIGHT_SENSOR=y
CONFIG_SUPPORT_SSC_MODE=y
CONFIG_SUPPORT_SSC_MODE_FOR_MAG=y

# Fingerprint sensor
CONFIG_SENSORS_FINGERPRINT=y
CONFIG_SENSORS_ET7XX=y
CONFIG_SENSORS_FP_SPI_NUMBER=1
CONFIG_SENSORS_FP_SPI_GPIO_START=0
CONFIG_SENSORS_FP_SPI_GPIO_END=3

# QCA Wi-Fi feature
CONFIG_QCA_CLD_WLAN=y
CONFIG_QCACLD_WLAN_LFR2=y
CONFIG_QCACLD_WLAN_LFR3=y
CONFIG_QCOM_TDLS=y
CONFIG_QCACLD_FEATURE_METERING=y
CONFIG_QCOM_VOWIFI_11R=y
CONFIG_WLAN_FEATURE_11W=y
CONFIG_QCOM_LTE_COEX=y
CONFIG_WLAN_FEATURE_LPSS=y
CONFIG_QCACLD_FEATURE_NAN=y
CONFIG_WLAN_FEATURE_NAN_DATAPATH=y
CONFIG_MPC_UT_FRAMEWORK=y
CONFIG_WLAN_OFFLOAD_PACKETS=y
CONFIG_WLAN_SYNC_TSF=y
CONFIG_WLAN_FEATURE_MEMDUMP=y
CONFIG_WLAN_FEATURE_DISA=y
CONFIG_WLAN_FASTPATH=y
CONFIG_WLAN_NAPI=y
CONFIG_WLAN_TX_FLOW_CONTROL_V2=y
CONFIG_LFR_SUBNET_DETECTION=y
CONFIG_MCC_TO_SCC_SWITCH=y
CONFIG_WLAN_LRO=y
CONFIG_ICNSS=y
CONFIG_CNSS_UTILS=y
CONFIG_QCACLD_FEATURE_GREEN_AP=y
CONFIG_WCNSS_MEM_PRE_ALLOC=y
CONFIG_MCL=y

# Hall ic
#CONFIG_FOLDER_HALL=y
CONFIG_SENSORS_HALL=y
CONFIG_CERTIFY_HALL=y

CONFIG_SS_VIBRATOR=y
CONFIG_LEDS_QPNP_VIBRATOR_LDO=y

#MST
CONFIG_MST_LDO=y
CONFIG_MST_LPM_DISABLE=y
```

## arch/arm64/configs/sm6150_sec_eng_defconfig
```kconfig
# SAMSUNG SM6150 project : Diff between sdmsteppe-perf_defconfig and sdmsteppe_defconfig

CONFIG_CGROUP_DEBUG=y
CONFIG_RELAY=y
CONFIG_SLUB_DEBUG=y
CONFIG_SLABINFO=y
CONFIG_PCI_LABEL=y
CONFIG_CLEANCACHE=y
CONFIG_CMA_DEBUGFS=y
CONFIG_DMI=y
CONFIG_PM_DEBUG=y
CONFIG_PM_SLEEP_DEBUG=y
CONFIG_L2TP_DEBUGFS=y
CONFIG_DNS_RESOLVER=y
CONFIG_SCSI_LOGGING=y
CONFIG_SCSI_UFSHCD_CMD_LOGGING=y
CONFIG_DEVMEM=y
CONFIG_SERIAL_EARLYCON=y
CONFIG_SERIAL_CORE_CONSOLE=y
CONFIG_SERIAL_MSM_GENI_CONSOLE=y
CONFIG_SERIAL_DEV_BUS=y
CONFIG_TTY_PRINTK=y
CONFIG_DSI_PARSER=y
CONFIG_FB_SYS_FILLRECT=y
CONFIG_FB_SYS_COPYAREA=y
CONFIG_FB_SYS_IMAGEBLIT=y
CONFIG_FB_SYS_FOPS=y
CONFIG_FB_VIRTUAL=y
CONFIG_MMC_RING_BUFFER=y
CONFIG_EDAC_QCOM_LLCC=y
CONFIG_EDAC_QCOM_LLCC_PANIC_ON_CE=y
CONFIG_EDAC_QCOM_LLCC_PANIC_ON_UE=y
CONFIG_EDAC_KRYO_ARM64_PANIC_ON_CE=y
CONFIG_QCOM_GPI_DMA_DEBUG=y
CONFIG_QCOM_WDOG_IPI_ENABLE=y
CONFIG_MSM_CORE_HANG_DETECT=y
CONFIG_MSM_GLADIATOR_HANG_DETECT=y
CONFIG_ICNSS_DEBUG=y
CONFIG_QCOM_SMCINVOKE=y
CONFIG_PHY_XGENE=y
CONFIG_ESOC_DEBUG=y
CONFIG_DMIID=y
CONFIG_DYNAMIC_DEBUG=y
CONFIG_PAGE_OWNER_ENABLE_DEFAULT=y
CONFIG_DEBUG_SECTION_MISMATCH=y
CONFIG_DEBUG_PAGEALLOC=y
CONFIG_SLUB_DEBUG_PANIC_ON=y
CONFIG_DEBUG_PAGEALLOC_ENABLE_DEFAULT=y
CONFIG_PAGE_POISONING=y
CONFIG_PAGE_POISONING_ENABLE_DEFAULT=y
CONFIG_DEBUG_OBJECTS=y
CONFIG_DEBUG_OBJECTS_FREE=y
CONFIG_DEBUG_OBJECTS_TIMERS=y
CONFIG_DEBUG_OBJECTS_WORK=y
CONFIG_DEBUG_OBJECTS_PERCPU_COUNTER=y
CONFIG_DEBUG_OBJECTS_ENABLE_DEFAULT=1
CONFIG_SLUB_DEBUG_ON=y
CONFIG_DEBUG_KMEMLEAK=y
CONFIG_DEBUG_KMEMLEAK_EARLY_LOG_SIZE=4000
CONFIG_DEBUG_KMEMLEAK_DEFAULT_OFF=y
CONFIG_DEBUG_STACK_USAGE=y
CONFIG_DEBUG_MEMORY_INIT=y
CONFIG_LOCKUP_DETECTOR=y
CONFIG_SOFTLOCKUP_DETECTOR=y
CONFIG_BOOTPARAM_SOFTLOCKUP_PANIC_VALUE=0
CONFIG_DETECT_HUNG_TASK=y
CONFIG_DEFAULT_HUNG_TASK_TIMEOUT=120
CONFIG_BOOTPARAM_HUNG_TASK_PANIC_VALUE=0
CONFIG_WQ_WATCHDOG=y
CONFIG_PANIC_ON_SCHED_BUG=y
CONFIG_PANIC_ON_RT_THROTTLING=y
CONFIG_SCHED_STACK_END_CHECK=y
CONFIG_DEBUG_SPINLOCK=y
CONFIG_DEBUG_SPINLOCK_BITE_ON_BUG=y
CONFIG_DEBUG_MUTEXES=y
CONFIG_DEBUG_ATOMIC_SLEEP=y
CONFIG_LOCK_TORTURE_TEST=m
CONFIG_TRACE_IRQFLAGS=y
CONFIG_DEBUG_LIST=y
CONFIG_DEBUG_SG=y
CONFIG_DEBUG_NOTIFIERS=y
CONFIG_DEBUG_CREDENTIALS=y
CONFIG_TORTURE_TEST=m
CONFIG_RCU_TORTURE_TEST=m
CONFIG_FAULT_INJECTION=y
CONFIG_FAIL_PAGE_ALLOC=y
CONFIG_UFS_FAULT_INJECTION=y
CONFIG_FAULT_INJECTION_DEBUG_FS=y
CONFIG_FAULT_INJECTION_STACKTRACE_FILTER=y
CONFIG_TRACER_MAX_TRACE=y
CONFIG_RING_BUFFER_ALLOW_SWAP=y
CONFIG_QCOM_RTB=y
CONFIG_QCOM_RTB_SEPARATE_CPUS=y
CONFIG_FUNCTION_TRACER=y
CONFIG_FUNCTION_GRAPH_TRACER=y
CONFIG_IRQSOFF_TRACER=y
CONFIG_PREEMPT_TRACER=y
CONFIG_TRACER_SNAPSHOT=y
CONFIG_TRACER_SNAPSHOT_PER_CPU_SWAP=y
CONFIG_BLK_DEV_IO_TRACE=y
CONFIG_DYNAMIC_FTRACE=y
CONFIG_FTRACE_MCOUNT_RECORD=y
CONFIG_LKDTM=m
CONFIG_ATOMIC64_SELFTEST=m
CONFIG_TEST_USER_COPY=m
CONFIG_MEMTEST=y
CONFIG_MEMTEST_ENABLE_DEFAULT=0
CONFIG_BUG_ON_DATA_CORRUPTION=y
CONFIG_STRICT_DEVMEM=y
CONFIG_PID_IN_CONTEXTIDR=y
CONFIG_ARM64_STRICT_BREAK_BEFORE_MAKE=y
CONFIG_CORESIGHT_TGU=y
CONFIG_HARDENED_USERCOPY_PAGESPAN=y
CONFIG_XZ_DEC=y
CONFIG_XZ_DEC_X86=y
CONFIG_XZ_DEC_POWERPC=y
CONFIG_XZ_DEC_IA64=y
CONFIG_XZ_DEC_ARM=y
CONFIG_XZ_DEC_ARMTHUMB=y
CONFIG_XZ_DEC_SPARC=y
CONFIG_XZ_DEC_BCJ=y
CONFIG_UCS2_STRING=y
CONFIG_STACK_HASH_ORDER_SHIFT=20
# CONFIG_RKP_KDP is not set
# CONFIG_RKP_NS_PROT is not set
# CONFIG_RKP_DMAP_PROT is not set
# CONFIG_UH_LKMAUTH is not set
# CONFIG_UH_LKM_BLOCK is not set
CONFIG_SEC_GPIO_DVS=y
CONFIG_ENG_BATTERY_CONCEPT=y
CONFIG_IPA_DEBUG=y

#
# ABC Hub bootc eng mode
#
CONFIG_SEC_ABC_HUB_BOOTC_ENG=y

CONFIG_SEC_DEBUG_FORCE_ERROR=y
CONFIG_SEC_USER_RESET_DEBUG_TEST=y
CONFIG_SEC_DEBUG_SEC_WDOG_BITE=y
```

## arch/arm64/configs/sm6150_sec_m40_swa_open_defconfig
```kconfig
# sm6150_sec_m40_swa_open_defconfig

CONFIG_SEC_M40_PROJECT=y
CONFIG_SEC_M40_SWA_PROJECT=y

# Display SUB PMIC
CONFIG_REGULATOR_S2DOS03=y

# Display CAMERA PMIC
CONFIG_REGULATOR_S2MPB03=y

#DISPLAY
CONFIG_PANEL_NT36672A_B6P064YQ5LP_FHD=y
CONFIG_PANEL_NT36672A_B6TMA60_FHD=y
CONFIG_PANEL_NT36672A_PM6300JB1_FHD=y
CONFIG_BLIC_LM36274=y

# TouchScreen
#CONFIG_TOUCHSCREEN_ZINITIX_ZT75XX=y
#CONFIG_TOUCHSCREEN_IST40XX=y
CONFIG_TOUCHSCREEN_NOVATEK_NT36672=y
CONFIG_INPUT_SEC_SECURE_TOUCH=y

#Audio
CONFIG_SND_SOC_TFA9894=y
CONFIG_SND_SOC_SAMSUNG_AUDIO=y

#Camera
CONFIG_SAMSUNG_MULTI_CAMERA=y
CONFIG_GC5035_SENSOR=y
CONFIG_SAMSUNG_CAMERA_OTP=y
CONFIG_SAMSUNG_REAR_TRIPLE=y
CONFIG_CAMERA_SYSFS_V2=y
CONFIG_USE_CAMERA_HW_BIG_DATA=y

# BATTERY
CONFIG_QPNP_QG=y
CONFIG_QPNP_SMB5=y
CONFIG_BATTERY_SAMSUNG=y
CONFIG_BATTERY_SAMSUNG_USING_QC=y
CONFIG_BATTERY_CISD=y

# CONFIG_PM6150_SBU_VBUS_SHORT is not set
CONFIG_PM6150_CC_VBUS_SHORT=y
CONFIG_PM6150_WATER_DETECT=y

# USB Notifier
CONFIG_USB_STORAGE_DETECT=y
CONFIG_USB_HOST_NOTIFY=y
CONFIG_USB_NOTIFY_LAYER=y
CONFIG_USB_NOTIFIER=y
CONFIG_USB_EXTERNAL_NOTIFY=y
CONFIG_USB_NOTIFY_PROC_LOG=y
CONFIG_USB_HW_PARAM=y
CONFIG_USB_CCIC_NOTIFIER_USING_QC=y
CONFIG_USB_TYPEC_MANAGER_NOTIFIER=y
CONFIG_USE_CCIC=y
CONFIG_CCIC_NOTIFIER=y
CONFIG_CCIC_PM6150=y
CONFIG_PM6150_FACTORY_MODE=y
CONFIG_TYPEC=y
CONFIG_SEC_EXT=y
CONFIG_VBUS_NOTIFIER=y

# RID
CONFIG_RID_ADC=y
CONFIG_PM6150L_RID_ADC=y
CONFIG_PM6150_USB_FALSE_DETECTION_WA_BY_GND=y

#AFC
CONFIG_AFC=y
CONFIG_PM6150_AFC=y

# NFC & eSE
CONFIG_NFC_PN547=y
CONFIG_NFC_PN547_ESE_SUPPORT=y
CONFIG_SEC_NFC_LOGGER=y
CONFIG_ESE_SECURE=y
CONFIG_ESE_SPI_NUMBER=2
CONFIG_ESE_SPI_GPIO_START=6
CONFIG_ESE_SPI_GPIO_END=9

# SENSOR
CONFIG_SENSORS=y
CONFIG_SENSORS_SSC=y
CONFIG_ADSP_FACTORY=y
CONFIG_LSM6DSM_FACTORY=y
CONFIG_AK09918_FACTORY=y
CONFIG_GP2AP110S_FACTORY=y

# Grip Sensor
CONFIG_SENSORS_TC3XXK_DUMMY=y
CONFIG_SENSORS_TC3XXK_A60=y

# Fingerprint sensor
CONFIG_SENSORS_FINGERPRINT=y
CONFIG_SENSORS_ET5XX=y
CONFIG_SENSORS_FP_SPI_NUMBER=1
CONFIG_SENSORS_FP_SPI_GPIO_START=0
CONFIG_SENSORS_FP_SPI_GPIO_END=3

# QCA Wi-Fi feature
CONFIG_QCA_CLD_WLAN=y
CONFIG_QCACLD_WLAN_LFR2=y
CONFIG_QCACLD_WLAN_LFR3=y
CONFIG_QCOM_TDLS=y
CONFIG_QCACLD_FEATURE_METERING=y
CONFIG_QCOM_VOWIFI_11R=y
CONFIG_WLAN_FEATURE_11W=y
CONFIG_QCOM_LTE_COEX=y
CONFIG_WLAN_FEATURE_LPSS=y
CONFIG_QCACLD_FEATURE_NAN=y
CONFIG_WLAN_FEATURE_NAN_DATAPATH=y
CONFIG_MPC_UT_FRAMEWORK=y
CONFIG_WLAN_OFFLOAD_PACKETS=y
CONFIG_WLAN_SYNC_TSF=y
CONFIG_WLAN_FEATURE_MEMDUMP=y
CONFIG_WLAN_FEATURE_DISA=y
CONFIG_WLAN_FASTPATH=y
CONFIG_WLAN_NAPI=y
CONFIG_WLAN_TX_FLOW_CONTROL_V2=y
CONFIG_LFR_SUBNET_DETECTION=y
CONFIG_MCC_TO_SCC_SWITCH=y
CONFIG_WLAN_LRO=y
CONFIG_ICNSS=y
CONFIG_CNSS_UTILS=y
CONFIG_QCACLD_FEATURE_GREEN_AP=y
CONFIG_WCNSS_MEM_PRE_ALLOC=y
CONFIG_MCL=y

# Hall ic
#CONFIG_FOLDER_HALL=y
CONFIG_SENSORS_HALL=y
CONFIG_CERTIFY_HALL=y

#Freecess
CONFIG_SAMSUNG_FREECESS=y

#Disable RKP
CONFIG_RKP_TEST=n
CONFIG_KDP_TEST=n
```
