## arch/arm64/configs/samsung/a01q/sdm439_sec_a01q_swa_ins_defconfig
```kconfig
CONFIG_SEC_A01Q_PROJECT=y
CONFIG_MACH_A01Q_USA_VZW=y
CONFIG_CRYPTO_ZSTD=y
CONFIG_PAGE_BOOST=y
```

## arch/arm64/configs/samsung/a01q/sdm439_sec_a01q_usa_att_defconfig
```kconfig
CONFIG_SEC_A01Q_PROJECT=y
CONFIG_MACH_A01Q_USA_ATT=y
CONFIG_TYPEC=y
CONFIG_USE_CCIC=y
```

## arch/arm64/configs/samsung/a01q/sdm439_sec_a01q_usa_cha_defconfig
```kconfig
CONFIG_SEC_A01Q_PROJECT=y
CONFIG_MACH_A01Q_USA_CHA=y
CONFIG_CRYPTO_ZSTD=y
CONFIG_TYPEC=y
CONFIG_USE_CCIC=y
CONFIG_PAGE_BOOST=y
```

## arch/arm64/configs/samsung/a01q/sdm439_sec_a01q_usa_mtr_defconfig
```kconfig
CONFIG_SEC_A01Q_PROJECT=y
CONFIG_MACH_A01Q_USA_MTR=y
CONFIG_TYPEC=y
CONFIG_USE_CCIC=y
```

## arch/arm64/configs/samsung/a01q/sdm439_sec_a01q_usa_spr_defconfig
```kconfig
CONFIG_SEC_A01Q_PROJECT=y
CONFIG_MACH_A01Q_USA_SPR=y
CONFIG_TYPEC=y
CONFIG_USE_CCIC=y
```

## arch/arm64/configs/samsung/a02q/sdm450_sec_a02q_cis_open_defconfig
```kconfig
CONFIG_SEC_A02Q_PROJECT=y
CONFIG_MACH_A02Q_CIS_OPEN=y
CONFIG_CRYPTO_ZSTD=y
CONFIG_VMPRESSURE_LEVEL_MED=70
```

## arch/arm64/configs/samsung/a02q/sdm450_sec_a02q_ltn_ve_defconfig
```kconfig
CONFIG_SEC_A02Q_PROJECT=y
CONFIG_MACH_A02Q_LTN_VE=y
CONFIG_CRYPTO_ZSTD=y
CONFIG_VMPRESSURE_LEVEL_MED=70
```

## arch/arm64/configs/samsung/a02q/sdm450_sec_a02q_swa_ins_defconfig
```kconfig
CONFIG_SEC_A02Q_PROJECT=y
CONFIG_MACH_A02Q_SWA_INS=y
CONFIG_CRYPTO_ZSTD=y
CONFIG_VMPRESSURE_LEVEL_MED=70
```

## arch/arm64/configs/samsung/a02q/sdm450_sec_a02q_usa_att_defconfig
```kconfig
CONFIG_SEC_A02Q_PROJECT=y
CONFIG_MACH_A02Q_USA_ATT=y
CONFIG_CRYPTO_ZSTD=y
CONFIG_VMPRESSURE_LEVEL_MED=70
```

## arch/arm64/configs/samsung/a11q/sdm450_sec_a11q_usa_aio_defconfig
```kconfig
CONFIG_SEC_A11Q_PROJECT=y
CONFIG_MACH_A11Q_USA_AIO=y
CONFIG_CRYPTO_ZSTD=y
CONFIG_VMPRESSURE_LEVEL_MED=70
CONFIG_PSI=y
CONFIG_PAGE_BOOST=y
CONFIG_ZRAM_WRITEBACK=y

#SS Sensor Factory feature
CONFIG_ADSP_FACTORY=y
CONFIG_SX93XX_FACTORY=y
```

## arch/arm64/configs/samsung/a11q/sdm450_sec_a11q_usa_single_defconfig
```kconfig
CONFIG_SEC_A11Q_PROJECT=y
CONFIG_MACH_A11Q_USA_SINGLE=y
CONFIG_CRYPTO_ZSTD=y
CONFIG_VMPRESSURE_LEVEL_MED=70
CONFIG_PSI=y

#SS Sensor Factory feature
CONFIG_ADSP_FACTORY=y
CONFIG_SX93XX_FACTORY=y
```

## arch/arm64/configs/samsung/sdm439_sec_eng_defconfig
```kconfig
CONFIG_TASK_DELAY_ACCT=y
CONFIG_CGROUP_DEBUG=y
CONFIG_CLEANCACHE=y
CONFIG_MODULE_FORCE_LOAD=y
CONFIG_MODVERSIONS=y
# CONFIG_MODULE_SIG is not set
# CONFIG_MODULE_SIG_FORCE is not set
# CONFIG_MODULE_SIG_SHA512 is not set
CONFIG_CMA_DEBUGFS=y
CONFIG_PM_DEBUG=y
CONFIG_L2TP_DEBUGFS=y
CONFIG_DNS_RESOLVER=y
CONFIG_SERIAL_MSM=y
CONFIG_SERIAL_MSM_CONSOLE=y
CONFIG_MSM_CAMERA_DEBUG=y
CONFIG_MSMB_CAMERA_DEBUG=y
CONFIG_FB_VIRTUAL=y
CONFIG_MMC_RING_BUFFER=y
CONFIG_IOMMU_TESTS=y
CONFIG_QCOM_CPUSS_DUMP=y
CONFIG_MSM_CORE_HANG_DETECT=y
CONFIG_MSM_DEBUG_LAR_UNLOCK=y
CONFIG_TRACER_PKT=y
CONFIG_MSDOS_FS=y
CONFIG_DYNAMIC_DEBUG=y
CONFIG_PAGE_OWNER=y
CONFIG_PAGE_OWNER_ENABLE_DEFAULT=y
CONFIG_DEBUG_PAGEALLOC=y
CONFIG_SLUB_DEBUG_PANIC_ON=y
CONFIG_DEBUG_PAGEALLOC_ENABLE_DEFAULT=y
CONFIG_PAGE_POISONING=y
CONFIG_DEBUG_OBJECTS=y
CONFIG_DEBUG_OBJECTS_FREE=y
CONFIG_DEBUG_OBJECTS_TIMERS=y
CONFIG_DEBUG_OBJECTS_WORK=y
CONFIG_DEBUG_OBJECTS_RCU_HEAD=y
CONFIG_DEBUG_OBJECTS_PERCPU_COUNTER=y
CONFIG_DEBUG_KMEMLEAK=y
CONFIG_DEBUG_KMEMLEAK_EARLY_LOG_SIZE=4000
CONFIG_DEBUG_KMEMLEAK_DEFAULT_OFF=y
CONFIG_DEBUG_STACK_USAGE=y
CONFIG_DEBUG_MEMORY_INIT=y
CONFIG_LOCKUP_DETECTOR=y
CONFIG_BOOTPARAM_SOFTLOCKUP_PANIC=y
CONFIG_WQ_WATCHDOG=y
CONFIG_PANIC_ON_SCHED_BUG=y
CONFIG_PANIC_ON_RT_THROTTLING=y
CONFIG_SCHED_STACK_END_CHECK=y
CONFIG_DEBUG_SPINLOCK=y
CONFIG_DEBUG_MUTEXES=y
CONFIG_DEBUG_ATOMIC_SLEEP=y
CONFIG_DEBUG_LIST=y
CONFIG_FAULT_INJECTION=y
CONFIG_FAIL_PAGE_ALLOC=y
CONFIG_FAULT_INJECTION_DEBUG_FS=y
CONFIG_FAULT_INJECTION_STACKTRACE_FILTER=y
CONFIG_QCOM_RTB=y
CONFIG_QCOM_RTB_SEPARATE_CPUS=y
CONFIG_FUNCTION_TRACER=y
CONFIG_IRQSOFF_TRACER=y
CONFIG_PREEMPT_TRACER=y
CONFIG_BLK_DEV_IO_TRACE=y
CONFIG_LKDTM=y
CONFIG_MEMTEST=y
CONFIG_PANIC_ON_DATA_CORRUPTION=y
CONFIG_ARM64_PTDUMP=y
CONFIG_PID_IN_CONTEXTIDR=y
CONFIG_CORESIGHT_SOURCE_ETM4X=y
CONFIG_CORESIGHT_REMOTE_ETM=y
CONFIG_CORESIGHT_REMOTE_ETM_DEFAULT_ENABLE=0
CONFIG_CORESIGHT_DBGUI=y
CONFIG_CORESIGHT_CTI=y

# Samsung Eng Debugging Feature
CONFIG_SEC_DEBUG_FORCE_ERROR=y
CONFIG_SEC_DEBUG_SEC_WDOG_BITE=y
CONFIG_SEC_USER_RESET_DEBUG_TEST=y

# ABC Hub bootc eng mode
CONFIG_SEC_ABC_HUB_BOOTC_ENG=y
```

## arch/arm64/configs/samsung/sdm450_sec_userdebug_defconfig
```kconfig
CONFIG_MODULE_FORCE_LOAD=y
CONFIG_MODVERSIONS=y
# CONFIG_MODULE_SIG is not set
# CONFIG_MODULE_SIG_FORCE is not set
# CONFIG_MODULE_SIG_SHA512 is not set
```

## arch/arm64/configs/sdm660_sec_a9y18qlte_eur_open_defconfig
```kconfig
# TODO: sdm660_sec_a9y18qlte_eur_open_defconfig

CONFIG_SEC_A9Y18QLTE_PROJECT=y
CONFIG_MACH_A9Y18QLTE_EUR=y

# BATTERY configs
CONFIG_BATTERY_SAMSUNG=y
CONFIG_BATTERY_SAMSUNG_V2=y
CONFIG_BATTERY_NOTIFIER=y
CONFIG_AFC_CHARGER_MODE=y
CONFIG_SAMSUNG_LPM_MODE=y
CONFIG_BATTERY_SWELLING=y
CONFIG_CHARGER_SM5705=y
CONFIG_FUELGAUGE_SM5705=y
# CONFIG_AFC_CURR_CONTROL_BY_TEMP=y
CONFIG_BATTERY_AGE_FORECAST=y
# CONFIG_UPDATE_BATTERY_DATA is not set
CONFIG_BATTERY_CISD=y

#MUIC configs
CONFIG_MFD_CORE=y
CONFIG_USE_MUIC=y
CONFIG_MUIC_NOTIFIER=y
CONFIG_MUIC_SUPPORT_CCIC=y
CONFIG_VBUS_NOTIFIER=y
CONFIG_VBUS_NOTIFIER_WORK=y
CONFIG_MUIC_HV=y
CONFIG_HICCUP_CHARGER=y

#MUIC-SM5705
CONFIG_MFD_SM5705=y
CONFIG_MUIC_UNIVERSAL=y
CONFIG_MUIC_UNIVERSAL_SM5705=y
CONFIG_MUIC_UNIVERSAL_SM5705_AFC=y
CONFIG_MUIC_SM5705_SWITCH_CONTROL_GPIO=y
CONFIG_MUIC_PINCTRL=y

#CCIC configs
CONFIG_CCIC_NOTIFIER=y
CONFIG_CCIC_S2MM005=y
CONFIG_CCIC_ALTERNATE_MODE=y
CONFIG_CCIC_LPM_ENABLE=y
CONFIG_CCIC_S2MM005_PD_DISABLE=y
#CONFIG_SEC_DISPLAYPORT is not set

# Display SUB PMIC
CONFIG_REGULATOR_S2DOS03=y
# CONFIG_REGULATOR_MAX77838 is not set

#INPUT DEVICE
#CONFIG_REGULATOR_FIXED_VOLTAGE is not set
CONFIG_TOUCHSCREEN_SEC_TS=y
CONFIG_TOUCHSCREEN_DUMP_MODE=y
CONFIG_TOUCHSCREEN_ZINITIX_ZT75XX_TCLM=y

# DISPLAY(MDSS)
#
CONFIG_PANEL_S6E3FA7_AMS628RF01_FHD=y
CONFIG_PANEL_S6E3FA7_AMS604NL01_FHD=y
CONFIG_DISPLAY_USE_INFO=y

# Audio
CONFIG_SAMSUNG_JACK=y
CONFIG_SLIMBUS=y
CONFIG_SND_SOC_TFA9872=y
# CONFIG_SND_SOC_MSM8998 is not set
# CONFIG_WCD9335_CODEC is not set
# CONFIG_WCD934X_CODEC is not set
# DBMD
CONFIG_SND_SOC_DBMDX=y
CONFIG_SND_SOC_DBMDX_SND_CAPTURE=y

# NFC
CONFIG_NFC_PN547=y
CONFIG_SEC_NFC_LOGGER=y

#FLASH
CONFIG_LEDS_SM5705=y
CONFIG_LEDS_SEPARATE=y
#CONFIG_DUAL_LEDS_FLASH is not set

#CAMERA
CONFIG_GET_REAR_MODULE_ID=y
CONFIG_GET_FRONT_MODULE_ID=y
CONFIG_MSM_FRONT_EEPROM=y
CONFIG_SAMSUNG_MULTI_CAMERA=y
CONFIG_CAMERA_DUAL_REAR=y
CONFIG_CAMERA_QUAD_REAR=y
#CONFIG_CAMERA_DUAL_FRONT is not set
CONFIG_CAMERA_SYSFS_V2=y
CONFIG_USE_CAMERA_HW_BIG_DATA=y
#CONFIG_S5K5E9YX=y
#CONFIG_MSM_OTP=y
CONFIG_A9Y18_ACTUATOR=y

# QCA Wi-Fi feature
CONFIG_QCA_CLD_WLAN=y
CONFIG_QCACLD_WLAN_LFR2=y
CONFIG_QCACLD_WLAN_LFR3=y
CONFIG_QCOM_TDLS=y
CONFIG_QCACLD_FEATURE_METERING=y
CONFIG_QCOM_VOWIFI_11R=y
CONFIG_WLAN_FEATURE_11W=y
CONFIG_QCOM_LTE_COEX=y
CONFIG_WLAN_FEATURE_LPSS=y
CONFIG_QCACLD_FEATURE_NAN=y
CONFIG_WLAN_FEATURE_NAN_DATAPATH=y
CONFIG_MPC_UT_FRAMEWORK=y
CONFIG_WLAN_OFFLOAD_PACKETS=y
CONFIG_WLAN_SYNC_TSF=y
CONFIG_WLAN_FEATURE_MEMDUMP=y
CONFIG_WLAN_FEATURE_DISA=y
CONFIG_WLAN_FASTPATH=y
CONFIG_WLAN_NAPI=y
CONFIG_WLAN_TX_FLOW_CONTROL_V2=y
CONFIG_LFR_SUBNET_DETECTION=y
CONFIG_MCC_TO_SCC_SWITCH=y
CONFIG_WLAN_LRO=y
CONFIG_ICNSS=y
CONFIG_CNSS_UTILS=y

#FLASH
CONFIG_LEDS_SM5705=y
CONFIG_LEDS_SEPARATE_PREFLASH=y
# CONFIG_DUAL_LEDS_FLASH is not set

# Finger print sensor
CONFIG_SENSORS_FINGERPRINT=y
CONFIG_SENSORS_FINGERPRINT_SYSFS=y
CONFIG_SENSORS_ET5XX=y
CONFIG_SENSORS_FP_SPI_NUMBER=3
CONFIG_SENSORS_FP_SPI_GPIO_START=8
CONFIG_SENSORS_FP_SPI_GPIO_END=11
CONFIG_SENSORS_FP_IRQ_GPIO=13

# Sensors ssc factory
CONFIG_ADSP_FACTORY=y
CONFIG_LSM6DSL_FACTORY=y
CONFIG_AK09918_FACTORY=y
CONFIG_TMD3725_FACTORY=y
CONFIG_SUPPORT_PROX_AUTO_CAL=y
CONFIG_ADSP_MOTOR=y

# Grip sensor
CONFIG_SENSORS_A96T3X6=y

#MPTCP
CONFIG_MPTCP=y 
CONFIG_SAMSUNG_MPTCP=y 
CONFIG_TCP_CONG_LIA=y
CONFIG_TCP_CONG_OLIA=y
CONFIG_TCP_CONG_WVEGAS=y
CONFIG_MPTCP_FULLMESH=y
CONFIG_MPTCP_NDIFFPORTS=y
CONFIG_MPTCP_BINDER=y
CONFIG_MPTCP_ROUNDROBIN=y

#EPDG
CONFIG_NET_CORE=y
CONFIG_NET_SCH_PRIO=y
CONFIG_NET_SCHED=y   #depends on CONFIG_NET  which is enabled by default.. coz not seeing in the config file
CONFIG_NET_CLS_BASIC=y # required if basic is being used as a filter. depends on CONFIG_NET_CLS so enabling it by default
CONFIG_NET_CLS=y
CONFIG_NET_CLS_ACT=y # for enabling the action target.
CONFIG_NET_ACT_MIRRED=y  # for enabling the mirred target for redirecting the packet between the devices.
CONFIG_NET_EMATCH=y   #basic uses extended matches so this has to be present
CONFIG_NET_SCH_INGRESS=y # classifier for ingress packet
#EPDG

# gpio expander
CONFIG_GPIO_KTS1620=y

# Hall ic
CONFIG_SENSORS_HALL=y

# UFS
CONFIG_UFS_UN_20DIGITS=y
```

## arch/arm64/configs/sdm670_sec_gtactivexl_eur_open_defconfig
```kconfig
# sdm710_sec_gtactivexl_eur_open_defconfig

CONFIG_SEC_GTACTIVEXL_PROJECT=y
CONFIG_SEC_GTACTIVEXL_EUR_PROJECT=y
CONFIG_POS_LAUNCH_PROJECT=y
CONFIG_PSI=y

# QCA Wi-Fi feature
CONFIG_QCA_CLD_WLAN=y
CONFIG_QCACLD_WLAN_LFR2=y
CONFIG_QCACLD_WLAN_LFR3=y
CONFIG_QCOM_TDLS=y
CONFIG_QCACLD_FEATURE_METERING=y
CONFIG_QCACLD_FEATURE_GREEN_AP=y
CONFIG_QCOM_VOWIFI_11R=y
CONFIG_WLAN_FEATURE_11W=y
CONFIG_QCOM_LTE_COEX=y
CONFIG_WLAN_FEATURE_LPSS=y
CONFIG_QCACLD_FEATURE_NAN=y
CONFIG_WLAN_FEATURE_NAN_DATAPATH=y
CONFIG_MPC_UT_FRAMEWORK=y
CONFIG_WLAN_OFFLOAD_PACKETS=y
CONFIG_WLAN_SYNC_TSF=y
CONFIG_WLAN_FEATURE_MEMDUMP=y
CONFIG_WLAN_FEATURE_DISA=y
CONFIG_WLAN_FASTPATH=y
CONFIG_WLAN_NAPI=y
CONFIG_WLAN_TX_FLOW_CONTROL_V2=y
CONFIG_LFR_SUBNET_DETECTION=y
CONFIG_MCC_TO_SCC_SWITCH=y
CONFIG_WLAN_LRO=y
CONFIG_ICNSS=y
CONFIG_CNSS_UTILS=y
# CONFIG_FORCE_ALLOC_FROM_DMA_ZONE is not set
CONFIG_QCACLD_FEATURE_GREEN_AP=y
CONFIG_WCNSS_MEM_PRE_ALLOC=y

# input
CONFIG_TOUCHSCREEN_STM_FTS1BA90=y
CONFIG_INPUT_WACOM=y
CONFIG_EPEN_WACOM_W9019=y
# CONFIG_INPUT_SEC_SECURE_TOUCH is not set
# CONFIG_KEYBOARD_STM32_POGO is not set

# PM
CONFIG_REGULATOR_S2MPB03=y

#pogo
CONFIG_MUIC_POGO=y

# Display
CONFIG_PANEL_HX8279_TV101WUM_WUXGA=y
CONFIG_PANEL_POWER_ISL98608=y

#MUIC configs
CONFIG_MFD_CORE=y
CONFIG_USE_MUIC=y
CONFIG_MUIC_SM5504A=y
CONFIG_MUIC_NOTIFIER=y
CONFIG_MUIC_SUPPORT_CCIC=y
CONFIG_VBUS_NOTIFIER=y
CONFIG_VBUS_NOTIFIER_WORK=y
CONFIG_MUIC_HV=y
CONFIG_HICCUP_CHARGER=y

#MUIC-SM5705
CONFIG_MFD_SM5705=y
CONFIG_MUIC_UNIVERSAL=y
CONFIG_MUIC_UNIVERSAL_SM5705=y
CONFIG_MUIC_UNIVERSAL_SM5705_AFC=y
CONFIG_MUIC_SM5705_SWITCH_CONTROL_GPIO=y
CONFIG_MUIC_PINCTRL=y
# CONFIG_MUIC_UNIVERSAL_MULTI_SUPPORT is not set
# CONFIG_MUIC_SUPPORT_RUSTPROOF is not set
CONFIG_MUIC_SUPPORT_KEYBOARDDOCK=y

#CCIC configs
CONFIG_CCIC_NOTIFIER=y
CONFIG_CCIC_S2MM005=y
CONFIG_CCIC_ALTERNATE_MODE=y
CONFIG_CCIC_LPM_ENABLE=y
#CONFIG_CCIC_S2MM005_ANALOG_AUDIO is not set

#redriver
# CONFIG_COMBO_REDRIVER is not set

# FPGA
# CONFIG_FPGA is not set
# CONFIG_POGO_FPGA is not set

#displayport
CONFIG_SEC_DISPLAYPORT=y
CONFIG_SEC_DISPLAYPORT_LOGGER=y
CONFIG_SEC_DISPLAYPORT_BIGDATA=y

# BATTERY configs
CONFIG_BATTERY_SAMSUNG=y
CONFIG_BATTERY_SAMSUNG_V2=y
CONFIG_BATTERY_NOTIFIER=y
CONFIG_AFC_CHARGER_MODE=y
CONFIG_SAMSUNG_LPM_MODE=y
CONFIG_BATTERY_SWELLING=y
CONFIG_CHARGER_SM5705=y
CONFIG_FUELGAUGE_SM5705=y
CONFIG_USE_POGO=y
CONFIG_CALC_TIME_TO_FULL=y
# CONFIG_AFC_CURR_CONTROL_BY_TEMP=y
CONFIG_BATTERY_AGE_FORECAST=y
CONFIG_BATTERY_AGE_FORECAST_DETACHABLE=y
CONFIG_DUMMY_BATTERY=y

# CONFIG_UPDATE_BATTERY_DATA is not set
CONFIG_BATTERY_CISD=y
CONFIG_TABLET_MODEL_CONCEPT=y

# NFC & eSE
CONFIG_NFC_PN547=y
CONFIG_NFC_PN547_ESE_SUPPORT=y
CONFIG_SEC_NFC_LOGGER=y
CONFIG_ESE_SECURE=y
CONFIG_ESE_SPI_NUMBER=1
CONFIG_ESE_SPI_GPIO_START=0
CONFIG_ESE_SPI_GPIO_END=3

# Audio
CONFIG_SND_SOC_CS35L41=y
CONFIG_MFD_CS35L41_I2C=y
CONFIG_SAMSUNG_JACK=y
CONFIG_SND_SOC_SAMSUNG_MBHC_SUPPORT=n
CONFIG_SND_SOC_SAMSUNG_AUDIO=n

#Camera
CONFIG_LEDS_SM5705=y
CONFIG_LEDS_SEPARATE_PREFLASH=y
#CONFIG_SAMSUNG_OIS_RUMBA_S4=y
#CONFIG_SAMSUNG_OIS_RUMBA_S6=y
CONFIG_DISABLE_OIS_SDM710=y
CONFIG_SAMSUNG_FRONT_EEPROM=y
CONFIG_CAMERA_SYSFS_V2=y
#CONFIG_SAMSUNG_SECURE_CAMERA=y
CONFIG_SAMSUNG_MULTI_CAMERA=y
CONFIG_CAMERA_DYNAMIC_MIPI=y
CONFIG_CAMERA_FRS_DRAM_TEST=y
CONFIG_USE_CAMERA_HW_BIG_DATA=y
CONFIG_CAMERA_SSM_I2C_ENV=y
CONFIG_S5K5E9YX=y

# Sensor
CONFIG_SENSORS=y
CONFIG_SENSORS_SSC=y
CONFIG_ADSP_FACTORY=y
CONFIG_ICM42605_FACTORY=y
CONFIG_AK09918_FACTORY=y
CONFIG_LPS22HH_FACTORY=y
CONFIG_VCNL36658_FACTORY=y
CONFIG_SUPPORT_PROX_AUTO_CAL=y

# Grip Sensor
CONFIG_SENSORS_SX9360=y
CONFIG_SENSORS_SX9360_WIFI=y

# Finger print sensor
CONFIG_SENSORS_FINGERPRINT=y
CONFIG_SENSORS_GW32X=y
CONFIG_SENSORS_FP_SPI_NUMBER=15
CONFIG_SENSORS_FP_SPI_GPIO_START=81
CONFIG_SENSORS_FP_SPI_GPIO_END=84

#Motor
CONFIG_MSM_VIBRATOR=y

#FreeCess
CONFIG_SAMSUNG_FREECESS=y

#Storage
CONFIG_SCSI_UFSHCD=n 
CONFIG_SCSI_UFSHCD_PLATFORM=n
CONFIG_SCSI_UFS_QCOM=n 
CONFIG_SCSI_UFS_QCOM_ICE=n 
CONFIG_SCSI_UFSHCD_CMD_LOGGING=n
CONFIG_UFS_DATA_LOG=n 
CONFIG_UFS_DATA_LOG_MAGIC_CODE=n

#SDCARD
# CONFIG_SEC_HYBRID_TRAY is not set

# Audio
CONFIG_SND_SOC_DBMDX=y
CONFIG_SND_SOC_DBMDX_SND_CAPTURE=y
CONFIG_SND_SOC_DBMDX_VA_NS_SUPPORT=y

# Hall ic
CONFIG_SENSORS_HALL=y
CONFIG_CERTIFY_HALL=y

# gpio expander
CONFIG_GPIO_PCAL6524=y
```
