## arch/arm64/configs/sm8150_sec_d2xq2_usa_single_defconfig
```kconfig
# sm8150_sec_d2xq2_usa_single_defconfig

CONFIG_SEC_D2XQ2_PROJECT=y
CONFIG_MACH_D2XQ2_USA_SINGLE=y
CONFIG_SEC_5GMODEL=y

# display
CONFIG_PANEL_S6E3HA9_AMB675TG01_WQHD=y
CONFIG_PANEL_S6E3HA9_AMB666WS04_WQHD=y

# Sub PMIC
# CONFIG_REGULATOR_S2ABB01 is not set
# CONFIG_REGULATOR_S2DOS03 is not set
CONFIG_REGULATOR_S2DOS05=y
# CONFIG_REGULATOR_MAX77838 is not set
CONFIG_MFD_S2MPB02=y
CONFIG_REGULATOR_S2MPB02=y
CONFIG_REGULATOR_S2MPB03=y

# input device
CONFIG_TOUCHSCREEN_SEC_TS_Y771_D=y
CONFIG_KEYBOARD_STM_FSR=y
CONFIG_INPUT_WACOM=y
CONFIG_EPEN_WACOM_W9020=y

# BATTERY
CONFIG_CALC_TIME_TO_FULL=y
CONFIG_BATTERY_AGE_FORECAST=y
CONFIG_AFC_CURR_CONTROL_BY_TEMP=y
CONFIG_LIMIT_CHARGING_DURING_CALL=y
CONFIG_ENABLE_100MA_CHARGING_BEFORE_USB_CONFIGURED=y
CONFIG_FUELGAUGE_MAX77705=y
CONFIG_CHARGER_MAX77705=y
CONFIG_MAX77705_CHECK_B2SOVRC=y
CONFIG_WIRELESS_CHARGER_MFC=y
CONFIG_WIRELESS_CHARGER_MFC_S2MIW04=y
CONFIG_WIRELESS_FIRMWARE_UPDATE=y
CONFIG_WIRELESS_AUTH=y
CONFIG_BATTERY_CISD=y
CONFIG_STEP_CHARGING=y
CONFIG_WIRELESS_TX_MODE=y
CONFIG_DIRECT_CHARGING=y
CONFIG_CHARGER_PCA9468=y
CONFIG_PDIC_PD30=y
CONFIG_PREVENT_USB_CONN_OVERHEAT=y
CONFIG_WIRELESS_IC_PARAM=y
CONFIG_WIRELESS_CHARGER_HAL_MFC=y

# MUIC configs
CONFIG_MFD_CORE=y
CONFIG_USE_MUIC=y
CONFIG_USE_SAFEOUT=y
CONFIG_MUIC_NOTIFIER=y
CONFIG_AFC_CHARGER_MODE=y
CONFIG_MUIC_SUPPORT_RUSTPROOF=y
CONFIG_VBUS_NOTIFIER=y
CONFIG_VBUS_NOTIFIER_WORK=y
CONFIG_MUIC_MAX77705=y
CONFIG_MFD_MAX77705=y
CONFIG_MUIC_MAX77705_CCIC=y
CONFIG_HV_MUIC_MAX77705_AFC=y
CONFIG_MUIC_SUPPORT_CCIC=y
CONFIG_AFC_CHARGER_MODE=y
CONFIG_MUIC_HV=y
CONFIG_HICCUP_CHARGER=y
CONFIG_MUIC_SUPPORT_UART_SEL=y

#SVCLED
#CONFIG_LEDS_MAX77705_RGB is not set

# ccic
CONFIG_CCIC_MAX77705=y
# CONFIG_CCIC_S2MM003 is not set
CONFIG_CCIC_S2MM005=y

# redriver
# CONFIG_COMBO_REDRIVER is not set
# CONFIG_COMBO_REDRIVER_PTN36502 is not set

# Motor
# CONFIG_SS_VIBRATOR is not set
# CONFIG_BOOST_POWER_SHARE is not set
# CONFIG_MOTOR_DRV_MAX77705 is not set
CONFIG_ANDROID_TIMED_OUTPUT=y
CONFIG_MOTOR_DRV_CS40L2X=y
CONFIG_MOTOR_DRV_CS40L2X_PMIC_RESET=y
CONFIG_CS40L2X_SAMSUNG_FEATURE=y
CONFIG_VIB_NOTIFIER=y

# BLUETOOTH
CONFIG_BT=y
CONFIG_BT_BCM4361=y
CONFIG_BT_BLUESLEEP=y
CONFIG_RFKILL=y

# Displayport
CONFIG_SEC_DISPLAYPORT=y
CONFIG_SEC_DISPLAYPORT_LOGGER=y
CONFIG_SEC_DISPLAYPORT_BIGDATA=y

# Fingerprint sensor
CONFIG_SENSORS_FINGERPRINT=y
#CONFIG_SENSORS_ET5XX is not set
CONFIG_SENSORS_QBT2000=y
CONFIG_SENSORS_FP_SPI_NUMBER=0
CONFIG_SENSORS_FP_SPI_GPIO_START=0
CONFIG_SENSORS_FP_SPI_GPIO_END=3

# NFC ESE
CONFIG_SAMSUNG_NFC=y
CONFIG_NFC_PN547=y
CONFIG_NFC_PN547_ESE_SUPPORT=y
CONFIG_ESE_SECURE=y
CONFIG_ESE_SPI_GPIO_START=23
CONFIG_ESE_SPI_GPIO_END=26
CONFIG_ESE_SPI_NUMBER=3
CONFIG_SEC_NFC_LOGGER=y

# Audio
CONFIG_SND_SOC_CS35L41=y
CONFIG_MFD_CS35L41_I2C=y
CONFIG_SND_SOC_SAMSUNG_AUDIO=y
CONFIG_SND_SOC_SAMSUNG_USB_HEADSET_ONLY=y
CONFIG_SLIMBUS_DEBUG=y

# FM radio
#CONFIG_MEDIA_RADIO_SUPPORT is not set
#CONFIG_I2C_RTC6213N is not set
#CONFIG_RADIO_RTC6213N is not set

# Grip sensor
CONFIG_SENSORS_SX9320=y
CONFIG_SENSORS_SX9330=y
CONFIG_SENSORS_SX9360=y

# Camera
CONFIG_LEDS_S2MPB02=y
CONFIG_SAMSUNG_OIS_MCU_STM32=y
CONFIG_SAMSUNG_APERTURE=y
# CONFIG_SAMSUNG_APERTURE_MULTI_MODE is not set
CONFIG_CAMERA_SYSFS_V2=y
CONFIG_SAMSUNG_REAR_TRIPLE=y
CONFIG_SAMSUNG_FRONT_EEPROM=y
# CONFIG_SAMSUNG_FRONT_TOF is not set
CONFIG_SAMSUNG_REAR_TOF=y
CONFIG_USE_CAMERA_HW_BIG_DATA=y
CONFIG_CAMERA_FRS_DRAM_TEST=y
CONFIG_SAMSUNG_APERTURE_HALLTEST=y
CONFIG_CAMERA_SSM_I2C_ENV=y
CONFIG_SAMSUNG_ACTUATOR_AK7377=y
CONFIG_SAMSUNG_FORCE_DISABLE_REGULATOR=y

# Hall ic
CONFIG_SENSORS_HALL=y
CONFIG_CERTIFY_HALL=y

#sensor
CONFIG_SENSORS=y
CONFIG_SENSORS_SSC=y
CONFIG_ADSP_FACTORY=y
CONFIG_LSM6DSO_FACTORY=y
CONFIG_AK09918_FACTORY=y
CONFIG_LPS22HH_FACTORY=y
CONFIG_TMD490X_FACTORY=y
CONFIG_SUPPORT_MOBEAM=y
CONFIG_SUPPORT_PROX_AUTO_CAL=y
CONFIG_SUPPORT_HIDDEN_HOLE=y
CONFIG_SUPPORT_BHL_COMPENSATION_FOR_LIGHT_SENSOR=y
CONFIG_SUPPORT_TMD4907_FACTORY=y
CONFIG_SUPPORT_SSC_SPU=y
CONFIG_SUPPORT_MOTOR_NOTIFIER=y

# ALS sensor
CONFIG_SENSORS_TCS3407=y

# MST
CONFIG_MFC_LDO_COMMAND=y

# CONFIG_WCNSS_MEM_PRE_ALLOC is not set
# CONFIG_CLD_LL_CORE is not set
# CONFIG_CNSS_GENL is not set
CONFIG_CFG80211_WEXT=y

CONFIG_KZEROD=y

# Disable feature for header_version@2
# CONFIG_BUILD_ARM64_APPENDED_DTB_IMAGE is not set
```
