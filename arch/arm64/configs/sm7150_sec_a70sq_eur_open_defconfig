## arch/arm64/configs/universal9925_defconfig
```kconfig
CONFIG_CMDLINE_EXTEND=y
CONFIG_KEYBOARD_S2MPS25=m
CONFIG_MFD_S2MPS25=m
CONFIG_MFD_S2MPS26=m
CONFIG_MFD_S2MPB02=m
CONFIG_MFD_S2MPM07=m
CONFIG_REGULATOR_S2MPS25=m
CONFIG_REGULATOR_S2MPS26=m
CONFIG_REGULATOR_S2MPM07=m
CONFIG_REGULATOR_S2MPB02=m
CONFIG_REGULATOR_S2DOS05=m
CONFIG_RTC_DRV_S2MPS25=m
CONFIG_S2MPS25_ADC=m
CONFIG_PINCTRL_SAMSUNG_S2MPS26=m
CONFIG_PINCTRL_SAMSUNG_S2MPM07=m
CONFIG_TOUCHSCREEN_SEC_TS=m
CONFIG_SND_SOC_SAMSUNG_EXYNOS_CS35L41_I2C=m
CONFIG_SND_SOC_SAMSUNG_EXYNOS9925_SOUND=m

# SEC CONFIGS
#CONFIG_SEC_REBOOT=m
CONFIG_SEC_PARAM=m
CONFIG_DRV_SAMSUNG=m

# USB Feature
CONFIG_USB_NOTIFIER=m
CONFIG_USB_NOTIFY_LAYER=m
CONFIG_USB_HOST_NOTIFY=y
CONFIG_USB_NOTIFY_PROC_LOG=y
CONFIG_USB_DEBUG_DETAILED_LOG=y
CONFIG_USB_EXTERNAL_NOTIFY=y
CONFIG_USB_HW_PARAM=y
CONFIG_USB_INTERFACE_LPM_LIST=y
CONFIG_USB_HOST_CERTI=y
CONFIG_GKI_USB=y

CONFIG_SWITCH=m
CONFIG_SEC_MISC=y
CONFIG_ANDROID_SWITCH=m

#CONFIG_PCI_EXYNOS=m
#CONFIG_PCI_EXYNOS_2100=m
#CONFIG_EXYNOS_PCIE_GEN2_S2MPU=m
CONFIG_DRM_PANEL_SAMSUNG_S6E3FAB=m
CONFIG_DRM_PANEL_SAMSUNG_S6E3FAC=m
CONFIG_DRM_SAMSUNG_DOZE=y

# CAMERA
CONFIG_CAMERA_CIS_2LD_OBJ=m
CONFIG_CAMERA_CIS_GW2_OBJ=m
CONFIG_CAMERA_CIS_3J1_OBJ=m
CONFIG_CAMERA_CIS_IMX563_OBJ=m
CONFIG_CAMERA_ACT_AK737X_OBJ=m
CONFIG_CAMERA_FLASH_S2MPB02_I2C_OBJ=m
CONFIG_LEDS_S2MPB02=m
CONFIG_LEDS_S2MPB02_FLASH=m

# CAMERA MCD
CONFIG_CAMERA_VENDER_MCD=y
CONFIG_OIS_USE=y
CONFIG_AF_HOST_CONTROL=y
CONFIG_CAMERA_USE_INTERNAL_MCU=y
#CONFIG_USE_SIGNED_BINARY=y

# DRM_Displayport
CONFIG_DRM_SAMSUNG_DP=y
```

## arch/arm64/configs/universal9925_evt0_defconfig
```kconfig
CONFIG_CMDLINE_EXTEND=y
CONFIG_KEYBOARD_S2MPS25=m
CONFIG_MFD_S2MPS25=m
CONFIG_MFD_S2MPS26=m
CONFIG_MFD_S2MPB02=m
CONFIG_MFD_S2MPM07=m
CONFIG_REGULATOR_S2MPS25=m
CONFIG_REGULATOR_S2MPS26=m
CONFIG_REGULATOR_S2MPM07=m
CONFIG_REGULATOR_S2MPB02=m
CONFIG_REGULATOR_S2DOS05=m
CONFIG_RTC_DRV_S2MPS25=m
CONFIG_S2MPS25_ADC=m
CONFIG_PINCTRL_SAMSUNG_S2MPS26=m
CONFIG_PINCTRL_SAMSUNG_S2MPM07=m
CONFIG_TOUCHSCREEN_SEC_TS=m
CONFIG_SND_SOC_SAMSUNG_EXYNOS_CS35L41_I2C=m
CONFIG_SND_SOC_SAMSUNG_EXYNOS9925_SOUND=m

# SEC CONFIGS
CONFIG_SEC_DEBUG=m
#CONFIG_SEC_REBOOT=m
CONFIG_SEC_PARAM=m
CONFIG_DRV_SAMSUNG=m
#CONFIG_SEC_DEBUG_BASE=m

# USB Feature
CONFIG_GKI_USB=y
CONFIG_USB_NOTIFY_LAYER=y
CONFIG_USB_NOTIFY_LAYER_MODULE=m
CONFIG_USB_NOTIFY_PROC_LOG=y
CONFIG_USB_DEBUG_DETAILED_LOG=y
CONFIG_USB_EXTERNAL_NOTIFY=y
CONFIG_USB_NOTIFIER=m
CONFIG_USB_HW_PARAM=y
CONFIG_USB_INTERFACE_LPM_LIST=y
CONFIG_USB_HOST_CERTI=y
CONFIG_USB_TYPEC_MANAGER_NOTIFIER=y
CONFIG_USB_TYPEC_MANAGER_NOTIFIER_MODULE=m
CONFIG_IF_CB_MANAGER=y
CONFIG_IF_CB_MANAGER_MODULE=m
CONFIG_CCIC_NOTIFIER=y
CONFIG_CCIC_NOTIFIER_MODULE=m
CONFIG_CCIC_MAX77705=y
CONFIG_CCIC_MAX77705_MODULE=m
CONFIG_SWITCH=m
CONFIG_MFD_MAX77705=m
CONFIG_VBUS_NOTIFIER=y
CONFIG_VBUS_NOTIFIER_MODULE=m
CONFIG_USE_MUIC=y
CONFIG_USE_SAFEOUT=y
CONFIG_MUIC_NOTIFIER=y
CONFIG_MUIC_NOTIFIER_MODULE=m
CONFIG_MUIC_SUPPORT_CCIC=y
CONFIG_MUIC_MAX77705=y
CONFIG_HV_MUIC_MAX77705_AFC=y
CONFIG_MUIC_MAX77705_CCIC=y
CONFIG_HICCUP_CHARGER=y
CONFIG_MAX77705_FW_PID03_SUPPORT=y
CONFIG_SEC_MISC=y
CONFIG_ANDROID_SWITCH=m
#CONFIG_USB_HOST_NOTIFY=y

# BATTERY
CONFIG_BATTERY_GKI=y
CONFIG_BATTERY_SAMSUNG_MODULE=m
CONFIG_BATTERY_SAMSUNG=y
CONFIG_BATTERY_SWELLING=y
CONFIG_BATTERY_AGE_FORECAST=y
CONFIG_AFC_CHARGER_MODE=y
CONFIG_FUELGAUGE_MAX77705_MODULE=m
CONFIG_FUELGAUGE_MAX77705=y
CONFIG_CHARGER_MAX77705_MODULE=m
CONFIG_CHARGER_MAX77705=y
CONFIG_DIRECT_CHARGING_MODULE=m
CONFIG_DIRECT_CHARGING=y
CONFIG_STEP_CHARGING=y
CONFIG_CHARGER_PCA9468_MODULE=m
CONFIG_CHARGER_PCA9468=y
CONFIG_SEC_PD_MODULE=m
CONFIG_SEC_PD=y
CONFIG_WIRELESS_CHARGER_MFC_MODULE=m
CONFIG_WIRELESS_CHARGER_MFC=y
CONFIG_WIRELESS_TX_MODE=y
CONFIG_WIRELESS_AUTH=y
#CONFIG_PCI_EXYNOS=m
#CONFIG_PCI_EXYNOS_2100=m
#CONFIG_EXYNOS_PCIE_GEN2_S2MPU=m
CONFIG_DRM_PANEL_SAMSUNG_S6E3FAB=m

# CAMERA
CONFIG_CAMERA_CIS_2LD_OBJ=m
CONFIG_CAMERA_CIS_GW2_OBJ=m
CONFIG_CAMERA_CIS_3J1_OBJ=m
CONFIG_CAMERA_CIS_IMX563_OBJ=m
CONFIG_CAMERA_ACT_AK737X_OBJ=m
CONFIG_CAMERA_FLASH_S2MPB02_OBJ=m
CONFIG_LEDS_S2MPB02=m

# CAMERA MCD
CONFIG_CAMERA_VENDER_MCD=y
CONFIG_OIS_USE=y
CONFIG_AF_HOST_CONTROL=y
CONFIG_CAMERA_USE_INTERNAL_MCU=y
#CONFIG_USE_SIGNED_BINARY=y

CONFIG_EXYNOS_EL2=m
CONFIG_EXYNOS_S2MPU=m
```
