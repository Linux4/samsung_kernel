## arch/arm64/configs/sm8150_sec_eng_defconfig
```kconfig
########################################################################################
# SAMSUNG SM8150 project : Diff between sm8150-perf_defconfig and sm8150_defconfig
# ES1
########################################################################################

CONFIG_DEBUG_BLK_CGROUP=y
CONFIG_CGROUP_DEBUG=y
CONFIG_CC_OPTIMIZE_FOR_SIZE=y
# CONFIG_BLK_DEV_BSG is not set
# CONFIG_IOSCHED_DEADLINE is not set
CONFIG_CLEANCACHE=y
CONFIG_PM_DEBUG=y
CONFIG_L2TP_DEBUGFS=y
CONFIG_DNS_RESOLVER=y
# CONFIG_CFG80211_CRDA_SUPPORT is not set
CONFIG_SCSI_LOGGING=y
CONFIG_SCSI_UFSHCD_CMD_LOGGING=y
CONFIG_INPUT_JOYSTICK=y
# CONFIG_SERIAL_DEV_BUS is not set
CONFIG_TTY_PRINTK=y
CONFIG_BACKLIGHT_LCD_SUPPORT=y
CONFIG_BACKLIGHT_CLASS_DEVICE=y
CONFIG_MMC_RING_BUFFER=y
CONFIG_EDAC_QCOM_LLCC=y
CONFIG_EDAC_QCOM_LLCC_PANIC_ON_CE=y
CONFIG_EDAC_QCOM_LLCC_PANIC_ON_UE=y
CONFIG_EDAC_KRYO_ARM64_PANIC_ON_CE=y
CONFIG_QCOM_GPI_DMA_DEBUG=y
CONFIG_DEBUG_DMA_BUF_REF=y
CONFIG_QCOM_WDOG_IPI_ENABLE=y
CONFIG_MSM_CORE_HANG_DETECT=y
CONFIG_MSM_GLADIATOR_HANG_DETECT=y
# CONFIG_ICNSS_DEBUG is not set
CONFIG_MSM_SPSS_UTILS=y
CONFIG_PHY_XGENE=y
CONFIG_ESOC_DEBUG=y
CONFIG_EFIVAR_FS=y
# CONFIG_NETWORK_FILESYSTEMS is not set
CONFIG_DYNAMIC_DEBUG=y
CONFIG_DEBUG_MODULE_LOAD_INFO=y
CONFIG_PAGE_OWNER=y
CONFIG_PAGE_OWNER_ENABLE_DEFAULT=y
CONFIG_DEBUG_SECTION_MISMATCH=y
# CONFIG_SECTION_MISMATCH_WARN_ONLY is not set
CONFIG_DEBUG_PAGEALLOC=y
CONFIG_SLUB_DEBUG_PANIC_ON=y
CONFIG_DEBUG_PAGEALLOC_ENABLE_DEFAULT=y
CONFIG_PAGE_POISONING=y
CONFIG_PAGE_POISONING_ENABLE_DEFAULT=y
CONFIG_DEBUG_OBJECTS=y
CONFIG_DEBUG_OBJECTS_FREE=y
CONFIG_DEBUG_OBJECTS_TIMERS=y
CONFIG_DEBUG_OBJECTS_WORK=y
CONFIG_DEBUG_OBJECTS_PERCPU_COUNTER=y
CONFIG_SLUB_DEBUG_ON=y
CONFIG_DEBUG_KMEMLEAK=y
CONFIG_DEBUG_KMEMLEAK_EARLY_LOG_SIZE=4000
CONFIG_DEBUG_KMEMLEAK_DEFAULT_OFF=y
CONFIG_DEBUG_STACK_USAGE=y
CONFIG_DEBUG_MEMORY_INIT=y
CONFIG_SOFTLOCKUP_DETECTOR=y
CONFIG_WQ_WATCHDOG=y
CONFIG_PANIC_ON_SCHED_BUG=y
CONFIG_PANIC_ON_RT_THROTTLING=y
CONFIG_SCHED_STACK_END_CHECK=y
CONFIG_DEBUG_SPINLOCK=y
CONFIG_DEBUG_MUTEXES=y
CONFIG_DEBUG_ATOMIC_SLEEP=y
CONFIG_LOCK_TORTURE_TEST=m
CONFIG_DEBUG_SG=y
CONFIG_DEBUG_NOTIFIERS=y
CONFIG_DEBUG_CREDENTIALS=y
CONFIG_RCU_TORTURE_TEST=m
CONFIG_FAULT_INJECTION=y
CONFIG_FAIL_PAGE_ALLOC=y
CONFIG_UFS_FAULT_INJECTION=y
CONFIG_FAULT_INJECTION_DEBUG_FS=y
CONFIG_FAULT_INJECTION_STACKTRACE_FILTER=y
CONFIG_QCOM_RTB=y
CONFIG_QCOM_RTB_SEPARATE_CPUS=y
CONFIG_FUNCTION_TRACER=y
CONFIG_IRQSOFF_TRACER=y
CONFIG_PREEMPT_TRACER=y
CONFIG_BLK_DEV_IO_TRACE=y
CONFIG_LKDTM=m
CONFIG_ATOMIC64_SELFTEST=m
CONFIG_TEST_USER_COPY=m
CONFIG_MEMTEST=y
CONFIG_BUG_ON_DATA_CORRUPTION=y
CONFIG_PANIC_ON_DATA_CORRUPTION=y
CONFIG_PID_IN_CONTEXTIDR=y
CONFIG_ARM64_STRICT_BREAK_BEFORE_MAKE=y
CONFIG_CORESIGHT_TGU=y
CONFIG_HARDENED_USERCOPY_PAGESPAN=y
CONFIG_XZ_DEC=y
CONFIG_CORESIGHT_SOURCE_ETM4X=y
CONFIG_PANIC_ON_REFCOUNT_ERROR=y
CONFIG_CMA_DEBUGFS=y
CONFIG_PRINT_VMEMLAYOUT=y
CONFIG_MHI_DEBUG=y
CONFIG_PREEMPTIRQ_EVENTS=y
CONFIG_IPA3_MHI_PRIME_MANAGER=y
CONFIG_IPA_DEBUG=y

CONFIG_SEC_DEBUG_FORCE_ERROR=y
CONFIG_SEC_USER_RESET_DEBUG_TEST=y
CONFIG_SEC_DEBUG_SEC_WDOG_BITE=y
CONFIG_SEC_GPIO_DVS=y
CONFIG_ENG_BATTERY_CONCEPT=y

CONFIG_SEC_BSP_PCIE_DEV=y

CONFIG_MST_LPM_DISABLE=y

# ABC Hub bootc eng mode
CONFIG_SEC_ABC_HUB_BOOTC_ENG=y

# CONFIG_UH_LKMAUTH is not set
# CONFIG_UH_LKM_BLOCK is not set

# SDP KeyManagement Test for MDFPP evaluation
CONFIG_SDP_KEY_DUMP=y

# for Displayport debugging
CONFIG_SEC_DISPLAYPORT_ENG=y

# KDP
# CONFIG_RKP_KDP is not set
# CONFIG_RKP_NS_PROT is not set
# CONFIG_RKP_DMAP_PROT is not set

# Maxim 77705 USBC Debug
#
CONFIG_CCIC_MAX77705_DEBUG=y

CONFIG_FIVE_DEBUG=y
CONFIG_FIVE_SIGN_TA=y
CONFIG_FIVE_SIGNCLIENT_PATH="/home/dpi/qb5_8814/workspace/P4_1716/buildscript/tools/signclient.jar"
CONFIG_FIVE_PILSPLITTER_PATH="/home/dpi/qb5_8814/workspace/P4_1716/buildscript/tools/pil_splitter.py"


CONFIG_PROCA=y


# CONFIG_FIVE_PA_FEATURE is not set


CONFIG_GAF_V6=y
```

## arch/arm64/configs/sm8150_sec_gts6l_eur_open_defconfig
```kconfig
# sm8150_sec_gts6l_eur_open_defconfig

CONFIG_SEC_GTS6L_PROJECT=y
CONFIG_MACH_GTS6L_EUR_OPEN=y

# display
CONFIG_PANEL_ANA38401_AMSA05RB06_WQXGA=y

# Sub PMIC
# CONFIG_REGULATOR_S2ABB01 is not set
# CONFIG_REGULATOR_S2DOS03 is not set
# CONFIG_REGULATOR_S2DOS05 is not set
# CONFIG_REGULATOR_MAX77838 is not set
# CONFIG_MFD_S2MPB02 is not set
# CONFIG_REGULATOR_S2MPB02 is not set
# CONFIG_REGULATOR_S2MPB03 is not set

# input device
CONFIG_TOUCHSCREEN_FTS1BA90A=y
CONFIG_INPUT_WACOM=y
CONFIG_EPEN_WACOM_W9021=y
CONFIG_KEYBOARD_STM32_POGO=y

# FPGA
CONFIG_FPGA=y
CONFIG_POGO_FPGA=y

# BATTERY
CONFIG_BATTERY_AGE_FORECAST=y
CONFIG_AFC_CURR_CONTROL_BY_TEMP=y
CONFIG_LIMIT_CHARGING_DURING_CALL=y
CONFIG_BATTERY_CISD=y
CONFIG_CHARGER_SM5705=y
CONFIG_FUELGAUGE_SM5705=y
CONFIG_AFC_CHARGER_MODE=y
CONFIG_TABLET_MODEL_CONCEPT=y
CONFIG_USE_POGO=y
CONFIG_ENABLE_100MA_CHARGING_BEFORE_USB_CONFIGURED=y
CONFIG_CALC_TIME_TO_FULL=y

#MUIC configs
CONFIG_MFD_CORE=y
CONFIG_USE_MUIC=y
CONFIG_MUIC_NOTIFIER=y
CONFIG_MUIC_SUPPORT_CCIC=y
CONFIG_VBUS_NOTIFIER=y
CONFIG_VBUS_NOTIFIER_WORK=y
CONFIG_MUIC_HV=y
CONFIG_HICCUP_CHARGER=y

#MUIC-SM5705
CONFIG_MFD_SM5705=y
CONFIG_MUIC_UNIVERSAL=y
CONFIG_MUIC_UNIVERSAL_SM5705=y
CONFIG_MUIC_UNIVERSAL_SM5705_AFC=y
CONFIG_MUIC_SM5705_SWITCH_CONTROL_GPIO=y
CONFIG_MUIC_PINCTRL=y
# CONFIG_MUIC_UNIVERSAL_MULTI_SUPPORT is not set
# CONFIG_MUIC_SUPPORT_RUSTPROOF is not set
CONFIG_MUIC_SUPPORT_KEYBOARDDOCK=y

# ccic
# CONFIG_CCIC_MAX77705 is not set
# CONFIG_CCIC_S2MM003 is not set
CONFIG_CCIC_S2MM005=y

# redriver
CONFIG_COMBO_REDRIVER_PTN36502=y

# BLUETOOTH
CONFIG_BT=y
CONFIG_MSM_BT_POWER=y
CONFIG_BTFM_SLIM=y
CONFIG_BTFM_SLIM_WCN3990=y
CONFIG_RFKILL=y

# Motor
#CONFIG_MOTOR_DRV_MAX77705 is not set
#CONFIG_SS_VIBRATOR is not set
#CONFIG_BOOST_POWER_SHARE is not set
CONFIG_MSM_VIBRATOR=y

# Displayport
CONFIG_SEC_DISPLAYPORT=y
CONFIG_SEC_DISPLAYPORT_LOGGER=y
CONFIG_SEC_DISPLAYPORT_BIGDATA=y

# Fingerprint sensor
CONFIG_SENSORS_FINGERPRINT=y
CONFIG_SENSORS_ET7XX=y
CONFIG_SENSORS_FP_SPI_NUMBER=0
CONFIG_SENSORS_FP_SPI_GPIO_START=0
CONFIG_SENSORS_FP_SPI_GPIO_END=3

# NFC ESE
#CONFIG_SAMSUNG_NFC is not set
#CONFIG_NFC_PN547 is not set
#CONFIG_NFC_PN547_ESE_SUPPORT is not set
#CONFIG_ESE_SECURE is not set
#CONFIG_ESE_SPI_GPIO_START is not set
#CONFIG_ESE_SPI_GPIO_END is not set
#CONFIG_ESE_SPI_NUMBER is not set
#CONFIG_SEC_NFC_LOGGER is not set

# Audio
CONFIG_GPIO_TACNA=y
CONFIG_MFD_CS48L33=y
CONFIG_SND_SOC_WM_ADSP=y
CONFIG_SND_SOC_CS48L32=y
CONFIG_MFD_TACNA_SPI=y
CONFIG_REGULATOR_ARIZONA_MICSUPP=y
CONFIG_SND_SOC_CS35L41=y
CONFIG_MFD_CS35L41_I2C=y
#CONFIG_SND_SOC_SAMSUNG_AUDIO is not set
#CONFIG_SLIMBUS_DEBUG is not set

# Sensor
CONFIG_SENSORS=y
CONFIG_SENSORS_SSC=y
CONFIG_ADSP_FACTORY=y
CONFIG_LSM6DSO_FACTORY=y
CONFIG_AK09918_FACTORY=y
CONFIG_VEML3328_FACTORY=y

# Grip sensor
CONFIG_SENSORS_A96T3X6=y
CONFIG_SENSORS_A96T3X6_2CH=y
CONFIG_SENSORS_A96T3X6_RESET=y
CONFIG_SENSORS_A96T3X6_WIFI=y
CONFIG_SENSORS_A96T3X6_WIFI_2CH=y

# Camera
# CONFIG_LEDS_S2MPB02 is not set
# CONFIG_SAMSUNG_OIS_MCU_STM32 is not set
# CONFIG_SAMSUNG_APERTURE is not set
CONFIG_CAMERA_SYSFS_V2=y
CONFIG_SAMSUNG_REAR_DUAL=y
CONFIG_SAMSUNG_FRONT_EEPROM=y
CONFIG_USE_CAMERA_HW_BIG_DATA=y
CONFIG_CAMERA_FRS_DRAM_TEST=y
# CONFIG_SAMSUNG_APERTURE_HALLTEST is not set
CONFIG_CAMERA_SSM_I2C_ENV=y
CONFIG_SAMSUNG_ACTUATOR_DW9808=y

# Hall ic
CONFIG_SENSORS_HALL=y
CONFIG_CERTIFY_HALL=y
CONFIG_LOGICAL_HALL=y
CONFIG_WACOM_HALL=y

# Linux On Dex
CONFIG_USER_NS=y
CONFIG_POSIX_MQUEUE=y
CONFIG_VETH=y
CONFIG_UTS_NS=y
CONFIG_PID_NS=y
CONFIG_CGROUP_PIDS=y
CONFIG_CGROUP_DEVICE=y
#CONFIG_MEMCG=y
#CONFIG_MEMCG_SWAP=y
CONFIG_NET_CLS_CGROUP=y
CONFIG_LOD_SEC=y

# RKP
CONFIG_UH=y
CONFIG_UH_RKP=y
CONFIG_RKP_TEST=y


# Broadcom WiFi feature remove
# CONFIG_BROADCOM_WIFI is not set
# CONFIG_BCM4375 is not set
# CONFIG_WLAN_BCM4375_ENHANCED_FEATURES is not set
# CONFIG_BCMDHD_FW_PATH is not set
# CONFIG_BCMDHD_NVRAM_PATH is not set
# CONFIG_BROADCOM_WIFI_RESERVED_MEM is not set
# CONFIG_CFG80211_REG_NOT_UPDATED is not set
# CONFIG_WIFI_MULTICAST_LOG is not set
# CONFIG_BCMDHD_PCIE is not set
# CONFIG_BCMDHD_PREALLOC_MEMDUMP is not set
# CONFIG_BCMDHD_OOB_HOST_WAKE is not set
# CONFIG_BCM_DHD_WLAN is not set
# CONFIG_WLAN_VENDOR_DUMP_ENABLE is not set
# CONFIG_WLAN_TSQ_MULTIPLIER is not set

# QCA Wi-Fi feature
CONFIG_QCA_CLD_WLAN=y
CONFIG_ICNSS=y
CONFIG_ICNSS_QMI=y
# CONFIG_ICNSS_DEBUG is not set

CONFIG_WCNSS_MEM_PRE_ALLOC=y

# Hall ic
CONFIG_SENSORS_HALL=y
```

## arch/arm64/configs/sm8150_sec_kasankcov_defconfig
```kconfig
#
# Kernel Coverage support for syzkaller fuzzer
#
CONFIG_KCOV=y

#
# KASAN Kernel Address SANitizer
#
CONFIG_KASAN=y
CONFIG_LOG_BUF_SHIFT=21
CONFIG_CC_OPTIMIZE_FOR_SIZE=y

CONFIG_SLUB_DEBUG=y

# needed, otherwise you'll get "stack frame size of <x> bytes in ...' [-Werror,-Wframe-larger-than=..."
CONFIG_FRAME_WARN=0

#
# Enable multishot mode
# https://github.sec.samsung.net/SRPOL-SRUK-SEC/syzkaller/issues/23
#
CONFIG_CMDLINE="kasan_multi_shot"
# CONFIG_CMDLINE_FROM_BOOTLOADER is not set
CONFIG_CMDLINE_EXTEND=y

#
# Undefined config for Kernel SANitizers
#
# CONFIG_SLUB_DEBUG_PANIC_ON is not set
# CONFIG_UH is not set
# CONFIG_UH_RKP is not set
# CONFIG_RKP_TEST is not set
# CONFIG_RKP_KDP is not set
# CONFIG_KDP_TEST is not set
# CONFIG_RKP_NS_PROT is not set
# CONFIG_RKP_DMAP_PROT is not set

# CONFIG_RKP_CFP_JOPP is not set
# CONFIG_RKP_CFP_ROPP is not set
# CONFIG_RKP_CFP_ROPP_SYSREGKEY is not set
# CONFIG_RANDOMIZE_BASE is not set
#
# Undefined to reduce vmlinux size
#
# vmlinux reduce by a few MB
# CONFIG_DYNAMIC_DEBUG is not set
# early_log is about 1MB
# CONFIG_DEBUG_KMEMLEAK is not set

#
# DO NOT REMOVE THE LAST BLANK LINE
#
```

## arch/arm64/configs/sm8150_sec_r3q_chn_open_defconfig
```kconfig
# sm8150_sec_r3q_chn_open_defconfig

CONFIG_SEC_R3Q_PROJECT=y
CONFIG_MACH_R3Q_CHN_OPEN=y
CONFIG_SEC_5GMODEL=y

# DISPLAY
CONFIG_PANEL_S6E3FC2_AMS670TA01_FHD=y

# Sub PMIC
# CONFIG_REGULATOR_S2ABB01 is not set
# CONFIG_REGULATOR_S2DOS03 is not set
CONFIG_REGULATOR_S2DOS05=y
# CONFIG_REGULATOR_MAX77838 is not set
CONFIG_MFD_S2MPB02=y
CONFIG_REGULATOR_S2MPB02=y
CONFIG_REGULATOR_S2MPB03=y

# input device
CONFIG_TOUCHSCREEN_IST40XX=y
CONFIG_TOUCHSCREEN_MELFAS_MSS100=y
# BATTERY
CONFIG_CALC_TIME_TO_FULL=y
CONFIG_BATTERY_AGE_FORECAST=y
CONFIG_AFC_CURR_CONTROL_BY_TEMP=y
CONFIG_LIMIT_CHARGING_DURING_CALL=y
# CONFIG_ENABLE_100MA_CHARGING_BEFORE_USB_CONFIGURED is not set
CONFIG_FUELGAUGE_MAX77705=y
CONFIG_CHARGER_MAX77705=y
CONFIG_MAX77705_CHECK_B2SOVRC=y
CONFIG_BATTERY_CISD=y
CONFIG_OTG_OVERCURRENT_BY_CHGIN=y
CONFIG_STEP_CHARGING=y
CONFIG_DIRECT_CHARGING=y
CONFIG_CHARGER_PCA9468=y
CONFIG_PDIC_PD30=y

# MUIC configs
CONFIG_MFD_CORE=y
CONFIG_USE_MUIC=y
CONFIG_USE_SAFEOUT=y
CONFIG_MUIC_NOTIFIER=y
CONFIG_AFC_CHARGER_MODE=y
CONFIG_MUIC_SUPPORT_RUSTPROOF=y
CONFIG_VBUS_NOTIFIER=y
CONFIG_VBUS_NOTIFIER_WORK=y
CONFIG_MUIC_MAX77705=y
CONFIG_MFD_MAX77705=y
CONFIG_MUIC_MAX77705_CCIC=y
CONFIG_HV_MUIC_MAX77705_AFC=y
CONFIG_MUIC_SUPPORT_CCIC=y
CONFIG_AFC_CHARGER_MODE=y
CONFIG_MUIC_HV=y
CONFIG_HICCUP_CHARGER=y
CONFIG_MUIC_SUPPORT_UART_SEL=y

# ccic
CONFIG_CCIC_MAX77705=y
# CONFIG_CCIC_S2MM003 is not set
CONFIG_CCIC_S2MM005=y

# redriver
# CONFIG_COMBO_REDRIVER is not set
CONFIG_COMBO_REDRIVER_PTN36502=y

# Motor
CONFIG_SS_VIBRATOR=y
CONFIG_BOOST_POWER_SHARE=y
CONFIG_ANDROID_TIMED_OUTPUT=y
CONFIG_MOTOR_DRV_MAX77705=y

# BLUETOOTH
CONFIG_BT=y
CONFIG_MSM_BT_POWER=y
CONFIG_BTFM_SLIM=y
CONFIG_BTFM_SLIM_WCN3990=y
CONFIG_RFKILL=y

# Displayport
CONFIG_SEC_DISPLAYPORT=y
CONFIG_SEC_DISPLAYPORT_LOGGER=y
CONFIG_SEC_DISPLAYPORT_BIGDATA=y

# Fingerprint sensor
CONFIG_SENSORS_FINGERPRINT=y
CONFIG_SENSORS_ET7XX=y
CONFIG_SENSORS_FP_SPI_NUMBER=0
CONFIG_SENSORS_FP_SPI_GPIO_START=0
CONFIG_SENSORS_FP_SPI_GPIO_END=3

# NFC ESE
CONFIG_SAMSUNG_NFC=y
CONFIG_NFC_PN547=y
CONFIG_NFC_PN547_ESE_SUPPORT=y
CONFIG_ESE_SECURE=y
CONFIG_ESE_SPI_GPIO_START=23
CONFIG_ESE_SPI_GPIO_END=26
CONFIG_ESE_SPI_NUMBER=3
CONFIG_SEC_NFC_LOGGER=y

# Audio
CONFIG_SLIMBUS_DEBUG=y
CONFIG_SND_SOC_SAMSUNG_AUDIO=y
CONFIG_SND_SOC_SAMSUNG_USB_HEADSET_ONLY=y

# Grip sensor
CONFIG_SENSORS_SX9360=y

# Camera
#CONFIG_LEDS_S2MPB02=y
CONFIG_LEDS_PMIC_QPNP=y
CONFIG_CAMERA_SYSFS_V2=y
CONFIG_SAMSUNG_REAR_TRIPLE=y
#CONFIG_SAMSUNG_FRONT_EEPROM=y
CONFIG_USE_CAMERA_HW_BIG_DATA=y
#CONFIG_CAMERA_FRS_DRAM_TEST=y
#CONFIG_SAMSUNG_APERTURE_HALLTEST=y
#CONFIG_CAMERA_SSM_I2C_ENV=y
CONFIG_SAMSUNG_REAR_BOKEH=y

# Hall ic
CONFIG_SENSORS_HALL=y
CONFIG_CERTIFY_HALL=y

#sensor
CONFIG_SENSORS=y
CONFIG_SENSORS_SSC=y
CONFIG_ADSP_FACTORY=y
CONFIG_LSM6DSL_FACTORY=y
CONFIG_AK09918_FACTORY=y
CONFIG_TMD490X_FACTORY=y
CONFIG_SUPPORT_TMD4907_FACTORY=y
CONFIG_SUPPORT_PROX_AUTO_CAL=y
CONFIG_SUPPORT_MOBEAM=y
CONFIG_SUPPORT_HIDDEN_HOLE=y
CONFIG_SUPPORT_BRIGHT_SYSFS_COMPENSATION_LUX=y

# Broadcom WiFi feature remove
# CONFIG_BROADCOM_WIFI is not set
# CONFIG_BCM4375 is not set
# CONFIG_WLAN_BCM4375_ENHANCED_FEATURES is not set
# CONFIG_BCMDHD_FW_PATH is not set
# CONFIG_BCMDHD_NVRAM_PATH is not set
# CONFIG_BROADCOM_WIFI_RESERVED_MEM is not set
# CONFIG_CFG80211_REG_NOT_UPDATED is not set
# CONFIG_WIFI_MULTICAST_LOG is not set
# CONFIG_BCMDHD_PCIE is not set
# CONFIG_BCMDHD_PREALLOC_MEMDUMP is not set
# CONFIG_BCMDHD_OOB_HOST_WAKE is not set
# CONFIG_BCM_DHD_WLAN is not set
# CONFIG_WLAN_VENDOR_DUMP_ENABLE is not set
# CONFIG_WLAN_TSQ_MULTIPLIER is not set

# QCA Wi-Fi feature
CONFIG_QCA_CLD_WLAN=y
CONFIG_ICNSS=y
CONFIG_ICNSS_QMI=y
# CONFIG_ICNSS_DEBUG is not set
CONFIG_WCNSS_MEM_PRE_ALLOC=y

#Actuator
CONFIG_SAMSUNG_ACTUATOR_DW9808=y
CONFIG_SAMSUNG_HW_SOFTLANDING=y
```
