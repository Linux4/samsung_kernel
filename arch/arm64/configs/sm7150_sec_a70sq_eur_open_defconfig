## arch/arm64/configs/universal7580_q_defconfig
```kconfig
# CONFIG_LOCALVERSION_AUTO is not set
# CONFIG_SWAP is not set
CONFIG_SYSVIPC=y
CONFIG_NO_HZ=y
CONFIG_HIGH_RES_TIMERS=y
CONFIG_CGROUPS=y
CONFIG_CGROUP_DEBUG=y
CONFIG_CGROUP_FREEZER=y
CONFIG_CGROUP_CPUACCT=y
CONFIG_RESOURCE_COUNTERS=y
CONFIG_CGROUP_SCHED=y
CONFIG_RT_GROUP_SCHED=y
CONFIG_BLK_DEV_INITRD=y
CONFIG_CC_OPTIMIZE_FOR_SIZE=y
# CONFIG_COMPAT_BRK is not set
CONFIG_PROFILING=y
# CONFIG_BLK_DEV_BSG is not set
# CONFIG_IOSCHED_DEADLINE is not set
CONFIG_ARCH_EXYNOS=y
CONFIG_ARCH_EXYNOS7=y
CONFIG_SOC_EXYNOS7580=y
CONFIG_EXYNOS_ASV=y
CONFIG_EXYNOS_ASV_DYNAMIC_ABB=y
CONFIG_EXYNOS_ASV_MARGIN_TEST=y
CONFIG_EXYNOS7580_QUAD=y
CONFIG_EXYNOS7580_DYNAMIC_CLUSTER_HOTPLUG=y
CONFIG_MACH_UNIVERSAL7580=y
CONFIG_SMP=y
CONFIG_SCHED_MC=y
CONFIG_NR_CPUS=4
CONFIG_PREEMPT=y
# CONFIG_HW_PERF_EVENTS is not set
CONFIG_ARMV7_COMPAT=y
CONFIG_CMDLINE="console=ttySAC1"
# CONFIG_CORE_DUMP_DEFAULT_ELF_HEADERS is not set
CONFIG_COMPAT=y
CONFIG_PM_AUTOSLEEP=y
CONFIG_PM_WAKELOCKS=y
CONFIG_PM_RUNTIME=y
CONFIG_PM_RUNTIME_TEST_SYSFS=y
CONFIG_CPU_FREQ=y
CONFIG_CPU_FREQ_DEFAULT_GOV_INTERACTIVE=y
CONFIG_ARM_EXYNOS_SMP_CPUFREQ=y
CONFIG_CPU_IDLE=y
CONFIG_OF_IDLE_STATES=y
CONFIG_CPU_IDLE_EXYNOS=y
CONFIG_NET=y
CONFIG_PACKET=y
CONFIG_UNIX=y
CONFIG_XFRM_USER=y
CONFIG_NET_KEY=y
CONFIG_INET=y
CONFIG_IP_ADVANCED_ROUTER=y
CONFIG_IP_MULTIPLE_TABLES=y
CONFIG_IP_PNP=y
CONFIG_IP_PNP_DHCP=y
CONFIG_IP_PNP_BOOTP=y
CONFIG_IP_PNP_RARP=y
CONFIG_INET_ESP=y
# CONFIG_INET_XFRM_MODE_TUNNEL is not set
# CONFIG_INET_XFRM_MODE_BEET is not set
# CONFIG_INET_LRO is not set
# CONFIG_INET_DIAG is not set
CONFIG_IPV6_PRIVACY=y
CONFIG_IPV6_ROUTER_PREF=y
CONFIG_IPV6_ROUTE_INFO=y
CONFIG_IPV6_OPTIMISTIC_DAD=y
CONFIG_INET6_AH=y
CONFIG_INET6_ESP=y
CONFIG_INET6_IPCOMP=y
CONFIG_IPV6_MIP6=y
CONFIG_IPV6_TUNNEL=y
CONFIG_IPV6_MULTIPLE_TABLES=y
CONFIG_NETFILTER=y
CONFIG_NF_CONNTRACK=y
CONFIG_NF_CONNTRACK_EVENTS=y
CONFIG_NF_CT_PROTO_DCCP=y
CONFIG_NF_CT_PROTO_SCTP=y
CONFIG_NF_CT_PROTO_UDPLITE=y
CONFIG_NF_CONNTRACK_AMANDA=y
CONFIG_NF_CONNTRACK_FTP=y
CONFIG_NF_CONNTRACK_H323=y
CONFIG_NF_CONNTRACK_IRC=y
CONFIG_NF_CONNTRACK_NETBIOS_NS=y
CONFIG_NF_CONNTRACK_PPTP=y
CONFIG_NF_CONNTRACK_SANE=y
CONFIG_NF_CONNTRACK_TFTP=y
CONFIG_NF_CT_NETLINK=y
CONFIG_NETFILTER_TPROXY=y
CONFIG_NETFILTER_XT_TARGET_CLASSIFY=y
CONFIG_NETFILTER_XT_TARGET_CONNMARK=y
CONFIG_NETFILTER_XT_TARGET_IDLETIMER=y
CONFIG_NETFILTER_XT_TARGET_MARK=y
CONFIG_NETFILTER_XT_TARGET_NFLOG=y
CONFIG_NETFILTER_XT_TARGET_NFQUEUE=y
CONFIG_NETFILTER_XT_TARGET_TPROXY=y
CONFIG_NETFILTER_XT_TARGET_TRACE=y
CONFIG_NETFILTER_XT_TARGET_TCPMSS=y
CONFIG_NETFILTER_XT_MATCH_COMMENT=y
CONFIG_NETFILTER_XT_MATCH_CONNBYTES=y
CONFIG_NETFILTER_XT_MATCH_CONNLABEL=y
CONFIG_NETFILTER_XT_MATCH_CONNLIMIT=y
CONFIG_NETFILTER_XT_MATCH_CONNMARK=y
CONFIG_NETFILTER_XT_MATCH_CONNTRACK=y
CONFIG_NETFILTER_XT_MATCH_HASHLIMIT=y
CONFIG_NETFILTER_XT_MATCH_HELPER=y
CONFIG_NETFILTER_XT_MATCH_IPRANGE=y
CONFIG_NETFILTER_XT_MATCH_LENGTH=y
CONFIG_NETFILTER_XT_MATCH_LIMIT=y
CONFIG_NETFILTER_XT_MATCH_MAC=y
CONFIG_NETFILTER_XT_MATCH_MARK=y
CONFIG_NETFILTER_XT_MATCH_POLICY=y
CONFIG_NETFILTER_XT_MATCH_PKTTYPE=y
CONFIG_NETFILTER_XT_MATCH_QTAGUID=y
CONFIG_NETFILTER_XT_MATCH_QUOTA=y
CONFIG_NETFILTER_XT_MATCH_QUOTA2=y
CONFIG_NETFILTER_XT_MATCH_QUOTA2_LOG=y
CONFIG_NETFILTER_XT_MATCH_SCTP=y
CONFIG_NETFILTER_XT_MATCH_SOCKET=y
CONFIG_NETFILTER_XT_MATCH_STATE=y
CONFIG_NETFILTER_XT_MATCH_STATISTIC=y
CONFIG_NETFILTER_XT_MATCH_STRING=y
CONFIG_NETFILTER_XT_MATCH_TIME=y
CONFIG_NETFILTER_XT_MATCH_U32=y
CONFIG_NF_CONNTRACK_IPV4=y
CONFIG_IP_NF_IPTABLES=y
CONFIG_IP_NF_MATCH_AH=y
CONFIG_IP_NF_MATCH_ECN=y
CONFIG_IP_NF_MATCH_TTL=y
CONFIG_IP_NF_FILTER=y
CONFIG_IP_NF_TARGET_REJECT=y
CONFIG_IP_NF_TARGET_REJECT_SKERR=y
CONFIG_NF_NAT_IPV4=y
CONFIG_IP_NF_TARGET_MASQUERADE=y
CONFIG_IP_NF_TARGET_NETMAP=y
CONFIG_IP_NF_TARGET_REDIRECT=y
CONFIG_IP_NF_MANGLE=y
CONFIG_IP_NF_RAW=y
CONFIG_IP_NF_ARPTABLES=y
CONFIG_IP_NF_ARPFILTER=y
CONFIG_IP_NF_ARP_MANGLE=y
CONFIG_NF_CONNTRACK_IPV6=y
CONFIG_IP6_NF_IPTABLES=y
CONFIG_IP6_NF_FILTER=y
CONFIG_IP6_NF_TARGET_REJECT=y
CONFIG_IP6_NF_TARGET_REJECT_SKERR=y
CONFIG_IP6_NF_MANGLE=y
CONFIG_IP6_NF_RAW=y
CONFIG_PHONET=y
CONFIG_NET_SCHED=y
CONFIG_NET_SCH_HTB=y
CONFIG_NET_SCH_INGRESS=y
CONFIG_NET_CLS_U32=y
CONFIG_NET_EMATCH=y
CONFIG_NET_EMATCH_U32=y
CONFIG_NET_CLS_ACT=y
CONFIG_NET_ACT_POLICE=y
CONFIG_NET_ACT_GACT=y
CONFIG_NET_ACT_MIRRED=y
CONFIG_UEVENT_HELPER_PATH="/sbin/hotplug"
CONFIG_DEVTMPFS=y
CONFIG_BLK_DEV_RAM=y
CONFIG_BLK_DEV_RAM_COUNT=1
CONFIG_BLK_DEV_RAM_SIZE=16384
CONFIG_USE_MUIC=y
CONFIG_MUIC_NOTIFIER=y
CONFIG_MUIC_S2MM001=y
CONFIG_SCSI=y
CONFIG_FMP=y
# CONFIG_SCSI_PROC_FS is not set
CONFIG_BLK_DEV_SD=y
CONFIG_SCSI_MULTI_LUN=y
# CONFIG_SCSI_LOWLEVEL is not set
CONFIG_MD=y
CONFIG_BLK_DEV_DM=y
CONFIG_DM_CRYPT=y
CONFIG_NETDEVICES=y
CONFIG_USB_PEGASUS=y
CONFIG_INPUT_EVDEV=y
CONFIG_KEYBOARD_GPIO=y
# CONFIG_INPUT_MOUSE is not set
CONFIG_INPUT_TOUCHSCREEN=y
CONFIG_TOUCHSCREEN_SYNAPTICS_I2C_DSX=y
# CONFIG_SERIO_I8042 is not set
# CONFIG_SERIO_SERPORT is not set
CONFIG_LEGACY_PTY_COUNT=16
CONFIG_SERIAL_SAMSUNG=y
CONFIG_SERIAL_SAMSUNG_CONSOLE=y
CONFIG_S3C_LOWLEVEL_UART_PORT=1
CONFIG_HW_RANDOM_EXYNOS_SWD=y
CONFIG_EXYRNG_FIPS_COMPLIANCE=y
CONFIG_EXYRNG_FAIL_POLICY_RESET=y
CONFIG_EXYRNG_USE_CRYPTOMANAGER=y
CONFIG_I2C=y
CONFIG_I2C_CHARDEV=y
CONFIG_I2C_EXYNOS5=y
CONFIG_I2C_GPIO=y
CONFIG_I2C_S3C2410=y
CONFIG_SPI=y
CONFIG_SPI_S3C64XX=y
# CONFIG_HWMON is not set
CONFIG_THERMAL=y
CONFIG_CPU_THERMAL=y
CONFIG_GPU_THERMAL=y
CONFIG_THERMAL_EMULATION=y
CONFIG_EXYNOS_THERMAL=y
CONFIG_EXYNOS_SWTRIP=y
CONFIG_EXYNOS_THERMAL_CORE=y
CONFIG_WATCHDOG=y
CONFIG_S3C2410_WATCHDOG=y
CONFIG_MFD_SEC_CORE=y
CONFIG_MFD_S2MU003=y
CONFIG_REGULATOR=y
CONFIG_REGULATOR_FIXED_VOLTAGE=y
CONFIG_REGULATOR_GPIO=y
CONFIG_REGULATOR_S2MPU03=y
CONFIG_REGULATOR_S2MU003=y
CONFIG_MEDIA_SUPPORT=y
CONFIG_MEDIA_CAMERA_SUPPORT=y
CONFIG_V4L_PLATFORM_DRIVERS=y
# CONFIG_VIDEO_EXYNOS_HEVC is not set
CONFIG_VIDEO_EXYNOS_FIMC_IS=y
CONFIG_USE_HOST_FD_LIBRARY=y
CONFIG_ENABLE_HAL3_2_META_INTERFACE=y
CONFIG_CAMERA_SENSOR_5E3_OBJ=y
CONFIG_CAMERA_SENSOR_2P2_OBJ=y
CONFIG_CSI_V3_4=y
CONFIG_FIMC_IS_V3_1_1=y
CONFIG_VIDEO_EXYNOS_SCALER=y
CONFIG_VIDEO_EXYNOS_HX_JPEG=y
CONFIG_V4L_MEM2MEM_DRIVERS=y
CONFIG_MALI_EXYNOS_TRACE=y
CONFIG_MALI_EXPERT=y
CONFIG_MALI_PLATFORM_THIRDPARTY_NAME="7580"
CONFIG_MALI_DVFS=y
CONFIG_MALI_RT_PM=y
CONFIG_MALI_ENABLE_TRACE=y
CONFIG_MALI_DEBUG_SYS=y
CONFIG_MALI_T7XX=y
CONFIG_MALI_R12P0=y
CONFIG_FB=y
CONFIG_USE_VSYNC_SKIP=y
CONFIG_DECON_MIPI_DSI_PKTGO=y
CONFIG_FB_SIMPLE=y
CONFIG_EXYNOS_VIDEO=y
CONFIG_FB_WINDOW_UPDATE=y
CONFIG_EXYNOS_DECON_EXYNOS7580=y
CONFIG_DECON_LPD_DISPLAY_WITH_CAMERA=y
CONFIG_DECON_DEVFREQ=y
CONFIG_EXYNOS_DECON_DISP_LCD=y
CONFIG_EXYNOS_DECON_LCD_S6E3FA2=y
CONFIG_BACKLIGHT_LCD_SUPPORT=y
CONFIG_SOUND=y
CONFIG_SND=y
CONFIG_SND_SOC=y
CONFIG_SND_SOC_SAMSUNG=y
CONFIG_SND_SOC_SAMSUNG_UNIVERSAL7580_COD3022X=y
CONFIG_SND_SOC_SAMSUNG_VERBOSE_DEBUG=y
CONFIG_SND_SOC_DBMD2=y
CONFIG_USB=y
CONFIG_USB_EHCI_HCD=y
CONFIG_USB_EHCI_S5P=y
CONFIG_USB_OHCI_HCD=y
CONFIG_USB_OHCI_EXYNOS=y
CONFIG_USB_STORAGE=y
CONFIG_USB_HOST_NOTIFY=y
CONFIG_USB_NOTIFY_LAYER=y
CONFIG_USB_NOTIFIER=y
CONFIG_USB_SERIAL=y
CONFIG_USB_SERIAL_FTDI_SIO=y
CONFIG_USB_EXYNOS_SWITCH=y
CONFIG_USB_PHY=y
CONFIG_SAMSUNG_DWC_USB2PHY=y
CONFIG_SAMSUNG_USB2PHY_CAL=y
CONFIG_USB_GADGET=y
CONFIG_USB_S3C_OTGD=y
CONFIG_USB_G_ANDROID=y
CONFIG_USB_RNDIS_MULTIPACKET=y
CONFIG_MMC=y
CONFIG_MMC_UNSAFE_RESUME=y
CONFIG_MMC_CLKGATE=y
CONFIG_MMC_DW=y
CONFIG_MMC_DW_FMP_DM_CRYPT=y
CONFIG_MMC_DW_FMP_ECRYPT_FS=y
CONFIG_MMC_DW_IDMAC=y
CONFIG_MMC_DW_64_IDMAC=y
CONFIG_MMC_DW_EXYNOS=y
# CONFIG_MMC_DW_SKIP_CACHE_OP is not set
CONFIG_MMC_DW_FORCE_32BIT_SFR_RW=y
CONFIG_NEW_LEDS=y
CONFIG_LEDS_CLASS=y
CONFIG_LEDS_S2MU003=y
CONFIG_SWITCH=y
CONFIG_RTC_CLASS=y
CONFIG_RTC_DRV_SEC=y
CONFIG_VIRTIO_MMIO=y
CONFIG_STAGING=y
CONFIG_ANDROID=y
CONFIG_ANDROID_BINDER_IPC=y
CONFIG_ANDROID_BINDER_IPC_32BIT=y
CONFIG_ASHMEM=y
CONFIG_ANDROID_LOGGER=y
CONFIG_ANDROID_LOW_MEMORY_KILLER=y
CONFIG_ANDROID_INTF_ALARM_DEV=y
CONFIG_SYNC=y
CONFIG_SW_SYNC=y
CONFIG_ION=y
CONFIG_ION_EXYNOS=y
CONFIG_ION_EXYNOS_OF=y
CONFIG_SEC_EXT=y
# CONFIG_SEC_SYSFS is not set
# CONFIG_SEC_DEBUG is not set
# CONFIG_SEC_PM is not set
CONFIG_EXYNOS_IOMMU_V6=y
CONFIG_PM_DEVFREQ=y
CONFIG_IIO=y
CONFIG_EXYNOS_ADC=y
CONFIG_PWM=y
CONFIG_PWM_SAMSUNG=y
CONFIG_BATTERY_SAMSUNG=y
CONFIG_CHARGER_S2MU003=y
CONFIG_MOBICORE_DRIVER=y
CONFIG_MOBICORE_API=y
CONFIG_EXYNOS_CORESIGHT=y
CONFIG_EXT2_FS=y
CONFIG_EXT3_FS=y
# CONFIG_EXT3_DEFAULTS_TO_ORDERED is not set
# CONFIG_EXT3_FS_XATTR is not set
CONFIG_EXT4_FS=y
CONFIG_FUSE_FS=y
CONFIG_CUSE=y
CONFIG_VFAT_FS=y
CONFIG_TMPFS=y
CONFIG_ECRYPT_FS=y
CONFIG_CRAMFS=y
CONFIG_NLS_CODEPAGE_437=y
CONFIG_NLS_ISO8859_1=y
CONFIG_PRINTK_TIME=y
CONFIG_PRINTK_CORE_NUM=y
CONFIG_PRINTK_PROCESS=y
CONFIG_MAGIC_SYSRQ=y
CONFIG_DEBUG_KERNEL=y
CONFIG_LOCKUP_DETECTOR=y
CONFIG_BOOTPARAM_HARDLOCKUP_PANIC=y
CONFIG_BOOTPARAM_SOFTLOCKUP_PANIC=y
# CONFIG_DETECT_HUNG_TASK is not set
CONFIG_SLUB_DEBUG_ON=y
CONFIG_DEBUG_RT_MUTEXES=y
CONFIG_DEBUG_LOCK_ALLOC=y
CONFIG_DEBUG_ATOMIC_SLEEP=y
CONFIG_DEBUG_INFO=y
CONFIG_DEBUG_LIST=y
# CONFIG_FTRACE is not set
CONFIG_ATOMIC64_SELFTEST=y
CONFIG_KEYS=y
CONFIG_ARM64_CRYPTO=y
CONFIG_CRYPTO_SHA1_ARM64_CE=y
CONFIG_CRYPTO_SHA2_ARM64_CE=y
CONFIG_CRYPTO_AES_ARM64_CE=y
CONFIG_CRYPTO_AES_ARM64_CE_BLK=y
```

## arch/arm64/configs/universal8825_defconfig
```kconfig
CONFIG_CMDLINE_EXTEND=y

CONFIG_KEYBOARD_S2MPU13=m
CONFIG_MFD_S2MPU13=m
CONFIG_MFD_S2MPU14=m
CONFIG_REGULATOR_S2MPU13=m
CONFIG_REGULATOR_S2MPU14=m
CONFIG_REGULATOR_S2MPB03=m
CONFIG_RTC_DRV_S2MPU13=m
CONFIG_S2MPU13_ADC=m
CONFIG_PINCTRL_SAMSUNG_S2MPU13=m
CONFIG_PINCTRL_SAMSUNG_S2MPU14=m

CONFIG_SND_SOC_SAMSUNG_EXYNOS_TFA9878=m
CONFIG_SND_SOC_SAMSUNG_EXYNOS8825_SOUND=m
CONFIG_CMA_SIZE_MBYTES=56

CONFIG_TOUCHSCREEN_STM_FTS5CU56A=m

CONFIG_EXYNOS_BTS=m
CONFIG_DRM_PANEL_SAMSUNG_S6E3FC3=m

# SEC CONFIGS
CONFIG_SEC_DEBUG=m
#CONFIG_SEC_REBOOT=m
CONFIG_SEC_PARAM=m
CONFIG_DRV_SAMSUNG=m
#CONFIG_SEC_DEBUG_BASE=m

# BATTERY
CONFIG_BATTERY_GKI=y
CONFIG_BATTERY_SAMSUNG_SM5714_MODULE=m
CONFIG_BATTERY_SAMSUNG=y
CONFIG_BATTERY_SWELLING=y
CONFIG_BATTERY_AGE_FORECAST=y
CONFIG_AFC_CHARGER_MODE=y
CONFIG_FUELGAUGE_SM5714=m
CONFIG_CHARGER_SM5714=m
CONFIG_SEC_PD_SM5714_MODULE=m
CONFIG_SEC_PD=y

# MFD
CONFIG_MFD_SM5714=m

# MUIC
CONFIG_USE_MUIC=y
CONFIG_MUIC_NOTIFIER_SM5714=m
CONFIG_MUIC_MANAGER=y
CONFIG_MUIC_CORE=y
CONFIG_MUIC_SM5714=m
CONFIG_MUIC_SYSFS=y
CONFIG_MUIC_SUPPORT_PDIC=m
CONFIG_MUIC_BCD_RESCAN=y
CONFIG_VBUS_NOTIFIER_SM5714=m

# PDIC
CONFIG_PDIC_SM5714=m

# USB
CONFIG_GKI_USB=y
CONFIG_PDIC_NOTIFIER=m
CONFIG_USB_ARCH_EXYNOS=y
CONFIG_USB_TYPEC_MANAGER_NOTIFIER_SM5714=m
CONFIG_IF_CB_MANAGER=m

CONFIG_VERIFY_VSS=m

# WLBT
CONFIG_SCSC_AP_INTERFACE_NAME="swlan0"

#Camera
CONFIG_CAMERA_VENDER_MCD_V2=y
# CONFIG_OIS_USE is not set
CONFIG_AF_HOST_CONTROL=y
# CONFIG_CAMERA_USE_INTERNAL_MCU is not set
```
