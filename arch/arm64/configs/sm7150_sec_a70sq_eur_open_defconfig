## arch/arm64/configs/sm8150_sec_beyond2q5g_usa_vzw_defconfig
```kconfig
# sm8150_sec_beyond2q5g_usa_vzw_defconfig

CONFIG_SEC_BEYOND2Q5G_PROJECT=y
CONFIG_MACH_BEYOND2Q5G_USA_VZW=y
CONFIG_SEC_5GMODEL=y

# display
CONFIG_PANEL_S6E3HA9_AMB644WF01_WQHD=y

# Sub PMIC
# CONFIG_REGULATOR_S2ABB01 is not set
# CONFIG_REGULATOR_S2DOS03 is not set
CONFIG_REGULATOR_S2DOS05=y
# CONFIG_REGULATOR_MAX77838 is not set
CONFIG_MFD_S2MPB02=y
CONFIG_REGULATOR_S2MPB02=y
CONFIG_REGULATOR_S2MPB03=y

# input device
CONFIG_TOUCHSCREEN_SEC_TS_Y771=y

# BATTERY
CONFIG_CALC_TIME_TO_FULL=y
CONFIG_BATTERY_AGE_FORECAST=y
CONFIG_AFC_CURR_CONTROL_BY_TEMP=y
CONFIG_LIMIT_CHARGING_DURING_CALL=y
CONFIG_ENABLE_100MA_CHARGING_BEFORE_USB_CONFIGURED=y
CONFIG_FUELGAUGE_MAX77705=y
CONFIG_CHARGER_MAX77705=y
CONFIG_MAX77705_CHECK_B2SOVRC=y
CONFIG_WIRELESS_CHARGER_MFC=y
CONFIG_WIRELESS_FIRMWARE_UPDATE=y
CONFIG_WIRELESS_AUTH=y
CONFIG_BATTERY_CISD=y
CONFIG_OTG_OVERCURRENT_BY_CHGIN=y
CONFIG_STEP_CHARGING=y
CONFIG_WIRELESS_TX_MODE=y
CONFIG_PREVENT_USB_CONN_OVERHEAT=y

# MUIC configs
CONFIG_MFD_CORE=y
CONFIG_USE_MUIC=y
CONFIG_USE_SAFEOUT=y
CONFIG_MUIC_NOTIFIER=y
CONFIG_AFC_CHARGER_MODE=y
CONFIG_MUIC_SUPPORT_RUSTPROOF=y
CONFIG_VBUS_NOTIFIER=y
CONFIG_VBUS_NOTIFIER_WORK=y
CONFIG_MUIC_MAX77705=y
CONFIG_MFD_MAX77705=y
CONFIG_MUIC_MAX77705_CCIC=y
CONFIG_HV_MUIC_MAX77705_AFC=y
CONFIG_MUIC_SUPPORT_CCIC=y
CONFIG_AFC_CHARGER_MODE=y
CONFIG_MUIC_HV=y
CONFIG_HICCUP_CHARGER=y
CONFIG_MUIC_SUPPORT_UART_SEL=y

# ccic
CONFIG_CCIC_MAX77705=y
# CONFIG_CCIC_S2MM003 is not set
CONFIG_CCIC_S2MM005=y

# redriver
# CONFIG_COMBO_REDRIVER is not set

# Motor
CONFIG_ANDROID_TIMED_OUTPUT=y
CONFIG_MOTOR_DRV_CS40L2X=y

# BLUETOOTH
CONFIG_BT=y
CONFIG_BT_BCM4361=y
CONFIG_BT_BLUESLEEP=y
CONFIG_RFKILL=y

# Displayport
CONFIG_SEC_DISPLAYPORT=y
CONFIG_SEC_DISPLAYPORT_LOGGER=y
CONFIG_SEC_DISPLAYPORT_BIGDATA=y

# Fingerprint sensor
CONFIG_SENSORS_FINGERPRINT=y
#CONFIG_SENSORS_ET5XX is not set
CONFIG_SENSORS_QBT2000=y
CONFIG_SENSORS_FP_SPI_NUMBER=0
CONFIG_SENSORS_FP_SPI_GPIO_START=0
CONFIG_SENSORS_FP_SPI_GPIO_END=3

# NFC ESE
CONFIG_SAMSUNG_NFC=y
CONFIG_NFC_PN547=y
CONFIG_NFC_PN547_ESE_SUPPORT=y
CONFIG_ESE_SECURE=y
CONFIG_ESE_SPI_GPIO_START=23
CONFIG_ESE_SPI_GPIO_END=26
CONFIG_ESE_SPI_NUMBER=3
CONFIG_SEC_NFC_LOGGER=y

# Audio
CONFIG_SND_SOC_CS35L41=y
CONFIG_MFD_CS35L41_I2C=y
CONFIG_SND_SOC_SAMSUNG_AUDIO=y
CONFIG_SND_SOC_SAMSUNG_MBHC_SUPPORT=y
CONFIG_SLIMBUS_DEBUG=y

# FM radio
CONFIG_MEDIA_RADIO_SUPPORT=y
CONFIG_I2C_RTC6213N=y
CONFIG_RADIO_RTC6213N=y

# Grip sensor
CONFIG_SENSORS_SX9330=y
CONFIG_SENSORS_A96T3X6=y

# Camera
CONFIG_LEDS_S2MPB02=y
CONFIG_SAMSUNG_OIS_MCU_STM32=y
CONFIG_SAMSUNG_APERTURE=y
CONFIG_CAMERA_SYSFS_V2=y
CONFIG_SAMSUNG_REAR_DUAL=y
CONFIG_SAMSUNG_FRONT_EEPROM=y
CONFIG_USE_CAMERA_HW_BIG_DATA=y
CONFIG_CAMERA_FRS_DRAM_TEST=y
CONFIG_SAMSUNG_APERTURE_HALLTEST=y
CONFIG_CAMERA_SSM_I2C_ENV=y
CONFIG_SAMSUNG_FORCE_DISABLE_REGULATOR=y

# Hall ic
CONFIG_SENSORS_HALL=y
CONFIG_CERTIFY_HALL=y

#sensor
CONFIG_SENSORS=y
CONFIG_SENSORS_SSC=y
CONFIG_ADSP_FACTORY=y
CONFIG_LSM6DSO_FACTORY=y
CONFIG_AK09918_FACTORY=y
CONFIG_LPS22HH_FACTORY=y
CONFIG_TMD490X_FACTORY=y
CONFIG_SUPPORT_MOBEAM=y
CONFIG_SUPPORT_PROX_AUTO_CAL=y
CONFIG_SUPPORT_HIDDEN_HOLE=y
CONFIG_SUPPORT_BHL_COMPENSATION_FOR_LIGHT_SENSOR=y

# ALS sensor
CONFIG_SENSORS_TCS3407=y
```

## arch/arm64/configs/sm8150_sec_beyond2qlte_jpn_dcm_defconfig
```kconfig
# sm8150_sec_beyond2qlte_jpn_dcm_defconfig

CONFIG_SEC_BEYOND2QLTE_PROJECT=y
CONFIG_MACH_BEYOND2QLTE_JPN_DCM=y

# display
CONFIG_PANEL_S6E3HA9_AMB644WF01_WQHD=y

# Sub PMIC
# CONFIG_REGULATOR_S2ABB01 is not set
# CONFIG_REGULATOR_S2DOS03 is not set
CONFIG_REGULATOR_S2DOS05=y
# CONFIG_REGULATOR_MAX77838 is not set
CONFIG_MFD_S2MPB02=y
CONFIG_REGULATOR_S2MPB02=y
CONFIG_REGULATOR_S2MPB03=y

# input device
CONFIG_TOUCHSCREEN_SEC_TS_Y771=y

# BATTERY
CONFIG_CALC_TIME_TO_FULL=y
CONFIG_BATTERY_AGE_FORECAST=y
CONFIG_AFC_CURR_CONTROL_BY_TEMP=y
CONFIG_LIMIT_CHARGING_DURING_CALL=y
CONFIG_FUELGAUGE_MAX77705=y
CONFIG_CHARGER_MAX77705=y
CONFIG_MAX77705_CHECK_B2SOVRC=y
CONFIG_WIRELESS_CHARGER_MFC=y
CONFIG_WIRELESS_FIRMWARE_UPDATE=y
CONFIG_WIRELESS_AUTH=y
CONFIG_BATTERY_CISD=y
CONFIG_OTG_OVERCURRENT_BY_CHGIN=y
CONFIG_STEP_CHARGING=y
CONFIG_WIRELESS_TX_MODE=y
CONFIG_ISDB_CHARGING_CONTROL=y
CONFIG_CS100_JPNCONCEPT=y
CONFIG_PREVENT_USB_CONN_OVERHEAT=y

# MUIC configs
CONFIG_MFD_CORE=y
CONFIG_USE_MUIC=y
CONFIG_USE_SAFEOUT=y
CONFIG_MUIC_NOTIFIER=y
CONFIG_AFC_CHARGER_MODE=y
CONFIG_MUIC_SUPPORT_RUSTPROOF=y
CONFIG_VBUS_NOTIFIER=y
CONFIG_VBUS_NOTIFIER_WORK=y
CONFIG_MUIC_MAX77705=y
CONFIG_MFD_MAX77705=y
CONFIG_MUIC_MAX77705_CCIC=y
CONFIG_HV_MUIC_MAX77705_AFC=y
CONFIG_MUIC_SUPPORT_CCIC=y
CONFIG_AFC_CHARGER_MODE=y
CONFIG_MUIC_HV=y
CONFIG_HICCUP_CHARGER=y

# ccic
CONFIG_CCIC_MAX77705=y
# CONFIG_CCIC_S2MM003 is not set
CONFIG_CCIC_S2MM005=y

# Motor
CONFIG_MOTOR_DRV_CS40L2X=y
CONFIG_SS_VIBRATOR=y
CONFIG_BOOST_POWER_SHARE=y
CONFIG_ANDROID_TIMED_OUTPUT=y
CONFIG_MOTOR_DRV_MAX77705=y

# BLUETOOTH
CONFIG_BT=y
CONFIG_BT_BCM4361=y
CONFIG_BT_BLUESLEEP=y
CONFIG_RFKILL=y

# Displayport
CONFIG_SEC_DISPLAYPORT=y
CONFIG_SEC_DISPLAYPORT_LOGGER=y
CONFIG_SEC_DISPLAYPORT_BIGDATA=y

# Fingerprint sensor
CONFIG_SENSORS_FINGERPRINT=y
#CONFIG_SENSORS_ET5XX is not set
CONFIG_SENSORS_QBT2000=y
CONFIG_SENSORS_FP_SPI_NUMBER=0
CONFIG_SENSORS_FP_SPI_GPIO_START=0
CONFIG_SENSORS_FP_SPI_GPIO_END=3

# NFC ESE
CONFIG_SAMSUNG_NFC=y
CONFIG_SEC_NFC=y
CONFIG_SEC_NFC_LOGGER=y

# ISDBT
CONFIG_ISDBT=y
CONFIG_ISDBT_FC8350_SPI=y

# Audio
CONFIG_SND_SOC_CS35L41=y
CONFIG_MFD_CS35L41_I2C=y
CONFIG_SND_SOC_SAMSUNG_AUDIO=y
CONFIG_SND_SOC_SAMSUNG_MBHC_SUPPORT=y
CONFIG_SLIMBUS_DEBUG=y

# Grip sensor
CONFIG_SENSORS_SX9330=y
CONFIG_SENSORS_A96T3X6=y

# Camera
CONFIG_LEDS_S2MPB02=y
CONFIG_SAMSUNG_OIS_MCU_STM32=y
CONFIG_SAMSUNG_APERTURE=y
CONFIG_CAMERA_SYSFS_V2=y
CONFIG_SAMSUNG_FRONT_DUAL=y
CONFIG_SAMSUNG_REAR_TRIPLE=y
CONFIG_SAMSUNG_FRONT_EEPROM=y
CONFIG_USE_CAMERA_HW_BIG_DATA=y
CONFIG_CAMERA_FRS_DRAM_TEST=y
CONFIG_SAMSUNG_APERTURE_HALLTEST=y
CONFIG_FLASH_CURRENT_JAPAN=y
CONFIG_CAMERA_SSM_I2C_ENV=y
CONFIG_SAMSUNG_FORCE_DISABLE_REGULATOR=y

# Hall ic
CONFIG_SENSORS_HALL=y
CONFIG_CERTIFY_HALL=y

#sensor
CONFIG_SENSORS=y
CONFIG_SENSORS_SSC=y
CONFIG_ADSP_FACTORY=y
CONFIG_LSM6DSO_FACTORY=y
CONFIG_AK09918_FACTORY=y
CONFIG_LPS22HH_FACTORY=y
CONFIG_TMD490X_FACTORY=y
CONFIG_SUPPORT_MOBEAM=y
CONFIG_SUPPORT_PROX_AUTO_CAL=y
CONFIG_SUPPORT_HIDDEN_HOLE=y
CONFIG_SUPPORT_BHL_COMPENSATION_FOR_LIGHT_SENSOR=y

#hrm sensor
CONFIG_SENSORS_MAX86915=y
CONFIG_SENSORS_SFH7832=y

# CPRM
CONFIG_MMC_CPRM=y
```

## arch/arm64/configs/sm8150_sec_bloomq_can_single_defconfig
```kconfig
# sm8150_sec_bloomq_can_single_defconfig

CONFIG_SEC_BLOOMQ_PROJECT=y
CONFIG_MACH_BLOOMQ_CAN_SINGLE=y

# display
CONFIG_PANEL_S6E3HA9_AMB611WE01_FHD=y
CONFIG_PANEL_S6E3HA9_AMF670UH01_FHD=y
CONFIG_PANEL_S6E36W3_AMB114EU09=y

# Sub PMIC
# CONFIG_REGULATOR_S2ABB01 is not set
# CONFIG_REGULATOR_S2DOS03 is not set
CONFIG_REGULATOR_S2DOS05=y
# CONFIG_REGULATOR_MAX77838 is not set
CONFIG_MFD_S2MPB02=y
CONFIG_REGULATOR_S2MPB02=y
CONFIG_REGULATOR_S2MPB03=y

# input device
CONFIG_TOUCHSCREEN_SEC_TS_Y771=y
CONFIG_TOUCHSCREEN_FTS9CU80F_B=y
CONFIG_TOUCHSCREEN_DUAL_FOLDABLE=y
CONFIG_TOUCHSCREEN_ZINITIX_ZTW522=y

# BATTERY
CONFIG_CALC_TIME_TO_FULL=y
CONFIG_BATTERY_AGE_FORECAST=y
CONFIG_AFC_CURR_CONTROL_BY_TEMP=y
CONFIG_LIMIT_CHARGING_DURING_CALL=y
CONFIG_ENABLE_100MA_CHARGING_BEFORE_USB_CONFIGURED=y
CONFIG_CHARGER_S2MU106=y
CONFIG_FUELGAUGE_S2MU106=y
CONFIG_PM_S2MU106=y
CONFIG_WIRELESS_CHARGER_MFC=y
CONFIG_WIRELESS_CHARGER_MFC_S2MIW04=y
CONFIG_WIRELESS_FIRMWARE_UPDATE=y
CONFIG_WIRELESS_AUTH=y
CONFIG_BATTERY_CISD=y
CONFIG_WIRELESS_TX_MODE=y
CONFIG_DUAL_BATTERY=y
CONFIG_SWITCHING_S2ASL01=y
CONFIG_MFD_S2MU106=y
CONFIG_FUELGAUGE_S2MU106_USE_5MILLIOHM=y
CONFIG_LSI_IFPMIC=y
CONFIG_WIRELESS_IC_PARAM=y
CONFIG_FUELGAUGE_MAX77705=y
CONFIG_CHARGER_MAX77705=y
CONFIG_STEP_CHARGING=y
CONFIG_TX_5V_DISABLE=y
CONFIG_WIRELESS_CHARGER_HAL_MFC=y
CONFIG_TX_GEAR_PHM_VOUT_CTRL=y

# MUIC configs
CONFIG_MFD_CORE=y
CONFIG_USE_MUIC=y
CONFIG_USE_SAFEOUT=y
CONFIG_MUIC_NOTIFIER=y
CONFIG_AFC_CHARGER_MODE=y
CONFIG_MUIC_SUPPORT_RUSTPROOF=y
CONFIG_VBUS_NOTIFIER=y
CONFIG_VBUS_NOTIFIER_WORK=y
CONFIG_MUIC_MAX77705=y
CONFIG_MFD_MAX77705=y
CONFIG_MUIC_MAX77705_CCIC=y
CONFIG_HV_MUIC_MAX77705_AFC=y
CONFIG_MUIC_SUPPORT_CCIC=y
CONFIG_AFC_CHARGER_MODE=y
CONFIG_MUIC_HV=y
CONFIG_HV_MUIC_VOLTAGE_CTRL=y
CONFIG_HICCUP_CHARGER=y
CONFIG_MUIC_SUPPORT_UART_SEL=y
CONFIG_MUIC_S2MU106=y
CONFIG_MUIC_S2MU106_RID=y
CONFIG_MUIC_SYSFS=y
CONFIG_MUIC_CORE=y
CONFIG_HV_MUIC_S2MU106_AFC=y
#CONFIG_S2MU106_TYPEC_WATER=y
CONFIG_MUIC_SUPPORT_PRSWAP=y
CONFIG_MUIC_SUPPORT_POWERMETER=y
#CONFIG_MUIC_SKIP_INCOMPLETE_INSERT=y
#CONFIG_USE_CCIC=y
CONFIG_MUIC_MANAGER=y

#SVCLED
# CONFIG_LEDS_MAX77705_RGB is not set

# ccic
CONFIG_CCIC_MAX77705=y
# CONFIG_CCIC_S2MM003 is not set
# CONFIG_CCIC_S2MM005 is not set
CONFIG_CCIC_S2MU106=y

CONFIG_USB_CONN_GADGET_NDOP=y

# redriver
# CONFIG_COMBO_REDRIVER is not set
# CONFIG_COMBO_REDRIVER_PTN36502 is not set
# CONFIG_COMBO_REDRIVER_PTN36502_WITHOUT_AUX is not set

# Motor
#All common apply
CONFIG_ANDROID_TIMED_OUTPUT=y
# for rev under 7
CONFIG_PWM_GPCLK=y
CONFIG_MOTOR_S2MU106=y
# for rev from 7
CONFIG_MOTOR_DRV_CS40L2X=y
CONFIG_MOTOR_DRV_CS40L2X_PMIC_RESET=y
CONFIG_CS40L2X_SAMSUNG_FEATURE=y
CONFIG_VIB_NOTIFIER=y
CONFIG_1030LRA_MOTOR=y

# BLUETOOTH
CONFIG_BT=y
CONFIG_MSM_BT_POWER=y
CONFIG_BTFM_SLIM=y
CONFIG_BTFM_SLIM_WCN3990=y
CONFIG_RFKILL=y

# Displayport
#CONFIG_SEC_DISPLAYPORT is not set
#CONFIG_SEC_DISPLAYPORT_LOGGER is not set
#CONFIG_SEC_DISPLAYPORT_BIGDATA is not set

# Fingerprint sensor
CONFIG_SENSORS_FINGERPRINT=y
CONFIG_SENSORS_ET5XX=y
CONFIG_SENSORS_FP_SPI_NUMBER=0
CONFIG_SENSORS_FP_SPI_GPIO_START=0
CONFIG_SENSORS_FP_SPI_GPIO_END=3

# NFC ESE
CONFIG_SAMSUNG_NFC=y
CONFIG_NFC_PN547=y
CONFIG_NFC_PN547_ESE_SUPPORT=y
CONFIG_ESE_SECURE=y
CONFIG_ESE_SPI_GPIO_START=23
CONFIG_ESE_SPI_GPIO_END=26
CONFIG_ESE_SPI_NUMBER=3
CONFIG_SEC_NFC_LOGGER=y

# Audio
CONFIG_SND_SOC_SAMSUNG_AUDIO=y
CONFIG_SND_SOC_SAMSUNG_USB_HEADSET_ONLY=y
CONFIG_SLIMBUS_DEBUG=y

# FM radio
#CONFIG_MEDIA_RADIO_SUPPORT is not set
#CONFIG_I2C_RTC6213N is not set
#CONFIG_RADIO_RTC6213N is not set

# Grip sensor
CONFIG_SENSORS_SX9360=y
CONFIG_SENSORS_SX9360_SUB=y
CONFIG_SENSORS_A96T3X6=y
CONFIG_SENSORS_FW_VENDOR=y
CONFIG_SENSORS_A96T3X6_CRC_CHECK=y
CONFIG_SENSORS_A96T365IF=y
CONFIG_SENSORS_GRIP_IC_VOLTAGE_SET_FOR_EACH=y

# Camera
CONFIG_LEDS_S2MPB02=y
CONFIG_SAMSUNG_OIS_RUMBA_S4=y
CONFIG_CAMERA_SYSFS_V2=y
CONFIG_SAMSUNG_REAR_DUAL=y
CONFIG_SAMSUNG_FRONT_EEPROM=y
# CONFIG_SAMSUNG_FRONT_TOF is not set
# CONFIG_SAMSUNG_REAR_TOF is not set
CONFIG_USE_CAMERA_HW_BIG_DATA=y
CONFIG_CAMERA_FRS_DRAM_TEST=y
CONFIG_CAMERA_SSM_I2C_ENV=y

# Hall ic
# CONFIG_SENSORS_HALL is not set
CONFIG_CERTIFY_HALL=y
CONFIG_FOLDER_HALL=y

#sensor
CONFIG_SENSORS=y
CONFIG_SENSORS_SSC=y
CONFIG_ADSP_FACTORY=y
CONFIG_LSM6DSO_FACTORY=y
CONFIG_AK09918_FACTORY=y
CONFIG_LPS22HH_FACTORY=y
CONFIG_TMD490X_FACTORY=y
CONFIG_SUPPORT_MOBEAM=y
CONFIG_SUPPORT_PROX_AUTO_CAL=y
CONFIG_SUPPORT_HIDDEN_HOLE=y
CONFIG_SUPPORT_BHL_COMPENSATION_FOR_LIGHT_SENSOR=y
CONFIG_SUPPORT_TMD4907_FACTORY=y
CONFIG_SUPPORT_DUAL_6AXIS=y
CONFIG_SUPPORT_AK0997X=y
CONFIG_SUPPORT_DEVICE_MODE=y
CONFIG_SUPPORT_SSC_AOD_RECT=y
CONFIG_SUPPORT_SLPI_NACK_FORCE_SSR=y

# ALS sensor
CONFIG_SENSORS_TCS3407=y

# Broadcom WiFi feature remove
# CONFIG_BROADCOM_WIFI is not set
# CONFIG_BCM4375 is not set
# CONFIG_BCMDHD_FW_PATH is not set
# CONFIG_BCMDHD_NVRAM_PATH is not set
# CONFIG_BROADCOM_WIFI_RESERVED_MEM is not set
# CONFIG_CFG80211_REG_NOT_UPDATED is not set
# CONFIG_WIFI_MULTICAST_LOG is not set
# CONFIG_BCMDHD_PCIE is not set
# CONFIG_BCMDHD_PREALLOC_MEMDUMP is not set
# CONFIG_BCMDHD_OOB_HOST_WAKE is not set
# CONFIG_BCM_DHD_WLAN is not set
# CONFIG_WLAN_VENDOR_DUMP_ENABLE is not set
# CONFIG_WLAN_TSQ_MULTIPLIER is not set

# QCA Wi-Fi feature
CONFIG_QCA_CLD_WLAN=y
CONFIG_QCACLD_WLAN_LFR2=y
CONFIG_QCACLD_WLAN_LFR3=y
CONFIG_QCOM_TDLS=y
CONFIG_QCACLD_FEATURE_METERING=y
CONFIG_QCOM_VOWIFI_11R=y
CONFIG_WLAN_FEATURE_11W=y
CONFIG_QCOM_LTE_COEX=y
CONFIG_WLAN_FEATURE_LPSS=y
CONFIG_QCACLD_FEATURE_NAN=y
CONFIG_WLAN_FEATURE_NAN_DATAPATH=y
CONFIG_MPC_UT_FRAMEWORK=y
CONFIG_WLAN_OFFLOAD_PACKETS=y
CONFIG_WLAN_SYNC_TSF=y
CONFIG_WLAN_FEATURE_MEMDUMP=y
CONFIG_WLAN_FEATURE_DISA=y
CONFIG_WLAN_FASTPATH=y
CONFIG_WLAN_NAPI=y
CONFIG_WLAN_TX_FLOW_CONTROL_V2=y
CONFIG_LFR_SUBNET_DETECTION=y
CONFIG_MCC_TO_SCC_SWITCH=y
CONFIG_WLAN_LRO=y
CONFIG_ICNSS=y
CONFIG_ICNSS_QMI=y
# CONFIG_ICNSS_DEBUG is not set
CONFIG_CNSS_UTILS=y
CONFIG_QCACLD_FEATURE_GREEN_AP=y
CONFIG_WCNSS_MEM_PRE_ALLOC=y
CONFIG_MCL=y

# Disable feature for header_version@2
# CONFIG_BUILD_ARM64_APPENDED_DTB_IMAGE is not set
```

## arch/arm64/configs/sm8150_sec_boltq5g_usa_vzw_defconfig
```kconfig
# sm8150_sec_boltq5g_usa_vzw_defconfig

CONFIG_SEC_BOLTQ5G_PROJECT=y
CONFIG_MACH_BOLTQ5G_USA_VZW=y
CONFIG_SEC_5GMODEL=y

# display
CONFIG_PANEL_S6E3HA8_AMB638RD01_WQHD=y
CONFIG_PANEL_S6E3HA8_AMB622NP01_WQHD=y

# Sub PMIC
# CONFIG_REGULATOR_S2ABB01 is not set
# CONFIG_REGULATOR_S2DOS03 is not set
CONFIG_REGULATOR_S2DOS05=y
# CONFIG_REGULATOR_MAX77838 is not set
CONFIG_MFD_S2MPB02=y
CONFIG_REGULATOR_S2MPB02=y
CONFIG_REGULATOR_S2MPB03=y

# input device
CONFIG_TOUCHSCREEN_SEC_TS_Y771=y

# BATTERY
CONFIG_CALC_TIME_TO_FULL=y
CONFIG_BATTERY_AGE_FORECAST=y
CONFIG_AFC_CURR_CONTROL_BY_TEMP=y
CONFIG_LIMIT_CHARGING_DURING_CALL=y
CONFIG_ENABLE_100MA_CHARGING_BEFORE_USB_CONFIGURED=y
CONFIG_FUELGAUGE_MAX77705=y
CONFIG_CHARGER_MAX77705=y
#CONFIG_WIRELESS_CHARGER_MFC is not set
#CONFIG_WIRELESS_FIRMWARE_UPDATE is not set
CONFIG_BATTERY_SAMSUNG_MHS=y
CONFIG_BATTERY_CISD=y
CONFIG_OTG_OVERCURRENT_BY_CHGIN=y

# MUIC configs
CONFIG_MFD_CORE=y
CONFIG_USE_MUIC=y
CONFIG_USE_SECOND_MUIC=y
CONFIG_USE_SAFEOUT=y
CONFIG_MUIC_NOTIFIER=y
CONFIG_AFC_CHARGER_MODE=y
CONFIG_MUIC_SUPPORT_RUSTPROOF=y
CONFIG_VBUS_NOTIFIER=y
CONFIG_VBUS_NOTIFIER_WORK=y
CONFIG_MUIC_MAX77705=y
CONFIG_MFD_MAX77705=y
CONFIG_MUIC_MAX77705_CCIC=y
CONFIG_HV_MUIC_MAX77705_AFC=y
CONFIG_MUIC_SUPPORT_CCIC=y
CONFIG_AFC_CHARGER_MODE=y
CONFIG_MUIC_HV=y
CONFIG_HICCUP_CHARGER=y
CONFIG_MUIC_SM5508=y
CONFIG_MUIC_SUPPORT_UART_SEL=y

# ccic
CONFIG_CCIC_MAX77705=y
# CONFIG_CCIC_S2MM003 is not set
CONFIG_CCIC_S2MM005=y

# redriver
CONFIG_COMBO_REDRIVER=y

# SVCLED
CONFIG_LEDS_SEP=y
CONFIG_LEDS_ET6312B=y

# BLUETOOTH
CONFIG_BT=y
CONFIG_BT_BCM4361=y
CONFIG_BT_BLUESLEEP=y
CONFIG_RFKILL=y


# Camera
CONFIG_SPECTRA_CAMERA=n

#sensor
#CONFIG_SENSORS_SSC is not set

# gpio expander
# CONFIG_GPIO_PCAL6524 is not set

# wlan
CONFIG_SEC_BOLT5G_PROJECT=y

# CONFIG_UH is not set
# CONFIG_UH_RKP is not set
# CONFIG_RKP_CFP_JOPP is not set
# CONFIG_RKP_CFP_ROPP is not set
# CONFIG_RKP_CFP_ROPP_SYSREGKEY is not set
```
