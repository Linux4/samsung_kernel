## arch/arm64/configs/sm7150_sec_a70sq_eur_open_defconfig
```kconfig
# sm7150_sec_a90q_eur_open_defconfig

CONFIG_SEC_A70SQ_PROJECT=y
CONFIG_SEC_A70SQ_EUR_PROJECT=y

# Display SUB PMIC
# CONFIG_REGULATOR_S2DOS03 is not set

# Display CAMERA PMIC
CONFIG_REGULATOR_S2MPB03=y

#CAMERA
#CONFIG_SAMSUNG_FRONT_TOF=y
#CONFIG_SAMSUNG_REAR_TOF=y
#CONFIG_SAMSUNG_FRONT_DUAL=y
CONFIG_SAMSUNG_MULTI_CAMERA=y
CONFIG_SAMSUNG_REAR_TRIPLE=y
CONFIG_CAMERA_SYSFS_V2=y
CONFIG_USE_CAMERA_HW_BIG_DATA=y

#DISPLAY
CONFIG_PANEL_ANA6705_AMS670TD01_FHD=y
CONFIG_PANEL_ANA6705_AMS667UK01_FHD=y

CONFIG_TOUCHSCREEN_IST40XX=y
CONFIG_INPUT_TOUCHSCREEN_TCLMV2=y
#CONFIG_INPUT_SEC_SECURE_TOUCH is not set
CONFIG_TOUCHSCREEN_MELFAS_MSS100=y

#Audio
CONFIG_SND_SOC_SAMSUNG_AUDIO=y
CONFIG_SND_SOC_SAMSUNG_MBHC_SUPPORT=y

#MFD
CONFIG_MFD_S2MU107=y

# MUIC
CONFIG_USE_MUIC=y
CONFIG_MUIC_S2MU107=y
CONFIG_MUIC_NOTIFIER=y
CONFIG_MUIC_S2MU107_RID=y
CONFIG_MUIC_SYSFS=y
CONFIG_MUIC_CORE=y
CONFIG_MUIC_MANAGER=y
CONFIG_MUIC_HV=y
CONFIG_HV_MUIC_S2MU107_AFC=y
CONFIG_MUIC_SUPPORT_PRSWAP=y
CONFIG_MUIC_SUPPORT_POWERMETER=y
CONFIG_MUIC_SKIP_INCOMPLETE_INSERT=y
CONFIG_HV_MUIC_VOLTAGE_CTRL=y

# CCIC
CONFIG_USE_CCIC=y
CONFIG_CCIC_S2MU107=y
CONFIG_CCIC_NOTIFIER=y
CONFIG_CCIC_VDM=y
CONFIG_USB_TYPEC_MANAGER_NOTIFIER=y
CONFIG_MUIC_SUPPORT_CCIC=y
CONFIG_CCIC_MANUAL_QBAT=y
CONFIG_PDIC_PD30=y

# USB Notifier
CONFIG_USB_STORAGE_DETECT=y
CONFIG_USB_HOST_NOTIFY=y
CONFIG_USB_NOTIFY_LAYER=y
CONFIG_USB_NOTIFIER=y
CONFIG_USB_EXTERNAL_NOTIFY=y
CONFIG_USB_NOTIFY_PROC_LOG=y
CONFIG_USB_HW_PARAM=y
CONFIG_TYPEC=y
CONFIG_SEC_EXT=y
CONFIG_VBUS_NOTIFIER=y
# CONFIG_USB_PD_POLICY is not set
# CONFIG_QPNP_USB_PDPHY is not set
# CONFIG_SEC_SVDM is not set

# BATTERY
CONFIG_STEP_CHARGING=y
CONFIG_BATTERY_SAMSUNG=y
CONFIG_BATTERY_SAMSUNG_V2=y
CONFIG_DIRECT_CHARGING=y
CONFIG_BATTERY_NOTIFIER=y
CONFIG_PM_S2MU107=y
CONFIG_CHARGER_S2MU107=y
CONFIG_CHARGER_S2MU107_DIRECT=y
CONFIG_FUELGAUGE_S2MU107=y
CONFIG_FUELGAUGE_S2MU107_BATCAP_LRN=y
CONFIG_FUELGAUGE_S2MU107_TEMP_COMPEN=y
CONFIG_BATTERY_SWELLING=y
CONFIG_BATTERY_CISD=y
CONFIG_AFC_CHARGER_MODE=y

#MOTOR
CONFIG_SS_VIBRATOR=y
CONFIG_LEDS_QPNP_VIBRATOR_LDO=y

# NFC & eSE
CONFIG_NFC_PN547=y
CONFIG_NFC_PN547_ESE_SUPPORT=y
CONFIG_SEC_NFC_LOGGER=y
CONFIG_ESE_SECURE=y
CONFIG_ESE_SPI_NUMBER=2
CONFIG_ESE_SPI_GPIO_START=0
CONFIG_ESE_SPI_GPIO_END=3

# SENSOR
CONFIG_SENSORS=y
CONFIG_SENSORS_SSC=y
CONFIG_ADSP_FACTORY=y
CONFIG_ICM42605_FACTORY=y
CONFIG_TCS3701_FACTORY=y
#CONFIG_STK3331_FACTORY=y
#CONFIG_VCNL36811_FACTORY=y
CONFIG_STK3031_VCNL36811_DUALIZATION_FACTORY=y
CONFIG_AK09918_FACTORY=y
CONFIG_SUPPORT_BHL_COMPENSATION_FOR_LIGHT_SENSOR=y
CONFIG_SUPPORT_SSC_MODE=y
CONFIG_SUPPORT_SSC_MODE_FOR_MAG=y
CONFIG_SUPPORT_PROX_DUALIZATION=y

# Grip Sensor
CONFIG_SENSORS_A96T3X6=y
CONFIG_SENSORS_A96T3X6_SUB=y

# Fingerprint sensor
CONFIG_SENSORS_FINGERPRINT=y
CONFIG_SENSORS_ET7XX=y
CONFIG_SENSORS_FP_SPI_NUMBER=5
CONFIG_SENSORS_FP_SPI_GPIO_START=59
CONFIG_SENSORS_FP_SPI_GPIO_END=62

# QCA Wi-Fi feature
CONFIG_QCA_CLD_WLAN=y
CONFIG_QCACLD_WLAN_LFR2=y
CONFIG_QCACLD_WLAN_LFR3=y
CONFIG_QCOM_TDLS=y
CONFIG_QCACLD_FEATURE_METERING=y
CONFIG_QCOM_VOWIFI_11R=y
CONFIG_WLAN_FEATURE_11W=y
CONFIG_QCOM_LTE_COEX=y
CONFIG_WLAN_FEATURE_LPSS=y
CONFIG_QCACLD_FEATURE_NAN=y
CONFIG_WLAN_FEATURE_NAN_DATAPATH=y
CONFIG_MPC_UT_FRAMEWORK=y
CONFIG_WLAN_OFFLOAD_PACKETS=y
CONFIG_WLAN_SYNC_TSF=y
CONFIG_WLAN_FEATURE_MEMDUMP=y
CONFIG_WLAN_FEATURE_DISA=y
CONFIG_WLAN_FASTPATH=y
CONFIG_WLAN_NAPI=y
CONFIG_WLAN_TX_FLOW_CONTROL_V2=y
CONFIG_LFR_SUBNET_DETECTION=y
CONFIG_MCC_TO_SCC_SWITCH=y
CONFIG_WLAN_LRO=y
CONFIG_ICNSS=y
CONFIG_CNSS_UTILS=y
CONFIG_QCACLD_FEATURE_GREEN_AP=y
CONFIG_WCNSS_MEM_PRE_ALLOC=y
CONFIG_MCL=y

# Hall ic
CONFIG_SENSORS_HALL=y
CONFIG_CERTIFY_HALL=y

#MST
CONFIG_MST_LDO=y
CONFIG_MST_SUPPORT_GPIO=y
CONFIG_MST_LPM_DISABLE=y

#Basic crypto flag for IPSecInterface
CONFIG_CRYPTO=y
CONFIG_CRYPTO_SHA1=y
CONFIG_CRYPTO_SHA256=y
CONFIG_CRYPTO_AES=y
CONFIG_CRYPTO_CBC=y
CONFIG_CRYPTO_ECHAINIV=y
CONFIG_CRYPTO_TWOFISH=y

#EPDG
CONFIG_NET_CORE=y
CONFIG_NET_SCH_PRIO=y
#CONFIG_NET_SCHED=y   #depends on CONFIG_NET  which is enabled by default.. coz not seeing in the config file
CONFIG_NET_CLS_BASIC=y # required if basic is being used as a filter. depends on CONFIG_NET_CLS so enabling it by default
CONFIG_NET_CLS=y
#CONFIG_NET_CLS_ACT=y # for enabling the action target.
#CONFIG_NET_ACT_MIRRED=y  # for enabling the mirred target for redirecting the packet between the devices.
#CONFIG_NET_EMATCH=y   #basic uses extended matches so this has to be present
#CONFIG_NET_SCH_INGRESS=y # classifier for ingress packet

#Freecess
CONFIG_SAMSUNG_FREECESS=y
```

## arch/arm64/configs/sm7150_sec_a90q_eur_ldu_defconfig
```kconfig
# sm7150_sec_a90q_eur_open_defconfig

CONFIG_SEC_A90Q_PROJECT=y
CONFIG_SEC_A90Q_EUR_LDU_PROJECT=y

# Display SUB PMIC
# CONFIG_REGULATOR_S2DOS03 is not set

# Display CAMERA PMIC
CONFIG_REGULATOR_S2MPB03=y

#CAMERA
CONFIG_SAMSUNG_FRONT_TOF=y
CONFIG_SAMSUNG_REAR_TOF=y
CONFIG_SAMSUNG_FRONT_DUAL=y
CONFIG_SAMSUNG_MULTI_CAMERA=y
CONFIG_SAMSUNG_REAR_TRIPLE=y
CONFIG_CAMERA_SYSFS_V2=y
CONFIG_USE_CAMERA_HW_BIG_DATA=y

#DISPLAY
CONFIG_PANEL_S6E3FA7_AMS604NL07_FHD=y
CONFIG_PANEL_S6E3FC2_AMS670TA01_FHD=y
#CONFIG_SUPPORT_POC_FLASH=n

CONFIG_TOUCHSCREEN_IST40XX=y
CONFIG_INPUT_TOUCHSCREEN_TCLMV2=y
CONFIG_INPUT_SEC_SECURE_TOUCH=y

#Audio
CONFIG_SND_SOC_TFA98XX=y
CONFIG_SND_SOC_TFA9894=y
CONFIG_GPIO_TACNA=y
CONFIG_MFD_CS48L32=y
CONFIG_MFD_CS48L33=y
CONFIG_SND_SOC_WM_ADSP=y
CONFIG_SND_SOC_CS48L32=y
CONFIG_MFD_TACNA_SPI=y
CONFIG_REGULATOR_ARIZONA_MICSUPP=y

#Camera
CONFIG_SAMSUNG_MULTI_CAMERA=y

# BATTERY
CONFIG_QPNP_QG=y
CONFIG_QPNP_SMB5=y
CONFIG_SMB1390_CHARGE_PUMP_PSY=y
CONFIG_BATTERY_SAMSUNG=y
CONFIG_BATTERY_SAMSUNG_USING_QC=y
CONFIG_BATTERY_CISD=y
CONFIG_DIRECT_CHARGING=y
CONFIG_STORE_MODE=y

# CONFIG_PM6150_SBU_VBUS_SHORT is not set
CONFIG_PM6150_CC_VBUS_SHORT=y
CONFIG_PM6150_WATER_DETECT=y

# USB Notifier
CONFIG_USB_STORAGE_DETECT=y
CONFIG_USB_HOST_NOTIFY=y
CONFIG_USB_NOTIFY_LAYER=y
CONFIG_USB_NOTIFIER=y
CONFIG_USB_EXTERNAL_NOTIFY=y
CONFIG_USB_NOTIFY_PROC_LOG=y
CONFIG_USB_HW_PARAM=y
CONFIG_USB_CCIC_NOTIFIER_USING_QC=y
CONFIG_USB_TYPEC_MANAGER_NOTIFIER=y
CONFIG_USE_CCIC=y
CONFIG_CCIC_NOTIFIER=y
CONFIG_CCIC_PM6150=y
CONFIG_PM6150_FACTORY_MODE=y
CONFIG_TYPEC=y
CONFIG_SEC_EXT=y
CONFIG_VBUS_NOTIFIER=y

# RID
CONFIG_RID_ADC=y
CONFIG_PM6150L_RID_ADC=y
CONFIG_PM6150_USB_FALSE_DETECTION_WA_BY_GND=y

#AFC
CONFIG_AFC=y
CONFIG_PM6150_AFC=y

#GPIO_EXPANDER
CONFIG_GPIO_PCAL6524=y

#MOTOR
CONFIG_STEP_MOTOR_STSPIN220=y

# NFC & eSE
CONFIG_NFC_PN547=y
CONFIG_NFC_PN547_ESE_SUPPORT=y
CONFIG_SEC_NFC_LOGGER=y
CONFIG_ESE_SECURE=y
CONFIG_ESE_SPI_NUMBER=2
CONFIG_ESE_SPI_GPIO_START=0
CONFIG_ESE_SPI_GPIO_END=3

# SENSOR
CONFIG_SENSORS=y
CONFIG_SENSORS_SSC=y
CONFIG_ADSP_FACTORY=y
CONFIG_LSM6DSM_FACTORY=y
CONFIG_TCS3701_FACTORY=y
CONFIG_STK3331_FACTORY=y
CONFIG_AK09918_FACTORY=y
CONFIG_SUPPORT_BHL_COMPENSATION_FOR_LIGHT_SENSOR=y
CONFIG_SUPPORT_SSC_MODE=y
CONFIG_SUPPORT_SSC_MODE_FOR_MAG=y

# Grip SENSOR_CALL_GESTURE_SUPPORT
CONFIG_SENSORS_SX9360=y
CONFIG_SUPPORT_CAMERA_FREEFALL=y

# Fingerprint sensor
#CONFIG_SENSORS_FINGERPRINT is not set
#CONFIG_SENSORS_ET7XX is not set
#CONFIG_SENSORS_FP_SPI_NUMBER is not set
#CONFIG_SENSORS_FP_SPI_GPIO_START is not set
#CONFIG_SENSORS_FP_SPI_GPIO_END is not set

# QCA Wi-Fi feature
CONFIG_QCA_CLD_WLAN=y
CONFIG_QCACLD_WLAN_LFR2=y
CONFIG_QCACLD_WLAN_LFR3=y
CONFIG_QCOM_TDLS=y
CONFIG_QCACLD_FEATURE_METERING=y
CONFIG_QCOM_VOWIFI_11R=y
CONFIG_WLAN_FEATURE_11W=y
CONFIG_QCOM_LTE_COEX=y
CONFIG_WLAN_FEATURE_LPSS=y
CONFIG_QCACLD_FEATURE_NAN=y
CONFIG_WLAN_FEATURE_NAN_DATAPATH=y
CONFIG_MPC_UT_FRAMEWORK=y
CONFIG_WLAN_OFFLOAD_PACKETS=y
CONFIG_WLAN_SYNC_TSF=y
CONFIG_WLAN_FEATURE_MEMDUMP=y
CONFIG_WLAN_FEATURE_DISA=y
CONFIG_WLAN_FASTPATH=y
CONFIG_WLAN_NAPI=y
CONFIG_WLAN_TX_FLOW_CONTROL_V2=y
CONFIG_LFR_SUBNET_DETECTION=y
CONFIG_MCC_TO_SCC_SWITCH=y
CONFIG_WLAN_LRO=y
CONFIG_ICNSS=y
CONFIG_CNSS_UTILS=y
CONFIG_QCACLD_FEATURE_GREEN_AP=y
CONFIG_WCNSS_MEM_PRE_ALLOC=y
CONFIG_MCL=y

# Hall ic
#CONFIG_FOLDER_HALL=y
CONFIG_CERTIFY_HALL=y
CONFIG_SLIDING_UP_HALL=y
CONFIG_SLIDING_DOWN_HALL=y
CONFIG_DW772X=y
CONFIG_DW772X_REVERSE=y

#MST
CONFIG_MST_LDO=y
CONFIG_MST_REGULATOR=y
CONFIG_MST_SUPPORT_GPIO=y
CONFIG_MST_LPM_DISABLE=y
```

## arch/arm64/configs/sm7150_sec_m51_eur_open_defconfig
```kconfig
# sm7150_sec_m51_eur_open_defconfig (Copied from base model A71 EUR OPEN)

CONFIG_SEC_M51_PROJECT=y
CONFIG_SEC_M51_EUR_PROJECT=y

# Display SUB PMIC
# CONFIG_REGULATOR_S2DOS03 is not set

# Display CAMERA PMIC
CONFIG_REGULATOR_S2MPB03=y

#CAMERA
#CONFIG_SAMSUNG_FRONT_TOF=y
#CONFIG_SAMSUNG_REAR_TOF=y
#CONFIG_SAMSUNG_FRONT_DUAL=y
CONFIG_SAMSUNG_MULTI_CAMERA=y
CONFIG_SAMSUNG_REAR_TRIPLE=y
CONFIG_CAMERA_SYSFS_V2=y
CONFIG_USE_CAMERA_HW_BIG_DATA=y
CONFIG_SAMSUNG_REAR_QUAD=y
#CONFIG_LEDS_S2MU107_FLASH=y
CONFIG_LEDS_S2MU106_FLASH=y
CONFIG_MCLK_I2C_DELAY=y
CONFIG_SAMSUNG_CAMERA_OTP=y
CONFIG_GC5035_SENSOR=y
CONFIG_GC5035_MACRO_OTP_DD_AUTOLOAD=y

#DISPLAY
CONFIG_PANEL_SW83106_FHD=y
CONFIG_PANEL_SW83106_WM6676Z21_FHD=y
CONFIG_PANEL_S6E3FA9_AMB667UM07_FHD=y

#TSP
CONFIG_INPUT_TOUCHSCREEN_TCLMV2=y
CONFIG_INPUT_SEC_SECURE_TOUCH=y
CONFIG_TOUCHSCREEN_SEC_TS_Y771=y
CONFIG_INPUT_TOUCHSCREEN_SEC_CMD=y

#Audio
CONFIG_SND_SOC_SAMSUNG_AUDIO=y
CONFIG_SND_SOC_SAMSUNG_MBHC_SUPPORT=y
CONFIG_SND_SOC_SAMSUNG_JACK=y

#MFD
CONFIG_MFD_S2MU106=y

# MUIC
CONFIG_USE_MUIC=y
CONFIG_MUIC_S2MU106=y
CONFIG_MUIC_NOTIFIER=y
CONFIG_MUIC_S2MU106_RID=y
CONFIG_MUIC_SYSFS=y
CONFIG_MUIC_CORE=y
CONFIG_MUIC_MANAGER=y
CONFIG_MUIC_HV=y
CONFIG_HV_MUIC_S2MU106_AFC=y
CONFIG_MUIC_SUPPORT_PRSWAP=y
CONFIG_MUIC_SKIP_INCOMPLETE_INSERT=y
CONFIG_HV_MUIC_VOLTAGE_CTRL=y
CONFIG_MUIC_SUPPORT_POWERMETER=y


# CCIC
CONFIG_USE_CCIC=y
CONFIG_CCIC_S2MU106=y
CONFIG_CCIC_NOTIFIER=y
CONFIG_CCIC_VDM=y
CONFIG_USB_TYPEC_MANAGER_NOTIFIER=y
CONFIG_MUIC_SUPPORT_CCIC=y
CONFIG_CCIC_MANUAL_QBAT=y
CONFIG_PDIC_PD30=y
# CONFIG_CCIC_AUTO_PPS is not set
CONFIG_CCIC_9V_OTG_SUPPORT=y

# USB Notifier
CONFIG_USB_STORAGE_DETECT=y
CONFIG_USB_HOST_NOTIFY=y
CONFIG_USB_NOTIFY_LAYER=y
CONFIG_USB_NOTIFIER=y
CONFIG_USB_EXTERNAL_NOTIFY=y
CONFIG_USB_NOTIFY_PROC_LOG=y
CONFIG_USB_HW_PARAM=y
CONFIG_TYPEC=y
CONFIG_SEC_EXT=y
CONFIG_VBUS_NOTIFIER=y
# CONFIG_USB_PD_POLICY is not set
# CONFIG_QPNP_USB_PDPHY is not set
# CONFIG_SEC_SVDM is not set

# BATTERY
CONFIG_STEP_CHARGING=y
CONFIG_BATTERY_SAMSUNG=y
CONFIG_BATTERY_SAMSUNG_V2=y
CONFIG_DIRECT_CHARGING=y
CONFIG_BATTERY_NOTIFIER=y
CONFIG_NEW_STEP_CHARGING_CONCEPT=y
CONFIG_CALC_TIME_TO_FULL=y
CONFIG_SUPPORT_9V_D2D_CHARGING=y

#S2MU106 Charger/FG
CONFIG_PM_S2MU106=y
CONFIG_CHARGER_S2MU106=y
CONFIG_CHARGER_PCA9468=y
CONFIG_FUELGAUGE_S2MU106=y
CONFIG_FUELGAUGE_S2MU106_USE_5MILLIOHM=y
CONFIG_BATTERY_SWELLING=y
CONFIG_BATTERY_CISD=y
CONFIG_AFC_CHARGER_MODE=y
CONFIG_BATTERY_AGE_FORECAST=y
CONFIG_ENABLE_100MA_CHARGING_BEFORE_USB_CONFIGURED=y

#MOTOR
CONFIG_SS_VIBRATOR=y
CONFIG_LEDS_QPNP_VIBRATOR_LDO=y

# NFC & eSE
CONFIG_SEC_NFC=y
CONFIG_SEC_NFC_LOGGER=y

# SENSOR
CONFIG_SENSORS=y
CONFIG_SENSORS_SSC=y
CONFIG_ADSP_FACTORY=y
CONFIG_LSM6DSM_FACTORY=y
CONFIG_STK33617_FACTORY=y
CONFIG_MMC5603X_FACTORY=y
CONFIG_SUPPORT_BHL_COMPENSATION_FOR_LIGHT_SENSOR=y
CONFIG_SUPPORT_SSC_MODE=y
CONFIG_SUPPORT_SSC_MODE_FOR_MAG=y
CONFIG_SUPPORT_LIGHT_READ_UBID=y
CONFIG_SLPI_MOTOR=y

# Grip Sensor
CONFIG_SENSORS_A96T3X6=y
CONFIG_SENSORS_A96T3X6_SUB=y
CONFIG_SENSORS_A96T3X6_CRC_CHECK=y

# Fingerprint sensor
CONFIG_SENSORS_FINGERPRINT=y
CONFIG_SENSORS_ET5XX=y
CONFIG_SENSORS_FP_SPI_NUMBER=5
CONFIG_SENSORS_FP_SPI_GPIO_START=59
CONFIG_SENSORS_FP_SPI_GPIO_END=62

# QCA Wi-Fi feature
CONFIG_QCA_CLD_WLAN=y
CONFIG_QCACLD_WLAN_LFR2=y
CONFIG_QCACLD_WLAN_LFR3=y
CONFIG_QCOM_TDLS=y
CONFIG_QCACLD_FEATURE_METERING=y
CONFIG_QCOM_VOWIFI_11R=y
CONFIG_WLAN_FEATURE_11W=y
CONFIG_QCOM_LTE_COEX=y
CONFIG_WLAN_FEATURE_LPSS=y
CONFIG_QCACLD_FEATURE_NAN=y
CONFIG_WLAN_FEATURE_NAN_DATAPATH=y
CONFIG_MPC_UT_FRAMEWORK=y
CONFIG_WLAN_OFFLOAD_PACKETS=y
CONFIG_WLAN_SYNC_TSF=y
CONFIG_WLAN_FEATURE_MEMDUMP=y
CONFIG_WLAN_FEATURE_DISA=y
CONFIG_WLAN_FASTPATH=y
CONFIG_WLAN_NAPI=y
CONFIG_WLAN_TX_FLOW_CONTROL_V2=y
CONFIG_LFR_SUBNET_DETECTION=y
CONFIG_MCC_TO_SCC_SWITCH=y
CONFIG_WLAN_LRO=y
CONFIG_ICNSS=y
CONFIG_CNSS_UTILS=y
CONFIG_QCACLD_FEATURE_GREEN_AP=y
CONFIG_WCNSS_MEM_PRE_ALLOC=y
CONFIG_MCL=y

#Basic crypto flag for IPSecInterface
CONFIG_CRYPTO=y
CONFIG_CRYPTO_SHA1=y
CONFIG_CRYPTO_SHA256=y
CONFIG_CRYPTO_AES=y
CONFIG_CRYPTO_CBC=y
CONFIG_CRYPTO_ECHAINIV=y
CONFIG_CRYPTO_TWOFISH=y

#EPDG
CONFIG_NET_CORE=y
CONFIG_NET_SCH_PRIO=y
#CONFIG_NET_SCHED=y   #depends on CONFIG_NET  which is enabled by default.. coz not seeing in the config file
CONFIG_NET_CLS_BASIC=y # required if basic is being used as a filter. depends on CONFIG_NET_CLS so enabling it by default
CONFIG_NET_CLS=y
#CONFIG_NET_CLS_ACT=y # for enabling the action target.
#CONFIG_NET_ACT_MIRRED=y  # for enabling the mirred target for redirecting the packet between the devices.
#CONFIG_NET_EMATCH=y   #basic uses extended matches so this has to be present
#CONFIG_NET_SCH_INGRESS=y # classifier for ingress packet

#Freecess
CONFIG_SAMSUNG_FREECESS=y

#Actuator
CONFIG_SAMSUNG_HW_SOFTLANDING=y
CONFIG_SAMSUNG_ACTUATOR_DW9817=y

CONFIG_RBIN=y

CONFIG_UH=n
CONFIG_UH_RKP=n
CONFIG_UH_LKMAUTH=n
CONFIG_UH_LKM_BLOCK=n
```

## arch/arm64/configs/sm7150_sec_userdebug_defconfig
```kconfig
# TODO: sm7150_sec_userdebug_defconfig

# CONFIG_PROCA is not set
# CONFIG_RKP_KDP is not set
```
