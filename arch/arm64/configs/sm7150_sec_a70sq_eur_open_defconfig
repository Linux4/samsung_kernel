## arch/arm64/configs/sm8150_sec_r5q_eur_ldu_defconfig
```kconfig
# sm8150_sec_r5q_eur_ldu_defconfig

CONFIG_SEC_R5Q_PROJECT=y
CONFIG_MACH_R5Q_EUR_LDU=y

# DISPLAY
CONFIG_PANEL_S6E3FA9_AMB667UM01_FHD=y

# Sub PMIC
# CONFIG_REGULATOR_S2ABB01 is not set
# CONFIG_REGULATOR_S2DOS03 is not set
CONFIG_REGULATOR_S2DOS05=y
# CONFIG_REGULATOR_MAX77838 is not set
CONFIG_MFD_S2MPB02=y
CONFIG_REGULATOR_S2MPB02=y
CONFIG_REGULATOR_S2MPB03=y

# input device
CONFIG_TOUCHSCREEN_SEC_TS_Y771_R5=y

# BATTERY
CONFIG_CALC_TIME_TO_FULL=y
CONFIG_BATTERY_AGE_FORECAST=y
CONFIG_AFC_CURR_CONTROL_BY_TEMP=y
CONFIG_LIMIT_CHARGING_DURING_CALL=y
CONFIG_ENABLE_100MA_CHARGING_BEFORE_USB_CONFIGURED=y
CONFIG_BATTERY_CISD=y
CONFIG_OTG_OVERCURRENT_BY_CHGIN=y
CONFIG_STEP_CHARGING=y
CONFIG_CHARGER_S2MU106=y
CONFIG_FUELGAUGE_S2MU106=y
CONFIG_FUELGAUGE_S2MU106_USE_5MILLIOHM=y
CONFIG_PM_S2MU106=y
CONFIG_LSI_IFPMIC=y
CONFIG_DIRECT_CHARGING=y
CONFIG_CHARGER_PCA9468=y
CONFIG_PDIC_PD30=y
CONFIG_PM_S2MU107=y
CONFIG_CHARGER_S2MU107=y
CONFIG_CHARGER_S2MU107_DIRECT=y
CONFIG_FUELGAUGE_S2MU107=y
CONFIG_FUELGAUGE_S2MU107_BATCAP_LRN=y
CONFIG_FUELGAUGE_S2MU107_TEMP_COMPEN=y
CONFIG_STORE_MODE=y

#MFD
CONFIG_MFD_S2MU106=y
CONFIG_MFD_S2MU107=y

# MUIC configs
CONFIG_MFD_CORE=y
CONFIG_USE_MUIC=y
CONFIG_USE_SAFEOUT=y
CONFIG_MUIC_NOTIFIER=y
CONFIG_AFC_CHARGER_MODE=y
CONFIG_MUIC_SUPPORT_RUSTPROOF=y
CONFIG_VBUS_NOTIFIER=y
CONFIG_VBUS_NOTIFIER_WORK=y
#CONFIG_MUIC_MAX77705=y
#CONFIG_MFD_MAX77705=y
#CONFIG_MUIC_MAX77705_CCIC=y
#CONFIG_HV_MUIC_MAX77705_AFC=y
CONFIG_MUIC_SUPPORT_CCIC=y
CONFIG_AFC_CHARGER_MODE=y
CONFIG_MUIC_HV=y
CONFIG_HV_MUIC_VOLTAGE_CTRL=y
CONFIG_HICCUP_CHARGER=y
CONFIG_MUIC_S2MU106=y
CONFIG_MUIC_S2MU106_RID=y
CONFIG_MUIC_S2MU107=y
CONFIG_MUIC_S2MU107_RID=y
CONFIG_MUIC_SYSFS=y
CONFIG_MUIC_CORE=y
CONFIG_HV_MUIC_S2MU106_AFC=y
CONFIG_HV_MUIC_S2MU107_AFC=y
#CONFIG_S2MU107_TYPEC_WATER is not set
CONFIG_MUIC_SUPPORT_PRSWAP=y
CONFIG_MUIC_SUPPORT_POWERMETER=y
#CONFIG_MUIC_SKIP_INCOMPLETE_INSERT=y
#CONFIG_USE_CCIC=y
CONFIG_MUIC_MANAGER=y

# ccic
#CONFIG_CCIC_MAX77705=y
# CONFIG_CCIC_S2MM003 is not set
# CONFIG_CCIC_S2MM005 is not set
CONFIG_CCIC_S2MU106=y
CONFIG_CCIC_S2MU107=y

CONFIG_USB_CONN_GADGET_NDOP=y

# Motor
CONFIG_SS_VIBRATOR=y
CONFIG_BOOST_POWER_SHARE=y
CONFIG_MOTOR_DRV_ISA1000A=y

CONFIG_PWM_GPCLK=y
CONFIG_ANDROID_TIMED_OUTPUT=y
CONFIG_MOTOR_S2MU106=y

# BLUETOOTH
CONFIG_BT=y
CONFIG_MSM_BT_POWER=y
CONFIG_BTFM_SLIM=y
CONFIG_BTFM_SLIM_WCN3990=y
CONFIG_RFKILL=y

# Fingerprint sensor
CONFIG_SENSORS_FINGERPRINT=y
CONFIG_SENSORS_ET7XX=y
CONFIG_SENSORS_FP_SPI_NUMBER=0
CONFIG_SENSORS_FP_SPI_GPIO_START=0
CONFIG_SENSORS_FP_SPI_GPIO_END=3

# NFC ESE
CONFIG_SAMSUNG_NFC=y
CONFIG_NFC_PN547=y
CONFIG_NFC_PN547_ESE_SUPPORT=y
CONFIG_ESE_SECURE=y
CONFIG_ESE_SPI_GPIO_START=23
CONFIG_ESE_SPI_GPIO_END=26
CONFIG_ESE_SPI_NUMBER=3
CONFIG_SEC_NFC_LOGGER=y

# Audio
CONFIG_SLIMBUS_DEBUG=y
CONFIG_SND_SOC_SAMSUNG_AUDIO=y
CONFIG_SND_SOC_SAMSUNG_USB_HEADSET_ONLY=y

# Grip sensor
CONFIG_SENSORS_SX9360=y

# Camera
#CONFIG_LEDS_S2MPB02=y
CONFIG_LEDS_PMIC_QPNP=y
CONFIG_CAMERA_SYSFS_V2=y
CONFIG_SAMSUNG_REAR_TRIPLE=y
#CONFIG_SAMSUNG_FRONT_EEPROM=y
CONFIG_USE_CAMERA_HW_BIG_DATA=y
#CONFIG_CAMERA_FRS_DRAM_TEST=y
#CONFIG_SAMSUNG_APERTURE_HALLTEST=y
#CONFIG_CAMERA_SSM_I2C_ENV=y
CONFIG_SAMSUNG_REAR_BOKEH=y
CONFIG_SAMSUNG_OIS_RUMBA_S4=y

# Hall ic
CONFIG_SENSORS_HALL=y
CONFIG_CERTIFY_HALL=y

#sensor
CONFIG_SENSORS=y
CONFIG_SENSORS_SSC=y
CONFIG_ADSP_FACTORY=y
CONFIG_LSM6DSL_FACTORY=y
CONFIG_AK09918_FACTORY=y
CONFIG_TMD490X_FACTORY=y
CONFIG_SUPPORT_TMD4907_FACTORY=y
CONFIG_SUPPORT_PROX_AUTO_CAL=y
CONFIG_SUPPORT_BHL_COMPENSATION_FOR_LIGHT_SENSOR=y
CONFIG_SUPPORT_BRIGHT_SYSFS_COMPENSATION_LUX=y
CONFIG_SUPPORT_MOBEAM=y
CONFIG_SUPPORT_HIDDEN_HOLE=y
CONFIG_SUPPORT_SSC_SPU=y
CONFIG_SUPPORT_SSC_MODE=y
CONFIG_SUPPORT_SSC_MODE_FOR_MAG=y

# MST
CONFIG_MST_REGULATOR=y
CONFIG_MST_SUPPORT_GPIO=y

# Broadcom WiFi feature remove
# CONFIG_BROADCOM_WIFI is not set
# CONFIG_BCM4375 is not set
# CONFIG_WLAN_BCM4375_ENHANCED_FEATURES is not set
# CONFIG_BCMDHD_FW_PATH is not set
# CONFIG_BCMDHD_NVRAM_PATH is not set
# CONFIG_BROADCOM_WIFI_RESERVED_MEM is not set
# CONFIG_CFG80211_REG_NOT_UPDATED is not set
# CONFIG_WIFI_MULTICAST_LOG is not set
# CONFIG_BCMDHD_PCIE is not set
# CONFIG_BCMDHD_PREALLOC_MEMDUMP is not set
# CONFIG_BCMDHD_OOB_HOST_WAKE is not set
# CONFIG_BCM_DHD_WLAN is not set
# CONFIG_WLAN_VENDOR_DUMP_ENABLE is not set
# CONFIG_WLAN_TSQ_MULTIPLIER is not set

# QCA Wi-Fi feature
CONFIG_QCA_CLD_WLAN=y
CONFIG_QCACLD_WLAN_LFR2=y
CONFIG_QCACLD_WLAN_LFR3=y
CONFIG_QCOM_TDLS=y
CONFIG_QCACLD_FEATURE_METERING=y
CONFIG_QCOM_VOWIFI_11R=y
CONFIG_WLAN_FEATURE_11W=y
CONFIG_QCOM_LTE_COEX=y
CONFIG_WLAN_FEATURE_LPSS=y
CONFIG_QCACLD_FEATURE_NAN=y
CONFIG_WLAN_FEATURE_NAN_DATAPATH=y
CONFIG_MPC_UT_FRAMEWORK=y
CONFIG_WLAN_OFFLOAD_PACKETS=y
CONFIG_WLAN_SYNC_TSF=y
CONFIG_WLAN_FEATURE_MEMDUMP=y
CONFIG_WLAN_FEATURE_DISA=y
CONFIG_WLAN_FASTPATH=y
CONFIG_WLAN_NAPI=y
CONFIG_WLAN_TX_FLOW_CONTROL_V2=y
CONFIG_LFR_SUBNET_DETECTION=y
CONFIG_MCC_TO_SCC_SWITCH=y
CONFIG_WLAN_LRO=y
CONFIG_ICNSS=y
CONFIG_ICNSS_QMI=y
# CONFIG_ICNSS_DEBUG is not set
CONFIG_CNSS_UTILS=y
CONFIG_QCACLD_FEATURE_GREEN_AP=y
CONFIG_WCNSS_MEM_PRE_ALLOC=y
CONFIG_MCL=y

# Debug for SELinux
CONFIG_SECURITY_DEBUG_UNLABELED=y

# Disable feature for header_version@2
# CONFIG_BUILD_ARM64_APPENDED_DTB_IMAGE is not set
```

## arch/arm64/configs/sm8150_sec_userdebug_defconfig
```kconfig
# TODO: sm8150_sec_userdebug_defconfig

CONFIG_GATOR=y

# CONFIG_RKP_KDP is not set
# CONFIG_RKP_NS_PROT is not set

# streamline
CONFIG_PROFILING=y
CONFIG_PERF_EVENTS=y
CONFIG_HIGH_RES_TIMERS=y
CONFIG_HW_PERF_EVENTS=y
CONFIG_LOCAL_TIMERS=y

# SDP KeyManagement Test for MDFPP evaluation
CONFIG_SDP_KEY_DUMP=y
CONFIG_FIVE_DEBUG=y
CONFIG_FIVE_SIGN_TA=y
CONFIG_FIVE_SIGNCLIENT_PATH="/home/dpi/qb5_8814/workspace/P4_1716/buildscript/tools/signclient.jar"
CONFIG_FIVE_PILSPLITTER_PATH="/home/dpi/qb5_8814/workspace/P4_1716/buildscript/tools/pil_splitter.py"


CONFIG_PROCA=y


# CONFIG_FIVE_PA_FEATURE is not set


CONFIG_GAF_V6=y
```

## arch/arm64/configs/sm8150_sec_winnerlte_jpn_dcm_defconfig
```kconfig
# sm8150_sec_winnerlte_jpn_dcm_defconfig

CONFIG_SEC_WINNERLTE_PROJECT=y
CONFIG_MACH_WINNERLTE_JPN_DCM=y

# display
CONFIG_PANEL_S6E3HA8_AMB622NP01_WQHD=y
CONFIG_PANEL_S6E3FA7_AMS628RF01_FHD=y
CONFIG_PANEL_S6E3FA7_AMB458WJ01_HD=y
CONFIG_PANEL_S6E3XA0_AMB729WA01_QXGA=y
CONFIG_SUPPORT_POC_FLASH=n

# Sub PMIC
# CONFIG_REGULATOR_S2ABB01 is not set
# CONFIG_REGULATOR_S2DOS03 is not set
CONFIG_REGULATOR_S2DOS05=y
# CONFIG_REGULATOR_MAX77838 is not set
CONFIG_MFD_S2MPB02=y
CONFIG_REGULATOR_S2MPB02=y
CONFIG_REGULATOR_S2MPB03=y

# input device
CONFIG_TOUCHSCREEN_DUAL_FOLDABLE=y
CONFIG_TOUCHSCREEN_SEC_TS_Y761_SUB=y
CONFIG_TOUCHSCREEN_ZINITIX_ZT75XX_TCLM=y
CONFIG_TOUCHSCREEN_FTS9=y

# BATTERY
CONFIG_CALC_TIME_TO_FULL=y
CONFIG_BATTERY_AGE_FORECAST=y
CONFIG_AFC_CURR_CONTROL_BY_TEMP=y
CONFIG_LIMIT_CHARGING_DURING_CALL=y
CONFIG_FUELGAUGE_MAX77705=y
CONFIG_CHARGER_MAX77705=y
CONFIG_WIRELESS_CHARGER_MFC=y
CONFIG_WIRELESS_FIRMWARE_UPDATE=y
CONFIG_WIRELESS_AUTH=y
CONFIG_BATTERY_CISD=y
CONFIG_DUAL_BATTERY=y
CONFIG_SWITCHING_S2ASL01=y
CONFIG_WIRELESS_TX_MODE=y
CONFIG_CS100_JPNCONCEPT=y
CONFIG_PREVENT_USB_CONN_OVERHEAT=y

# MUIC configs
CONFIG_MFD_CORE=y
CONFIG_USE_MUIC=y
CONFIG_USE_SAFEOUT=y
CONFIG_MUIC_NOTIFIER=y
CONFIG_AFC_CHARGER_MODE=y
CONFIG_MUIC_SUPPORT_RUSTPROOF=y
CONFIG_VBUS_NOTIFIER=y
CONFIG_VBUS_NOTIFIER_WORK=y
CONFIG_MUIC_MAX77705=y
CONFIG_MFD_MAX77705=y
CONFIG_MUIC_MAX77705_CCIC=y
CONFIG_HV_MUIC_MAX77705_AFC=y
CONFIG_MUIC_SUPPORT_CCIC=y
CONFIG_AFC_CHARGER_MODE=y
CONFIG_MUIC_HV=y
CONFIG_HICCUP_CHARGER=y

# ccic
CONFIG_CCIC_MAX77705=y
# CONFIG_CCIC_S2MM003 is not set
CONFIG_CCIC_S2MM005=y

# Motor
CONFIG_ANDROID_TIMED_OUTPUT=y
CONFIG_MOTOR_DRV_CS40L2X=y
CONFIG_MOTOR_DRV_CS40L2X_PMIC_RESET=y
CONFIG_CS40L2X_SAMSUNG_FEATURE=y

# BLUETOOTH
CONFIG_BT=y
CONFIG_BT_BCM4361=y
CONFIG_BT_BLUESLEEP=y
CONFIG_RFKILL=y

# Displayport
CONFIG_SEC_DISPLAYPORT=y
CONFIG_SEC_DISPLAYPORT_LOGGER=y
CONFIG_SEC_DISPLAYPORT_BIGDATA=y

# NFC ESE
CONFIG_SAMSUNG_NFC=y
CONFIG_NFC_PN547=y
CONFIG_NFC_PN547_ESE_SUPPORT=y
CONFIG_ESE_SECURE=y
CONFIG_ESE_SPI_GPIO_START=23
CONFIG_ESE_SPI_GPIO_END=26
CONFIG_ESE_SPI_NUMBER=3
CONFIG_SEC_NFC_LOGGER=y

# Audio
CONFIG_SND_SOC_CS35L41=y
CONFIG_MFD_CS35L41_I2C=y
CONFIG_SND_SOC_SAMSUNG_AUDIO=y
CONFIG_SND_SOC_SAMSUNG_USB_HEADSET_ONLY=y
CONFIG_SLIMBUS_DEBUG=y

# Camera
CONFIG_LEDS_S2MPB02=y
CONFIG_SAMSUNG_OIS_MCU_STM32=y
CONFIG_SAMSUNG_APERTURE=y
CONFIG_CAMERA_SYSFS_V2=y
CONFIG_SAMSUNG_FRONT_DUAL=y
CONFIG_SAMSUNG_REAR_TRIPLE=y
CONFIG_SAMSUNG_FRONT_EEPROM=y
CONFIG_SAMSUNG_FRONT_TOP=y
CONFIG_USE_CAMERA_HW_BIG_DATA=y
CONFIG_CAMERA_FRS_DRAM_TEST=y
CONFIG_SAMSUNG_APERTURE_HALLTEST=y
CONFIG_SAMSUNG_FRONT_TOP_EEPROM=y
CONFIG_CAMERA_SSM_I2C_ENV=y
CONFIG_FLASH_CURRENT_JAPAN=y
CONFIG_SAMSUNG_FORCE_DISABLE_REGULATOR=y

# Hall ic
CONFIG_FOLDER_HALL=y
#CONFIG_SENSORS_HALL=y
CONFIG_CERTIFY_HALL=y

# Fingerprint sensor
CONFIG_SENSORS_FINGERPRINT=y
CONFIG_SENSORS_ET5XX=y
CONFIG_SENSORS_FP_SPI_NUMBER=0
CONFIG_SENSORS_FP_SPI_GPIO_START=0
CONFIG_SENSORS_FP_SPI_GPIO_END=3

#sensor
CONFIG_SENSORS=y
CONFIG_SENSORS_SSC=y
CONFIG_ADSP_FACTORY=y
CONFIG_LSM6DSO_FACTORY=y
CONFIG_AK09918_FACTORY=y
CONFIG_LPS22HH_FACTORY=y
CONFIG_TMD490X_FACTORY=y
CONFIG_SUPPORT_MOBEAM=y
CONFIG_SUPPORT_DUAL_6AXIS=y
CONFIG_SUPPORT_DEVICE_MODE=y
CONFIG_SUPPORT_HIDDEN_HOLE=y
CONFIG_SUPPORT_HIDDEN_HOLE_SUB=y
CONFIG_SUPPORT_SUB_MOBEAM=y
CONFIG_SUPPORT_DUAL_OPTIC=y
CONFIG_SUPPORT_VIRTUAL_OPTIC=y
CONFIG_SUPPORT_PROX_AUTO_CAL=y
CONFIG_SUPPORT_BRIGHT_COMPENSATION_LUX=y

# ALS sensor
CONFIG_SENSORS_TCS3407=y

# Grip sensor
CONFIG_SENSORS_SX9330=y

CONFIG_KZEROD=y
```

## arch/arm64/configs/universal2100_defconfig
```kconfig
CONFIG_BOARD_UNIVERSAL2100=y
CONFIG_KEYBOARD_S2MPS23=m
CONFIG_MFD_S2MPS23=m
CONFIG_MFD_S2MPS24=m
CONFIG_MFD_S2MPB02=m
CONFIG_REGULATOR_S2MPS23=m
CONFIG_REGULATOR_S2MPS24=m
CONFIG_REGULATOR_S2MPB02=m
CONFIG_REGULATOR_S2MPB03=m
CONFIG_REGULATOR_S2DOS05=m
CONFIG_RTC_DRV_S2MPS23=m
CONFIG_S2MPS23_ADC=m
CONFIG_TOUCHSCREEN_SEC_TS=m

# SEC CONFIGS
CONFIG_SEC_DEBUG=m
#CONFIG_SEC_REBOOT=m
CONFIG_SEC_PARAM=m
CONFIG_DRV_SAMSUNG=m
#CONFIG_SEC_DEBUG_BASE=m

# USB Feature
CONFIG_GKI_USB=y
CONFIG_USB_NOTIFY_LAYER=y
CONFIG_USB_NOTIFY_LAYER_MODULE=m
CONFIG_USB_NOTIFY_PROC_LOG=y
CONFIG_USB_DEBUG_DETAILED_LOG=y
CONFIG_USB_EXTERNAL_NOTIFY=y
CONFIG_USB_NOTIFIER=m
CONFIG_USB_HW_PARAM=y
CONFIG_USB_INTERFACE_LPM_LIST=y
CONFIG_USB_HOST_CERTI=y
CONFIG_USB_TYPEC_MANAGER_NOTIFIER=y
CONFIG_USB_TYPEC_MANAGER_NOTIFIER_MODULE=m
CONFIG_IF_CB_MANAGER=y
CONFIG_IF_CB_MANAGER_MODULE=m
CONFIG_CCIC_NOTIFIER=y
CONFIG_CCIC_NOTIFIER_MODULE=m
CONFIG_CCIC_MAX77705=y
CONFIG_CCIC_MAX77705_MODULE=m
CONFIG_SWITCH=m
CONFIG_MFD_MAX77705=m
CONFIG_VBUS_NOTIFIER=y
CONFIG_VBUS_NOTIFIER_MODULE=m
CONFIG_USE_MUIC=y
CONFIG_USE_SAFEOUT=y
CONFIG_MUIC_NOTIFIER=y
CONFIG_MUIC_NOTIFIER_MODULE=m
CONFIG_MUIC_SUPPORT_CCIC=y
CONFIG_MUIC_MAX77705=y
CONFIG_HV_MUIC_MAX77705_AFC=y
CONFIG_MUIC_MAX77705_CCIC=y
CONFIG_HICCUP_CHARGER=y
CONFIG_MAX77705_FW_PID03_SUPPORT=y
CONFIG_SEC_MISC=y
CONFIG_ANDROID_SWITCH=m
#CONFIG_USB_HOST_NOTIFY=y

# BATTERY
CONFIG_BATTERY_GKI=y
CONFIG_BATTERY_SAMSUNG_MODULE=m
CONFIG_BATTERY_SAMSUNG=y
CONFIG_BATTERY_SWELLING=y
CONFIG_BATTERY_AGE_FORECAST=y
CONFIG_AFC_CHARGER_MODE=y
CONFIG_FUELGAUGE_MAX77705_MODULE=m
CONFIG_FUELGAUGE_MAX77705=y
CONFIG_CHARGER_MAX77705_MODULE=m
CONFIG_CHARGER_MAX77705=y
CONFIG_DIRECT_CHARGING_MODULE=m
CONFIG_DIRECT_CHARGING=y
CONFIG_STEP_CHARGING=y
CONFIG_CHARGER_PCA9468_MODULE=m
CONFIG_CHARGER_PCA9468=y
CONFIG_SEC_PD_MODULE=m
CONFIG_SEC_PD=y
CONFIG_WIRELESS_CHARGER_MFC_MODULE=m
CONFIG_WIRELESS_CHARGER_MFC=y
CONFIG_WIRELESS_TX_MODE=y
CONFIG_WIRELESS_AUTH=y
CONFIG_PCI_EXYNOS=m
CONFIG_PCI_EXYNOS_2100=m
CONFIG_EXYNOS_PCIE_GEN2_S2MPU=m
```
