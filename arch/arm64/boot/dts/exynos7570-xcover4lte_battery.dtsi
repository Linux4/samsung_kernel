/*
 * SAMSUNG UNIVERSAL7570 board device tree source
 *
 * Copyright (c) 2013 Samsung Electronics Co., Ltd.
 *		http://www.samsung.com
 *
 * This program is free software; you can redistribute it and/or modify
 * it under the terms of the GNU General Public License version 2 as
 * published by the Free Software Foundation.
*/

/ {
	s2mpu06-fuelgauge {
		status = "disable";
		compatible = "samsung,s2mpu06-fuelgauge";
		fuelgauge,fuel_alert_soc = <1>;
		fuelgauge,capacity_max = <1000>;
		fuelgauge,capacity_max_margin = <70>;
		fuelgauge,capacity_min = <0>;
		fuelgauge,capacity_full = <2800>;
		fuelgauge,capacity_calculation_type = <28>;
		fuelgauge,type_str = "SDI";
		fuelgauge,model_type = <1>;

		fuelgauge,cell_character = <
			/* 4.35V Cell character*/
			/* Cell character 0, 0x34 ~ 0xD7 */
			0xB8 0x0A 0xB8 0x0A 0x74 0x0A 0x26 0x0A 0x9A 0x09
			0x27 0x09 0xBB 0x08 0x56 0x08 0xFB 0x07 0xAD 0x07
			0x32 0x07 0xE0 0x06 0xAB 0x06 0x81 0x06 0x5E 0x06
			0x43 0x06 0x27 0x06 0xFC 0x05 0xB4 0x05 0x7E 0x05
			0x4B 0x05 0x87 0x02 0x2E 0x08 0x2E 0x08 0x00 0x08
			0xBE 0x07 0x4E 0x07 0xDE 0x06 0x6E 0x06 0xFE 0x05
			0x8E 0x05 0x1E 0x05 0xAE 0x04 0x3F 0x04 0xCF 0x03
			0x5F 0x03 0xEF 0x02 0x7F 0x02 0x0F 0x02 0x9F 0x01
			0x2F 0x01 0xBF 0x00 0x50 0x00 0xEC 0x0F 0xFE 0x29
			0xDC 0x29 0x8A 0x29 0x4D 0x29 0x28 0x1F 0x23 0x10
			0x21 0x21 0x14 0x21 0xF3 0xF7 0xE6 0xF7 0xDA 0xDE
			0xCA 0xD4 0xD3 0xD4 0x40 0x80 0x26 0x33 0x26 0x40
			0x26 0x5C 0x26 0x5C 0x26 0x5C 0xFF 0xFF 0x02 0x05
			0x14 0x0B 0x03 0x12 0x06 0x1C 0x0C 0x1C 0x10 0x1C
			0x1F 0x1F 0x38 0x38 0x38 0x40 0x40 0x3F 0x40 0x3F
			0x3F 0x3F 0x40 0x41 0x3D 0x39 0x3A 0x3B 0x3C 0x3E
			0x42 0x55 0x7B 0xA4
			/* Cell character 1, 0x0F ~ 0x13 */
			0x0F 0xF0 0x0A 0x00 0x00

			/* 4.33V Cell character*/
			/* Cell character 0, 0x34 ~ 0xD7 */
			0x7B 0x0A 0x7B 0x0A 0x2E 0x0A 0xAD 0x09 0x3B 0x09
			0xCE 0x08 0x78 0x08 0xF7 0x07 0xB5 0x07 0x6F 0x07
			0xFF 0x06 0xB7 0x06 0x89 0x06 0x66 0x06 0x4B 0x06
			0x37 0x06 0x26 0x06 0x01 0x06 0xB3 0x05 0x89 0x05
			0x6B 0x05 0xD5 0x02 0x6D 0x08 0x6D 0x08 0x00 0x08
			0x93 0x07 0x26 0x07 0xB9 0x06 0x4C 0x06 0xDE 0x05
			0x71 0x05 0x04 0x05 0x97 0x04 0x2A 0x04 0xBD 0x03
			0x50 0x03 0xE3 0x02 0x76 0x02 0x09 0x02 0x9C 0x01
			0x2E 0x01 0xC1 0x00 0x54 0x00 0xF8 0x0F 0xFE 0x29
			0xDC 0x29 0x8A 0x29 0x4D 0x29 0x28 0x1F 0x23 0x10
			0x21 0x21 0x14 0x21 0xF3 0xF7 0xE6 0xF7 0xDA 0xDE
			0xCA 0xD4 0xD3 0xD4 0x40 0x80 0x26 0x33 0x26 0x40
			0x26 0x5C 0x26 0x5C 0x26 0x5C 0xFF 0xFF 0x02 0x05
			0x14 0x0B 0x03 0x12 0x06 0x1C 0x0C 0x1C 0x10 0x1C
			0x1F 0x1F 0x38 0x38 0x38 0x40 0x40 0x3F 0x40 0x3F
			0x3F 0x3F 0x40 0x41 0x3D 0x39 0x3A 0x3B 0x3C 0x3E
			0x42 0x55 0x7B 0xA4
			/* Cell character 1, 0x0F ~ 0x13 */
			0x0F 0xF0 0x0A 0x00 0x00

			/* 4.31V Cell character*/
			/* Cell character 0, 0x34 ~ 0xD7 */
			0x4A 0x0A 0xFD 0x09 0x87 0x09 0x1F 0x09 0xBB 0x08
			0x6C 0x08 0xF5 0x07 0xB9 0x07 0x73 0x07 0x0F 0x07
			0xC6 0x06 0x98 0x06 0x75 0x06 0x58 0x06 0x43 0x06
			0x33 0x06 0x1D 0x06 0xF3 0x05 0xA1 0x05 0x88 0x05
			0x6A 0x05 0x9B 0x02 0x67 0x08 0x00 0x08 0x99 0x07
			0x32 0x07 0xCB 0x06 0x64 0x06 0xFC 0x05 0x95 0x05
			0x2E 0x05 0xC7 0x04 0x60 0x04 0xF9 0x03 0x92 0x03
			0x2A 0x03 0xC3 0x02 0x5C 0x02 0xF5 0x01 0x8E 0x01
			0x26 0x01 0xBF 0x00 0x58 0x00 0xF8 0x0F 0xFE 0x29
			0xDC 0x29 0x8A 0x29 0x4D 0x29 0x28 0x1F 0x23 0x10
			0x21 0x21 0x14 0x21 0xF3 0xF7 0xE6 0xF7 0xDA 0xDE
			0xCA 0xD4 0xD3 0xD4 0x40 0x80 0x26 0x33 0x26 0x40
			0x26 0x5C 0x26 0x5C 0x26 0x5C 0xFF 0xFF 0x02 0x05
			0x14 0x0B 0x03 0x12 0x06 0x1C 0x0C 0x1C 0x10 0x1C
			0x1F 0x1F 0x38 0x38 0x38 0x40 0x40 0x3F 0x40 0x3F
			0x3F 0x3F 0x40 0x41 0x3D 0x39 0x3A 0x3B 0x3C 0x3E
			0x42 0x55 0x7B 0xA4
			/* Cell character 1, 0x0F ~ 0x13 */
			0x0F 0xF0 0x0A 0x00 0x00
			>;

		fuelgauge,raw_100_vbat = <4307 4273 4249>;
	};

	battery {
		status = "okay";

		pinctrl-names = "default";

		compatible = "samsung,sec-battery";
		battery,vendor = "SDI SDI";
		battery,charger_name = "s2mpu06-charger";
		battery,fuelgauge_name = "s2mpu06-fuelgauge";
		battery,technology = <2>; /* POWER_SUPPLY_TECHNOLOGY_LION */

		battery,chip_vendor = "LSI";

		/* battery,battery_type = <&gpd1 5 0x1>; */

		battery,temp_adc_type = <1>; /* SEC_BATTERY_ADC_TYPE_AP */

		battery,polling_time = <10 30 30 30 3600>;

		battery,enable_water_resistance;

		battery,temp_table_adc = <300 354 406 473 554 648 765 837 894 952 1035 1127 1186 1269 1340 1374 1454
								1534 1574 1770 2009 2246 2484 2565 2698 2812 2901 2997 3112 3242 3296 3441 3577 3682>;

		battery,temp_table_data = <900 850 800 750 700 650 600 570 550 530 500 470 450 430 410 400 380
								360 350 300 250 200 150 130 100 70 50 30 0 (-30) (-50) (-100) (-150) (-200)>;

		battery,input_current_limit = <1500 460 460 1550 460 900 1000 460 1000 0 820 820 820 1000 1000 0 0 400 700 1000 300 1000 1000 0 1000 1550 1000 1550 80 1550 1000 1000 1000 1000 820 820 460>;
		battery,fast_charging_current = <1800 0 0 1800 460 1200 1000 460 1200 0 1200 1200 1200 1200 1200 0 0 400 700 1200 300 1000 1200 0 1800 1800 1000 1800 80 1800 1000 1400 0 1000 1200 1200 0>;
		battery,full_check_current_1st = <280 0 0 280 280 280 280 280 280 0 280 280 280 280 280 0 0 280 280 280 280 280 280 0 280 280 280 280 0 280 280 280 0 280 280 280 0>;
		battery,full_check_current_2nd = <140 0 0 140 140 140 140 140 140 0 140 140 140 140 140 0 0 140 140 140 140 140 140 0 140 140 140 140 0 140 140 140 0 140 140 140 0>;

		battery,wireless_cc_cv = <86>;
		battery,inbat_voltage = <1>;

		battery,inbat_voltage_table_adc = <3120 3101 3061 3038 3001 2956 2920 2887 2856 2814
						2793 2754 2720 2677 2641 2613 2572 2531 2502 2467 2436>;
		battery,inbat_voltage_table_data = <438 435 430 425 420 415 410 405 400 395
						390 385 380 375 370 365 360 355 350 345 340>;

		battery,adc_check_count = <5>;

		battery,cable_check_type = <4>; /* SEC_BATTERY_CABLE_CHECK_PSY */
		battery,cable_source_type = <1>; /* SEC_BATTERY_CABLE_SOURCE_EXTERNAL */
		battery,polling_type = <1>; /* SEC_BATTERY_MONITOR_ALARM */
		battery,monitor_initial_count = <0>;

		battery,battery_check_type = <5>; /* SEC_BATTERY_CHECK_CHARGER */
		battery,check_count = <0>;

		battery,ovp_uvlo_check_type = <3>; /* SEC_BATTERY_OVP_UVLO_CHGPOLLING */

		battery,check_adc_max = <1440>;
		battery,check_adc_min = <0>;

		battery,thermal_source = <2>; /* SEC_BATTERY_THERMAL_SOURCE_ADC */

		battery,temp_check_type = <2>; /* SEC_BATTERY_TEMP_CHECK_TEMP */
		battery,temp_check_count = <1>;
		battery,temp_highlimit_threshold_normal = <800>;
		battery,temp_highlimit_recovery_normal = <750>;
		battery,temp_high_threshold_normal = <500>;
		battery,temp_high_recovery_normal = <450>;
		battery,temp_low_threshold_normal = <0>;
		battery,temp_low_recovery_normal = <50>;
		battery,temp_highlimit_threshold_lpm = <800>;
		battery,temp_highlimit_recovery_lpm = <750>;
		battery,temp_high_threshold_lpm = <500>;
		battery,temp_high_recovery_lpm = <450>;
		battery,temp_low_threshold_lpm = <0>;
		battery,temp_low_recovery_lpm = <50>;

		battery,full_check_type = <7>; /* SEC_BATTERY_FULLCHARGED_CHGPSY */
		battery,full_check_type_2nd = <7>; /* SEC_BATTERY_FULLCHARGED_CHGPSY */
		battery,full_check_count = <1>;
		battery,chg_gpio_full_check = <0>;
		battery,chg_polarity_full_check = <1>;

		battery,chg_high_temp_1st = <530>;
		battery,chg_high_temp_2nd = <530>;
		battery,chg_high_temp_recovery = <525>;
		battery,chg_charging_limit_current = <1300>;
		battery,chg_charging_limit_current_2nd = <1300>;
		battery,chg_skip_check_capacity = <10>;
		battery,chg_skip_check_time = <600>;

		battery,wpc_high_temp = <420>;
		battery,wpc_high_temp_recovery = <410>;
		battery,wpc_charging_limit_current = <450>;

		/* SEC_BATTERY_FULL_CONDITION_SOC |
		   SEC_BATTERY_FULL_CONDITION_NOTIMEFULL |
		   SEC_BATTERY_FULL_CONDITION_VCELL */
		battery,full_condition_type = <15>;
		battery,full_condition_soc = <93>;
		battery,full_condition_vcell = <4250>;
		/* battery,full_condition_vcell2 = <4280>; */

		battery,recharge_check_count = <2>;
		battery,recharge_condition_type = <4>; /* SEC_BATTERY_RECHARGE_CONDITION_VCELL */
		battery,recharge_condition_soc = <98>;
		battery,recharge_condition_vcell = <4280>;
		/* battery,recharge_condition_vcell2 = <4340>; */

		battery,standard_curr = <1603>;  /* IP < OP */
		battery,recharging_expired_time = <5400>;
		battery,expired_time = <13800>; /* 230min = 160min + 70min*/

		battery,charging_total_time = <21600>;
		battery,recharging_total_time = <5400>;
		battery,charging_reset_time = <0>;

		battery,chg_float_voltage = <4350>;
		/* battery,chg_float_voltage2 = <4380>; */

		/* cycle(week), chg_float_voltage, recharge_condition_vcell, full_condition_vcell, full_condition_soc*/
		battery,age_data = <0 4350 4280 4250 93
				28 4330 4260 4230 91
				36 4310 4240 4210 89>;

		battery,call_event_siop_level = <50>;

		battery,swelling_high_temp_block = <410>;
		battery,swelling_high_temp_recov = <390>;

		battery,swelling_low_temp_2step_mode = <1>;
		battery,swelling_low_temp_block_1st = <150>;
		battery,swelling_low_temp_recov_1st = <200>;
		battery,swelling_low_temp_block_2nd = <50>;
		battery,swelling_low_temp_recov_2nd = <100>;

		battery,swelling_high_temp_current = <1000>;
		battery,swelling_low_temp_current = <660>;
		battery,swelling_low_temp_topoff = <140>;
		battery,swelling_high_temp_topoff = <140>;

		battery,swelling_drop_float_voltage = <4150>;
		battery,swelling_high_rechg_voltage = <4000>;
		battery,swelling_low_rechg_voltage = <4000>;
		battery,swelling_block_time = <600>;
		battery,battery_full_capacity = <2800>;

		io-channels = <&exynos_adc 1>;
		io-channel-names = "adc-temp";
		#io-channel-cells = <1>;
		io-channel-ranges;
	};

	s2mpu06-charger {
		status = "disable";
		compatible = "samsung,s2mpu06-charger";
		battery,is_1MHz_switching = <1>;
		battery,chg_gpio_en = <0>;
		battery,chg_polarity_en = <0>;
		battery,chg_gpio_status = <0>;
		battery,chg_polarity_status = <0>;
	};
};

