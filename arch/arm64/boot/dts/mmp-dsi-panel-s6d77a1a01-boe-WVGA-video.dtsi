&gen_panel {
	dsi_s6d77a1a01_boe_WVGA: gen-panel-s6d77a1a01-boe-WVGA-video {
		gen-panel-manu = "BOE";			/* condensed manufacturer name */
		gen-panel-name = "s6d77a1a01-boe";
		gen-panel-id = <0x55b810>;
		gen-panel-type = "video_mode";
		gen-panel-refresh = <60>;
		gen-panel-xres = <480>;
		gen-panel-yres = <800>;
		gen-panel-width= <56>;			/* screen width in mm */
		gen-panel-height = <94>;		/* screen height in mm */
		gen-panel-h-front-porch = <84>;	/* right margin */
		gen-panel-h-back-porch = <90>;	/* left margin */
		gen-panel-h-sync-width = <40>;	/* hsync len */
		gen-panel-v-front-porch = <16>;	/* lower margin */
		gen-panel-v-back-porch = <12>;	/* upper margin */
		gen-panel-v-sync-width = <4>;	/* vsync len */
		gen-panel-hsync-invert = <0>;	/* hsync invert */
		gen-panel-vsync-invert = <0>;	/* vsync invert */
		gen-panel-lanes = <2>;
		gen-panel-burst-mode = <2>;
		gen-panel-master-mode;
		/* gen-panel-hfp-en; */
		/* gen-panel-hbp-en; */

		/*
		 * DSI PACKET HEADER INFO
		 * @ data type : 1byte
		 * @ tx mode : 1byte
		 * @ delay(msec) : 2byte
		 * @ size of data : 2byte
		 */
		gen-panel-pkt-dinfo-addr-offset = <0>;
		gen-panel-pkt-dinfo-addr-length = <1>;
		gen-panel-pkt-dinfo-data-offset = <1>;
		gen-panel-pkt-dinfo-data-length = <1>;
		gen-panel-init-cmds = [
			39 00 00 00 00 01	11
			39 00 00 00 00 03	F0 5A 5A
			39 00 00 00 00 03	F1 5A 5A
			39 00 00 00 00 03	FC A5 A5
			39 00 00 00 00 02	B3 01
			39 00 00 00 00 02	B5 10
			39 00 00 00 00 04	BC 00 29 51
			39 00 00 00 00 03	E3 24 2C
			39 00 00 00 00 01	21
			39 00 00 00 00 08	F2 11 04 08 10 10 82 54
			39 00 00 00 00 06	F3 91 00 00 00 10
			39 00 00 00 00 2C	F4 01 02 23 24 25 25 26 26 29 29 2C 2B 2C 07 08
						05 04 04 01 01 22 0A 17 0F 11 23 0D 0A 0B 02 19
						13 1E 1F 23 20 05 16 1A 16 1E 24 1E
			39 00 00 00 00 1D	F5 28 28 B9 21 35 55 36 0A 00 39 00 00 0B 4B C4
						CB 4B 12 12 1A 00 10 E0 E2 0E 34 34 03
			39 00 00 14 00 12	FE 00 02 01 39 60 40 21 00 4B 00 80 00 F0 00 00
						00 02
			39 00 00 00 00 0B	EE 00 A8 00 A8 00 00 00 00 00 00
			39 00 00 00 00 16	EF 23 01 00 00 2A 49 08 27 21 40 10 28 02 21 21
						03 03 40 00 08 00
			39 00 00 00 00 1F	F7 02 1B 0D 0D 09 09 0C 0C 08 08 04 06 1A 02 02
						02 1B 0F 0F 0B 0B 0E 0E 0A 0A 05 07 1A 02 02
			39 00 00 00 00 07	F6 63 25 15 00 00 2A
			39 00 00 00 00 02	36 10
			39 00 00 00 00 12	FA 0C 36 11 17 0E 14 19 18 1A 21 23 22 22 21 22
						22 29
			39 00 00 78 00 12	FB 0C 36 12 17 0F 14 19 18 1A 21 24 22 23 21 22
						22 29
		];
		gen-panel-enable-cmds = [
			39 00 00 78 00 01	29
		];
		gen-panel-disable-cmds = [
			05 00 00 32 00 01	28
			05 00 00 32 00 01	10
		];
		gen-panel-read-id = [
			DA 00 01
			DB 00 01
			DC 00 01
		];
		gen-panel-read-status-reg = [0A];
		gen-panel-read-status-ok = [9A];
		status = "okay";
	};
};
