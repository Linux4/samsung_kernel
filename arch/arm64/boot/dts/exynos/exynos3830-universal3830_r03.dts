/dts-v1/;

/ {
	compatible = "samsung,exynos3830\0samsung,UNIVERSAL3830";
	board_id = <0x00>;
	board_rev = <0x03>;

	fragment@common {
		target-path = [2f 00];

		__overlay__ {
			#address-cells = <0x02>;
			#size-cells = <0x01>;

			fixed-rate-clocks {

				oscclk {
					compatible = "samsung,exynos9630-oscclk";
					clock-frequency = <0x18cba80>;
				};
			};

			firmware {

				android {
					compatible = "android,firmware";

					vbmeta {
						compatible = "android,vbmeta";
						parts = "vbmeta,boot,system,vendor";
					};
				};
			};

			gpio_keys {
				status = "okay";
				compatible = "gpio-keys";
				pinctrl-names = "default";
				pinctrl-0 = <0x01 0x02>;

				button@1 {
					label = "gpio-keys: KEY_VOLUMEDOWN";
					linux,code = <0x72>;
					gpios = <0xffffffff 0x00 0x0f>;
				};

				button@2 {
					label = "gpio-keys: KEY_VOLUMEUP";
					linux,code = <0x73>;
					gpios = <0xffffffff 0x07 0x0f>;
				};
			};

			ifconn {
				status = "okay";
				compatible = "samsung,ifconn";
				ifconn,usbpd = "s2mu106";
				ifconn,muic = "s2mu106-muic";
			};

			gnss_mailbox {
				status = "okay";
				compatible = "samsung,exynos-gnss-mailbox";
				reg = <0x00 0x11980000 0x180>;
				interrupt-parent = <0xffffffff>;
				interrupts = <0x00 0x35 0x04>;
				mbox,name = "gnss_mailbox";
				mbox,id = <0x00>;
				phandle = <0x03>;
			};

			gnssif {
				status = "okay";
				compatible = "samsung,exynos-gnss";
				interrupt-parent = <0xffffffff>;
				interrupts = <0x00 0x25 0x04 0x00 0x82 0x01 0x00 0x81 0x04 0x00 0x80 0x01>;
				interrupt-names = "ACTIVE\0WATCHDOG\0WAKEUP\0SW_INIT";
				shmem,name = "KEPLER";
				device_node_name = "gnss_ipc";
				mbox_info = <0x03>;
				mbx,int_bcmd = <0x00>;
				mbx,int_req_fault_info = <0x01>;
				mbx,int_ipc_msg = <0x02>;
				mbx,int_ack_wake_set = <0x03>;
				mbx,int_ack_wake_clr = <0x04>;
				mbx,irq_bcmd = <0x00>;
				mbx,irq_rsp_fault_info = <0x01>;
				mbx,irq_ipc_msg = <0x02>;
				mbx,irq_req_wake_clr = <0x04>;
				mbx,irq_simple_lock = <0x0f>;
				mbx,reg_bcmd_ctrl = <0x00 0x01 0x02 0x03>;
				memory-region = <0xffffffff>;
				reg_rx_ipc_msg = <0x01 0x05>;
				reg_tx_ipc_msg = <0x01 0x04>;
				reg_rx_head = <0x01 0x03>;
				reg_rx_tail = <0x01 0x02>;
				reg_tx_head = <0x01 0x01>;
				reg_tx_tail = <0x01 0x00>;
				fault_info = <0x01 0x200000 0x180000>;
				shmem,gnss_code_offset = <0x00>;
				shmem,gnss_code_size = <0x00>;
				shmem,ipc_offset = <0x380000>;
				shmem,ipc_size = <0x80000>;
				shmem,ipc_reg_cnt = <0x20>;
			};

			but_zones {
				#list-but-cells = <0x03>;
				phandle = <0x0e>;
			};

			exynos_rgt {
				compatible = "samsung,exynos-rgt";
				num-acpm-pmic = <0x01>;
			};
		};
	};

	fragment@0 {
		target = <0xffffffff>;

		__overlay__ {
			bootargs_ext = [00];
		};
	};

	fragment@1 {
		target = <0xffffffff>;

		__overlay__ {
			status = "okay";
		};
	};

	fragment@2 {
		target = <0xffffffff>;

		__overlay__ {

			attn-irq {
				samsung,pins = "gpa0-0";
				samsung,pin-function = <0x0f>;
				samsung,pin-pud = <0x00>;
				samsung,pin-drv = <0x00>;
				phandle = <0x05>;
			};

			attn-input {
				samsung,pins = "gpa0-0";
				samsung,pin-function = <0x00>;
				samsung,pin-pud = <0x01>;
				phandle = <0x07>;
			};

			key-voldown {
				samsung,pins = "gpa1-0";
				samsung,pin-function = <0x0f>;
				samsung,pin-pud = <0x00>;
				samsung,pin-drv = <0x00>;
				phandle = <0x01>;
			};

			key-volup {
				samsung,pins = "gpa0-7";
				samsung,pin-function = <0x0f>;
				samsung,pin-pud = <0x00>;
				samsung,pin-drv = <0x00>;
				phandle = <0x02>;
			};

			dwmmc2_cd_ext_irq {
				samsung,pins = "gpa0-3";
				samsung,pin-function = <0x0f>;
				samsung,pin-pud = <0x00>;
				samsung,pin-drv = <0x04>;
				phandle = <0x04>;
			};
		};
	};

	fragment@3 {
		target = <0xffffffff>;

		__overlay__ {
			#address-cells = <0x01>;
			#size-cells = <0x00>;
			status = "okay";
			num-slots = <0x01>;
			broken-cd;
			fixed_voltage;
			supports-highspeed;
			mmc-ddr-1_8v;
			mmc-hs200-1_8v;
			mmc-hs400-1_8v;
			supports-8bit;
			supports-cmd23;
			supports-erase;
			support-cmdq;
			support-cmd-logging;
			extended-tmout;
			mmc-hs400-enhanced-strobe;
			card-init-hwacg-ctrl;
			mmc-inline-crypt;
			qos-dvfs-level = <0x518b0>;
			data-timeout = <0x1f4>;
			hto-timeout = <0x50>;
			enable-ulp-mode;
			fifo-depth = <0x40>;
			non-removable;
			desc-size = <0x04>;
			card-detect-delay = <0xc8>;
			samsung,dw-mshc-ciu-div = <0x03>;
			samsung,dw-mshc-txdt-crc-timer-fastlimit = <0x34>;
			samsung,dw-mshc-txdt-crc-timer-initval = <0x38>;
			samsung,dw-mshc-hs400-tx-delay-line = <0x40>;
			samsung,dw-mshc-hs400-delay-line = <0x60>;
			samsung,dw-mshc-sdr-timing = <0x03 0x00 0x04 0x00>;
			samsung,dw-mshc-ddr-timing = <0x03 0x00 0x04 0x02>;
			samsung,dw-mshc-hs200-timing = <0x03 0x00 0x03 0x00>;
			samsung,dw-mshc-hs400-timing = <0x01 0x00 0x02 0x00>;
			samsung,dw-mshc-hs400-ulp-timing = <0x03 0x00 0x04 0x02>;
			num-ref-clks = <0x0c>;
			ciu_clkin = <0x19 0x32 0x32 0x19 0x32 0x64 0xc8 0x32 0x32 0xc8 0xc8 0xc8>;
			clk-drive-number = <0x04>;
			pinctrl-names = "default\0fast-slew-rate-1x\0fast-slew-rate-2x\0fast-slew-rate-3x\0fast-slew-rate-4x";
			pinctrl-0 = <0xffffffff 0xffffffff 0xffffffff 0xffffffff 0xffffffff 0xffffffff 0xffffffff>;
			pinctrl-1 = <0xffffffff>;
			pinctrl-2 = <0xffffffff>;
			pinctrl-3 = <0xffffffff>;
			pinctrl-4 = <0xffffffff>;

			slot@0 {
				reg = <0x00>;
				bus-width = <0x08>;
			};
		};
	};

	fragment@4 {
		target = <0xffffffff>;

		__overlay__ {
			#address-cells = <0x01>;
			#size-cells = <0x00>;
			status = "okay";
			num-slots = <0x01>;
			supports-4bit;
			supports-cmd23;
			supports-erase;
			supports-highspeed;
			sd-uhs-sdr50;
			sd-uhs-sdr104;
			card-detect-gpio;
			card-detect-invert;
			bypass-for-allpass;
			use-fine-tuning;
			card-init-hwacg-ctrl;
			skip-init-mmc-scan;
			use-runtime-pm;
			skip-init-no-tray;
			fifo-depth = <0x40>;
			data-timeout = <0xc8>;
			hto-timeout = <0x50>;
			desc-size = <0x04>;
			ssc-rate = <0x03>;
			card-detect-delay = <0xc8>;
			samsung,dw-mshc-ciu-div = <0x03>;
			clock-frequency = <0x2faf0800>;
			samsung,dw-mshc-sdr-timing = <0x03 0x00 0x02 0x00>;
			samsung,dw-mshc-ddr-timing = <0x03 0x00 0x02 0x01>;
			samsung,dw-mshc-sdr50-timing = <0x03 0x00 0x04 0x02>;
			samsung,dw-mshc-sdr104-timing = <0x03 0x00 0x03 0x00>;
			num-ref-clks = <0x09>;
			ciu_clkin = <0x19 0x32 0x32 0x19 0x32 0x64 0xc8 0x32 0x32>;
			clk-drive-number = <0x06>;
			pinctrl-names = "init\0fast-slew-rate-1x\0fast-slew-rate-1_5x\0fast-slew-rate-2x\0fast-slew-rate-2_5x\0fast-slew-rate-3x\0fast-slew-rate-4x\0pins-as-pdn\0pins-as-func";
			pinctrl-0 = <0xffffffff 0xffffffff 0xffffffff 0xffffffff 0x04>;
			pinctrl-1 = <0xffffffff>;
			pinctrl-2 = <0xffffffff>;
			pinctrl-3 = <0xffffffff>;
			pinctrl-4 = <0xffffffff>;
			pinctrl-5 = <0xffffffff>;
			pinctrl-6 = <0xffffffff>;
			pinctrl-7 = <0xffffffff>;
			pinctrl-8 = <0xffffffff 0xffffffff 0xffffffff 0xffffffff>;
			card-detect = <0xffffffff 0x03 0x0f>;

			slot@0 {
				reg = <0x00>;
				bus-width = <0x04>;
				disable-wp;
			};

			mmc-pmu-pad {
				offset = <0x1ca0>;
				mask = <0x800>;
				val = <0x800>;
			};
		};
	};

	fragment@5 {
		target = <0xffffffff>;

		__overlay__ {

			vdd-on {
				samsung,pins = "gpg2-6";
				samsung,pin-function = <0x01>;
				samsung,pin-val = <0x01>;
				samsung,pin-pud = <0x03>;
				samsung,pin-drv = <0x03>;
				phandle = <0x06>;
			};

			vdd-off {
				samsung,pins = "gpg2-6";
				samsung,pin-functon = <0x01>;
				samsung,pin-val = <0x00>;
				samsung,pin-pud = <0x01>;
				samsung,pin-drv = <0x03>;
				phandle = <0x08>;
			};
		};
	};

	fragment@6 {
		target = <0xffffffff>;

		__overlay__ {
			status = "okay";
			#address-cells = <0x01>;
			#size-cells = <0x00>;

			touchscreen@20 {
				compatible = "synaptics,rmi4";
				reg = <0x20>;
				pinctrl-names = "on_state\0off_state";
				pinctrl-0 = <0x05 0x06>;
				pinctrl-1 = <0x07 0x08>;
				synaptics,irq_gpio = <0xffffffff 0x00 0x00>;
				synaptics,irq_type = <0x2008>;
				synaptics,max_coords = <0x5a0 0xa00>;
				synaptics,num_lines = <0x1d 0x10>;
				synaptics,regulator_avdd = "vdd_ldo27";
			};
		};
	};

	fragment@7 {
		target = <0xffffffff>;

		__overlay__ {
			#address-cells = <0x01>;
			#size-cells = <0x00>;
			status = "okay";

			s2mu106@3d {
				compatible = "samsung,s2mu106mfd";
				reg = <0x3d>;
				pinctrl-names = "default";
				pinctrl-0 = <0x09>;
				s2mu106,irq-gpio = <0xffffffff 0x01 0x00>;
				s2mu106,wakeup;
			};

			s2mu106-charger {
				status = "okay";
				battery,charger_name = "s2mu106-charger";
				battery,chg_gpio_en = <0x00>;
				battery,chg_polarity_en = <0x00>;
				battery,chg_gpio_status = <0x00>;
				battery,chg_polarity_status = <0x00>;
				battery,chg_float_voltage = <0x10fe>;
				battery,chg_recharge_vcell = <0x109a>;
				battery,chg_full_vcell = <0x10cc>;
				battery,full_check_type = <0x02>;
				battery,full_check_type_2nd = <0x02>;
				battery,input_current_limit = <0x1f4 0x1c2 0x1f4 0x4b0 0x1f4 0x4b0 0x4b0 0x3e8 0x3e8 0x3e8 0x3e8 0x1f4 0x1f4 0x4b0 0x3e8 0x1f4 0x1c2>;
				battery,fast_charging_current = <0x1f4 0x1c2 0x1f4 0x4b0 0x1f4 0x4b0 0x4b0 0x3e8 0x3e8 0x3e8 0x3e8 0x1f4 0x1f4 0x4b0 0x3e8 0x1f4 0x1c2>;
				battery,full_check_current_1st = <0x12c 0x00 0x12c 0x12c 0x12c 0x12c 0x12c 0x12c 0x12c 0x12c 0x12c 0x12c 0x12c 0x12c 0x12c 0x12c 0x00>;
				battery,full_check_current_2nd = <0x64 0x00 0x64 0x64 0x64 0x64 0x64 0x64 0x64 0x64 0x64 0x64 0x64 0x64 0x64 0x64 0x00>;
			};

			s2mu106-fuelgauge@3B {
				compatible = "samsung,s2mu106-fuelgauge";
				reg = <0x3b>;
				pinctrl-names = "default";
				fuelgauge,fuel_alert_vol = <0xd48>;
				fuelgauge,fuel_alert_soc = <0x01>;
				fuelgauge,type_str = "SDI";
				fuelgauge,model_type = <0x01>;
			};

			usbpd-s2mu106@3C {
				compatible = "sec-usbpd,i2c";
				reg = <0x3c>;
				pinctrl-names = "default";
				pinctrl-0 = <0x0a>;
				usbpd,usbpd_int = <0xffffffff 0x02 0x00>;

				pdic-manager {
					pdic,max_power = <0x1388>;
					pdic_op_power = <0x9c4>;
					pdic_max_voltage = <0x1770>;
					pdic_max_current = <0x7d0>;
					pdic,min_current = <0x1f4>;
					pdic,giveback = <0x00>;
					pdic,usb_com_capable = <0x01>;
					pdic,no_usb_suspend = <0x01>;
					source,max_voltage = <0x1388>;
					source,min_voltage = <0xfa0>;
					source,max_power = <0x9c4>;
					sink,capable_max_voltage = <0x1388>;
				};
			};
		};
	};

	fragment@modemif {
		target-path = [2f 00];

		__overlay__ {
			#address-cells = <0x02>;
			#size-cells = <0x01>;

			cpif {
				compatible = "samsung,exynos-cp";
				status = "okay";
				interrupt-parent = <0xffffffff>;
				interrupts = <0x00 0xbe 0x04>;
				interrupt-names = "RESET_REQ";
				ap2cp_cfg_addr = <0x14020000>;
				mif,name = "s318ap";
				mif,cp_num = <0x00>;
				mif,modem_type = <0x00>;
				mif,protocol = <0x00>;
				mif,ipc_version = <0x32>;
				mif,link_type = <0x00>;
				mif,link_name = "shmem";
				mif,link_attrs = <0x7c9>;
				mif,interrupt_types = <0x00>;
				mif,int_ap2cp_msg = <0x00>;
				mif,int_ap2cp_wakeup = <0x01>;
				mif,int_ap2cp_status = <0x02>;
				mif,int_ap2cp_active = <0x03>;
				mif,int_ap2cp_lcd_status = <0x04>;
				mif,int_ap2cp_uart_noti = <0x0f>;
				mif,irq_cp2ap_msg = <0x00>;
				mif,irq_cp2ap_status = <0x02>;
				mif,irq_cp2ap_active = <0x03>;
				mif,irq_cp2ap_wakelock = <0x08>;
				mif,irq_cp2ap_ratmode = <0x09>;
				legacy_fmt_head_tail_offset = <0x08>;
				legacy_fmt_buffer_offset = <0x1000>;
				legacy_fmt_txq_size = <0x1000>;
				legacy_fmt_rxq_size = <0x1000>;
				legacy_raw_head_tail_offset = <0x18>;
				legacy_raw_buffer_offset = <0x3000>;
				legacy_raw_txq_size = <0x1fd000>;
				legacy_raw_rxq_size = <0x200000>;
				ap2cp_msg = <0x01 0x00>;
				cp2ap_msg = <0x01 0x01>;
				ap2cp_united_status = <0x01 0x02>;
				cp2ap_united_status = <0x01 0x03>;
				ap2cp_kerneltime = <0x01 0x09>;
				srinfo_offset = <0xf800>;
				srinfo_size = <0x800>;
				clk_table_offset = <0x28>;
				sbi_lcd_status_mask = <0x01>;
				sbi_lcd_status_pos = <0x1b>;
				sbi_crash_type_mask = <0x0f>;
				sbi_crash_type_pos = <0x17>;
				sbi_ext_backtrace_mask = <0x01>;
				sbi_ext_backtrace_pos = <0x11>;
				sbi_uart_noti_mask = <0x01>;
				sbi_uart_noti_pos = <0x10>;
				sbi_ds_det_mask = <0x03>;
				sbi_ds_det_pos = <0x0e>;
				sbi_sys_rev_mask = <0xff>;
				sbi_sys_rev_pos = <0x06>;
				sbi_pda_active_mask = <0x01>;
				sbi_pda_active_pos = <0x05>;
				sbi_ap_status_mask = <0x0f>;
				sbi_ap_status_pos = <0x01>;
				sbi_cp_rat_mode_mask = <0x3f>;
				sbi_cp_rat_mode_pos = <0x1a>;
				sbi_cp_evs_mode_mask = <0x01>;
				sbi_cp_evs_mode_pos = <0x07>;
				sbi_cp2ap_wakelock_mask = <0x01>;
				sbi_cp2ap_wakelock_pos = <0x06>;
				sbi_lte_active_mask = <0x01>;
				sbi_lte_active_pos = <0x05>;
				sbi_cp_status_mask = <0x0f>;
				sbi_cp_status_pos = <0x01>;
				sbi_ap2cp_kerneltime_sec_mask = <0xfff>;
				sbi_ap2cp_kerneltime_sec_pos = <0x14>;
				sbi_ap2cp_kerneltime_usec_mask = <0xfffff>;
				sbi_ap2cp_kerneltime_usec_pos = <0x00>;
				cp_btl_node_name = "ramdump_memshare";
				mif,num_iodevs = <0x16>;
				phandle = <0x14>;

				iodevs {

					io_device_0 {
						iod,name = "umts_cass";
						iod,ch = <0x23>;
						iod,format = <0x01>;
						iod,io_type = <0x01>;
						iod,link_type = <0x00>;
						iod,attrs = <0x2082>;
						iod,max_tx_size = <0x800>;
						iod,ul_num_buffers = <0x10>;
						iod,ul_buffer_size = <0x800>;
						iod,dl_num_buffers = <0x10>;
						iod,dl_buffer_size = <0x800>;
					};

					io_device_1 {
						iod,name = "umts_ipc0";
						iod,ch = <0xeb>;
						iod,format = <0x00>;
						iod,io_type = <0x01>;
						iod,link_type = <0x00>;
						iod,attrs = <0x82>;
						iod,ul_num_buffers = <0x10>;
						iod,ul_buffer_size = <0x1000>;
						iod,dl_num_buffers = <0x20>;
						iod,dl_buffer_size = <0x1000>;
					};

					io_device_2 {
						iod,name = "umts_ipc1";
						iod,ch = <0xec>;
						iod,format = <0x00>;
						iod,io_type = <0x01>;
						iod,link_type = <0x00>;
						iod,attrs = <0x82>;
						iod,ul_num_buffers = <0x10>;
						iod,ul_buffer_size = <0x1000>;
						iod,dl_num_buffers = <0x20>;
						iod,dl_buffer_size = <0x1000>;
					};

					io_device_3 {
						iod,name = "umts_rfs0";
						iod,ch = <0xf5>;
						iod,format = <0x02>;
						iod,io_type = <0x01>;
						iod,link_type = <0x00>;
						iod,attrs = <0x82>;
						iod,ul_num_buffers = <0x10>;
						iod,ul_buffer_size = <0x800>;
						iod,dl_num_buffers = <0x200>;
						iod,dl_buffer_size = <0x800>;
					};

					io_device_4 {
						iod,name = "umts_csd";
						iod,ch = <0x01>;
						iod,format = <0x01>;
						iod,io_type = <0x01>;
						iod,link_type = <0x00>;
						iod,attrs = <0x82>;
						iod,ul_num_buffers = <0x20>;
						iod,ul_buffer_size = <0x800>;
						iod,dl_num_buffers = <0x40>;
						iod,dl_buffer_size = <0x800>;
					};

					io_device_5 {
						iod,name = "umts_router";
						iod,ch = <0x19>;
						iod,format = <0x01>;
						iod,io_type = <0x01>;
						iod,link_type = <0x00>;
						iod,attrs = <0x82>;
						iod,ul_num_buffers = <0x10>;
						iod,ul_buffer_size = <0x800>;
						iod,dl_num_buffers = <0x10>;
						iod,dl_buffer_size = <0x800>;
					};

					io_device_6 {
						iod,name = "umts_dm0";
						iod,ch = <0x1c>;
						iod,format = <0x01>;
						iod,io_type = <0x01>;
						iod,link_type = <0x00>;
						iod,attrs = <0x82>;
						iod,ul_num_buffers = <0x10>;
						iod,ul_buffer_size = <0x800>;
						iod,dl_num_buffers = <0x80>;
						iod,dl_buffer_size = <0x800>;
					};

					io_device_7 {
						iod,name = "ipc_loopback0";
						iod,ch = <0xf4>;
						iod,format = <0x00>;
						iod,io_type = <0x01>;
						iod,link_type = <0x00>;
						iod,attrs = <0x82>;
						iod,ul_num_buffers = <0x10>;
						iod,ul_buffer_size = <0x800>;
						iod,dl_num_buffers = <0x20>;
						iod,dl_buffer_size = <0x800>;
					};

					io_device_8 {
						iod,name = "rmnet0";
						iod,ch = <0x0a>;
						iod,format = <0x01>;
						iod,io_type = <0x02>;
						iod,link_type = <0x00>;
						iod,attrs = <0x180>;
						iod,ul_num_buffers = <0x00>;
						iod,ul_buffer_size = <0x800>;
						iod,dl_num_buffers = <0x00>;
						iod,dl_buffer_size = <0x800>;
					};

					io_device_9 {
						iod,name = "rmnet1";
						iod,ch = <0x0b>;
						iod,format = <0x01>;
						iod,io_type = <0x02>;
						iod,link_type = <0x00>;
						iod,attrs = <0x180>;
						iod,ul_num_buffers = <0x00>;
						iod,ul_buffer_size = <0x800>;
						iod,dl_num_buffers = <0x00>;
						iod,dl_buffer_size = <0x800>;
					};

					io_device_10 {
						iod,name = "rmnet2";
						iod,ch = <0x0c>;
						iod,format = <0x01>;
						iod,io_type = <0x02>;
						iod,link_type = <0x00>;
						iod,attrs = <0x180>;
						iod,ul_num_buffers = <0x00>;
						iod,ul_buffer_size = <0x800>;
						iod,dl_num_buffers = <0x00>;
						iod,dl_buffer_size = <0x800>;
					};

					io_device_11 {
						iod,name = "rmnet3";
						iod,ch = <0x0d>;
						iod,format = <0x01>;
						iod,io_type = <0x02>;
						iod,link_type = <0x00>;
						iod,attrs = <0x180>;
						iod,ul_num_buffers = <0x00>;
						iod,ul_buffer_size = <0x800>;
						iod,dl_num_buffers = <0x00>;
						iod,dl_buffer_size = <0x800>;
					};

					io_device_12 {
						iod,name = "rmnet4";
						iod,ch = <0x0e>;
						iod,format = <0x01>;
						iod,io_type = <0x02>;
						iod,link_type = <0x00>;
						iod,attrs = <0x180>;
						iod,ul_num_buffers = <0x00>;
						iod,ul_buffer_size = <0x800>;
						iod,dl_num_buffers = <0x00>;
						iod,dl_buffer_size = <0x800>;
					};

					io_device_13 {
						iod,name = "rmnet5";
						iod,ch = <0x0f>;
						iod,format = <0x01>;
						iod,io_type = <0x02>;
						iod,link_type = <0x00>;
						iod,attrs = <0x180>;
						iod,ul_num_buffers = <0x00>;
						iod,ul_buffer_size = <0x800>;
						iod,dl_num_buffers = <0x00>;
						iod,dl_buffer_size = <0x800>;
					};

					io_device_14 {
						iod,name = "rmnet6";
						iod,ch = <0x10>;
						iod,format = <0x01>;
						iod,io_type = <0x02>;
						iod,link_type = <0x00>;
						iod,attrs = <0x180>;
						iod,ul_num_buffers = <0x00>;
						iod,ul_buffer_size = <0x800>;
						iod,dl_num_buffers = <0x00>;
						iod,dl_buffer_size = <0x800>;
					};

					io_device_15 {
						iod,name = "rmnet7";
						iod,ch = <0x11>;
						iod,format = <0x01>;
						iod,io_type = <0x02>;
						iod,link_type = <0x00>;
						iod,attrs = <0x180>;
						iod,ul_num_buffers = <0x00>;
						iod,ul_buffer_size = <0x800>;
						iod,dl_num_buffers = <0x00>;
						iod,dl_buffer_size = <0x800>;
					};

					io_device_16 {
						iod,name = "multipdp_hiprio";
						iod,ch = <0x00>;
						iod,format = <0x03>;
						iod,io_type = <0x03>;
						iod,link_type = <0x00>;
						iod,attrs = <0x180>;
						iod,ul_num_buffers = <0x100>;
						iod,ul_buffer_size = <0x800>;
						iod,dl_num_buffers = <0x400>;
						iod,dl_buffer_size = <0x800>;
					};

					io_device_17 {
						iod,name = "multipdp";
						iod,ch = <0x00>;
						iod,format = <0x03>;
						iod,io_type = <0x03>;
						iod,link_type = <0x00>;
						iod,attrs = <0x180>;
						iod,ul_num_buffers = <0x200>;
						iod,ul_buffer_size = <0x800>;
						iod,dl_num_buffers = <0x400>;
						iod,dl_buffer_size = <0x800>;
					};

					io_device_18 {
						iod,name = "umts_boot0";
						iod,ch = <0xd7>;
						iod,format = <0x04>;
						iod,io_type = <0x00>;
						iod,link_type = <0x00>;
						iod,attrs = <0x02>;
					};

					io_device_19 {
						iod,name = "umts_ramdump0";
						iod,ch = <0xe1>;
						iod,format = <0x05>;
						iod,io_type = <0x00>;
						iod,link_type = <0x00>;
						iod,attrs = <0x202>;
					};

					io_device_20 {
						iod,name = "smd4";
						iod,ch = <0x21>;
						iod,format = <0x01>;
						iod,io_type = <0x01>;
						iod,link_type = <0x00>;
						iod,attrs = <0x882>;
						iod,ul_num_buffers = <0x10>;
						iod,ul_buffer_size = <0x800>;
						iod,dl_num_buffers = <0x80>;
						iod,dl_buffer_size = <0x800>;
						iod,option_region = "kor_skt";
					};

					io_device_21 {
						iod,name = "umts_ciq0";
						iod,ch = <0x1a>;
						iod,format = <0x01>;
						iod,io_type = <0x01>;
						iod,link_type = <0x00>;
						iod,attrs = <0x882>;
						iod,ul_num_buffers = <0x10>;
						iod,ul_buffer_size = <0x800>;
						iod,dl_num_buffers = <0x80>;
						iod,dl_buffer_size = <0x800>;
						iod,option_region = "usa_";
					};
				};
			};

			cp_mailbox {
				compatible = "samsung,exynos-cp-mailbox";
				reg = <0x00 0x11920000 0x180>;
				interrupt-parent = <0xffffffff>;
				interrupts = <0x00 0x33 0x04>;
				mcu,name = "cp_mailbox";
				mcu,id = <0x00>;
				mcu,irq_affinity_mask = <0x03>;
			};

			cp_shmem {
				compatible = "samsung,exynos-cp-shmem";
				cp_num = <0x00>;
				use_mem_map_on_cp = <0x01>;

				regions {

					cp {
						region,name = "CP";
						region,index = <0x00>;
						region,rmem = <0x00>;
						region,offset = <0x00>;
						region,size = <0x6900000>;
						region,cached = <0x00>;
					};

					vss {
						region,name = "VSS";
						region,index = <0x01>;
						region,rmem = <0x00>;
						region,offset = <0x6900000>;
						region,size = <0x700000>;
						region,cached = <0x00>;
					};

					ipc {
						region,name = "IPC";
						region,index = <0x03>;
						region,rmem = <0x00>;
						region,offset = <0x7000000>;
						region,size = <0x800000>;
						region,cached = <0x00>;
					};

					btl {
						region,name = "BTL";
						region,index = <0x05>;
						region,rmem = <0x00>;
						region,offset = <0x7800000>;
						region,size = <0x1000000>;
						region,cached = <0x00>;
					};
				};
			};
		};
	};

	fragment@8 {
		target = <0xffffffff>;

		__overlay__ {

			rffe1_clk {
				samsung,pins = "gpa1-4";
				samsung,pin-function = <0x03>;
				samsung,pin-pud = <0x00>;
				phandle = <0x15>;
			};

			rffe1_data {
				samsung,pins = "gpa1-5";
				samsung,pin-function = <0x03>;
				samsung,pin-pud = <0x00>;
				phandle = <0x16>;
			};

			b7_prx_lna_en {
				samsung,pins = "gpa2-1";
				samsung,pin-function = <0x03>;
				samsung,pin-pud = <0x00>;
				phandle = <0x17>;
			};
		};
	};

	fragment@battery {
		target-path = [2f 00];

		__overlay__ {

			battery {
				status = "okay";
				compatible = "samsung,s2m-battery";
				pinctrl-names = "default";
				battery,vendor = "SDI SDI";
				battery,charger_name = "s2mu106-charger";
				battery,fuelgauge_name = "s2mu106-fuelgauge";
				battery,technology = <0x02>;
				battery,temp_high = <0x1f4>;
				battery,temp_high_recovery = <0x1c2>;
				battery,temp_low = <0x64>;
				battery,temp_low_recovery = <0x96>;
				battery,low_temp_limit = <0x64>;
				battery,chg_float_voltage = <0x1130>;
				battery,full_check_count = <0x03>;
				battery,chg_full_vcell = <0x1108>;
				battery,chg_recharge_vcell = <0x10cc>;
				battery,max_rawsoc = <0x3e8>;
				battery,max_rawsoc_offset = <0x0a>;
				battery,default_input_current = <0x3e8>;
				battery,default_charging_current = <0x3e8>;
				battery,default_full_check_current = <0x12c>;
				battery,max_input_current = <0xbb8>;
				battery,max_charging_current = <0xbb8>;
				battery,pdo_max_input_vol = <0x1388>;
				battery,pdo_max_chg_power = <0x3a98>;
				battery,input_current_limit = <0x1f4 0x1c2 0x1f4 0xbb8 0x1f4 0x4b0 0x4b0 0x3e8 0x3e8 0xbb8 0x3e8 0x1f4 0x1f4 0xbb8 0x7d0 0x1f4 0x1c2>;
				battery,fast_charging_current = <0x1f4 0x1c2 0x1f4 0xbb8 0x1f4 0x4b0 0x4b0 0x3e8 0x3e8 0xbb8 0x3e8 0x1f4 0x1f4 0xbb8 0x7d0 0x1f4 0x1c2>;
				battery,full_check_current = <0x12c 0x00 0x12c 0x12c 0x12c 0x12c 0x12c 0x12c 0x12c 0x12c 0x12c 0x12c 0x12c 0x12c 0x12c 0x12c 0x00>;
				battery,battery_table3 = <0x58 0x0b 0xd6 0x0a 0x54 0x0a 0xda 0x09 0x64 0x09 0xf3 0x08 0x8c 0x08 0x22 0x08 0xcd 0x07 0x7b 0x07 0x08 0x07 0xc6 0x06 0x97 0x06 0x71 0x06 0x54 0x06 0x39 0x06 0x0f 0x06 0xea 0x05 0xaf 0x05 0x85 0x05 0xfd 0x04 0xb2 0x01 0x69 0x08 0x00 0x08 0x97 0x07 0x2d 0x07 0xc4 0x06 0x5a 0x06 0xf1 0x05 0x87 0x05 0x1e 0x05 0xb5 0x04 0x4b 0x04 0xe2 0x03 0x78 0x03 0x0f 0x03 0xa6 0x02 0x3c 0x02 0xd3 0x01 0x69 0x01 0x00 0x01 0x96 0x00 0x2d 0x00 0xda 0x0f>;
				battery,battery_table4 = <0x21 0x21 0x21 0x21 0x21 0x21 0x21 0x21 0x21 0x20 0x20 0x21 0x21 0x21 0x21 0x22 0x22 0x22 0x22 0x24 0x26 0x7c>;
				battery,batcap = <0xb0 0x36 0xac 0x0d>;
				battery,accum = <0x08 0x00>;
				battery,soc_arr_val = <0x2912 0x2710 0x250d 0x230a 0x2107 0x1f05 0x1d02 0x1aff 0x18fc 0x16fa 0x14f7 0x12f4 0x10f2 0xeef 0xcec 0xae9 0x8e7 0x6e4 0x4e1 0x2de 0xdc 0xffffff47>;
				battery,ocv_arr_val = <0xac93 0xaa18 0xa79e 0xa54b 0xa30c 0xa0e4 0x9eeb 0x9ce7 0x9b45 0x99b7 0x9787 0x9645 0x955d 0x94a6 0x9417 0x9392 0x92c6 0x920e 0x90f2 0x9024 0x8d8c 0x7d78>;
				battery,battery_param_ver = <0x03>;
			};
		};
	};

	fragment@model {
		target-path = [2f 00];

		__overlay__ {
			#address-cells = <0x02>;
			#size-cells = <0x01>;
			model = "Samsung UNIVERSAL3830 board based on EXYNOS3830";

			audio-codec-dummy {
				compatible = "snd-soc-dummy";
				#sound-dai-cells = <0x00>;
				phandle = <0x0b>;
			};

			sound {
				compatible = "samsung,exynos3830-madera";
				samsung,routing = "SPEAKER\0OUTL\0AEC Loopback\0SPEAKER FB\0ABOX SPDY Capture\0VINPUT_FM\0BLUETOOTH2 SPK\0ABOX UAIF2 Playback\0ABOX UAIF2 Capture\0BLUETOOTH2 MIC";
				samsung,aux = <0xffffffff>;

				rdma0 {

					cpu {
						sound-dai = <0xffffffff 0x00>;
					};

					platform {
						sound-dai = <0xffffffff 0x00>;
					};

					codec {
						sound-dai = <0x0b>;
					};
				};

				rdma1 {

					cpu {
						sound-dai = <0xffffffff 0x00>;
					};

					platform {
						sound-dai = <0xffffffff 0x00>;
					};

					codec {
						sound-dai = <0x0b>;
					};
				};

				rdma2 {

					cpu {
						sound-dai = <0xffffffff 0x00>;
					};

					platform {
						sound-dai = <0xffffffff 0x00>;
					};

					codec {
						sound-dai = <0x0b>;
					};
				};

				rdma3 {

					cpu {
						sound-dai = <0xffffffff 0x00>;
					};

					platform {
						sound-dai = <0xffffffff 0x00>;
					};

					codec {
						sound-dai = <0x0b>;
					};
				};

				rdma4 {

					cpu {
						sound-dai = <0xffffffff 0x00>;
					};

					platform {
						sound-dai = <0xffffffff 0x00>;
					};

					codec {
						sound-dai = <0x0b>;
					};
				};

				rdma5 {

					cpu {
						sound-dai = <0xffffffff 0x00>;
					};

					platform {
						sound-dai = <0xffffffff 0x00>;
					};

					codec {
						sound-dai = <0x0b>;
					};
				};

				rdma6 {

					cpu {
						sound-dai = <0xffffffff 0x00>;
					};

					platform {
						sound-dai = <0xffffffff 0x00>;
					};

					codec {
						sound-dai = <0x0b>;
					};
				};

				rdma7 {

					cpu {
						sound-dai = <0xffffffff 0x00>;
					};

					platform {
						sound-dai = <0xffffffff 0x00>;
					};

					codec {
						sound-dai = <0x0b>;
					};
				};

				rdma8 {

					cpu {
						sound-dai = <0xffffffff 0x00>;
					};

					platform {
						sound-dai = <0xffffffff 0x00>;
					};

					codec {
						sound-dai = <0x0b>;
					};
				};

				rdma9 {

					cpu {
						sound-dai = <0xffffffff 0x00>;
					};

					platform {
						sound-dai = <0xffffffff 0x00>;
					};

					codec {
						sound-dai = <0x0b>;
					};
				};

				rdma10 {

					cpu {
						sound-dai = <0xffffffff 0x00>;
					};

					platform {
						sound-dai = <0xffffffff 0x00>;
					};

					codec {
						sound-dai = <0x0b>;
					};
				};

				rdma11 {

					cpu {
						sound-dai = <0xffffffff 0x00>;
					};

					platform {
						sound-dai = <0xffffffff 0x00>;
					};

					codec {
						sound-dai = <0x0b>;
					};
				};

				wdma0 {

					cpu {
						sound-dai = <0xffffffff 0x00>;
					};

					platform {
						sound-dai = <0xffffffff 0x00>;
					};

					codec {
						sound-dai = <0x0b>;
					};
				};

				wdma1 {

					cpu {
						sound-dai = <0xffffffff 0x00>;
					};

					platform {
						sound-dai = <0xffffffff 0x00>;
					};

					codec {
						sound-dai = <0x0b>;
					};
				};

				wdma2 {

					cpu {
						sound-dai = <0xffffffff 0x00>;
					};

					platform {
						sound-dai = <0xffffffff 0x00>;
					};

					codec {
						sound-dai = <0x0b>;
					};
				};

				wdma3 {

					cpu {
						sound-dai = <0xffffffff 0x00>;
					};

					platform {
						sound-dai = <0xffffffff 0x00>;
					};

					codec {
						sound-dai = <0x0b>;
					};
				};

				wdma4 {

					cpu {
						sound-dai = <0xffffffff 0x00>;
					};

					platform {
						sound-dai = <0xffffffff 0x00>;
					};

					codec {
						sound-dai = <0x0b>;
					};
				};

				dual0 {

					cpu {
						sound-dai = <0xffffffff>;
					};

					platform {
						sound-dai = <0xffffffff>;
					};

					codec {
						sound-dai = <0x0b>;
					};
				};

				dual1 {

					cpu {
						sound-dai = <0xffffffff>;
					};

					platform {
						sound-dai = <0xffffffff>;
					};

					codec {
						sound-dai = <0x0b>;
					};
				};

				dual2 {

					cpu {
						sound-dai = <0xffffffff>;
					};

					platform {
						sound-dai = <0xffffffff>;
					};

					codec {
						sound-dai = <0x0b>;
					};
				};

				dual3 {

					cpu {
						sound-dai = <0xffffffff>;
					};

					platform {
						sound-dai = <0xffffffff>;
					};

					codec {
						sound-dai = <0x0b>;
					};
				};

				dual4 {

					cpu {
						sound-dai = <0xffffffff>;
					};

					platform {
						sound-dai = <0xffffffff>;
					};

					codec {
						sound-dai = <0x0b>;
					};
				};

				ddma0 {

					cpu {
						sound-dai = <0xffffffff>;
					};

					platform {
						sound-dai = <0xffffffff>;
					};

					codec {
						sound-dai = <0x0b>;
					};
				};

				ddma1 {

					cpu {
						sound-dai = <0xffffffff>;
					};

					platform {
						sound-dai = <0xffffffff>;
					};

					codec {
						sound-dai = <0x0b>;
					};
				};

				ddma2 {

					cpu {
						sound-dai = <0xffffffff>;
					};

					platform {
						sound-dai = <0xffffffff>;
					};

					codec {
						sound-dai = <0x0b>;
					};
				};

				ddma3 {

					cpu {
						sound-dai = <0xffffffff>;
					};

					platform {
						sound-dai = <0xffffffff>;
					};

					codec {
						sound-dai = <0x0b>;
					};
				};

				ddma4 {

					cpu {
						sound-dai = <0xffffffff>;
					};

					platform {
						sound-dai = <0xffffffff>;
					};

					codec {
						sound-dai = <0x0b>;
					};
				};

				ddma5 {

					cpu {
						sound-dai = <0xffffffff>;
					};

					platform {
						sound-dai = <0xffffffff>;
					};

					codec {
						sound-dai = <0x0b>;
					};
				};

				uaif0 {
					format = "i2s";

					cpu {
						sound-dai = <0xffffffff>;
					};

					codec {
						sound-dai = <0x0c>;
					};
				};

				uaif1 {
					format = "i2s";

					cpu {
						sound-dai = <0xffffffff>;
					};

					codec {
						sound-dai = <0x0d>;
					};
				};

				uaif2 {
					format = "i2s";

					cpu {
						sound-dai = <0xffffffff>;
					};

					codec {
						sound-dai = <0x0b>;
					};
				};

				spdy {

					cpu {
						sound-dai = <0xffffffff>;
					};

					codec {
						sound-dai = <0x0b>;
					};
				};

				sifs0 {

					cpu {
						sound-dai = <0xffffffff 0x00>;
					};

					codec {
						sound-dai = <0x0b>;
					};
				};

				sifs1 {

					cpu {
						sound-dai = <0xffffffff 0x01>;
					};

					codec {
						sound-dai = <0x0b>;
					};
				};

				sifs2 {

					cpu {
						sound-dai = <0xffffffff 0x02>;
					};

					codec {
						sound-dai = <0x0b>;
					};
				};

				sifs3 {

					cpu {
						sound-dai = <0xffffffff 0x03>;
					};

					codec {
						sound-dai = <0x0b>;
					};
				};

				sifs4 {

					cpu {
						sound-dai = <0xffffffff 0x04>;
					};

					codec {
						sound-dai = <0x0b>;
					};
				};

				sifs5 {

					cpu {
						sound-dai = <0xffffffff 0x05>;
					};

					codec {
						sound-dai = <0x0b>;
					};
				};

				nsrc0 {

					cpu {
						sound-dai = <0xffffffff 0x06>;
					};

					codec {
						sound-dai = <0x0b>;
					};
				};

				nsrc1 {

					cpu {
						sound-dai = <0xffffffff 0x07>;
					};

					codec {
						sound-dai = <0x0b>;
					};
				};

				nsrc2 {

					cpu {
						sound-dai = <0xffffffff 0x08>;
					};

					codec {
						sound-dai = <0x0b>;
					};
				};

				nsrc3 {

					cpu {
						sound-dai = <0xffffffff 0x09>;
					};

					codec {
						sound-dai = <0x0b>;
					};
				};

				nsrc4 {

					cpu {
						sound-dai = <0xffffffff 0x0a>;
					};

					codec {
						sound-dai = <0x0b>;
					};
				};

				rdma0_be {

					cpu {
						sound-dai = <0xffffffff 0x01>;
					};

					platform {
						sound-dai = <0xffffffff 0x01>;
					};

					codec {
						sound-dai = <0x0b>;
					};
				};

				rdma1_be {

					cpu {
						sound-dai = <0xffffffff 0x01>;
					};

					platform {
						sound-dai = <0xffffffff 0x01>;
					};

					codec {
						sound-dai = <0x0b>;
					};
				};

				rdma2_be {

					cpu {
						sound-dai = <0xffffffff 0x01>;
					};

					platform {
						sound-dai = <0xffffffff 0x01>;
					};

					codec {
						sound-dai = <0x0b>;
					};
				};

				rdma3_be {

					cpu {
						sound-dai = <0xffffffff 0x01>;
					};

					platform {
						sound-dai = <0xffffffff 0x01>;
					};

					codec {
						sound-dai = <0x0b>;
					};
				};

				rdma4_be {

					cpu {
						sound-dai = <0xffffffff 0x01>;
					};

					platform {
						sound-dai = <0xffffffff 0x01>;
					};

					codec {
						sound-dai = <0x0b>;
					};
				};

				rdma5_be {

					cpu {
						sound-dai = <0xffffffff 0x01>;
					};

					platform {
						sound-dai = <0xffffffff 0x01>;
					};

					codec {
						sound-dai = <0x0b>;
					};
				};

				rdma6_be {

					cpu {
						sound-dai = <0xffffffff 0x01>;
					};

					platform {
						sound-dai = <0xffffffff 0x01>;
					};

					codec {
						sound-dai = <0x0b>;
					};
				};

				rdma7_be {

					cpu {
						sound-dai = <0xffffffff 0x01>;
					};

					platform {
						sound-dai = <0xffffffff 0x01>;
					};

					codec {
						sound-dai = <0x0b>;
					};
				};

				rdma8_be {

					cpu {
						sound-dai = <0xffffffff 0x01>;
					};

					platform {
						sound-dai = <0xffffffff 0x01>;
					};

					codec {
						sound-dai = <0x0b>;
					};
				};

				rdma9_be {

					cpu {
						sound-dai = <0xffffffff 0x01>;
					};

					platform {
						sound-dai = <0xffffffff 0x01>;
					};

					codec {
						sound-dai = <0x0b>;
					};
				};

				rdma10_be {

					cpu {
						sound-dai = <0xffffffff 0x01>;
					};

					platform {
						sound-dai = <0xffffffff 0x01>;
					};

					codec {
						sound-dai = <0x0b>;
					};
				};

				rdma11_be {

					cpu {
						sound-dai = <0xffffffff 0x01>;
					};

					platform {
						sound-dai = <0xffffffff 0x01>;
					};

					codec {
						sound-dai = <0x0b>;
					};
				};

				wdma0_be {

					cpu {
						sound-dai = <0xffffffff 0x01>;
					};

					platform {
						sound-dai = <0xffffffff 0x01>;
					};

					codec {
						sound-dai = <0x0b>;
					};
				};

				wdma1_be {

					cpu {
						sound-dai = <0xffffffff 0x01>;
					};

					platform {
						sound-dai = <0xffffffff 0x01>;
					};

					codec {
						sound-dai = <0x0b>;
					};
				};

				wdma2_be {

					cpu {
						sound-dai = <0xffffffff 0x01>;
					};

					platform {
						sound-dai = <0xffffffff 0x01>;
					};

					codec {
						sound-dai = <0x0b>;
					};
				};

				wdma3_be {

					cpu {
						sound-dai = <0xffffffff 0x01>;
					};

					platform {
						sound-dai = <0xffffffff 0x01>;
					};

					codec {
						sound-dai = <0x0b>;
					};
				};

				wdma4_be {

					cpu {
						sound-dai = <0xffffffff 0x01>;
					};

					platform {
						sound-dai = <0xffffffff 0x01>;
					};

					codec {
						sound-dai = <0x0b>;
					};
				};
			};

			hs_tune {
				status = "disabled";
				hs_tune_cnt = <0x0a>;
				phandle = <0x11>;

				hs_tune1 {
					tune_name = "tx_pre_emp";
					tune_value = <0x03 0x03>;
				};

				hs_tune2 {
					tune_name = "tx_pre_emp_plus";
					tune_value = <0x00 0x00>;
				};

				hs_tune3 {
					tune_name = "tx_vref";
					tune_value = <0x0f 0x0f>;
				};

				hs_tune4 {
					tune_name = "rx_sqrx";
					tune_value = <0x07 0x07>;
				};

				hs_tune5 {
					tune_name = "tx_rise";
					tune_value = <0x03 0x03>;
				};

				hs_tune6 {
					tune_name = "compdis";
					tune_value = <0x07 0x07>;
				};

				hs_tune7 {
					tune_name = "tx_hsxv";
					tune_value = <0x03 0x03>;
				};

				hs_tune8 {
					tune_name = "tx_fsls";
					tune_value = <0x03 0x03>;
				};

				hs_tune9 {
					tune_name = "tx_res";
					tune_value = <0x03 0x03>;
				};

				hs_tune10 {
					tune_name = "utmi_clk";
					tune_value = <0x01 0x01>;
				};
			};

			usb_notifier {
				compatible = "samsung,usb-notifier";
				udc = <0xffffffff>;
			};

			acpm_mfd_bus@11A50000 {
				status = "okay";
				#address-cells = <0x01>;
				#size-cells = <0x00>;
				interrupt-parent = <0xffffffff>;

				aud3004x@07 {
					compatible = "codec,aud3004x";
					#sound-dai-cells = <0x00>;
					reg = <0x07>;
					i2c-speedy-address;
					pinctrl-names = "default";
					io-channels = <0xffffffff 0x07 0xffffffff 0x06>;
					io-channel-names = "adc-gdet\0adc-ear";
					#io-channel-cells = <0x01>;
					mic-adc-range = <0x57c>;
					adc-thd-fake-jack = <0x141>;
					adc-thd-auxcable = <0x227>;
					adc-thd-water-in = <0x29f>;
					adc-thd-water-out = <0xc4f>;
					but-zones-list = <0x0e 0xe2 0x00 0x15e 0x0e 0x246 0x15f 0x1f4 0x0e 0x73 0x1f5 0x2bc 0x0e 0x72 0x2bd 0x489>;
					btn-release-value = <0x57c>;
					phandle = <0x0c>;
				};

				s2mpu12mfd@00 {
					compatible = "samsung,s2mpu12mfd";
					acpm-ipc-channel = <0x02>;
					i2c-speedy-address;
					s2mpu12,wakeup = "enabled";
					reg = <0x00>;
					interrupts = <0x00 0x38 0x04>;
					pinctrl-names = "default";
					pinctrl-0 = <0x0f>;
					wtsr_en = "enabled";
					smpl_en = "enabled";
					wtsr_timer_val = <0x03>;
					smpl_timer_val = <0x04>;
					check_jigon = <0x00>;
					init_time,sec = <0x00>;
					init_time,min = <0x00>;
					init_time,hour = <0x0c>;
					init_time,mday = <0x01>;
					init_time,mon = <0x00>;
					init_time,year = <0x77>;
					init_time,wday = <0x02>;

					s2mpu12-keys {

						button@1 {
							label = "pmic-keys: KEY_POWER";
							linux,code = <0x74>;
							wakeup = <0x01>;
						};
					};

					regulators {

						BUCK1 {
							regulator-name = "vdd_cpu";
							regulator-min-microvolt = <0x7a120>;
							regulator-max-microvolt = <0x124f80>;
							regulator-always-on;
							regulator-ramp-delay = <0x1770>;
							regulator-initial-mode = <0x01>;
							phandle = <0x18>;
						};

						BUCK2 {
							regulator-name = "vdd_gpu";
							regulator-min-microvolt = <0x7a120>;
							regulator-max-microvolt = <0x124f80>;
							regulator-always-on;
							regulator-ramp-delay = <0x1770>;
							regulator-initial-mode = <0x01>;
							phandle = <0x19>;
						};

						BUCK4 {
							regulator-name = "vdd_lldo";
							regulator-min-microvolt = <0xdbba0>;
							regulator-max-microvolt = <0x16e360>;
							regulator-always-on;
							regulator-ramp-delay = <0x1770>;
							regulator-initial-mode = <0x03>;
							phandle = <0x1a>;
						};

						BUCK5 {
							regulator-name = "vdd_mldo";
							regulator-min-microvolt = <0x1b7740>;
							regulator-max-microvolt = <0x200b20>;
							regulator-always-on;
							regulator-ramp-delay = <0x1770>;
							regulator-initial-mode = <0x03>;
							phandle = <0x1b>;
						};

						LDO1 {
							regulator-name = "vdd_ldo1";
							regulator-min-microvolt = <0xaae60>;
							regulator-max-microvolt = <0x13d620>;
							regulator-always-on;
							regulator-ramp-delay = <0x2ee0>;
							regulator-initial-mode = <0x03>;
							phandle = <0x1c>;
						};

						LDO2 {
							regulator-name = "vdd_ldo2";
							regulator-min-microvolt = <0x186a00>;
							regulator-max-microvolt = <0x1dc130>;
							regulator-always-on;
							regulator-ramp-delay = <0x2ee0>;
							regulator-initial-mode = <0x03>;
							phandle = <0x1d>;
						};

						LDO3 {
							regulator-name = "vdd_ldo3";
							regulator-min-microvolt = <0xaae60>;
							regulator-max-microvolt = <0x13d620>;
							regulator-always-on;
							regulator-ramp-delay = <0x2ee0>;
							regulator-initial-mode = <0x01>;
							phandle = <0x1e>;
						};

						LDO4 {
							regulator-name = "vdd_ldo4";
							regulator-min-microvolt = <0x186a00>;
							regulator-max-microvolt = <0x1dc130>;
							regulator-always-on;
							regulator-ramp-delay = <0x2ee0>;
							regulator-initial-mode = <0x01>;
							phandle = <0x1f>;
						};

						LDO5 {
							regulator-name = "vdd_ldo5";
							regulator-min-microvolt = <0xaae60>;
							regulator-max-microvolt = <0x13d620>;
							regulator-always-on;
							regulator-ramp-delay = <0x2ee0>;
							regulator-initial-mode = <0x03>;
							phandle = <0x20>;
						};

						LDO6 {
							regulator-name = "vdd_ldo6";
							regulator-min-microvolt = <0x7a120>;
							regulator-max-microvolt = <0x121eac>;
							regulator-always-on;
							regulator-ramp-delay = <0x2ee0>;
							regulator-initial-mode = <0x01>;
							phandle = <0x21>;
						};

						LDO7 {
							regulator-name = "vdd_ldo7";
							regulator-min-microvolt = <0xaae60>;
							regulator-max-microvolt = <0x13d620>;
							regulator-always-on;
							regulator-ramp-delay = <0x2ee0>;
							regulator-initial-mode = <0x01>;
							phandle = <0x22>;
						};

						LDO8 {
							regulator-name = "vdd_ldo8";
							regulator-min-microvolt = <0x7a120>;
							regulator-max-microvolt = <0x13d620>;
							regulator-always-on;
							regulator-ramp-delay = <0x2ee0>;
							regulator-initial-mode = <0x01>;
							phandle = <0x23>;
						};

						LDO9 {
							regulator-name = "vdd_ldo9";
							regulator-min-microvolt = <0x7a120>;
							regulator-max-microvolt = <0x13d620>;
							regulator-always-on;
							regulator-ramp-delay = <0x2ee0>;
							regulator-initial-mode = <0x01>;
							phandle = <0x24>;
						};

						LDO10 {
							regulator-name = "vqmmc";
							regulator-min-microvolt = <0x1b7740>;
							regulator-max-microvolt = <0x337f98>;
							regulator-ramp-delay = <0x2ee0>;
							regulator-initial-mode = <0x03>;
							phandle = <0x25>;
						};

						LDO11 {
							regulator-name = "vdd_ldo11";
							regulator-min-microvolt = <0x1b7740>;
							regulator-max-microvolt = <0x337f98>;
							regulator-always-on;
							regulator-ramp-delay = <0x2ee0>;
							regulator-initial-mode = <0x03>;
							phandle = <0x26>;
						};

						LDO23 {
							regulator-name = "vdd_ldo23";
							regulator-min-microvolt = <0x1b7740>;
							regulator-max-microvolt = <0x337f98>;
							regulator-always-on;
							regulator-ramp-delay = <0x2ee0>;
							regulator-initial-mode = <0x03>;
							phandle = <0x27>;
						};

						LDO24 {
							regulator-name = "vmmc";
							regulator-min-microvolt = <0x1b7740>;
							regulator-max-microvolt = <0x337f98>;
							regulator-ramp-delay = <0x2ee0>;
							regulator-initial-mode = <0x03>;
							phandle = <0x28>;
						};

						LDO25 {
							regulator-name = "vdd_ldo25";
							regulator-min-microvolt = <0x1b7740>;
							regulator-max-microvolt = <0x337f98>;
							regulator-always-on;
							regulator-ramp-delay = <0x2ee0>;
							regulator-initial-mode = <0x03>;
							phandle = <0x29>;
						};

						LDO26 {
							regulator-name = "vdd_ldo26";
							regulator-min-microvolt = <0x1b7740>;
							regulator-max-microvolt = <0x337f98>;
							regulator-always-on;
							regulator-ramp-delay = <0x2ee0>;
							regulator-initial-mode = <0x03>;
							phandle = <0x2a>;
						};

						LDO27 {
							regulator-name = "vdd_ldo27";
							regulator-min-microvolt = <0x1b7740>;
							regulator-max-microvolt = <0x337f98>;
							regulator-always-on;
							regulator-ramp-delay = <0x2ee0>;
							regulator-initial-mode = <0x03>;
							phandle = <0x2b>;
						};

						LDO28 {
							regulator-name = "vdd_ldo28";
							regulator-min-microvolt = <0x186a00>;
							regulator-max-microvolt = <0x1dc130>;
							regulator-boot-on;
							regulator-ramp-delay = <0x2ee0>;
							regulator-initial-mode = <0x03>;
							phandle = <0x2c>;
						};

						LDO29 {
							regulator-name = "vdd_ldo29";
							regulator-min-microvolt = <0xaae60>;
							regulator-max-microvolt = <0x13d620>;
							regulator-always-on;
							regulator-ramp-delay = <0x2ee0>;
							regulator-initial-mode = <0x03>;
							phandle = <0x2d>;
						};

						LDO30 {
							regulator-name = "vdd_ldo30";
							regulator-min-microvolt = <0x186a00>;
							regulator-max-microvolt = <0x1dc130>;
							regulator-always-on;
							regulator-ramp-delay = <0x2ee0>;
							regulator-initial-mode = <0x03>;
							phandle = <0x2e>;
						};

						LDO31 {
							regulator-name = "vdd_ldo31";
							regulator-min-microvolt = <0x1b7740>;
							regulator-max-microvolt = <0x337f98>;
							regulator-always-on;
							regulator-ramp-delay = <0x2ee0>;
							regulator-initial-mode = <0x03>;
							phandle = <0x2f>;
						};

						LDO32 {
							regulator-name = "vdd_ldo32";
							regulator-min-microvolt = <0x1b7740>;
							regulator-max-microvolt = <0x337f98>;
							regulator-always-on;
							regulator-ramp-delay = <0x2ee0>;
							regulator-initial-mode = <0x03>;
							phandle = <0x30>;
						};

						LDO33 {
							regulator-name = "vdd_aldo1";
							regulator-min-microvolt = <0x186a00>;
							regulator-max-microvolt = <0x1dc130>;
							regulator-always-on;
							regulator-ramp-delay = <0x2ee0>;
							regulator-initial-mode = <0x03>;
							phandle = <0x31>;
						};

						LDO34 {
							regulator-name = "vdd_aldo2";
							regulator-min-microvolt = <0x1b7740>;
							regulator-max-microvolt = <0x337f98>;
							regulator-always-on;
							regulator-ramp-delay = <0x2ee0>;
							regulator-initial-mode = <0x03>;
							phandle = <0x32>;
						};

						LDO35 {
							regulator-name = "vdd_ldo_core";
							regulator-min-microvolt = <0x186a00>;
							regulator-max-microvolt = <0x1dc130>;
							regulator-always-on;
							regulator-ramp-delay = <0x2ee0>;
							regulator-initial-mode = <0x01>;
							phandle = <0x33>;
						};

						LDO36 {
							regulator-name = "vdd_ldo_buf";
							regulator-min-microvolt = <0xaae60>;
							regulator-max-microvolt = <0x13d620>;
							regulator-always-on;
							regulator-ramp-delay = <0x2ee0>;
							regulator-initial-mode = <0x03>;
							phandle = <0x34>;
						};
					};
				};
			};
		};
	};

	fragment@9 {
		target = <0xffffffff>;

		__overlay__ {
			gpios = <0xffffffff 0x04 0x01 0xffffffff 0x01 0x01>;
			regulator_1p8v = "vdd_ldo28";
		};
	};

	fragment@10 {
		target = <0xffffffff>;

		__overlay__ {
			status = "okay";
		};
	};

	fragment@11 {
		target = <0xffffffff>;

		__overlay__ {

			if-pmic-irq {
				samsung,pins = "gpa2-5";
				samsung,pin-function = <0x00>;
				samsung,pin-pud = <0x00>;
				samsung,pin-drv = <0x00>;
				phandle = <0x09>;
			};

			intr-on {
				samsung,pins = "gpa0-0";
				samsung,pin-function = <0x0f>;
				samsung,pin-pud = <0x00>;
				samsung,pin-drv = <0x00>;
				phandle = <0x12>;
			};

			intr-off {
				samsung,pins = "gpa0-0";
				samsung,pin-function = <0x00>;
				samsung,pin-pud = <0x01>;
				phandle = <0x13>;
			};

			fuel-irq {
				samsung,pins = "gpa3-0";
				samsung,pin-function = <0x00>;
				samsung,pin-pud = <0x02>;
				samsung,pin-drv = <0x00>;
				phandle = <0x10>;
			};

			usbpd_irq {
				samsung,pins = "gpa0-6";
				samsung,pin-function = <0x0f>;
				samsung,pin-pud = <0x03>;
				samsung-pin-drv = <0x03>;
				phandle = <0x0a>;
			};
		};
	};

	fragment@12 {
		target = <0xffffffff>;

		__overlay__ {

			pm-wrstbi {
				samsung,pins = "gpg1-5";
				samsung,pin-con-pdn = <0x03>;
				phandle = <0x0f>;
			};
		};
	};

	fragment@13 {
		target = <0xffffffff>;

		__overlay__ {
			#address-cells = <0x01>;
			#size-cells = <0x00>;

			s2mu106@3d {
				compatible = "samsung,s2mu106mfd";
				reg = <0x3d>;
				pinctrl-names = "default";
				pinctrl-0 = <0x09>;
				s2mu106,irq-gpio = <0xffffffff 0x05 0x00>;
				s2mu106,wakeup;
			};

			s2mu106-fuelgauge@3B {
				compatible = "samsung,s2mu106-fuelgauge";
				reg = <0x3b>;
				pinctrl-names = "default";
				pinctrl-0 = <0x10>;
				fuelgauge,fuel_int = <0xffffffff 0x00 0x00>;
				fuelgauge,fuel_alert_vol = <0xd48>;
				fuelgauge,fuel_alert_soc = <0x01>;
				fuelgauge,type_str = "SDI";
				fuelgauge,model_type = <0x01>;
			};

			usbpd-s2mu106@3C {
				compatible = "sec-usbpd,i2c";
				reg = <0x3c>;
				pinctrl-names = "default";
				pinctrl-0 = <0x0a>;
				usbpd,usbpd_int = <0xffffffff 0x06 0x00>;

				pdic-manager {
					pdic,max_power = <0x1388>;
					pdic_op_power = <0x9c4>;
					pdic_max_voltage = <0x1770>;
					pdic_max_current = <0x7d0>;
					pdic,min_current = <0x1f4>;
					pdic,giveback = <0x00>;
					pdic,usb_com_capable = <0x01>;
					pdic,no_usb_suspend = <0x01>;
					source,max_voltage = <0x1388>;
					source,min_voltage = <0xfa0>;
					source,max_power = <0x9c4>;
					sink,capable_max_voltage = <0x1388>;
				};
			};
		};
	};

	fragment@14 {
		target = <0xffffffff>;

		__overlay__ {
			#address-cells = <0x01>;
			#size-cells = <0x00>;
			clock-frequency = <0x61a80>;
			status = "okay";

			lm36274@11 {
				compatible = "i2c,lm36274";
				reg = <0x11>;
			};
		};
	};

	fragment@15 {
		target = <0xffffffff>;

		__overlay__ {
			dr_mode = "otg";
			maximum-speed = "high-speed";
			snps,quirk-frame-length-adjustment = <0x20>;
			snps,u1u2_exitfail_quirk;
			snps,ux_exit_in_px_quirk;
			snps,elastic_buf_mode_quirk;
			snps,dis-u2-freeclk-exists-quirk;
			usb_audio_offloading = <0x00>;
		};
	};

	fragment@16 {
		target = <0xffffffff>;

		__overlay__ {
			status = "okay";
			usb3phy-isolation = <0x01>;
			pinctrl-names = "default";
			hs_tune_param = <0x11>;
		};
	};

	fragment@17 {
		target = <0xffffffff>;

		__overlay__ {
			status = "okay";
			usi_v2_mode = "spi";
		};
	};

	fragment@18 {
		target = <0xffffffff>;

		__overlay__ {
			#address-cells = <0x01>;
			#size-cells = <0x00>;
			status = "okay";
			pinctrl-names = "default\0sleep";
			pinctrl-0 = <0xffffffff 0xffffffff>;
			pinctrl-1 = <0xffffffff>;

			synaptics_tcm@0 {
				compatible = "synaptics,tcm-spi";
				reg = <0x00>;
				spi-max-frequency = <0x4c4b40>;
				pinctrl-names = "pmx_ts_active\0pmx_ts_suspend";
				pinctrl-0 = <0x12>;
				pinctrl-1 = <0x13>;
				synaptics,irq-gpio = <0xffffffff 0x00 0x2008>;
				synaptics,irq-on-state = <0x00>;
				synaptics,spi-mode = <0x03>;
				synaptics,byte-delay-us = <0x00>;
				synaptics,block-delay-us = <0x00>;
				synaptics,ubl-max-freq = <0x4c4b40>;
				synaptics,ubl-byte-delay-us = <0x14>;
				synaptics,fw_name = "tsp_synaptics/td4150_a21s.bin";

				controller-data {
					cs-gpio = <0xffffffff 0x00 0x00>;
					samsung,spi-feedback-delay = <0x00>;
					samsung,spi-chip-select-mode = <0x00>;
				};
			};
		};
	};

	fragment@19 {
		target = <0xffffffff>;

		__overlay__ {
			#address-cells = <0x01>;
			#size-cells = <0x00>;
			status = "okay";

			sma1303@1e {
				compatible = "siliconmitus,sma1303";
				#sound-dai-cells = <0x00>;
				reg = <0x1e>;
				init-vol = <0x31>;
				sys-clk-id = <0x03>;
				status = "okay";
				phandle = <0x0d>;
			};
		};
	};

	fragment@20 {
		target = <0xffffffff>;

		__overlay__ {
			#address-cells = <0x01>;
			#size-cells = <0x00>;
			status = "okay";

			s2mpb03_pmic@56 {
				compatible = "samsung,s2mpb03pmic";
				reg = <0x56>;
				s2mpb03,wakeup;

				regulators {

					s2mpb03-ldo1 {
						regulator-name = "S2MPB03_VLDO1";
						regulator-min-microvolt = <0x100590>;
						regulator-max-microvolt = <0x100590>;
						phandle = <0x35>;
					};

					s2mpb03-ldo2 {
						regulator-name = "S2MPB03_VLDO2";
						regulator-min-microvolt = <0x124f80>;
						regulator-max-microvolt = <0x124f80>;
						phandle = <0x36>;
					};

					s2mpb03-ldo3 {
						regulator-name = "S2MPB03_VLDO3";
						regulator-min-microvolt = <0x1b7740>;
						regulator-max-microvolt = <0x1b7740>;
						phandle = <0x37>;
					};

					s2mpb03-ldo4 {
						regulator-name = "S2MPB03_VLDO4";
						regulator-min-microvolt = <0x124f80>;
						regulator-max-microvolt = <0x124f80>;
						phandle = <0x38>;
					};

					s2mpb03-ldo5 {
						regulator-name = "S2MPB03_VLDO5";
						regulator-min-microvolt = <0x2ab980>;
						regulator-max-microvolt = <0x2ab980>;
						phandle = <0x39>;
					};

					s2mpb03-ldo6 {
						regulator-name = "S2MPB03_VLDO6";
						regulator-min-microvolt = <0x2ab980>;
						regulator-max-microvolt = <0x2ab980>;
						phandle = <0x3a>;
					};

					s2mpb03-ldo7 {
						regulator-name = "S2MPB03_VLDO7";
						regulator-min-microvolt = <0x2ab980>;
						regulator-max-microvolt = <0x2ab980>;
						phandle = <0x3b>;
					};
				};
			};
		};
	};

	__symbols__ {
		gnss_mailbox = "/fragment@common/__overlay__/gnss_mailbox";
		but_zones = "/fragment@common/__overlay__/but_zones";
		attn_irq = "/fragment@2/__overlay__/attn-irq";
		attn_input = "/fragment@2/__overlay__/attn-input";
		key_voldown = "/fragment@2/__overlay__/key-voldown";
		key_volup = "/fragment@2/__overlay__/key-volup";
		dwmmc2_cd_ext_irq = "/fragment@2/__overlay__/dwmmc2_cd_ext_irq";
		vdd_on = "/fragment@5/__overlay__/vdd-on";
		vdd_off = "/fragment@5/__overlay__/vdd-off";
		cpif = "/fragment@modemif/__overlay__/cpif";
		rffe1_clk = "/fragment@8/__overlay__/rffe1_clk";
		rffe1_data = "/fragment@8/__overlay__/rffe1_data";
		b7_prx_lna_en = "/fragment@8/__overlay__/b7_prx_lna_en";
		dummy_audio_codec = "/fragment@model/__overlay__/audio-codec-dummy";
		usb_hs_tune = "/fragment@model/__overlay__/hs_tune";
		codec_aud3004x = "/fragment@model/__overlay__/acpm_mfd_bus@11A50000/aud3004x@07";
		b1_reg = "/fragment@model/__overlay__/acpm_mfd_bus@11A50000/s2mpu12mfd@00/regulators/BUCK1";
		b2_reg = "/fragment@model/__overlay__/acpm_mfd_bus@11A50000/s2mpu12mfd@00/regulators/BUCK2";
		b4_reg = "/fragment@model/__overlay__/acpm_mfd_bus@11A50000/s2mpu12mfd@00/regulators/BUCK4";
		b5_reg = "/fragment@model/__overlay__/acpm_mfd_bus@11A50000/s2mpu12mfd@00/regulators/BUCK5";
		l1_reg = "/fragment@model/__overlay__/acpm_mfd_bus@11A50000/s2mpu12mfd@00/regulators/LDO1";
		l2_reg = "/fragment@model/__overlay__/acpm_mfd_bus@11A50000/s2mpu12mfd@00/regulators/LDO2";
		l3_reg = "/fragment@model/__overlay__/acpm_mfd_bus@11A50000/s2mpu12mfd@00/regulators/LDO3";
		l4_reg = "/fragment@model/__overlay__/acpm_mfd_bus@11A50000/s2mpu12mfd@00/regulators/LDO4";
		l5_reg = "/fragment@model/__overlay__/acpm_mfd_bus@11A50000/s2mpu12mfd@00/regulators/LDO5";
		l6_reg = "/fragment@model/__overlay__/acpm_mfd_bus@11A50000/s2mpu12mfd@00/regulators/LDO6";
		l7_reg = "/fragment@model/__overlay__/acpm_mfd_bus@11A50000/s2mpu12mfd@00/regulators/LDO7";
		l8_reg = "/fragment@model/__overlay__/acpm_mfd_bus@11A50000/s2mpu12mfd@00/regulators/LDO8";
		l9_reg = "/fragment@model/__overlay__/acpm_mfd_bus@11A50000/s2mpu12mfd@00/regulators/LDO9";
		l10_reg = "/fragment@model/__overlay__/acpm_mfd_bus@11A50000/s2mpu12mfd@00/regulators/LDO10";
		l11_reg = "/fragment@model/__overlay__/acpm_mfd_bus@11A50000/s2mpu12mfd@00/regulators/LDO11";
		l23_reg = "/fragment@model/__overlay__/acpm_mfd_bus@11A50000/s2mpu12mfd@00/regulators/LDO23";
		l24_reg = "/fragment@model/__overlay__/acpm_mfd_bus@11A50000/s2mpu12mfd@00/regulators/LDO24";
		l25_reg = "/fragment@model/__overlay__/acpm_mfd_bus@11A50000/s2mpu12mfd@00/regulators/LDO25";
		l26_reg = "/fragment@model/__overlay__/acpm_mfd_bus@11A50000/s2mpu12mfd@00/regulators/LDO26";
		l27_reg = "/fragment@model/__overlay__/acpm_mfd_bus@11A50000/s2mpu12mfd@00/regulators/LDO27";
		l28_reg = "/fragment@model/__overlay__/acpm_mfd_bus@11A50000/s2mpu12mfd@00/regulators/LDO28";
		l29_reg = "/fragment@model/__overlay__/acpm_mfd_bus@11A50000/s2mpu12mfd@00/regulators/LDO29";
		l30_reg = "/fragment@model/__overlay__/acpm_mfd_bus@11A50000/s2mpu12mfd@00/regulators/LDO30";
		l31_reg = "/fragment@model/__overlay__/acpm_mfd_bus@11A50000/s2mpu12mfd@00/regulators/LDO31";
		l32_reg = "/fragment@model/__overlay__/acpm_mfd_bus@11A50000/s2mpu12mfd@00/regulators/LDO32";
		l33_reg = "/fragment@model/__overlay__/acpm_mfd_bus@11A50000/s2mpu12mfd@00/regulators/LDO33";
		l34_reg = "/fragment@model/__overlay__/acpm_mfd_bus@11A50000/s2mpu12mfd@00/regulators/LDO34";
		l35_reg = "/fragment@model/__overlay__/acpm_mfd_bus@11A50000/s2mpu12mfd@00/regulators/LDO35";
		l36_reg = "/fragment@model/__overlay__/acpm_mfd_bus@11A50000/s2mpu12mfd@00/regulators/LDO36";
		if_pmic_irq = "/fragment@11/__overlay__/if-pmic-irq";
		intr_on = "/fragment@11/__overlay__/intr-on";
		intr_off = "/fragment@11/__overlay__/intr-off";
		fuel_irq = "/fragment@11/__overlay__/fuel-irq";
		usbpd_irq = "/fragment@11/__overlay__/usbpd_irq";
		pm_wrstbi = "/fragment@12/__overlay__/pm-wrstbi";
		sma1303_amp = "/fragment@19/__overlay__/sma1303@1e";
		__ldo1_reg = "/fragment@20/__overlay__/s2mpb03_pmic@56/regulators/s2mpb03-ldo1";
		__ldo2_reg = "/fragment@20/__overlay__/s2mpb03_pmic@56/regulators/s2mpb03-ldo2";
		__ldo3_reg = "/fragment@20/__overlay__/s2mpb03_pmic@56/regulators/s2mpb03-ldo3";
		__ldo4_reg = "/fragment@20/__overlay__/s2mpb03_pmic@56/regulators/s2mpb03-ldo4";
		__ldo5_reg = "/fragment@20/__overlay__/s2mpb03_pmic@56/regulators/s2mpb03-ldo5";
		__ldo6_reg = "/fragment@20/__overlay__/s2mpb03_pmic@56/regulators/s2mpb03-ldo6";
		__ldo7_reg = "/fragment@20/__overlay__/s2mpb03_pmic@56/regulators/s2mpb03-ldo7";
	};

	__fixups__ {
		gpa1 = "/fragment@common/__overlay__/gpio_keys/button@1:gpios:0\0/fragment@7/__overlay__/s2mu106@3d:s2mu106,irq-gpio:0";
		gpa0 = "/fragment@common/__overlay__/gpio_keys/button@2:gpios:0\0/fragment@4/__overlay__:card-detect:0\0/fragment@6/__overlay__/touchscreen@20:synaptics,irq_gpio:0\0/fragment@7/__overlay__/usbpd-s2mu106@3C:usbpd,usbpd_int:0\0/fragment@13/__overlay__/usbpd-s2mu106@3C:usbpd,usbpd_int:0\0/fragment@18/__overlay__/synaptics_tcm@0:synaptics,irq-gpio:0";
		gic = "/fragment@common/__overlay__/gnss_mailbox:interrupt-parent:0\0/fragment@common/__overlay__/gnssif:interrupt-parent:0\0/fragment@modemif/__overlay__/cpif:interrupt-parent:0\0/fragment@modemif/__overlay__/cp_mailbox:interrupt-parent:0\0/fragment@model/__overlay__/acpm_mfd_bus@11A50000:interrupt-parent:0";
		gnss_rmem = "/fragment@common/__overlay__/gnssif:memory-region:0";
		chosen = "/fragment@0:target:0";
		serial_0 = "/fragment@1:target:0";
		pinctrl_0 = "/fragment@2:target:0\0/fragment@8:target:0\0/fragment@11:target:0";
		dwmmc_0 = "/fragment@3:target:0";
		sd0_clk = "/fragment@3/__overlay__:pinctrl-0:0";
		sd0_cmd = "/fragment@3/__overlay__:pinctrl-0:4";
		sd0_rdqs = "/fragment@3/__overlay__:pinctrl-0:8";
		sd0_nreset = "/fragment@3/__overlay__:pinctrl-0:12";
		sd0_bus1 = "/fragment@3/__overlay__:pinctrl-0:16";
		sd0_bus4 = "/fragment@3/__overlay__:pinctrl-0:20";
		sd0_bus8 = "/fragment@3/__overlay__:pinctrl-0:24";
		sd0_clk_fast_slew_rate_1x = "/fragment@3/__overlay__:pinctrl-1:0";
		sd0_clk_fast_slew_rate_2x = "/fragment@3/__overlay__:pinctrl-2:0";
		sd0_clk_fast_slew_rate_3x = "/fragment@3/__overlay__:pinctrl-3:0";
		sd0_clk_fast_slew_rate_4x = "/fragment@3/__overlay__:pinctrl-4:0";
		dwmmc_2 = "/fragment@4:target:0";
		sd2_clk = "/fragment@4/__overlay__:pinctrl-0:0\0/fragment@4/__overlay__:pinctrl-8:0";
		sd2_cmd = "/fragment@4/__overlay__:pinctrl-0:4\0/fragment@4/__overlay__:pinctrl-8:4";
		sd2_bus1 = "/fragment@4/__overlay__:pinctrl-0:8\0/fragment@4/__overlay__:pinctrl-8:8";
		sd2_bus4 = "/fragment@4/__overlay__:pinctrl-0:12\0/fragment@4/__overlay__:pinctrl-8:12";
		sd2_clk_fast_slew_rate_1x = "/fragment@4/__overlay__:pinctrl-1:0";
		sd2_clk_fast_slew_rate_1_5x = "/fragment@4/__overlay__:pinctrl-2:0";
		sd2_clk_fast_slew_rate_2x = "/fragment@4/__overlay__:pinctrl-3:0";
		sd2_clk_fast_slew_rate_2_5x = "/fragment@4/__overlay__:pinctrl-4:0";
		sd2_clk_fast_slew_rate_3x = "/fragment@4/__overlay__:pinctrl-5:0";
		sd2_clk_fast_slew_rate_4x = "/fragment@4/__overlay__:pinctrl-6:0";
		sd2_pins_as_pdn = "/fragment@4/__overlay__:pinctrl-7:0";
		pinctrl_5 = "/fragment@5:target:0\0/fragment@12:target:0";
		i2c_2 = "/fragment@6:target:0";
		i2c_0 = "/fragment@7:target:0\0/fragment@13:target:0";
		abox_tplg = "/fragment@model/__overlay__/sound:samsung,aux:0";
		abox_rdma_0 = "/fragment@model/__overlay__/sound/rdma0/cpu:sound-dai:0\0/fragment@model/__overlay__/sound/rdma0/platform:sound-dai:0\0/fragment@model/__overlay__/sound/rdma0_be/cpu:sound-dai:0\0/fragment@model/__overlay__/sound/rdma0_be/platform:sound-dai:0";
		abox_rdma_1 = "/fragment@model/__overlay__/sound/rdma1/cpu:sound-dai:0\0/fragment@model/__overlay__/sound/rdma1/platform:sound-dai:0\0/fragment@model/__overlay__/sound/rdma1_be/cpu:sound-dai:0\0/fragment@model/__overlay__/sound/rdma1_be/platform:sound-dai:0";
		abox_rdma_2 = "/fragment@model/__overlay__/sound/rdma2/cpu:sound-dai:0\0/fragment@model/__overlay__/sound/rdma2/platform:sound-dai:0\0/fragment@model/__overlay__/sound/rdma2_be/cpu:sound-dai:0\0/fragment@model/__overlay__/sound/rdma2_be/platform:sound-dai:0";
		abox_rdma_3 = "/fragment@model/__overlay__/sound/rdma3/cpu:sound-dai:0\0/fragment@model/__overlay__/sound/rdma3/platform:sound-dai:0\0/fragment@model/__overlay__/sound/rdma3_be/cpu:sound-dai:0\0/fragment@model/__overlay__/sound/rdma3_be/platform:sound-dai:0";
		abox_rdma_4 = "/fragment@model/__overlay__/sound/rdma4/cpu:sound-dai:0\0/fragment@model/__overlay__/sound/rdma4/platform:sound-dai:0\0/fragment@model/__overlay__/sound/rdma4_be/cpu:sound-dai:0\0/fragment@model/__overlay__/sound/rdma4_be/platform:sound-dai:0";
		abox_rdma_5 = "/fragment@model/__overlay__/sound/rdma5/cpu:sound-dai:0\0/fragment@model/__overlay__/sound/rdma5/platform:sound-dai:0\0/fragment@model/__overlay__/sound/rdma5_be/cpu:sound-dai:0\0/fragment@model/__overlay__/sound/rdma5_be/platform:sound-dai:0";
		abox_rdma_6 = "/fragment@model/__overlay__/sound/rdma6/cpu:sound-dai:0\0/fragment@model/__overlay__/sound/rdma6/platform:sound-dai:0\0/fragment@model/__overlay__/sound/rdma6_be/cpu:sound-dai:0\0/fragment@model/__overlay__/sound/rdma6_be/platform:sound-dai:0";
		abox_rdma_7 = "/fragment@model/__overlay__/sound/rdma7/cpu:sound-dai:0\0/fragment@model/__overlay__/sound/rdma7/platform:sound-dai:0\0/fragment@model/__overlay__/sound/rdma7_be/cpu:sound-dai:0\0/fragment@model/__overlay__/sound/rdma7_be/platform:sound-dai:0";
		abox_rdma_8 = "/fragment@model/__overlay__/sound/rdma8/cpu:sound-dai:0\0/fragment@model/__overlay__/sound/rdma8/platform:sound-dai:0\0/fragment@model/__overlay__/sound/rdma8_be/cpu:sound-dai:0\0/fragment@model/__overlay__/sound/rdma8_be/platform:sound-dai:0";
		abox_rdma_9 = "/fragment@model/__overlay__/sound/rdma9/cpu:sound-dai:0\0/fragment@model/__overlay__/sound/rdma9/platform:sound-dai:0\0/fragment@model/__overlay__/sound/rdma9_be/cpu:sound-dai:0\0/fragment@model/__overlay__/sound/rdma9_be/platform:sound-dai:0";
		abox_rdma_10 = "/fragment@model/__overlay__/sound/rdma10/cpu:sound-dai:0\0/fragment@model/__overlay__/sound/rdma10/platform:sound-dai:0\0/fragment@model/__overlay__/sound/rdma10_be/cpu:sound-dai:0\0/fragment@model/__overlay__/sound/rdma10_be/platform:sound-dai:0";
		abox_rdma_11 = "/fragment@model/__overlay__/sound/rdma11/cpu:sound-dai:0\0/fragment@model/__overlay__/sound/rdma11/platform:sound-dai:0\0/fragment@model/__overlay__/sound/rdma11_be/cpu:sound-dai:0\0/fragment@model/__overlay__/sound/rdma11_be/platform:sound-dai:0";
		abox_wdma_0 = "/fragment@model/__overlay__/sound/wdma0/cpu:sound-dai:0\0/fragment@model/__overlay__/sound/wdma0/platform:sound-dai:0\0/fragment@model/__overlay__/sound/wdma0_be/cpu:sound-dai:0\0/fragment@model/__overlay__/sound/wdma0_be/platform:sound-dai:0";
		abox_wdma_1 = "/fragment@model/__overlay__/sound/wdma1/cpu:sound-dai:0\0/fragment@model/__overlay__/sound/wdma1/platform:sound-dai:0\0/fragment@model/__overlay__/sound/wdma1_be/cpu:sound-dai:0\0/fragment@model/__overlay__/sound/wdma1_be/platform:sound-dai:0";
		abox_wdma_2 = "/fragment@model/__overlay__/sound/wdma2/cpu:sound-dai:0\0/fragment@model/__overlay__/sound/wdma2/platform:sound-dai:0\0/fragment@model/__overlay__/sound/wdma2_be/cpu:sound-dai:0\0/fragment@model/__overlay__/sound/wdma2_be/platform:sound-dai:0";
		abox_wdma_3 = "/fragment@model/__overlay__/sound/wdma3/cpu:sound-dai:0\0/fragment@model/__overlay__/sound/wdma3/platform:sound-dai:0\0/fragment@model/__overlay__/sound/wdma3_be/cpu:sound-dai:0\0/fragment@model/__overlay__/sound/wdma3_be/platform:sound-dai:0";
		abox_wdma_4 = "/fragment@model/__overlay__/sound/wdma4/cpu:sound-dai:0\0/fragment@model/__overlay__/sound/wdma4/platform:sound-dai:0\0/fragment@model/__overlay__/sound/wdma4_be/cpu:sound-dai:0\0/fragment@model/__overlay__/sound/wdma4_be/platform:sound-dai:0";
		abox_dual_0 = "/fragment@model/__overlay__/sound/dual0/cpu:sound-dai:0\0/fragment@model/__overlay__/sound/dual0/platform:sound-dai:0";
		abox_dual_1 = "/fragment@model/__overlay__/sound/dual1/cpu:sound-dai:0\0/fragment@model/__overlay__/sound/dual1/platform:sound-dai:0";
		abox_dual_2 = "/fragment@model/__overlay__/sound/dual2/cpu:sound-dai:0\0/fragment@model/__overlay__/sound/dual2/platform:sound-dai:0";
		abox_dual_3 = "/fragment@model/__overlay__/sound/dual3/cpu:sound-dai:0\0/fragment@model/__overlay__/sound/dual3/platform:sound-dai:0";
		abox_dual_4 = "/fragment@model/__overlay__/sound/dual4/cpu:sound-dai:0\0/fragment@model/__overlay__/sound/dual4/platform:sound-dai:0";
		abox_ddma_0 = "/fragment@model/__overlay__/sound/ddma0/cpu:sound-dai:0\0/fragment@model/__overlay__/sound/ddma0/platform:sound-dai:0";
		abox_ddma_1 = "/fragment@model/__overlay__/sound/ddma1/cpu:sound-dai:0\0/fragment@model/__overlay__/sound/ddma1/platform:sound-dai:0";
		abox_ddma_2 = "/fragment@model/__overlay__/sound/ddma2/cpu:sound-dai:0\0/fragment@model/__overlay__/sound/ddma2/platform:sound-dai:0";
		abox_ddma_3 = "/fragment@model/__overlay__/sound/ddma3/cpu:sound-dai:0\0/fragment@model/__overlay__/sound/ddma3/platform:sound-dai:0";
		abox_ddma_4 = "/fragment@model/__overlay__/sound/ddma4/cpu:sound-dai:0\0/fragment@model/__overlay__/sound/ddma4/platform:sound-dai:0";
		abox_ddma_5 = "/fragment@model/__overlay__/sound/ddma5/cpu:sound-dai:0\0/fragment@model/__overlay__/sound/ddma5/platform:sound-dai:0";
		abox_uaif_0 = "/fragment@model/__overlay__/sound/uaif0/cpu:sound-dai:0";
		abox_uaif_1 = "/fragment@model/__overlay__/sound/uaif1/cpu:sound-dai:0";
		abox_uaif_2 = "/fragment@model/__overlay__/sound/uaif2/cpu:sound-dai:0";
		abox_spdy = "/fragment@model/__overlay__/sound/spdy/cpu:sound-dai:0";
		abox = "/fragment@model/__overlay__/sound/sifs0/cpu:sound-dai:0\0/fragment@model/__overlay__/sound/sifs1/cpu:sound-dai:0\0/fragment@model/__overlay__/sound/sifs2/cpu:sound-dai:0\0/fragment@model/__overlay__/sound/sifs3/cpu:sound-dai:0\0/fragment@model/__overlay__/sound/sifs4/cpu:sound-dai:0\0/fragment@model/__overlay__/sound/sifs5/cpu:sound-dai:0\0/fragment@model/__overlay__/sound/nsrc0/cpu:sound-dai:0\0/fragment@model/__overlay__/sound/nsrc1/cpu:sound-dai:0\0/fragment@model/__overlay__/sound/nsrc2/cpu:sound-dai:0\0/fragment@model/__overlay__/sound/nsrc3/cpu:sound-dai:0\0/fragment@model/__overlay__/sound/nsrc4/cpu:sound-dai:0";
		udc = "/fragment@model/__overlay__/usb_notifier:udc:0\0/fragment@10:target:0";
		exynos_adc = "/fragment@model/__overlay__/acpm_mfd_bus@11A50000/aud3004x@07:io-channels:0\0/fragment@model/__overlay__/acpm_mfd_bus@11A50000/aud3004x@07:io-channels:8";
		panel_0 = "/fragment@9:target:0";
		gpg2 = "/fragment@9/__overlay__:gpios:0\0/fragment@9/__overlay__:gpios:12";
		gpa2 = "/fragment@13/__overlay__/s2mu106@3d:s2mu106,irq-gpio:0";
		gpa3 = "/fragment@13/__overlay__/s2mu106-fuelgauge@3B:fuelgauge,fuel_int:0";
		i2c_1 = "/fragment@14:target:0";
		usbdrd_dwc3 = "/fragment@15:target:0";
		usbdrd_phy0 = "/fragment@16:target:0";
		usi_00_cmgp = "/fragment@17:target:0";
		spi_1 = "/fragment@18:target:0";
		spi1_bus = "/fragment@18/__overlay__:pinctrl-0:0";
		spi1_cs = "/fragment@18/__overlay__:pinctrl-0:4";
		spi1_sleep = "/fragment@18/__overlay__:pinctrl-1:0";
		gpm3 = "/fragment@18/__overlay__/synaptics_tcm@0/controller-data:cs-gpio:0";
		i2c_3 = "/fragment@19:target:0";
		i2c_5 = "/fragment@20:target:0";
	};

	__local_fixups__ {

		fragment@common {

			__overlay__ {

				gpio_keys {
					pinctrl-0 = <0x00 0x04>;
				};

				gnssif {
					mbox_info = <0x00>;
				};
			};
		};

		fragment@4 {

			__overlay__ {
				pinctrl-0 = <0x10>;
			};
		};

		fragment@6 {

			__overlay__ {

				touchscreen@20 {
					pinctrl-0 = <0x00 0x04>;
					pinctrl-1 = <0x00 0x04>;
				};
			};
		};

		fragment@7 {

			__overlay__ {

				s2mu106@3d {
					pinctrl-0 = <0x00>;
				};

				usbpd-s2mu106@3C {
					pinctrl-0 = <0x00>;
				};
			};
		};

		fragment@model {

			__overlay__ {

				sound {

					rdma0 {

						codec {
							sound-dai = <0x00>;
						};
					};

					rdma1 {

						codec {
							sound-dai = <0x00>;
						};
					};

					rdma2 {

						codec {
							sound-dai = <0x00>;
						};
					};

					rdma3 {

						codec {
							sound-dai = <0x00>;
						};
					};

					rdma4 {

						codec {
							sound-dai = <0x00>;
						};
					};

					rdma5 {

						codec {
							sound-dai = <0x00>;
						};
					};

					rdma6 {

						codec {
							sound-dai = <0x00>;
						};
					};

					rdma7 {

						codec {
							sound-dai = <0x00>;
						};
					};

					rdma8 {

						codec {
							sound-dai = <0x00>;
						};
					};

					rdma9 {

						codec {
							sound-dai = <0x00>;
						};
					};

					rdma10 {

						codec {
							sound-dai = <0x00>;
						};
					};

					rdma11 {

						codec {
							sound-dai = <0x00>;
						};
					};

					wdma0 {

						codec {
							sound-dai = <0x00>;
						};
					};

					wdma1 {

						codec {
							sound-dai = <0x00>;
						};
					};

					wdma2 {

						codec {
							sound-dai = <0x00>;
						};
					};

					wdma3 {

						codec {
							sound-dai = <0x00>;
						};
					};

					wdma4 {

						codec {
							sound-dai = <0x00>;
						};
					};

					dual0 {

						codec {
							sound-dai = <0x00>;
						};
					};

					dual1 {

						codec {
							sound-dai = <0x00>;
						};
					};

					dual2 {

						codec {
							sound-dai = <0x00>;
						};
					};

					dual3 {

						codec {
							sound-dai = <0x00>;
						};
					};

					dual4 {

						codec {
							sound-dai = <0x00>;
						};
					};

					ddma0 {

						codec {
							sound-dai = <0x00>;
						};
					};

					ddma1 {

						codec {
							sound-dai = <0x00>;
						};
					};

					ddma2 {

						codec {
							sound-dai = <0x00>;
						};
					};

					ddma3 {

						codec {
							sound-dai = <0x00>;
						};
					};

					ddma4 {

						codec {
							sound-dai = <0x00>;
						};
					};

					ddma5 {

						codec {
							sound-dai = <0x00>;
						};
					};

					uaif0 {

						codec {
							sound-dai = <0x00>;
						};
					};

					uaif1 {

						codec {
							sound-dai = <0x00>;
						};
					};

					uaif2 {

						codec {
							sound-dai = <0x00>;
						};
					};

					spdy {

						codec {
							sound-dai = <0x00>;
						};
					};

					sifs0 {

						codec {
							sound-dai = <0x00>;
						};
					};

					sifs1 {

						codec {
							sound-dai = <0x00>;
						};
					};

					sifs2 {

						codec {
							sound-dai = <0x00>;
						};
					};

					sifs3 {

						codec {
							sound-dai = <0x00>;
						};
					};

					sifs4 {

						codec {
							sound-dai = <0x00>;
						};
					};

					sifs5 {

						codec {
							sound-dai = <0x00>;
						};
					};

					nsrc0 {

						codec {
							sound-dai = <0x00>;
						};
					};

					nsrc1 {

						codec {
							sound-dai = <0x00>;
						};
					};

					nsrc2 {

						codec {
							sound-dai = <0x00>;
						};
					};

					nsrc3 {

						codec {
							sound-dai = <0x00>;
						};
					};

					nsrc4 {

						codec {
							sound-dai = <0x00>;
						};
					};

					rdma0_be {

						codec {
							sound-dai = <0x00>;
						};
					};

					rdma1_be {

						codec {
							sound-dai = <0x00>;
						};
					};

					rdma2_be {

						codec {
							sound-dai = <0x00>;
						};
					};

					rdma3_be {

						codec {
							sound-dai = <0x00>;
						};
					};

					rdma4_be {

						codec {
							sound-dai = <0x00>;
						};
					};

					rdma5_be {

						codec {
							sound-dai = <0x00>;
						};
					};

					rdma6_be {

						codec {
							sound-dai = <0x00>;
						};
					};

					rdma7_be {

						codec {
							sound-dai = <0x00>;
						};
					};

					rdma8_be {

						codec {
							sound-dai = <0x00>;
						};
					};

					rdma9_be {

						codec {
							sound-dai = <0x00>;
						};
					};

					rdma10_be {

						codec {
							sound-dai = <0x00>;
						};
					};

					rdma11_be {

						codec {
							sound-dai = <0x00>;
						};
					};

					wdma0_be {

						codec {
							sound-dai = <0x00>;
						};
					};

					wdma1_be {

						codec {
							sound-dai = <0x00>;
						};
					};

					wdma2_be {

						codec {
							sound-dai = <0x00>;
						};
					};

					wdma3_be {

						codec {
							sound-dai = <0x00>;
						};
					};

					wdma4_be {

						codec {
							sound-dai = <0x00>;
						};
					};
				};

				acpm_mfd_bus@11A50000 {

					aud3004x@07 {
						but-zones-list = <0x00 0x10 0x20 0x30>;
					};

					s2mpu12mfd@00 {
						pinctrl-0 = <0x00>;
					};
				};
			};
		};

		fragment@13 {

			__overlay__ {

				s2mu106@3d {
					pinctrl-0 = <0x00>;
				};

				s2mu106-fuelgauge@3B {
					pinctrl-0 = <0x00>;
				};

				usbpd-s2mu106@3C {
					pinctrl-0 = <0x00>;
				};
			};
		};

		fragment@16 {

			__overlay__ {
				hs_tune_param = <0x00>;
			};
		};

		fragment@18 {

			__overlay__ {

				synaptics_tcm@0 {
					pinctrl-0 = <0x00>;
					pinctrl-1 = <0x00>;
				};
			};
		};
	};
};
