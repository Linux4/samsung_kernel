/*
 * SAMSUNG EXYNOS2100 PCIe device tree source
 *
 * Copyright (c) 2019 Samsung Electronics Co., Ltd.
 *		http://www.samsung.com
 *
 * SAMSUNG EXYNOS2100 SoC device nodes are listed in this file.
 * EXYNOS9820 based board files can include this file and provide
 * values for board specfic bindings.
 *
 * This program is free software; you can redistribute it and/or modify
 * it under the terms of the GNU General Public License version 2 as
 * published by the Free Software Foundation.
 */

#include <dt-bindings/pci/pci.h>
/ {
	/* HSI1 GEN2 */
	pcie_0: pcie@113B0000 {
		compatible = "samsung,exynos-pcie";
		gpios = <&gpf0 1 0x1 /* PERST */>;
		reg = <0x0 0x113B0000 0x1000    /* elbi base */
			0x0 0x113E0000 0x1000   /* phy base */
			0x0 0x11021044 0x10     /* sysreg base */
			0x0 0x113F0000 0x1000   /* DBI base */
			0x0 0x113D0000 0x1FC    /* phy pcs base */
			0x0 0x20FFE000 0x2000   /* configuration space */
			0x0 0x11390000 0x1000>; /* I/A space */
		reg-names = "elbi", "phy", "sysreg", "dbi", "pcs", "config", "ia";
		interrupts = <GIC_SPI INTREQ__PCIE_GEN2 IRQ_TYPE_LEVEL_HIGH>;
		#interrupt-cells = <1>;
		interrupt-map-mask = <0 0 0 0>;
		interrupt-map = <0 0 0 0 &gic 0 INTREQ__PCIE_GEN2 0x4>;
		samsung,syscon-phandle = <&pmu_system_controller>;
		clocks = <&clock GATE_PCIE_GEN2_QCH_MSTR>, <&clock GATE_PCIE_GEN2_QCH_PCS>,
		       <&clock GATE_PCIE_GEN2_QCH_PHY>, <&clock GATE_PCIE_GEN2_QCH_DBI>,
		       <&clock GATE_PCIE_GEN2_QCH_APB>, <&clock GATE_PCIE_GEN2_QCH_REF>;
		clock-names = "bus", "pcie";
		pinctrl-names = "active";
		pinctrl-0 = <&pcie0_clkreq &pcie0_perst>;
		#address-cells = <3>;
		#size-cells = <2>;
		device_type = "pci";
		/* non-prefetchable memory */
		ranges = <0x82000000 0 0x20000000 0 0x20000000 0 0xFF0000>;
		/* ranges = <0x82000000 0 0x20000000 0 0x20000000 0 0x20000000>; */
		ip-ver = <0x984000>;
		ep-ver = <0x04375>;
		num-lanes = <1>;
		ch-num = <0>;
		pcie-clk-num = <0>;
		phy-clk-num = <0>;
		pcie-pm-qos-int = <267000>;
		use-cache-coherency = "false";
		use-msi = "false";
		use-sicd = "true";
		use-sysmmu = "false";
		use-ia = "true";
		pmu-offset = <0x71c>;
		use-nclkoff-en = "false";
		max-link-speed = <LINK_SPEED_GEN1>;
		status = "disabled";
	};

	/* HSI1 GEN4_0 */
	pcie_1:	pcie@11320000 {
		compatible = "samsung,exynos-pcie-rc";
		gpios = <&gpf0 3 0x1 /* PERST */>;
		reg = <0x0 0x11320000 0x2000    /* elbi base */
			0x0 0x11350000 0x2000   /* phy base */
			0x0 0x11021054 0x10     /* sysreg base */
			0x0 0x11400000 0x301000   /* DBI base */
			0x0 0x11340000 0x1000    /* phy pcs base */
			0x0 0x40FFE000 0x2000   /* configuration space */
			0x0 0x11300000 0x1000>; /* I/A space */
		reg-names = "elbi", "phy", "sysreg", "dbi", "pcs", "config", "ia";
		interrupts = <GIC_SPI INTREQ__PCIE_GEN4_0 IRQ_TYPE_LEVEL_HIGH>;
		interrupt-names = "msi";
		#interrupt-cells = <1>;
		samsung,syscon-phandle = <&pmu_system_controller>;
		clocks = <&clock GATE_PCIE_GEN4_0_QCH_APB>, <&clock GATE_PCIE_GEN4_0_QCH_DBI>,
			<&clock GATE_PCIE_GEN4_0_QCH_AXI>, <&clock GATE_PCIE_GEN4_0_QCH_PCS_APB>,
			<&clock GATE_PCIE_GEN4_0_QCH_REF>, <&clock GATE_PCIE_GEN4_0_QCH_PMA_APB>;
		pinctrl-names = "active";
		pinctrl-0 = <&pcie1_clkreq &pcie1_perst>;
		#address-cells = <3>;
		#size-cells = <2>;
		device_type = "pci";
		/* non-prefetchable memory */
		/* S5100 doorbell target address: 0x12D0_02D0  */
		ranges = <0x82000000 0 0x40000000 0 0x40000000 0 0xFF0000>;
		/* ranges = <0x82000000 0 0x14000000 0 0x14000000 0 0xFF0000>; */
		ip-ver = <0x984000>;
		num-lanes = <2>;
		ch-num = <1>;
		pcie-clk-num = <0>;
		phy-clk-num = <0>;
		pcie-pm-qos-int = <267000>;
		use-cache-coherency = "true";
		use-pcieon-sleep = "true";
		use-msi = "false";
		use-sicd = "true";
		use-sysmmu = "false";
		use-ia = "false";
		pmu-offset = <0x720>;
		max-link-speed = <LINK_SPEED_GEN3>;
		status = "disabled";
	};
};
