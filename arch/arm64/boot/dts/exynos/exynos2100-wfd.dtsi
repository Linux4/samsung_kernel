/* SPDX-License-Identifier: GPL-2.0-only */
/*
 * EXYNOS device tree source for WFD
 *
 * Copyright (c) 2021 Samsung Electronics Co., Ltd.
 *		http://www.samsung.com
 */
#include <dt-bindings/clock/exynos2100.h>
#include <dt-bindings/interrupt-controller/exynos2100.h>

/ {
	tsmux: tsmux@186E0000 {
		compatible = "samsung,exynos-tsmux";
		reg = <0x0 0x186E0000 0x1000>;
		interrupts = <0 INTREQ__WFD IRQ_TYPE_LEVEL_HIGH>;
		iommus = <&sysmmu_d1_mfc0>;
		samsung,iommu-group = <&iommu_group_mfc>;
		power-domains = <&pd_mfc0>;
	};

	repeater: repeater@0 {
		compatible = "samsung,exynos-repeater";
		power-domains = <&pd_dpuf0>;
	};
};
