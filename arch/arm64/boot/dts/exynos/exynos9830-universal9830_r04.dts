/dts-v1/;

/ {
	compatible = "samsung,exynos990\0samsung,UNIVERSAL990";
	board_id = <0x10>;
	board_rev = <0x04>;

	fragment@0 {
		target = <0xffffffff>;

		__overlay__ {

			m-pmic-irq {
				samsung,pins = "gpa0-1";
				samsung,pin-pud = <0x03>;
				samsung,pin-drv = <0x03>;
				phandle = <0x01>;
			};

			s-pmic-irq {
				samsung,pins = "gpa2-5";
				samsung,pin-pud = <0x03>;
				samsung,pin-drv = <0x03>;
				phandle = <0x03>;
			};

			dp-pmic-irq {
				samsung,pins = "gpa1-4";
				samsung,pin-function = <0x00>;
				samsung,pin-pud = <0x00>;
				samsung,pin-drv = <0x00>;
				phandle = <0x05>;
			};
		};
	};

	fragment@1 {
		target = <0xffffffff>;

		__overlay__ {

			sub-pmic-irq {
				samsung,pins = "gpg1-2";
				samsung,pin-function = <0x00>;
				samsung,pin-pud = <0x00>;
				samsung,pin-drv = <0x00>;
				phandle = <0x04>;
			};
		};
	};

	fragment@2 {
		target = <0xffffffff>;

		__overlay__ {

			smpl-warn {
				samsung,pins = "gpg0-1";
				samsung,pin-function = <0x0f>;
				samsung,pin-pud = <0x00>;
				samsung,pin-drv = <0x00>;
				phandle = <0x02>;
			};
		};
	};

	fragment@3 {
		target = <0xffffffff>;

		__overlay__ {
			#address-cells = <0x01>;
			#size-cells = <0x00>;
			status = "okay";

			s2mps19mfd@00 {
				compatible = "samsung,s2mps19mfd";
				acpm-ipc-channel = <0x02>;
				acpm-speedy-channel = <0x00>;
				i2c-speedy-address;
				s2mps19,wakeup = "enabled";
				s2mps19,irq-gpio = <0xffffffff 0x01 0x00>;
				reg = <0x00>;
				interrupts = <0x01 0x00 0x00>;
				interrupt-parent = <0xffffffff>;
				pinctrl-names = "default";
				pinctrl-0 = <0x01 0x02>;
				gpios = <0xffffffff 0x01 0x00>;
				smpl_warn_en = <0x01>;
				smpl_warn_vth = <0x80>;
				smpl_warn_hys = <0x00>;
				ocp_warn1_en = <0x01>;
				ocp_warn1_cnt = <0x00>;
				ocp_warn1_dvs_mask = <0x00>;
				ocp_warn1_lv = <0x00>;
				ocp_warn2_en = <0x00>;
				ocp_warn2_cnt = <0x00>;
				ocp_warn2_dvs_mask = <0x00>;
				ocp_warn2_lv = <0x00>;
				adc_mode = <0x01>;
				adc_sync_mode = <0x02>;
				wtsr_en = "enabled";
				smpl_en = "enabled";
				wtsr_timer_val = <0x03>;
				smpl_timer_val = <0x04>;
				sub_smpl_en = "enabled";
				check_jigon = <0x00>;
				init_time,sec = <0x00>;
				init_time,min = <0x00>;
				init_time,hour = <0x0c>;
				init_time,mday = <0x01>;
				init_time,mon = <0x00>;
				init_time,year = <0x75>;
				init_time,wday = <0x00>;

				regulators {

					BUCK1M {
						regulator-name = "m_vdd_buck1";
						regulator-min-microvolt = <0x6ddd0>;
						regulator-max-microvolt = <0x10c8e0>;
						regulator-always-on;
						regulator-ramp-delay = <0x1770>;
						regulator-initial-mode = <0x02>;
						phandle = <0x27>;
					};

					BUCK2M {
						regulator-name = "m_vdd_buck2";
						regulator-min-microvolt = <0x6ddd0>;
						regulator-max-microvolt = <0x13d620>;
						regulator-always-on;
						regulator-ramp-delay = <0x1770>;
						regulator-initial-mode = <0x02>;
						phandle = <0x28>;
					};

					BUCK3M {
						regulator-name = "m_vdd_buck3";
						regulator-min-microvolt = <0x6ddd0>;
						regulator-max-microvolt = <0x13d620>;
						regulator-always-on;
						regulator-ramp-delay = <0x1770>;
						regulator-initial-mode = <0x02>;
						phandle = <0x29>;
					};

					BUCK5M {
						regulator-name = "m_vdd_buck5";
						regulator-min-microvolt = <0x6ddd0>;
						regulator-max-microvolt = <0x10c8e0>;
						regulator-always-on;
						regulator-ramp-delay = <0x1770>;
						regulator-initial-mode = <0x02>;
						phandle = <0x2a>;
					};

					BUCK6M {
						regulator-name = "m_vdd_buck6";
						regulator-min-microvolt = <0x6ddd0>;
						regulator-max-microvolt = <0x10c8e0>;
						regulator-always-on;
						regulator-ramp-delay = <0x1770>;
						regulator-initial-mode = <0x01>;
						phandle = <0x2b>;
					};

					BUCK7M {
						regulator-name = "m_vdd_buck7";
						regulator-min-microvolt = <0x6ddd0>;
						regulator-max-microvolt = <0x13d620>;
						regulator-always-on;
						regulator-ramp-delay = <0x1770>;
						regulator-initial-mode = <0x02>;
						phandle = <0x2c>;
					};

					BUCK8M {
						regulator-name = "m_vdd_buck8";
						regulator-min-microvolt = <0x6ddd0>;
						regulator-max-microvolt = <0xe7ef0>;
						regulator-always-on;
						regulator-ramp-delay = <0x1770>;
						regulator-initial-mode = <0x02>;
						phandle = <0x2d>;
					};

					BUCK9M {
						regulator-name = "m_vdd_buck9";
						regulator-min-microvolt = <0xc3500>;
						regulator-max-microvolt = <0x13d620>;
						regulator-always-on;
						regulator-ramp-delay = <0x1770>;
						regulator-initial-mode = <0x03>;
						phandle = <0x2e>;
					};

					BUCK10M {
						regulator-name = "m_vdd_buck10";
						regulator-min-microvolt = <0xc3500>;
						regulator-max-microvolt = <0x13d620>;
						regulator-always-on;
						regulator-ramp-delay = <0x1770>;
						regulator-initial-mode = <0x03>;
						phandle = <0x2f>;
					};

					BUCK11M {
						regulator-name = "m_vdd_buck11";
						regulator-min-microvolt = <0x10c8e0>;
						regulator-max-microvolt = <0x16e360>;
						regulator-always-on;
						regulator-ramp-delay = <0x1770>;
						regulator-initial-mode = <0x03>;
						phandle = <0x30>;
					};

					BUCK12M {
						regulator-name = "m_vdd_buck12";
						regulator-min-microvolt = <0x1ab3f0>;
						regulator-max-microvolt = <0x20ce70>;
						regulator-always-on;
						regulator-ramp-delay = <0x1770>;
						regulator-initial-mode = <0x03>;
						phandle = <0x0c>;
					};

					LDO1M {
						regulator-name = "m_vdd_ldo1";
						regulator-min-microvolt = <0xaae60>;
						regulator-max-microvolt = <0xe7ef0>;
						regulator-always-on;
						regulator-ramp-delay = <0x2ee0>;
						regulator-initial-mode = <0x03>;
						phandle = <0x31>;
					};

					LDO2M {
						regulator-name = "vqmmc";
						regulator-min-microvolt = <0x19f0a0>;
						regulator-max-microvolt = <0x325aa0>;
						regulator-ramp-delay = <0x2ee0>;
						regulator-initial-mode = <0x03>;
						phandle = <0x32>;
					};

					LDO3M {
						regulator-name = "m_vdd_ldo3";
						regulator-min-microvolt = <0xaae60>;
						regulator-max-microvolt = <0x10c8e0>;
						regulator-always-on;
						regulator-ramp-delay = <0x2ee0>;
						regulator-initial-mode = <0x01>;
						phandle = <0x33>;
					};

					LDO4M {
						regulator-name = "m_vdd_ldo4";
						regulator-min-microvolt = <0x186a00>;
						regulator-max-microvolt = <0x1dc130>;
						regulator-always-on;
						regulator-ramp-delay = <0x2ee0>;
						regulator-initial-mode = <0x01>;
						phandle = <0x34>;
					};

					LDO5M {
						regulator-name = "m_vdd_ldo5";
						regulator-min-microvolt = <0x6ddd0>;
						regulator-max-microvolt = <0x10c8e0>;
						regulator-always-on;
						regulator-ramp-delay = <0x2ee0>;
						regulator-initial-mode = <0x01>;
						phandle = <0x35>;
					};

					LDO6M {
						regulator-name = "m_vdd_ldo6";
						regulator-min-microvolt = <0x6ddd0>;
						regulator-max-microvolt = <0xe7ef0>;
						regulator-always-on;
						regulator-ramp-delay = <0x2ee0>;
						regulator-initial-mode = <0x01>;
						phandle = <0x36>;
					};

					LDO9M {
						regulator-name = "m_vdd_ldo9";
						regulator-min-microvolt = <0xaae60>;
						regulator-max-microvolt = <0x13d620>;
						regulator-always-on;
						regulator-ramp-delay = <0x2ee0>;
						regulator-initial-mode = <0x01>;
						phandle = <0x37>;
					};

					LDO10M {
						regulator-name = "m_vdd_ldo10";
						regulator-min-microvolt = <0xaae60>;
						regulator-max-microvolt = <0x10c8e0>;
						regulator-boot-on;
						regulator-ramp-delay = <0x2ee0>;
						regulator-initial-mode = <0x03>;
						phandle = <0x38>;
					};

					LDO11M {
						regulator-name = "m_vdd_ldo11";
						regulator-min-microvolt = <0x186a00>;
						regulator-max-microvolt = <0x1dc130>;
						regulator-boot-on;
						regulator-ramp-delay = <0x2ee0>;
						regulator-initial-mode = <0x03>;
						phandle = <0x39>;
					};

					LDO12M {
						regulator-name = "m_vdd_ldo12";
						regulator-min-microvolt = <0x19f0a0>;
						regulator-max-microvolt = <0x331df0>;
						regulator-boot-on;
						regulator-ramp-delay = <0x2ee0>;
						regulator-initial-mode = <0x03>;
						phandle = <0x3a>;
					};

					LDO13M {
						regulator-name = "m_vdd_ldo13";
						regulator-min-microvolt = <0x1b7740>;
						regulator-max-microvolt = <0x1b7740>;
						regulator-boot-on;
						regulator-ramp-delay = <0x2ee0>;
						regulator-initial-mode = <0x01>;
						phandle = <0x0e>;
					};

					LDO14M {
						regulator-name = "m_vdd_ldo14";
						regulator-min-microvolt = <0x1b7740>;
						regulator-max-microvolt = <0x1b7740>;
						regulator-boot-on;
						regulator-ramp-delay = <0x2ee0>;
						regulator-initial-mode = <0x01>;
						phandle = <0x0f>;
					};

					LDO15M {
						regulator-name = "vmmc";
						regulator-min-microvolt = <0x2625a0>;
						regulator-max-microvolt = <0x325aa0>;
						regulator-ramp-delay = <0x2ee0>;
						regulator-initial-mode = <0x03>;
						phandle = <0x3b>;
					};

					LDO16M {
						regulator-name = "m_vdd_ldo16";
						regulator-min-microvolt = <0x2625a0>;
						regulator-max-microvolt = <0x325aa0>;
						regulator-always-on;
						regulator-ramp-delay = <0x2ee0>;
						regulator-initial-mode = <0x03>;
						phandle = <0x3c>;
					};

					LDO17M {
						regulator-name = "m_vdd_ldo17";
						regulator-min-microvolt = <0x1b7740>;
						regulator-max-microvolt = <0x1b7740>;
						regulator-boot-on;
						regulator-ramp-delay = <0x2ee0>;
						regulator-initial-mode = <0x01>;
						phandle = <0x10>;
					};

					LDO18M {
						regulator-name = "m_vdd_ldo18";
						regulator-min-microvolt = <0xaae60>;
						regulator-max-microvolt = <0x13d620>;
						regulator-always-on;
						regulator-ramp-delay = <0x2ee0>;
						regulator-initial-mode = <0x03>;
						phandle = <0x3d>;
					};

					LDO19M {
						regulator-name = "m_vdd_ldo19";
						regulator-min-microvolt = <0x186a00>;
						regulator-max-microvolt = <0x2191c0>;
						regulator-always-on;
						regulator-ramp-delay = <0x2ee0>;
						regulator-initial-mode = <0x03>;
						phandle = <0x3e>;
					};

					LDO20M {
						regulator-name = "m_vdd_ldo20";
						regulator-min-microvolt = <0x2625a0>;
						regulator-max-microvolt = <0x325aa0>;
						regulator-always-on;
						regulator-ramp-delay = <0x2ee0>;
						regulator-initial-mode = <0x03>;
						phandle = <0x3f>;
					};

					LDO21M {
						regulator-name = "m_vdd_ldo21";
						regulator-min-microvolt = <0x186a00>;
						regulator-max-microvolt = <0x2191c0>;
						regulator-always-on;
						regulator-ramp-delay = <0x2ee0>;
						regulator-initial-mode = <0x03>;
						phandle = <0x40>;
					};

					LDO22M {
						regulator-name = "m_vdd_ldo22";
						regulator-min-microvolt = <0x186a00>;
						regulator-max-microvolt = <0x2191c0>;
						regulator-always-on;
						regulator-ramp-delay = <0x2ee0>;
						regulator-initial-mode = <0x03>;
						phandle = <0x41>;
					};

					LDO23M {
						regulator-name = "VDDD_1.2V_FRONTSUB";
						regulator-min-microvolt = <0xaae60>;
						regulator-max-microvolt = <0x13d620>;
						regulator-ramp-delay = <0x2ee0>;
						regulator-initial-mode = <0x03>;
						phandle = <0x42>;
					};

					LDO24M {
						regulator-name = "VDDA_2.8V_FRONTSUB";
						regulator-min-microvolt = <0x2625a0>;
						regulator-max-microvolt = <0x325aa0>;
						regulator-ramp-delay = <0x2ee0>;
						regulator-initial-mode = <0x03>;
						phandle = <0x43>;
					};

					LDO25M {
						regulator-name = "VDDIO_1.8V_FRONTSUB";
						regulator-min-microvolt = <0x186a00>;
						regulator-max-microvolt = <0x2191c0>;
						regulator-ramp-delay = <0x2ee0>;
						regulator-initial-mode = <0x03>;
						phandle = <0x44>;
					};

					LDO26M {
						regulator-name = "m_vdd_ldo26";
						regulator-min-microvolt = <0x1b7740>;
						regulator-max-microvolt = <0x2191c0>;
						regulator-always-on;
						regulator-ramp-delay = <0x2ee0>;
						regulator-initial-mode = <0x03>;
						phandle = <0x45>;
					};

					LDO27M {
						regulator-name = "m_vdd_ldo27";
						regulator-min-microvolt = <0x2625a0>;
						regulator-max-microvolt = <0x325aa0>;
						regulator-always-on;
						regulator-ramp-delay = <0x2ee0>;
						regulator-initial-mode = <0x03>;
						phandle = <0x46>;
					};

					LDO28M {
						regulator-name = "m_vdd_ldo28";
						regulator-min-microvolt = <0x186a00>;
						regulator-max-microvolt = <0x2191c0>;
						regulator-always-on;
						regulator-ramp-delay = <0x2ee0>;
						regulator-initial-mode = <0x03>;
						phandle = <0x47>;
					};

					LDO29M {
						regulator-name = "m_vdd_ldo29";
						regulator-min-microvolt = <0x2625a0>;
						regulator-max-microvolt = <0x325aa0>;
						regulator-always-on;
						regulator-ramp-delay = <0x2ee0>;
						regulator-initial-mode = <0x03>;
						phandle = <0x48>;
					};
				};
			};
		};
	};

	fragment@4 {
		target = <0xffffffff>;

		__overlay__ {
			#address-cells = <0x01>;
			#size-cells = <0x00>;
			status = "okay";

			s2mps22mfd@00 {
				compatible = "samsung,s2mps22mfd";
				acpm-ipc-channel = <0x02>;
				acpm-speedy-channel = <0x01>;
				i2c-speedy-address;
				s2mps22,wakeup = "enabled";
				s2mps22,irq-gpio = <0xffffffff 0x05 0x00>;
				reg = <0x00>;
				interrupts = <0x01 0x00 0x00>;
				interrupt-parent = <0xffffffff>;
				pinctrl-names = "default";
				pinctrl-0 = <0x03>;
				adc_mode = <0x01>;
				adc_sync_mode = <0x02>;
				wtsr_en = <0x01>;

				regulators {

					BUCK1S {
						regulator-name = "s_vdd_buck1";
						regulator-min-microvolt = <0x6ddd0>;
						regulator-max-microvolt = <0xe7ef0>;
						regulator-always-on;
						regulator-ramp-delay = <0x1770>;
						regulator-initial-mode = <0x01>;
						phandle = <0x49>;
					};

					BUCK2S {
						regulator-name = "s_vdd_buck2";
						regulator-min-microvolt = <0x6ddd0>;
						regulator-max-microvolt = <0x10c8e0>;
						regulator-always-on;
						regulator-ramp-delay = <0x1770>;
						regulator-initial-mode = <0x01>;
						phandle = <0x4a>;
					};

					BUCK3S {
						regulator-name = "s_vdd_buck3";
						regulator-min-microvolt = <0x6ddd0>;
						regulator-max-microvolt = <0x13d620>;
						regulator-always-on;
						regulator-ramp-delay = <0x1770>;
						regulator-initial-mode = <0x01>;
						phandle = <0x4b>;
					};

					BUCK4S {
						regulator-name = "s_vdd_buck4";
						regulator-min-microvolt = <0xdbba0>;
						regulator-max-microvolt = <0x13d620>;
						regulator-always-on;
						regulator-ramp-delay = <0x1770>;
						regulator-initial-mode = <0x03>;
						phandle = <0x4c>;
					};

					LDO1S {
						regulator-name = "s_vdd_ldo1";
						regulator-min-microvolt = <0x6ddd0>;
						regulator-max-microvolt = <0xe7ef0>;
						regulator-always-on;
						regulator-ramp-delay = <0x2ee0>;
						regulator-initial-mode = <0x01>;
						phandle = <0x4d>;
					};

					LDO2S {
						regulator-name = "s_vdd_ldo2";
						regulator-min-microvolt = <0x6ddd0>;
						regulator-max-microvolt = <0xe7ef0>;
						regulator-always-on;
						regulator-ramp-delay = <0x2ee0>;
						regulator-initial-mode = <0x01>;
						phandle = <0x4e>;
					};

					LDO3S {
						regulator-name = "s_vdd_ldo3";
						regulator-min-microvolt = <0x6ddd0>;
						regulator-max-microvolt = <0x13d620>;
						regulator-always-on;
						regulator-ramp-delay = <0x2ee0>;
						regulator-initial-mode = <0x01>;
						phandle = <0x4f>;
					};

					LDO4S {
						regulator-name = "s_vdd_ldo4";
						regulator-min-microvolt = <0x186a00>;
						regulator-max-microvolt = <0x1dc130>;
						regulator-always-on;
						regulator-ramp-delay = <0x2ee0>;
						regulator-initial-mode = <0x03>;
						phandle = <0x19>;
					};

					LDO5S {
						regulator-name = "s_vdd_ldo5";
						regulator-min-microvolt = <0xaae60>;
						regulator-max-microvolt = <0x10c8e0>;
						regulator-always-on;
						regulator-ramp-delay = <0x2ee0>;
						regulator-initial-mode = <0x01>;
						phandle = <0x50>;
					};

					LDO6S {
						regulator-name = "s_vdd_ldo6";
						regulator-min-microvolt = <0x186a00>;
						regulator-max-microvolt = <0x1dc130>;
						regulator-always-on;
						regulator-ramp-delay = <0x2ee0>;
						regulator-initial-mode = <0x01>;
						phandle = <0x51>;
					};
				};
			};
		};
	};

	fragment@5 {
		target = <0xffffffff>;

		__overlay__ {
			#address-cells = <0x01>;
			#size-cells = <0x00>;
			status = "okay";

			s2mpb02_pmic@59 {
				compatible = "s2mpb02,s2mpb02mfd";
				reg = <0x59>;
				s2mpb02,wakeup;
				pinctrl-names = "default";
				pinctrl-0 = <0x04>;

				regulators {

					s2mpb02-buck1 {
						regulator-name = "S2MPB02_BUCK1";
						regulator-min-microvolt = <0x927c0>;
						regulator-max-microvolt = <0x19f0a0>;
						regulator-always-on;
						regulator-boot-on;
						phandle = <0x52>;
					};

					s2mpb02-buck2 {
						regulator-name = "S2MPB02_BUCK2";
						regulator-min-microvolt = <0x13d620>;
						regulator-max-microvolt = <0x13d620>;
						regulator-always-on;
						regulator-boot-on;
						phandle = <0x53>;
					};

					s2mpb02-bb {
						regulator-name = "S2MPB02_BB";
						regulator-min-microvolt = <0x27ac40>;
						regulator-max-microvolt = <0x3d0900>;
						regulator-always-on;
						regulator-boot-on;
						phandle = <0x54>;
					};

					s2mpb02-ldo1 {
						regulator-name = "S2MPB02_LDO1";
						regulator-min-microvolt = <0x927c0>;
						regulator-max-microvolt = <0x927c0>;
						regulator-always-on;
						phandle = <0x55>;
					};

					s2mpb02-ldo2 {
						regulator-name = "S2MPB02_LDO2";
						regulator-min-microvolt = <0x927c0>;
						regulator-max-microvolt = <0x927c0>;
						phandle = <0x56>;
					};

					s2mpb02-ldo3 {
						regulator-name = "VDDD_1.05V_SUB";
						regulator-min-microvolt = <0x100590>;
						regulator-max-microvolt = <0x100590>;
						phandle = <0x57>;
					};

					s2mpb02-ldo4 {
						regulator-name = "VDDD_1.05V_WIDESUB";
						regulator-min-microvolt = <0x100590>;
						regulator-max-microvolt = <0x100590>;
						phandle = <0x58>;
					};

					s2mpb02-ldo5 {
						regulator-name = "VDDD_1.05V_VT";
						regulator-min-microvolt = <0x100590>;
						regulator-max-microvolt = <0x100590>;
						phandle = <0x59>;
					};

					s2mpb02-ldo6 {
						regulator-name = "VDDIO_1.8V_VT";
						regulator-min-microvolt = <0x1b7740>;
						regulator-max-microvolt = <0x1b7740>;
						regulator-always-on;
						regulator-boot-on;
						phandle = <0x5a>;
					};

					s2mpb02-ldo7 {
						regulator-name = "VDDIO_1.8V_SUB";
						regulator-min-microvolt = <0x1b7740>;
						regulator-max-microvolt = <0x1b7740>;
						phandle = <0x5b>;
					};

					s2mpb02-ldo8 {
						regulator-name = "VDDIO_1.8V_WIDESUB";
						regulator-min-microvolt = <0x1b7740>;
						regulator-max-microvolt = <0x1b7740>;
						phandle = <0x5c>;
					};

					s2mpb02-ldo9 {
						regulator-name = "S2MPB02_LDO9";
						regulator-min-microvolt = <0x1b7740>;
						regulator-max-microvolt = <0x1b7740>;
						regulator-always-on;
						regulator-boot-on;
						phandle = <0x5d>;
					};

					s2mpb02-ldo10 {
						regulator-name = "VDDD_1.8V_OIS";
						regulator-min-microvolt = <0x1b7740>;
						regulator-max-microvolt = <0x1b7740>;
						regulator-always-on;
						regulator-boot-on;
						phandle = <0x5e>;
					};

					s2mpb02-ldo11 {
						regulator-name = "VDDA_2.8V_SUB";
						regulator-min-microvolt = <0x2ab980>;
						regulator-max-microvolt = <0x2ab980>;
						regulator-always-on;
						regulator-boot-on;
						phandle = <0x5f>;
					};

					s2mpb02-ldo12 {
						regulator-name = "VDDAF_2.8V_SUB";
						regulator-min-microvolt = <0x2ab980>;
						regulator-max-microvolt = <0x2ab980>;
						phandle = <0x60>;
					};

					s2mpb02-ldo13 {
						regulator-name = "VDDA_2.95V_VT";
						regulator-min-microvolt = <0x2d0370>;
						regulator-max-microvolt = <0x2d0370>;
						phandle = <0x61>;
					};

					s2mpb02-ldo14 {
						regulator-name = "VDDAF_COMMON_CAM";
						regulator-min-microvolt = <0x325aa0>;
						regulator-max-microvolt = <0x325aa0>;
						phandle = <0x62>;
					};

					s2mpb02-ldo15 {
						regulator-name = "VDDA_2.8V_WIDESUB";
						regulator-min-microvolt = <0x2ab980>;
						regulator-max-microvolt = <0x2ab980>;
						phandle = <0x63>;
					};

					s2mpb02-ldo16 {
						regulator-name = "VDDAF_2.8V_VT";
						regulator-min-microvolt = <0x2ab980>;
						regulator-max-microvolt = <0x2ab980>;
						phandle = <0x64>;
					};

					s2mpb02-ldo17 {
						regulator-name = "S2MPB02_LDO17";
						regulator-min-microvolt = <0x927c0>;
						regulator-max-microvolt = <0x337f98>;
						phandle = <0x65>;
					};

					s2mpb02-ldo18 {
						regulator-name = "S2MPB02_LDO18";
						regulator-min-microvolt = <0x325aa0>;
						regulator-max-microvolt = <0x325aa0>;
						regulator-always-on;
						regulator-boot-on;
						phandle = <0x66>;
					};
				};
			};
		};
	};

	fragment@6 {
		target = <0xffffffff>;

		__overlay__ {
			#address-cells = <0x01>;
			#size-cells = <0x00>;
			status = "okay";

			s2dos05_pmic@60 {
				compatible = "samsung,s2dos05pmic";
				reg = <0x60>;
				s2dos05,wakeup;
				pinctrl-names = "default";
				pinctrl-0 = <0x05>;
				s2dos05,s2dos05_int = <0xffffffff 0x04 0x00>;
				adc_mode = <0x01>;
				adc_sync_mode = <0x02>;

				regulators {

					s2dos05-buck1 {
						regulator-name = "vdd1";
						regulator-min-microvolt = <0xcf850>;
						regulator-max-microvolt = <0x200b20>;
						regulator-always-on;
						regulator-boot-on;
						phandle = <0x67>;
					};

					s2dos05-ldo1 {
						regulator-name = "vdd2";
						regulator-min-microvolt = <0x16e360>;
						regulator-max-microvolt = <0x1e8480>;
						regulator-always-on;
						regulator-boot-on;
						phandle = <0x68>;
					};

					s2dos05-ldo2 {
						regulator-name = "vdd3";
						regulator-min-microvolt = <0x16e360>;
						regulator-max-microvolt = <0x1e8480>;
						regulator-always-on;
						regulator-boot-on;
						phandle = <0x69>;
					};

					s2dos05-ldo3 {
						regulator-name = "vdd4";
						regulator-min-microvolt = <0x2932e0>;
						regulator-max-microvolt = <0x399a18>;
						regulator-always-on;
						regulator-boot-on;
						phandle = <0x6a>;
					};

					s2dos05-ldo4 {
						regulator-name = "vdd5";
						regulator-min-microvolt = <0x2932e0>;
						regulator-max-microvolt = <0x399a18>;
						regulator-always-on;
						regulator-boot-on;
						phandle = <0x6b>;
					};
				};
			};
		};
	};

	fragment@7 {
		target = <0xffffffff>;

		__overlay__ {
			#address-cells = <0x01>;
			#size-cells = <0x00>;
			status = "okay";

			s2mpb03_pmic@56 {
				compatible = "samsung,s2mpb03pmic";
				reg = <0x56>;
				s2mpb03,wakeup;

				regulators {

					s2mpb03-ldo1 {
						regulator-name = "VDDD_1.0V_CAM";
						regulator-min-microvolt = <0xfa3e8>;
						regulator-max-microvolt = <0xfa3e8>;
						phandle = <0x6c>;
					};

					s2mpb03-ldo2 {
						regulator-name = "VDDQ_1.1V_CAM";
						regulator-min-microvolt = <0x10c8e0>;
						regulator-max-microvolt = <0x10c8e0>;
						phandle = <0x6d>;
					};

					s2mpb03-ldo3 {
						regulator-name = "VDDIO_1.8V_CAM";
						regulator-min-microvolt = <0x1b7740>;
						regulator-max-microvolt = <0x1b7740>;
						phandle = <0x6e>;
					};

					s2mpb03-ldo4 {
						regulator-name = "VDDD_RET_1.0V_CAM";
						regulator-min-microvolt = <0xaae60>;
						regulator-max-microvolt = <0xfa3e8>;
						phandle = <0x6f>;
					};

					s2mpb03-ldo5 {
						regulator-name = "VDDA_2.4V_CAM";
						regulator-min-microvolt = <0x249f00>;
						regulator-max-microvolt = <0x249f00>;
						phandle = <0x70>;
					};

					s2mpb03-ldo6 {
						regulator-name = "VDDA_2.8V_CAM";
						regulator-min-microvolt = <0x2ab980>;
						regulator-max-microvolt = <0x2ab980>;
						phandle = <0x71>;
					};

					s2mpb03-ldo7 {
						regulator-name = "VDD_VM_2.8V_OIS";
						regulator-min-microvolt = <0x2ab980>;
						regulator-max-microvolt = <0x2ab980>;
						phandle = <0x72>;
					};
				};
			};
		};
	};

	fragment@battery {
		target-path = [2f 00];

		__overlay__ {

			battery {
				status = "okay";
				compatible = "samsung,sec-battery";
				pinctrl-names = "default";
				battery,vendor = "Battery";
				battery,charger_name = "max77705-charger";
				battery,fuelgauge_name = "max77705-fuelgauge";
				battery,wireless_charger_name = "mfc-charger";
				battery,technology = <0x02>;
				battery,fgsrc_switch_name = "max77705-charger";
				battery,batt_data_version = <0x02>;
				battery,chip_vendor = "LSI";
				battery,temp_adc_type = <0x01>;
				battery,temp_check_type = <0x00>;
				battery,chg_temp_check = <0x00>;
				battery,wpc_temp_check = <0x01>;
				battery,thermal_source = <0x02>;
				battery,usb_thermal_source = <0x02>;
				battery,chg_thermal_source = <0x01>;
				battery,wpc_thermal_source = <0x01>;
				battery,coil_thermal_source = <0x01>;
				battery,polling_time = <0x0a 0x1e 0x1e 0x1e 0xe10>;
				battery,temp_table_adc = <0x113 0x150 0x19f 0x1e3 0x227 0x29b 0x2fc 0x387 0x41e 0x4a5 0x568 0x627 0x6fb 0x7fa 0x8d7 0x9bc 0xaa3 0xb79 0xc37 0xced 0xd87 0xdfa 0xe5e>;
				battery,temp_table_data = <0x384 0x352 0x320 0x2ee 0x2bc 0x28a 0x258 0x226 0x1f4 0x1c2 0x190 0x15e 0x12c 0xfa 0xc8 0x96 0x64 0x32 0x00 0xffffffce 0xffffff9c 0xffffff6a 0xffffff38>;
				battery,usb_temp_table_adc = <0x113 0x150 0x19f 0x1e3 0x227 0x29b 0x2fc 0x387 0x41e 0x4a5 0x568 0x627 0x6fb 0x7fa 0x8d7 0x9bc 0xaa3 0xb79 0xc37 0xced 0xd87 0xdfa 0xe5e>;
				battery,usb_temp_table_data = <0x384 0x352 0x320 0x2ee 0x2bc 0x28a 0x258 0x226 0x1f4 0x1c2 0x190 0x15e 0x12c 0xfa 0xc8 0x96 0x64 0x32 0x00 0xffffffce 0xffffff9c 0xffffff6a 0xffffff38>;
				battery,chg_temp_table_adc = <0x113 0x150 0x19f 0x1e3 0x227 0x29b 0x2fc 0x387 0x41e 0x4a5 0x568 0x627 0x6fb 0x7fa 0x8d7 0x9bc 0xaa3 0xb79 0xc37 0xced 0xd87 0xdfa 0xe5e>;
				battery,chg_temp_table_data = <0x384 0x352 0x320 0x2ee 0x2bc 0x28a 0x258 0x226 0x1f4 0x1c2 0x190 0x15e 0x12c 0xfa 0xc8 0x96 0x64 0x32 0x00 0xffffffce 0xffffff9c 0xffffff6a 0xffffff38>;
				battery,wpc_temp_table_adc = <0x113 0x150 0x19f 0x1e3 0x227 0x29b 0x2fc 0x387 0x41e 0x4a5 0x568 0x627 0x6fb 0x7fa 0x8d7 0x9bc 0xaa3 0xb79 0xc37 0xced 0xd87 0xdfa 0xe5e>;
				battery,wpc_temp_table_data = <0x384 0x352 0x320 0x2ee 0x2bc 0x28a 0x258 0x226 0x1f4 0x1c2 0x190 0x15e 0x12c 0xfa 0xc8 0x96 0x64 0x32 0x00 0xffffffce 0xffffff9c 0xffffff6a 0xffffff38>;
				battery,wireless_cc_cv = <0x55>;
				battery,set_cv_vout_in_low_capacity = <0x09>;
				battery,fod_data = <0xcc 0x09 0x96 0x1c 0x82 0x37 0x82 0x39 0x9d 0x05 0x9d 0x06>;
				battery,fod_data_cv = <0xcc 0x27 0x96 0x3a 0x82 0x55 0x82 0x57 0x9d 0x23 0x9d 0x24>;
				battery,wpc_cc_cv_vout = <0x157c>;
				battery,wpc_cv_call_vout = <0x1388>;
				battery,wpc_cc_call_vout = <0x1388>;
				battery,wpc_det = <0xffffffff 0x00 0x00>;
				battery,wpc_int = <0xffffffff 0x02 0x00>;
				battery,hv_vout_wa = <0x41>;
				battery,adc_check_count = <0x05>;
				battery,cable_check_type = <0x04>;
				battery,cable_source_type = <0x01>;
				battery,polling_type = <0x01>;
				battery,monitor_initial_count = <0x00>;
				battery,battery_check_type = <0x00>;
				battery,check_count = <0x00>;
				battery,check_adc_max = <0x5a0>;
				battery,check_adc_min = <0x00>;
				battery,ovp_uvlo_check_type = <0x03>;
				battery,temp_check_count = <0x01>;
				battery,temp_highlimit_threshold_event = <0x320>;
				battery,temp_highlimit_recovery_event = <0x2ee>;
				battery,temp_high_threshold_event = <0x1f4>;
				battery,temp_high_recovery_event = <0x1c2>;
				battery,temp_low_threshold_event = <0x00>;
				battery,temp_low_recovery_event = <0x32>;
				battery,temp_highlimit_threshold_normal = <0x320>;
				battery,temp_highlimit_recovery_normal = <0x2ee>;
				battery,temp_high_threshold_normal = <0x1f4>;
				battery,temp_high_recovery_normal = <0x1c2>;
				battery,temp_low_threshold_normal = <0x00>;
				battery,temp_low_recovery_normal = <0x32>;
				battery,temp_highlimit_threshold_lpm = <0x320>;
				battery,temp_highlimit_recovery_lpm = <0x2ee>;
				battery,temp_high_threshold_lpm = <0x1f4>;
				battery,temp_high_recovery_lpm = <0x1c2>;
				battery,temp_low_threshold_lpm = <0x00>;
				battery,temp_low_recovery_lpm = <0x32>;
				battery,wpc_high_threshold_normal = <0x1c2>;
				battery,wpc_high_recovery_normal = <0x190>;
				battery,wpc_low_threshold_normal = <0x00>;
				battery,wpc_low_recovery_normal = <0x32>;
				battery,full_check_type = <0x07>;
				battery,full_check_type_2nd = <0x07>;
				battery,full_check_count = <0x01>;
				battery,chg_gpio_full_check = <0x00>;
				battery,chg_polarity_full_check = <0x01>;
				battery,chg_high_temp = <0x1cc>;
				battery,chg_high_temp_recovery = <0x1b8>;
				battery,chg_input_limit_current = <0x3e8>;
				battery,chg_charging_limit_current = <0x5dc>;
				battery,wpc_temp_control_source = <0x01>;
				battery,wpc_high_temp = <0x17c>;
				battery,wpc_high_temp_recovery = <0x168>;
				battery,wpc_charging_limit_current = <0x258>;
				battery,wpc_temp_lcd_on_control_source = <0x01>;
				battery,wpc_lcd_on_high_temp = <0x17c>;
				battery,wpc_lcd_on_high_temp_rec = <0x168>;
				battery,wpc_lcd_on_charging_limit_current = <0x1c2>;
				battery,wpc_store_high_temp = <0x168>;
				battery,wpc_store_high_temp_recovery = <0x154>;
				battery,wpc_store_lcd_on_high_temp = <0x168>;
				battery,wpc_store_lcd_on_high_temp_rec = <0x12c>;
				battery,wpc_store_lcd_on_charging_limit_current = <0x190>;
				battery,sleep_mode_limit_current = <0x1f4>;
				battery,wc_full_input_limit_current = <0x64>;
				battery,wc_cv_current = <0x334>;
				battery,wc_cv_pack_current = <0x276>;
				battery,mix_high_temp = <0x1a4>;
				battery,mix_high_chg_temp = <0x1f4>;
				battery,mix_high_temp_recovery = <0x186>;
				battery,full_condition_type = <0x09>;
				battery,full_condition_soc = <0x5d>;
				battery,full_condition_vcell = <0x109a>;
				battery,recharge_check_count = <0x01>;
				battery,recharge_condition_type = <0x04>;
				battery,recharge_condition_soc = <0x62>;
				battery,recharge_condition_vcell = <0x10b8>;
				battery,charging_total_time = <0x3840>;
				battery,hv_charging_total_time = <0x2a30>;
				battery,normal_charging_total_time = <0x4650>;
				battery,usb_charging_total_time = <0x8ca0>;
				battery,recharging_total_time = <0x1518>;
				battery,charging_reset_time = <0x00>;
				battery,chg_float_voltage = <0x10fe>;
				battery,swelling_high_temp_block = <0x19a>;
				battery,swelling_high_temp_recov = <0x186>;
				battery,swelling_low_temp_block_1st = <0x96>;
				battery,swelling_low_temp_recov_1st = <0xc8>;
				battery,swelling_low_temp_block_2nd = <0x32>;
				battery,swelling_low_temp_recov_2nd = <0x64>;
				battery,swelling_low_temp_current = <0x320>;
				battery,swelling_low_temp_topoff = <0xc8>;
				battery,swelling_high_temp_current = <0x4e2>;
				battery,swelling_high_temp_topoff = <0xc8>;
				battery,swelling_wc_high_temp_current = <0x320>;
				battery,swelling_wc_low_temp_current = <0x320>;
				battery,swelling_drop_float_voltage = <0x1036>;
				battery,swelling_high_rechg_voltage = <0xfa0>;
				battery,swelling_low_rechg_voltage = <0xfa0>;
				battery,wa_float_voltage = <0xfd2>;
				battery,siop_event_check_type = <0x01>;
				battery,siop_call_cv_current = <0x14a>;
				battery,siop_call_cc_current = <0x14a>;
				battery,siop_input_limit_current = <0x4b0>;
				battery,siop_charging_limit_current = <0x3e8>;
				battery,siop_hv_input_limit_current = <0x1f4>;
				battery,siop_hv_charging_limit_current = <0x3e8>;
				battery,siop_wireless_input_limit_current = <0x258>;
				battery,siop_wireless_charging_limit_current = <0x352>;
				battery,siop_hv_wireless_input_limit_current = <0x258>;
				battery,siop_hv_wireless_charging_limit_current = <0x352>;
				battery,siop_store_hv_wireless_input_limit_current = <0x1c2>;
				battery,ttf_hv_charge_current = <0x9c4>;
				battery,ttf_hv_wireless_charge_current = <0x53c>;
				battery,ttf_wireless_charge_current = <0x3e3>;
				battery,pd_charging_charge_power = <0x3a98>;
				battery,max_charging_current = <0x9c4>;
				battery,battery_full_capacity = <0xdac>;
				battery,age_data = <0x00 0x10fe 0x10b8 0x109a 0x5d 0xc8 0x10ea 0x10a4 0x1086 0x5c 0xfa 0x10d6 0x1090 0x1072 0x5b 0x12c 0x10c2 0x107c 0x105e 0x5a 0x3e8 0x1090 0x104a 0x102c 0x59>;
				battery,pre_afc_input_current = <0x1f4>;
				battery,prepare_ta_delay = <0x00>;
				battery,max_input_voltage = <0x2328>;
				battery,max_input_current = <0xbb8>;
				battery,enable_sysovlo_irq;
				battery,standard_curr = <0x9c4>;
				battery,expired_time = <0x2a30>;
				battery,recharging_expired_time = <0x1518>;
				battery,cisd_max_voltage_thr = <0x1130>;
				battery,cisd_alg_index = <0x07>;
				#io-channel-cells = <0x05>;
			};

			max77705-fuelgauge {
				status = "okay";
				fuelgauge,fuel_alert_soc = <0x01>;
				fuelgauge,jig_gpio = <0xffffffff 0x00 0x00>;
				fuelgauge,jig_low_active;
				fuelgauge,capacity_max = <0x3e8>;
				fuelgauge,capacity_max_margin = <0x12c>;
				fuelgauge,capacity_min = <0x00>;
				fuelgauge,capacity_calculation_type = <0x1c>;
				fuelgauge,repeated_fuelalert;
				fuelgauge,using_temp_compensation;
				fuelgauge,low_temp_limit = <0x64>;
				fuelgauge,using_hw_vempty;
				fuelgauge,v_empty = <0xa7e2>;
				fuelgauge,v_empty_origin = <0x7d54>;
				fuelgauge,sw_v_empty_voltage = <0xc80>;
				fuelgauge,sw_v_empty_voltage_cisd = <0xc1c>;
				fuelgauge,sw_v_empty_recover_voltage = <0xd98>;
				fuelgauge,qrtable20 = <0x1e04>;
				fuelgauge,qrtable30 = <0x1902>;
				fuelgauge,fg_resistor = <0x02>;
				fuelgauge,capacity = <0xce7>;
				fuelgauge,discharge_temp_threshold = <0x258>;
				fuelgauge,discharge_volt_threshold = <0x1068>;
				fuelgauge,ttf_capacity = <0xdac>;
				fuelgauge,cv_data = <0x9b8 0x33d 0x711 0x969 0x340 0x704 0x917 0x345 0x6e9 0x8e0 0x348 0x6cf 0x886 0x34e 0x6b9 0x838 0x352 0x69a 0x7f6 0x356 0x686 0x79e 0x35b 0x668 0x770 0x35d 0x656 0x72e 0x361 0x63a 0x705 0x363 0x628 0x6d5 0x366 0x618 0x6a7 0x369 0x5fb 0x693 0x369 0x5f5 0x683 0x36b 0x5eb 0x67c 0x36b 0x5e8 0x675 0x36c 0x5e5 0x64f 0x36e 0x5de 0x62c 0x370 0x5cb 0x611 0x371 0x5b7 0x608 0x372 0x5b2 0x5f0 0x373 0x5ab 0x5c5 0x376 0x590 0x597 0x378 0x581 0x574 0x37b 0x567 0x543 0x37e 0x551 0x513 0x380 0x534 0x4f3 0x382 0x523 0x4cf 0x386 0x508 0x4b2 0x388 0x4ef 0x47c 0x38a 0x4db 0x455 0x38d 0x4bd 0x42b 0x38f 0x4a1 0x407 0x392 0x484 0x3f5 0x393 0x474 0x3cf 0x395 0x457 0x3c1 0x397 0x43c 0x399 0x399 0x428 0x37c 0x39b 0x40e 0x377 0x39b 0x3fb 0x35f 0x39d 0x3ec 0x341 0x39f 0x3d0 0x328 0x3a1 0x3b2 0x313 0x3a2 0x396 0x30c 0x3a3 0x388 0x2fc 0x3a4 0x37f 0x2e8 0x3a6 0x360 0x2da 0x3a7 0x34e 0x2cb 0x3a8 0x33c 0x2b5 0x3a9 0x320 0x2a9 0x3aa 0x30f 0x29a 0x3ac 0x2f0 0x28b 0x3ad 0x2df 0x280 0x3ae 0x2c8 0x274 0x3b1 0x2b9 0x26e 0x3b2 0x2a7 0x26a 0x3b3 0x298 0x258 0x3b6 0x286 0x254 0x3b7 0x273 0x24d 0x3b9 0x266 0x248 0x3b9 0x259 0x240 0x3bc 0x23c 0x241 0x3bd 0x229 0x232 0x3be 0x217 0x1ff 0x3c8 0x1fa 0x1f9 0x3c9 0x1e7 0x1ed 0x3cb 0x1d0 0x1ec 0x3cc 0x1b3 0x1e4 0x3cd 0x1a1 0x1e0 0x3cf 0x18e 0x1da 0x3d0 0x17c 0x1d6 0x3d1 0x16c 0x1ce 0x3d1 0x163 0x1c8 0x3d2 0x150 0x1c4 0x3d3 0x149 0x1be 0x3d5 0x12f 0x1b5 0x3d6 0x11a 0x1ad 0x3d8 0xff 0x1a7 0x3d9 0xf2 0x1a6 0x3da 0xe5 0x19e 0x3db 0xd3 0x19b 0x3dc 0xc7 0x195 0x3dd 0xbf 0x18d 0x3de 0xab 0x187 0x3df 0x8c 0x183 0x3e0 0x7e 0x180 0x3e1 0x6b 0x174 0x3e3 0x54 0x16c 0x3e5 0x36 0x164 0x3e6 0x1a 0x164 0x3e6 0x0d 0x00 0x3e8 0x00>;
			};

			cable-info {
				default_input_current = <0x708>;
				default_charging_current = <0x834>;
				full_check_current_1st = <0x15e>;
				full_check_current_2nd = <0xc8>;

				current_group_1 {
					cable_number = <0x02 0x13 0x15 0x16 0x17 0x1e>;
					input_current = <0x1f4>;
					charging_current = <0x1f4>;
				};

				current_group_2 {
					cable_number = <0x19 0x1f>;
					input_current = <0x3e8>;
					charging_current = <0x3e8>;
				};

				current_group_3 {
					cable_number = <0x05 0x20>;
					input_current = <0x5dc>;
					charging_current = <0x5dc>;
				};

				current_group_4 {
					cable_number = <0x06 0x07 0x08>;
					input_current = <0x672>;
					charging_current = <0x9c4>;
				};

				current_group_5 {
					cable_number = <0x09>;
					input_current = <0x672>;
					charging_current = <0x9c4>;
				};

				current_group_6 {
					cable_number = <0x0a 0x0c 0x0e 0x0f 0x1b>;
					input_current = <0x384>;
					charging_current = <0x578>;
				};

				current_group_7 {
					cable_number = <0x0d>;
					input_current = <0x2bc>;
					charging_current = <0x578>;
				};

				current_group_8 {
					cable_number = <0x18>;
					input_current = <0x3e8>;
					charging_current = <0x1c2>;
				};

				current_group_9 {
					cable_number = <0x1a>;
					input_current = <0x7d0>;
					charging_current = <0x708>;
				};

				current_group_10 {
					cable_number = <0x0b 0x10 0x1c>;
					input_current = <0x28a>;
					charging_current = <0x578>;
				};

				current_group_11 {
					cable_number = <0x1d>;
					input_current = <0x1f4>;
					charging_current = <0x578>;
				};

				current_group_12 {
					cable_number = <0x01 0x04>;
					input_current = <0x1db>;
					charging_current = <0x226>;
				};
			};
		};
	};

	fragment@8 {
		target = <0xffffffff>;

		__overlay__ {

			wpc-int {
				samsung,pins = "gpa3-1";
				samsung,pin-function = <0x0f>;
				samsung,pin-pud = <0x00>;
				samsung,pin-drv = <0x00>;
				phandle = <0x06>;
			};

			wpc-det {
				samsung,pins = "gpa2-0";
				samsung,pin-function = <0x0f>;
				samsung,pin-pud = <0x01>;
				phandle = <0x07>;
			};
		};
	};

	fragment@9 {
		target = <0xffffffff>;

		__overlay__ {

			jig-gpio {
				samsung,pins = "gpg0-0";
				samsung,pin-function = <0x0f>;
				samsung,pin-pud = <0x00>;
				samsung,pin-drv = <0x00>;
				phandle = <0x73>;
			};
		};
	};

	fragment@10 {
		target = <0xffffffff>;

		__overlay__ {
			#address-cells = <0x01>;
			#size-cells = <0x00>;
			status = "okay";
			samsung,stop-after-trans;
			samsung,stand-mode;
			clock-frequency = <0x186a0>;

			mfc-charger@3b {
				compatible = "idt,mfc-charger";
				reg = <0x3b>;
				status = "okay";
				pinctrl-names = "default";
				pinctrl-0 = <0x06 0x07>;
				battery,wpc_int = <0xffffffff 0x01 0x00>;
				battery,wpc_det = <0xffffffff 0x00 0x00>;
				battery,mst_en = <0xffffffff 0x07 0x00>;
				battery,charger_name = "max77705-charger";
				battery,fuelgauge_name = "max77705-fuelgauge";
				battery,wireless_charger_name = "mfc-charger";
				battery,fod_wpc_data = <0x96 0x34 0x8e 0x2c 0x96 0x1e 0x96 0x16 0xa5 0xeb 0x9c 0x0b>;
				battery,fod_pma_data = <0x96 0x34 0x8e 0x2c 0x96 0x1e 0x96 0x16 0xa5 0xeb 0x9c 0x0b>;
				battery,fod_a4wp_data = <0x96 0x34 0x8e 0x2c 0x96 0x1e 0x96 0x16 0xa5 0xeb 0x9c 0x0b>;
				battery,fod_wpc_data_cv = <0x96 0x52 0x8e 0x4a 0x96 0x3c 0x96 0x34 0xa5 0xff 0x9c 0x29>;
				battery,fod_pma_data_cv = <0x96 0x52 0x8e 0x4a 0x96 0x3c 0x96 0x34 0xa5 0xff 0x9c 0x29>;
				battery,fod_a4wp_data_cv = <0x96 0x52 0x8e 0x4a 0x96 0x3c 0x96 0x34 0xa5 0xff 0x9c 0x29>;
				battery,fod_hero_5v_data = <0x96 0x02 0x8e 0xfffffffa 0x96 0xffffffec 0x96 0xffffffe4 0xa5 0xb9 0x9c 0xffffffd9>;
				battery,wpc_cc_cv_vout = <0x157c>;
				battery,wpc_cv_call_vout = <0x1388>;
				battery,wpc_cc_call_vout = <0x1388>;
				battery,hv_vout_wa = <0x41>;
				battery,wc_cover_rpp = <0x44>;
			};
		};
	};

	fragment@muic {
		target-path = [2f 00];

		__overlay__ {

			muic {
				status = "okay";
				muic,support-list = "TA\0USB\0CDP\0JIG UART OFF\0JIG UART OFF/VB\0JIG UART ON\0JIG UART ON/VB\0JIG USB OFF\0JIG USB ON\0OTG\0Unofficial TA\0DCD Timeout\0AFC Charger";
			};
		};
	};

	fragment@11 {
		target = <0xffffffff>;

		__overlay__ {

			max77705-irq {
				samsung,pins = "gpa1-6";
				samsung,pin-function = <0x0f>;
				samsung,pin-pud = <0x00>;
				samsung,pin-drv = <0x00>;
				phandle = <0x08>;
			};
		};
	};

	fragment@12 {
		target = <0xffffffff>;

		__overlay__ {
			#address-cells = <0x01>;
			#size-cells = <0x00>;
			status = "okay";

			max77705@66 {
				compatible = "maxim,max77705";
				pinctrl-names = "default";
				pinctrl-0 = <0x08>;
				reg = <0x66>;
				max77705,irq-gpio = <0xffffffff 0x06 0x01>;
				max77705,wakeup;
				max77705,fw_product_id = <0x03>;

				regulators {

					ESAFEOUT1 {
						regulator-compatible = "safeout1";
						regulator-name = "safeout1_range";
						regulator-min-microvolt = <0x325aa0>;
						regulator-max-microvolt = <0x4ac4a0>;
						regulator-boot-on;
					};

					ESAFEOUT2 {
						regulator-compatible = "safeout2";
						regulator-name = "safeout2_range";
						regulator-min-microvolt = <0x325aa0>;
						regulator-max-microvolt = <0x4ac4a0>;
					};
				};
			};
		};
	};

	fragment@model {
		target-path = [2f 00];

		__overlay__ {
			#address-cells = <0x02>;
			#size-cells = <0x01>;
			model = "Samsung UNIVERSAL9830 board based on EXYNOS9830";

			fixed-rate-clocks {

				oscclk {
					compatible = "samsung,exynos9830-oscclk";
					clock-frequency = <0x18cba80>;
				};
			};

			gpio_keys {
				status = "okay";
				compatible = "gpio-keys";
				pinctrl-names = "default";
				pinctrl-0 = <0x09 0x0a 0x0b>;

				button@2 {
					label = "gpio-keys: KEY_VOLUMEDOWN";
					linux,code = <0x72>;
					gpios = <0xffffffff 0x04 0x0f>;
				};

				button@3 {
					label = "gpio-keys: KEY_VOLUMEUP";
					linux,code = <0x73>;
					gpios = <0xffffffff 0x03 0x0f>;
				};

				button@4 {
					label = "gpio-keys: KEY_POWER";
					linux,code = <0x74>;
					gpios = <0xffffffff 0x04 0x0f>;
					gpio-key,wakeup = <0x01>;
				};
			};

			exynos_rgt {
				compatible = "samsung,exynos-rgt";
				num-acpm-pmic = <0x02>;
			};

			exynos_pm_dvs {
				compatible = "samsung,exynos-pm-dvs";

				vdd_lldo1 {
					regulator_name = "m_vdd_buck9";
					suspend_volt = <0xc3500>;
					init_volt = <0xcf850>;
					volt_range_step = <0xf424>;
				};

				vdd_lldo2 {
					regulator_name = "m_vdd_buck10";
					suspend_volt = <0xdbba0>;
					init_volt = <0xe7ef0>;
					volt_range_step = <0xf424>;
				};

				vdd_lldo3 {
					regulator_name = "m_vdd_buck11";
					suspend_volt = <0x1312d0>;
					init_volt = <0x149970>;
					volt_range_step = <0xf424>;
				};

				vdd_mldo {
					regulator_name = "m_vdd_buck12";
					suspend_volt = <0x1c3a90>;
					init_volt = <0x1e8480>;
					volt_range_step = <0x30d4>;
				};
			};

			hs_tune {
				status = "disabled";
				hs_tune_cnt = <0x06>;
				phandle = <0x14>;

				hs_tune1 {
					tune_name = "tx_pre_emp";
					tune_value = <0x03 0x03>;
				};

				hs_tune2 {
					tune_name = "tx_vref";
					tune_value = <0x0f 0x0f>;
				};

				hs_tune3 {
					tune_name = "rx_sqrx";
					tune_value = <0x07 0x07>;
				};

				hs_tune4 {
					tune_name = "utmi_clk";
					tune_value = <0x01 0x01>;
				};

				hs_tune5 {
					tune_name = "compdis";
					tune_value = <0x07 0x07>;
				};

				hs_tune6 {
					tune_name = "tx_res";
					tune_value = <0x03 0x03>;
				};
			};

			ss_tune {
				status = "disabled";
				ss_tune_cnt = <0x24>;
				phandle = <0x15>;

				ss_tune1 {
					tune_name = "ssrx_sqhs_th_ss";
					tune_value = <0xffffffff 0xffffffff>;
				};

				ss_tune2 {
					tune_name = "ssrx_sqhs_th_ssp";
					tune_value = <0xffffffff 0xffffffff>;
				};

				ss_tune3 {
					tune_name = "ssrx_lfps_th";
					tune_value = <0xffffffff 0xffffffff>;
				};

				ss_tune4 {
					tune_name = "ssrx_adap_coef_sel";
					tune_value = <0xffffffff 0xffffffff>;
				};

				ss_tune5 {
					tune_name = "ssrx_mf_eq_psel_ctrl_ss";
					tune_value = <0xffffffff 0xffffffff>;
				};

				ss_tune6 {
					tune_name = "ssrx_mf_eq_psel_ctrl_ssp";
					tune_value = <0xffffffff 0xffffffff>;
				};

				ss_tune7 {
					tune_name = "ssrx_mf_eq_zsel_ctrl_ss";
					tune_value = <0xffffffff 0xffffffff>;
				};

				ss_tune8 {
					tune_name = "ssrx_mf_eq_zsel_ctrl_ssp";
					tune_value = <0xffffffff 0xffffffff>;
				};

				ss_tune9 {
					tune_name = "ssrx_hf_eq_rsel_ctrl_ss";
					tune_value = <0xffffffff 0xffffffff>;
				};

				ss_tune10 {
					tune_name = "ssrx_hf_eq_rsel_ctrl_ssp";
					tune_value = <0xffffffff 0xffffffff>;
				};

				ss_tune11 {
					tune_name = "ssrx_hf_eq_csel_ctrl_ss";
					tune_value = <0xffffffff 0xffffffff>;
				};

				ss_tune12 {
					tune_name = "ssrx_hf_eq_csel_ctrl_ssp";
					tune_value = <0xffffffff 0xffffffff>;
				};

				ss_tune13 {
					tune_name = "ssrx_dfe_1tap_ctrl_ss";
					tune_value = <0xffffffff 0xffffffff>;
				};

				ss_tune14 {
					tune_name = "ssrx_dfe_1tap_ctrl_ssp";
					tune_value = <0xffffffff 0xffffffff>;
				};

				ss_tune15 {
					tune_name = "ssrx_dfe_2tap_ctrl_ss";
					tune_value = <0xffffffff 0xffffffff>;
				};

				ss_tune16 {
					tune_name = "ssrx_dfe_2tap_ctrl_ssp";
					tune_value = <0xffffffff 0xffffffff>;
				};

				ss_tune17 {
					tune_name = "ssrx_dfe_3tap_ctrl_ss";
					tune_value = <0xffffffff 0xffffffff>;
				};

				ss_tune18 {
					tune_name = "ssrx_dfe_3tap_ctrl_ssp";
					tune_value = <0xffffffff 0xffffffff>;
				};

				ss_tune19 {
					tune_name = "ssrx_dfe_4tap_ctrl_ss";
					tune_value = <0xffffffff 0xffffffff>;
				};

				ss_tune20 {
					tune_name = "ssrx_dfe_4tap_ctrl_ssp";
					tune_value = <0xffffffff 0xffffffff>;
				};

				ss_tune21 {
					tune_name = "ssrx_dfe_5tap_ctrl_ss";
					tune_value = <0xffffffff 0xffffffff>;
				};

				ss_tune22 {
					tune_name = "ssrx_dfe_5tap_ctrl_ssp";
					tune_value = <0xffffffff 0xffffffff>;
				};

				ss_tune23 {
					tune_name = "ssrx_term_cal";
					tune_value = <0xffffffff 0xffffffff>;
				};

				ss_tune24 {
					tune_name = "sstx_amp_ss";
					tune_value = <0xffffffff 0xffffffff>;
				};

				ss_tune25 {
					tune_name = "sstx_deemp_ss";
					tune_value = <0xffffffff 0xffffffff>;
				};

				ss_tune26 {
					tune_name = "sstx_pre_shoot_ss";
					tune_value = <0xffffffff 0xffffffff>;
				};

				ss_tune27 {
					tune_name = "sstx_amp_ssp";
					tune_value = <0xffffffff 0xffffffff>;
				};

				ss_tune28 {
					tune_name = "sstx_deemp_ssp";
					tune_value = <0xffffffff 0xffffffff>;
				};

				ss_tune29 {
					tune_name = "sstx_pre_shoot_ssp";
					tune_value = <0xffffffff 0xffffffff>;
				};

				ss_tune30 {
					tune_name = "sstx_idrv_up";
					tune_value = <0xffffffff 0xffffffff>;
				};

				ss_tune31 {
					tune_name = "sstx_lfps_idrv_up";
					tune_value = <0xffffffff 0xffffffff>;
				};

				ss_tune32 {
					tune_name = "sstx_up_term";
					tune_value = <0xffffffff 0xffffffff>;
				};

				ss_tune33 {
					tune_name = "sstx_dn_term";
					tune_value = <0xffffffff 0xffffffff>;
				};

				ss_tune34 {
					tune_name = "rext_ovrd";
					tune_value = <0xffffffff 0xffffffff>;
				};

				ss_tune35 {
					tune_name = "ssrx_cdr_fbb_fine_ctrl_sp";
					tune_value = <0xffffffff 0xffffffff>;
				};

				ss_tune36 {
					tune_name = "ssrx_cdr_fbb_fine_ctrl_ssp";
					tune_value = <0xffffffff 0xffffffff>;
				};
			};

			usb_notifier {
				compatible = "samsung,usb-notifier";
				udc = <0xffffffff>;
				usb-ldocontrol = <0x04>;
				disable_host_wakelock = <0x01>;
			};

			vbat {
				compatible = "regulator-fixed";
				regulator-name = "VBAT";
				regulator-min-microvolt = <0x401640>;
				regulator-max-microvolt = <0x401640>;
				regulator-boot-on;
				phandle = <0x1a>;
			};

			fixedregulator@1 {
				compatible = "regulator-fixed";
				regulator-name = "main_micbias_1p8";
				regulator-min-microvolt = <0x1b7740>;
				regulator-max-microvolt = <0x1b7740>;
				gpio = <0xffffffff 0x01 0x00>;
				enable-active-high;
				vin-supply = <0x0c>;
				phandle = <0x0d>;
			};

			audio-codec-dummy {
				compatible = "snd-soc-dummy";
				#sound-dai-cells = <0x00>;
				phandle = <0x13>;
			};

			audio-cpu-dummy {
				compatible = "samsung,dummy-cpu";
				#sound-dai-cells = <0x00>;
				phandle = <0x74>;
			};

			sound {
				compatible = "samsung,exynos9830-madera";
				clock-names = "xclkout";
				clocks = <0xffffffff 0x385>;
				MICBIAS1-supply = <0x0d>;
				MICBIAS2-supply = <0x0e>;
				MICBIAS3-supply = <0x0f>;
				MICBIAS4-supply = <0x10>;
				samsung,routing = "DMIC1\0MICBIAS1\0DMIC2\0MICBIAS2\0DMIC3\0MICBIAS3\0DMIC4\0MICBIAS4\0RECEIVER\0Left AMP SPK\0SPEAKER\0Right AMP SPK\0BLUETOOTH SPK\0ABOX UAIF3 Playback\0ABOX UAIF3 Capture\0BLUETOOTH MIC\0USB SPK\0ABOX USB Playback\0ABOX USB Capture\0USB MIC\0FWD SPK\0ABOX FWD Playback\0ABOX FWD Capture\0FWD MIC\0VTS Virtual Output\0VTS Virtual Output Mux\0PAD DPDM\0DMIC1\0PAD DPDM\0DMIC2\0PAD DPDM\0DMIC3\0PAD DPDM\0DMIC4";
				samsung,codec = <0x11 0x12 0xffffffff>;
				samsung,prefix = "Left\0Right\0VTS";
				samsung,aux = <0xffffffff 0xffffffff>;

				rdma0 {

					cpu {
						sound-dai = <0xffffffff 0x00>;
					};

					platform {
						sound-dai = <0xffffffff 0x00>;
					};

					codec {
						sound-dai = <0x13>;
					};
				};

				rdma1 {

					cpu {
						sound-dai = <0xffffffff 0x00>;
					};

					platform {
						sound-dai = <0xffffffff 0x00>;
					};

					codec {
						sound-dai = <0x13>;
					};
				};

				rdma2 {

					cpu {
						sound-dai = <0xffffffff 0x00>;
					};

					platform {
						sound-dai = <0xffffffff 0x00>;
					};

					codec {
						sound-dai = <0x13>;
					};
				};

				rdma3 {

					cpu {
						sound-dai = <0xffffffff 0x00>;
					};

					platform {
						sound-dai = <0xffffffff 0x00>;
					};

					codec {
						sound-dai = <0x13>;
					};
				};

				rdma4 {

					cpu {
						sound-dai = <0xffffffff 0x00>;
					};

					platform {
						sound-dai = <0xffffffff 0x00>;
					};

					codec {
						sound-dai = <0x13>;
					};
				};

				rdma5 {

					cpu {
						sound-dai = <0xffffffff 0x00>;
					};

					platform {
						sound-dai = <0xffffffff 0x00>;
					};

					codec {
						sound-dai = <0x13>;
					};
				};

				rdma6 {

					cpu {
						sound-dai = <0xffffffff 0x00>;
					};

					platform {
						sound-dai = <0xffffffff 0x00>;
					};

					codec {
						sound-dai = <0x13>;
					};
				};

				rdma7 {

					cpu {
						sound-dai = <0xffffffff 0x00>;
					};

					platform {
						sound-dai = <0xffffffff 0x00>;
					};

					codec {
						sound-dai = <0x13>;
					};
				};

				rdma8 {

					cpu {
						sound-dai = <0xffffffff 0x00>;
					};

					platform {
						sound-dai = <0xffffffff 0x00>;
					};

					codec {
						sound-dai = <0x13>;
					};
				};

				rdma9 {

					cpu {
						sound-dai = <0xffffffff 0x00>;
					};

					platform {
						sound-dai = <0xffffffff 0x00>;
					};

					codec {
						sound-dai = <0x13>;
					};
				};

				rdma10 {

					cpu {
						sound-dai = <0xffffffff 0x00>;
					};

					platform {
						sound-dai = <0xffffffff 0x00>;
					};

					codec {
						sound-dai = <0x13>;
					};
				};

				rdma11 {

					cpu {
						sound-dai = <0xffffffff 0x00>;
					};

					platform {
						sound-dai = <0xffffffff 0x00>;
					};

					codec {
						sound-dai = <0x13>;
					};
				};

				wdma0 {

					cpu {
						sound-dai = <0xffffffff 0x00>;
					};

					platform {
						sound-dai = <0xffffffff 0x00>;
					};

					codec {
						sound-dai = <0x13>;
					};
				};

				wdma1 {

					cpu {
						sound-dai = <0xffffffff 0x00>;
					};

					platform {
						sound-dai = <0xffffffff 0x00>;
					};

					codec {
						sound-dai = <0x13>;
					};
				};

				wdma2 {

					cpu {
						sound-dai = <0xffffffff 0x00>;
					};

					platform {
						sound-dai = <0xffffffff 0x00>;
					};

					codec {
						sound-dai = <0x13>;
					};
				};

				wdma3 {

					cpu {
						sound-dai = <0xffffffff 0x00>;
					};

					platform {
						sound-dai = <0xffffffff 0x00>;
					};

					codec {
						sound-dai = <0x13>;
					};
				};

				wdma4 {

					cpu {
						sound-dai = <0xffffffff 0x00>;
					};

					platform {
						sound-dai = <0xffffffff 0x00>;
					};

					codec {
						sound-dai = <0x13>;
					};
				};

				vts0 {

					cpu {
						sound-dai = <0xffffffff 0x00>;
					};

					codec {
						sound-dai = <0x13>;
					};
				};

				vts1 {

					cpu {
						sound-dai = <0xffffffff 0x01>;
					};

					codec {
						sound-dai = <0x13>;
					};
				};

				dp0_audio {

					cpu {
						sound-dai = <0xffffffff 0x00>;
					};

					codec {
						sound-dai = <0x13>;
					};
				};

				dp1_audio {

					cpu {
						sound-dai = <0xffffffff 0x01>;
					};

					codec {
						sound-dai = <0x13>;
					};
				};

				dual0 {

					cpu {
						sound-dai = <0xffffffff>;
					};

					platform {
						sound-dai = <0xffffffff>;
					};

					codec {
						sound-dai = <0x13>;
					};
				};

				dual1 {

					cpu {
						sound-dai = <0xffffffff>;
					};

					platform {
						sound-dai = <0xffffffff>;
					};

					codec {
						sound-dai = <0x13>;
					};
				};

				dual2 {

					cpu {
						sound-dai = <0xffffffff>;
					};

					platform {
						sound-dai = <0xffffffff>;
					};

					codec {
						sound-dai = <0x13>;
					};
				};

				dual3 {

					cpu {
						sound-dai = <0xffffffff>;
					};

					platform {
						sound-dai = <0xffffffff>;
					};

					codec {
						sound-dai = <0x13>;
					};
				};

				dual4 {

					cpu {
						sound-dai = <0xffffffff>;
					};

					platform {
						sound-dai = <0xffffffff>;
					};

					codec {
						sound-dai = <0x13>;
					};
				};

				ddma0 {

					cpu {
						sound-dai = <0xffffffff>;
					};

					platform {
						sound-dai = <0xffffffff>;
					};

					codec {
						sound-dai = <0x13>;
					};
				};

				ddma1 {

					cpu {
						sound-dai = <0xffffffff>;
					};

					platform {
						sound-dai = <0xffffffff>;
					};

					codec {
						sound-dai = <0x13>;
					};
				};

				ddma2 {

					cpu {
						sound-dai = <0xffffffff>;
					};

					platform {
						sound-dai = <0xffffffff>;
					};

					codec {
						sound-dai = <0x13>;
					};
				};

				ddma3 {

					cpu {
						sound-dai = <0xffffffff>;
					};

					platform {
						sound-dai = <0xffffffff>;
					};

					codec {
						sound-dai = <0x13>;
					};
				};

				ddma4 {

					cpu {
						sound-dai = <0xffffffff>;
					};

					platform {
						sound-dai = <0xffffffff>;
					};

					codec {
						sound-dai = <0x13>;
					};
				};

				ddma5 {

					cpu {
						sound-dai = <0xffffffff>;
					};

					platform {
						sound-dai = <0xffffffff>;
					};

					codec {
						sound-dai = <0x13>;
					};
				};

				uaif0 {
					format = "i2s";

					cpu {
						sound-dai = <0xffffffff>;
					};

					codec {
						sound-dai = <0x13>;
					};
				};

				uaif1 {
					format = "i2s";

					cpu {
						sound-dai = <0xffffffff>;
					};

					codec {
						sound-dai = <0x13>;
					};
				};

				uaif2 {
					format = "dsp_a";

					cpu {
						sound-dai = <0xffffffff>;
					};

					codec {
						sound-dai = <0x11 0x00 0x12 0x00>;
					};
				};

				uaif3 {
					format = "i2s";

					cpu {
						sound-dai = <0xffffffff>;
					};

					codec {
						sound-dai = <0x13>;
					};
				};

				uaif4 {
					format = "i2s";

					cpu {
						sound-dai = <0xffffffff>;
					};

					codec {
						sound-dai = <0x13>;
					};
				};

				uaif5 {
					format = "i2s";

					cpu {
						sound-dai = <0xffffffff>;
					};

					codec {
						sound-dai = <0x13>;
					};
				};

				uaif6 {
					format = "dsp_a";
					bitclock-master;
					bitclock-inversion;
					frame-master;

					cpu {
						sound-dai = <0xffffffff>;
					};

					codec {
						sound-dai = <0xffffffff 0x00>;
					};
				};

				dsif0 {
					format = "pdm";

					cpu {
						sound-dai = <0xffffffff>;
					};

					codec {
						sound-dai = <0x13>;
					};
				};

				sifs0 {

					cpu {
						sound-dai = <0xffffffff 0x00>;
					};

					codec {
						sound-dai = <0x13>;
					};
				};

				sifs1 {

					cpu {
						sound-dai = <0xffffffff 0x01>;
					};

					codec {
						sound-dai = <0x13>;
					};
				};

				sifs2 {

					cpu {
						sound-dai = <0xffffffff 0x02>;
					};

					codec {
						sound-dai = <0x13>;
					};
				};

				sifs3 {

					cpu {
						sound-dai = <0xffffffff 0x03>;
					};

					codec {
						sound-dai = <0x13>;
					};
				};

				sifs4 {

					cpu {
						sound-dai = <0xffffffff 0x04>;
					};

					codec {
						sound-dai = <0x13>;
					};
				};

				sifs5 {

					cpu {
						sound-dai = <0xffffffff 0x05>;
					};

					codec {
						sound-dai = <0x13>;
					};
				};

				nsrc0 {

					cpu {
						sound-dai = <0xffffffff 0x06>;
					};

					codec {
						sound-dai = <0x13>;
					};
				};

				nsrc1 {

					cpu {
						sound-dai = <0xffffffff 0x07>;
					};

					codec {
						sound-dai = <0x13>;
					};
				};

				nsrc2 {

					cpu {
						sound-dai = <0xffffffff 0x08>;
					};

					codec {
						sound-dai = <0x13>;
					};
				};

				nsrc3 {

					cpu {
						sound-dai = <0xffffffff 0x09>;
					};

					codec {
						sound-dai = <0x13>;
					};
				};

				nsrc4 {

					cpu {
						sound-dai = <0xffffffff 0x0a>;
					};

					codec {
						sound-dai = <0x13>;
					};
				};

				rdma0_be {

					cpu {
						sound-dai = <0xffffffff 0x01>;
					};

					platform {
						sound-dai = <0xffffffff 0x01>;
					};

					codec {
						sound-dai = <0x13>;
					};
				};

				rdma1_be {

					cpu {
						sound-dai = <0xffffffff 0x01>;
					};

					platform {
						sound-dai = <0xffffffff 0x01>;
					};

					codec {
						sound-dai = <0x13>;
					};
				};

				rdma2_be {

					cpu {
						sound-dai = <0xffffffff 0x01>;
					};

					platform {
						sound-dai = <0xffffffff 0x01>;
					};

					codec {
						sound-dai = <0x13>;
					};
				};

				rdma3_be {

					cpu {
						sound-dai = <0xffffffff 0x01>;
					};

					platform {
						sound-dai = <0xffffffff 0x01>;
					};

					codec {
						sound-dai = <0x13>;
					};
				};

				rdma4_be {

					cpu {
						sound-dai = <0xffffffff 0x01>;
					};

					platform {
						sound-dai = <0xffffffff 0x01>;
					};

					codec {
						sound-dai = <0x13>;
					};
				};

				rdma5_be {

					cpu {
						sound-dai = <0xffffffff 0x01>;
					};

					platform {
						sound-dai = <0xffffffff 0x01>;
					};

					codec {
						sound-dai = <0x13>;
					};
				};

				rdma6_be {

					cpu {
						sound-dai = <0xffffffff 0x01>;
					};

					platform {
						sound-dai = <0xffffffff 0x01>;
					};

					codec {
						sound-dai = <0x13>;
					};
				};

				rdma7_be {

					cpu {
						sound-dai = <0xffffffff 0x01>;
					};

					platform {
						sound-dai = <0xffffffff 0x01>;
					};

					codec {
						sound-dai = <0x13>;
					};
				};

				rdma8_be {

					cpu {
						sound-dai = <0xffffffff 0x01>;
					};

					platform {
						sound-dai = <0xffffffff 0x01>;
					};

					codec {
						sound-dai = <0x13>;
					};
				};

				rdma9_be {

					cpu {
						sound-dai = <0xffffffff 0x01>;
					};

					platform {
						sound-dai = <0xffffffff 0x01>;
					};

					codec {
						sound-dai = <0x13>;
					};
				};

				rdma10_be {

					cpu {
						sound-dai = <0xffffffff 0x01>;
					};

					platform {
						sound-dai = <0xffffffff 0x01>;
					};

					codec {
						sound-dai = <0x13>;
					};
				};

				rdma11_be {

					cpu {
						sound-dai = <0xffffffff 0x01>;
					};

					platform {
						sound-dai = <0xffffffff 0x01>;
					};

					codec {
						sound-dai = <0x13>;
					};
				};

				wdma0_be {

					cpu {
						sound-dai = <0xffffffff 0x01>;
					};

					platform {
						sound-dai = <0xffffffff 0x01>;
					};

					codec {
						sound-dai = <0x13>;
					};
				};

				wdma1_be {

					cpu {
						sound-dai = <0xffffffff 0x01>;
					};

					platform {
						sound-dai = <0xffffffff 0x01>;
					};

					codec {
						sound-dai = <0x13>;
					};
				};

				wdma2_be {

					cpu {
						sound-dai = <0xffffffff 0x01>;
					};

					platform {
						sound-dai = <0xffffffff 0x01>;
					};

					codec {
						sound-dai = <0x13>;
					};
				};

				wdma3_be {

					cpu {
						sound-dai = <0xffffffff 0x01>;
					};

					platform {
						sound-dai = <0xffffffff 0x01>;
					};

					codec {
						sound-dai = <0x13>;
					};
				};

				wdma4_be {

					cpu {
						sound-dai = <0xffffffff 0x01>;
					};

					platform {
						sound-dai = <0xffffffff 0x01>;
					};

					codec {
						sound-dai = <0x13>;
					};
				};

				usb {

					cpu {
						sound-dai = <0xffffffff 0x10>;
					};

					codec {
						sound-dai = <0x13>;
					};
				};

				fwd {

					cpu {
						sound-dai = <0xffffffff 0x11>;
					};

					codec {
						sound-dai = <0x13>;
					};
				};
			};

			acpm_ipc {
				compatible = "samsung,exynos-acpm-ipc";
				board-id = <0x10>;
				board-rev = <0x04>;
			};

			firmware {

				android {
					compatible = "android,firmware";
					phandle = <0x75>;

					vbmeta {
						compatible = "android,vbmeta";
						parts = "vbmeta,boot,system,vendor";
					};

					fstab {
						compatible = "android,fstab";

						vendor {
							compatible = "android,vendor";
							dev = "/dev/block/platform/13100000.ufs/by-name/vendor";
							type = "ext4";
							mnt_flags = "ro";
							fsmgr_flags = "wait,avb";
							status = "disabled";
							phandle = <0x76>;
						};
					};
				};
			};
		};
	};

	fragment@13 {
		target = <0xffffffff>;

		__overlay__ {
			samsung,rts-trig-level = <0x01>;
			status = "okay";
		};
	};

	fragment@14 {
		target = <0xffffffff>;

		__overlay__ {

			key-voldown {
				samsung,pins = "gpa0-4";
				samsung,pin-function = <0x0f>;
				samsung,pin-pud = <0x00>;
				samsung,pin-drv = <0x00>;
				phandle = <0x09>;
			};

			key-volup {
				samsung,pins = "gpa0-3";
				samsung,pin-function = <0x0f>;
				samsung,pin-pud = <0x00>;
				samsung,pin-drv = <0x00>;
				phandle = <0x0a>;
			};

			key-power {
				samsung,pins = "gpa2-4";
				samsung,pin-function = <0x0f>;
				samsung,pin-pud = <0x00>;
				samsung,pin-drv = <0x00>;
				phandle = <0x0b>;
			};

			attn-irq {
				samsung,pins = "gpa1-0";
				samsung,pin-function = <0x0f>;
				samsung,pin-pud = <0x00>;
				samsung,pin-drv = <0x00>;
				phandle = <0x16>;
			};

			attn-input {
				samsung,pins = "gpa1-0";
				samsung,pin-function = <0x00>;
				samsung,pin-pud = <0x01>;
				phandle = <0x17>;
			};
		};
	};

	fragment@15 {
		target = <0xffffffff>;

		__overlay__ {
			exynos,block-type = "sda";
			exynos,fips-block_offset = <0x05>;
		};
	};

	fragment@16 {
		target = <0xffffffff>;

		__overlay__ {
			usi_v2_mode = "i2c";
			status = "okay";
		};
	};

	fragment@17 {
		target = <0xffffffff>;

		__overlay__ {
			usi_v2_mode = "i2c";
			status = "okay";
		};
	};

	fragment@18 {
		target = <0xffffffff>;

		__overlay__ {
			usi_v2_mode = "i2c";
			status = "okay";
		};
	};

	fragment@19 {
		target = <0xffffffff>;

		__overlay__ {
			usi_v2_mode = "i2c";
			status = "okay";
		};
	};

	fragment@20 {
		target = <0xffffffff>;

		__overlay__ {
			usi_v2_mode = "spi";
			status = "okay";
		};
	};

	fragment@21 {
		target = <0xffffffff>;

		__overlay__ {
			usi_v2_mode = "i2c";
			status = "okay";
		};
	};

	fragment@22 {
		target = <0xffffffff>;

		__overlay__ {
			usi_v2_mode = "spi";
			status = "okay";
		};
	};

	fragment@23 {
		target = <0xffffffff>;

		__overlay__ {
			usi_v2_mode = "i2c";
			status = "okay";
		};
	};

	fragment@24 {
		target = <0xffffffff>;

		__overlay__ {
			usi_v2_mode = "spi";
			status = "okay";
		};
	};

	fragment@25 {
		target = <0xffffffff>;

		__overlay__ {
			usi_v2_mode = "spi";
			status = "okay";
		};
	};

	fragment@26 {
		target = <0xffffffff>;

		__overlay__ {
			usi_v2_mode = "spi";
			status = "okay";
		};
	};

	fragment@27 {
		target = <0xffffffff>;

		__overlay__ {
			usi_v2_mode = "i2c";
			status = "okay";
		};
	};

	fragment@28 {
		target = <0xffffffff>;

		__overlay__ {
			usi_v2_mode = "i2c";
			status = "okay";
		};
	};

	fragment@29 {
		target = <0xffffffff>;

		__overlay__ {
			usi_v2_mode = "spi";
			status = "okay";
		};
	};

	fragment@30 {
		target = <0xffffffff>;

		__overlay__ {
			usi_v2_mode = "uart";
			status = "okay";
		};
	};

	fragment@31 {
		target = <0xffffffff>;

		__overlay__ {
			usi_v2_mode = "i2c";
			status = "okay";
		};
	};

	fragment@32 {
		target = <0xffffffff>;

		__overlay__ {
			usi_v2_mode = "spi";
			status = "okay";
		};
	};

	fragment@33 {
		target = <0xffffffff>;

		__overlay__ {
			usi_v2_mode = "i2c";
			status = "okay";
		};
	};

	fragment@34 {
		target = <0xffffffff>;

		__overlay__ {
			pinctrl-0 = <0xffffffff>;
		};
	};

	fragment@35 {
		target = <0xffffffff>;

		__overlay__ {
			status = "okay";
		};
	};

	fragment@36 {
		target = <0xffffffff>;

		__overlay__ {
			status = "okay";
			dr_mode = "otg";
			maximum-speed = "super-speed-plus";
			snps,quirk-frame-length-adjustment = <0x20>;
			snps,ux_exit_in_px_quirk;
			snps,elastic_buf_mode_quirk;
			usb3-lpm-capable;
			snps,usb3_lpm_capable;
			adj-sof-accuracy = <0x01>;
			snps,dis-u2-freeclk-exists-quirk;
			samsung,no-extra-delay;
			usb_host_device_timeout = <0xc8>;
			usb_audio_offloading = <0x01>;
			abox = <0xffffffff>;
			xhci_l2_support = <0x01>;
			xhci_use_uram_for_audio = <0x01>;
		};
	};

	fragment@37 {
		target = <0xffffffff>;

		__overlay__ {
			status = "okay";
			phy,gpio_phy_port = <0xffffffff 0x00 0x00>;
			hs_tune_param = <0x14>;
			ss_tune_param = <0x15>;
		};
	};

	fragment@38 {
		target = <0xffffffff>;

		__overlay__ {
			#address-cells = <0x01>;
			#size-cells = <0x00>;
			status = "okay";
			samsung,reset-before-trans;

			touchscreen@48 {
				compatible = "sec,sec_ts";
				reg = <0x48>;
				pinctrl-names = "on_state\0off_state";
				pinctrl-0 = <0x16>;
				pinctrl-1 = <0x17>;
				pressure-sensor = [59 00];
				sec,irq_gpio = <0xffffffff 0x00 0x00>;
				sec,irq_type = <0x2008>;
				sec,max_coords = <0xfff 0xfff>;
				sec,mis_cal_check = <0x01>;
				sec,regulator_dvdd = "m_vdd_ldo19";
				sec,regulator_avdd = "m_vdd_ldo27";
				sec,regulator_boot_on;
				sec,always_lpmode = <0x01>;
				sec,project_name = "Picasso\0GS11";
				sec,firmware_name = "tsp_sec/y761_dream1.fw\0tsp_sec/y761_dream1.fw";
			};
		};
	};

	fragment@39 {
		target = <0xffffffff>;

		__overlay__ {

			dwmmc2_cd_ext_irq {
				samsung,pins = "gpa1-5";
				samsung,pin-function = <0x0f>;
				samsung,pin-pud = <0x03>;
				samsung,pin-drv = <0x04>;
				phandle = <0x1c>;
			};
		};
	};

	fragment@40 {
		target = <0xffffffff>;

		__overlay__ {

			expander-reset-active {
				samsung,pins = "gpm21-0";
				samsung,pin-function = <0x01>;
				samsung,pin-pud = <0x00>;
				samsung,pin-val = <0x01>;
				phandle = <0x25>;
			};
		};
	};

	fragment@41 {
		target = <0xffffffff>;

		__overlay__ {

			cs35l40-r-reset {
				samsung,pins = "gpb2-5";
				samsung,pin-con-pdn = <0x03>;
				samsung,pin-pud-pdn = <0x00>;
				phandle = <0x18>;
			};

			cs35l40-l-reset {
				samsung,pins = "gpb2-4";
				samsung,pin-con-pdn = <0x03>;
				samsung,pin-pud-pdn = <0x00>;
				phandle = <0x1b>;
			};
		};
	};

	fragment@42 {
		target = <0xffffffff>;

		__overlay__ {
			#address-cells = <0x01>;
			#size-cells = <0x00>;
			status = "okay";
			clock-frequency = <0x61a80>;

			cs35l40@40 {
				#sound-dai-cells = <0x01>;
				compatible = "cirrus,cs35l40";
				reg = <0x40>;
				interrupt-parent = <0xffffffff>;
				interrupts = <0x00 0x00 0x00>;
				pinctrl-names = "default";
				pinctrl-0 = <0x18>;
				reset-gpios = <0xffffffff 0x05 0x00>;
				VA-supply = <0x19>;
				VP-supply = <0x1a>;
				cirrus,right-channel-amp;
				phandle = <0x12>;

				cirrus,gpio-config2 {
					cirrus,gpio-src-select = <0x04>;
					cirrus,gpio-output-enable;
				};
			};

			cs35l40@41 {
				#sound-dai-cells = <0x01>;
				compatible = "cirrus,cs35l40";
				reg = <0x41>;
				interrupt-parent = <0xffffffff>;
				interrupts = <0x00 0x00 0x00>;
				pinctrl-names = "default";
				pinctrl-0 = <0x1b>;
				reset-gpios = <0xffffffff 0x04 0x00>;
				VA-supply = <0x19>;
				VP-supply = <0x1a>;
				phandle = <0x11>;

				cirrus,gpio-config2 {
					cirrus,gpio-src-select = <0x04>;
					cirrus,gpio-output-enable;
				};
			};
		};
	};

	fragment@43 {
		target = <0xffffffff>;

		__overlay__ {
			brd-for-cal = [10];
		};
	};

	fragment@44 {
		target = <0xffffffff>;

		__overlay__ {
			#address-cells = <0x02>;
			#size-cells = <0x01>;
			status = "okay";
			num-slots = <0x01>;
			supports-4bit;
			supports-cmd23;
			supports-erase;
			supports-highspeed;
			sd-uhs-sdr50;
			sd-uhs-sdr104;
			card-detect-gpio;
			bypass-for-allpass;
			use-fine-tuning;
			card-init-hwacg-ctrl;
			skip-init-mmc-scan;
			fifo-depth = <0x40>;
			qos_dvfs_level = <0x61a80>;
			desc-size = <0x04>;
			ssc-rate = <0x03>;
			card-detect-delay = <0xc8>;
			data-timeout = <0xc8>;
			hto-timeout = <0x50>;
			samsung,dw-mshc-ciu-div = <0x03>;
			clock-frequency = <0x2faf0800>;
			samsung,dw-mshc-sdr-timing = <0x03 0x00 0x02 0x00>;
			samsung,dw-mshc-ddr-timing = <0x03 0x00 0x02 0x01>;
			samsung,dw-mshc-sdr50-timing = <0x03 0x00 0x04 0x02>;
			samsung,dw-mshc-sdr104-timing = <0x03 0x00 0x03 0x00>;
			num-ref-clks = <0x09>;
			ciu_clkin = <0x19 0x32 0x32 0x19 0x32 0x64 0xc8 0x32 0x32>;
			clk-drive-number = <0x06>;
			pinctrl-names = "default\0fast-slew-rate-1x\0fast-slew-rate-1_5x\0fast-slew-rate-2x\0fast-slew-rate-2_5x\0fast-slew-rate-3x\0fast-slew-rate-4x\0pins-as-pdn\0pins-as-func";
			pinctrl-0 = <0xffffffff 0xffffffff 0xffffffff 0xffffffff 0x1c>;
			pinctrl-1 = <0xffffffff>;
			pinctrl-2 = <0xffffffff>;
			pinctrl-3 = <0xffffffff>;
			pinctrl-4 = <0xffffffff>;
			pinctrl-5 = <0xffffffff>;
			pinctrl-6 = <0xffffffff>;
			pinctrl-7 = <0xffffffff>;
			pinctrl-8 = <0xffffffff 0xffffffff 0xffffffff 0xffffffff>;
			card-detect = <0xffffffff 0x05 0x0f>;

			slot@0 {
				reg = <0x00>;
				bus-width = <0x04>;
				disable-wp;
			};
		};
	};

	fragment@45 {
		target = <0xffffffff>;

		__overlay__ {

			ext-bin@0 {
				compatible = "samsung,abox-ext-bin";
				samsung,name = "APSV_AUDIO_SLSI.bin";
				samsung,area = <0x01>;
				samsung,offset = <0x582000>;
				samsung,changable;
				phandle = <0x77>;
			};

			ext-bin@1 {
				compatible = "samsung,abox-ext-bin";
				samsung,name = "AP_AUDIO_SLSI.bin";
				samsung,area = <0x01>;
				samsung,offset = <0x5ea000>;
				samsung,changable;
				phandle = <0x78>;
			};

			ext-bin@2 {
				compatible = "samsung,abox-ext-bin";
				samsung,name = "APBargeIn_AUDIO_SLSI.bin";
				samsung,area = <0x01>;
				samsung,offset = <0x652000>;
				samsung,changable;
				phandle = <0x79>;
			};

			ext-bin@3 {
				compatible = "samsung,abox-ext-bin";
				samsung,name = "APBiBF_AUDIO_SLSI.bin";
				samsung,area = <0x01>;
				samsung,offset = <0x655000>;
				samsung,changable;
				phandle = <0x7a>;
			};

			ext-bin@4 {
				compatible = "samsung,abox-ext-bin";
				samsung,name = "APDV_AUDIO_SLSI.bin";
				samsung,area = <0x01>;
				samsung,offset = <0x656000>;
				samsung,changable;
				phandle = <0x7b>;
			};

			ext-bin@5 {
				compatible = "samsung,abox-ext-bin";
				samsung,name = "SoundBoosterParam.bin";
				samsung,area = <0x01>;
				samsung,offset = <0x6d6000>;
				samsung,changable;
				phandle = <0x7c>;
			};

			ext-bin@6 {
				compatible = "samsung,abox-ext-bin";
				samsung,name = "bidirmic.bin";
				samsung,area = <0x01>;
				samsung,offset = <0x700000>;
				phandle = <0x7d>;
			};

			ext-bin@7 {
				compatible = "samsung,abox-ext-bin";
				samsung,name = "txse1.bin";
				samsung,area = <0x01>;
				samsung,offset = <0x1800000>;
				phandle = <0x7e>;
			};

			ext-bin@8 {
				compatible = "samsung,abox-ext-bin";
				samsung,name = "txse2.bin";
				samsung,area = <0x01>;
				samsung,offset = <0x19e4000>;
				phandle = <0x7f>;
			};

			ext-bin@9 {
				compatible = "samsung,abox-ext-bin";
				samsung,name = "volumemonitor.bin";
				samsung,area = <0x01>;
				samsung,offset = <0x1a16000>;
				phandle = <0x80>;
			};

			ext-bin@10 {
				compatible = "samsung,abox-ext-bin";
				samsung,name = "sv.bin";
				samsung,area = <0x01>;
				samsung,offset = <0x1a2f000>;
				phandle = <0x81>;
			};

			ext-bin@11 {
				compatible = "samsung,abox-ext-bin";
				samsung,name = "rxse.bin";
				samsung,area = <0x01>;
				samsung,offset = <0x1e4f000>;
				phandle = <0x82>;
			};

			ext-bin@12 {
				compatible = "samsung,abox-ext-bin";
				samsung,name = "sb_music.bin";
				samsung,area = <0x01>;
				samsung,offset = <0x1eff000>;
				phandle = <0x83>;
			};

			ext-bin@13 {
				compatible = "samsung,abox-ext-bin";
				samsung,name = "sb_others.bin";
				samsung,area = <0x01>;
				samsung,offset = <0x1fdd000>;
				phandle = <0x84>;
			};

			ext-bin@14 {
				compatible = "samsung,abox-ext-bin";
				samsung,name = "sb_ll.bin";
				samsung,area = <0x01>;
				samsung,offset = <0x20bb000>;
				phandle = <0x85>;
			};

			ext-bin@15 {
				compatible = "samsung,abox-ext-bin";
				samsung,name = "listenbackeffect.bin";
				samsung,area = <0x01>;
				samsung,offset = <0x2199000>;
				phandle = <0x86>;
			};

			ext-bin@16 {
				compatible = "samsung,abox-ext-bin";
				samsung,name = "a2dpcom.bin";
				samsung,area = <0x01>;
				samsung,offset = <0x21fd000>;
				phandle = <0x87>;
			};
		};
	};

	fragment@46 {
		target = <0xffffffff>;

		__overlay__ {
			pinctrl-names;
		};
	};

	fragment@modemif {
		target-path = [2f 00];

		__overlay__ {
			#address-cells = <0x02>;
			#size-cells = <0x01>;

			cpif {
				compatible = "samsung,exynos-cp";
				status = "okay";
				pinctrl-names = "default";
				pinctrl-0 = <0x1d 0x1e 0x1f 0x20 0x21 0x22 0x23 0x24>;
				gpio_ap2cp_cp_pwr_on = <0xffffffff 0x00 0x01>;
				gpio_ap2cp_nreset_n = <0xffffffff 0x00 0x01>;
				gpio_cp2ap_cp_ps_hold = <0xffffffff 0x00 0x01>;
				gpio_ap2cp_wake_up = <0xffffffff 0x03 0x01>;
				gpio_cp2ap_wake_up = <0xffffffff 0x00 0x01>;
				gpio_ap2cp_dump_noti = <0xffffffff 0x06 0x01>;
				gpio_ap2cp_pda_active = <0xffffffff 0x00 0x01>;
				gpio_cp2ap_phone_active = <0xffffffff 0x00 0x01>;
				pci_ch_num = <0x01>;
				pci_db_addr = <0x14d60000>;
				cpboot_spi_bus_num = <0x10>;
				mif,name = "s5123";
				mif,cp_num = <0x00>;
				mif,modem_type = <0x01>;
				mif,use_handover = <0x00>;
				mif,protocol = <0x00>;
				mif,ipc_version = <0x32>;
				mif,link_type = <0x01>;
				mif,link_name = "PCIE";
				mif,link_attrs = <0xfc9>;
				mif,interrupt_types = <0x01>;
				mif,int_ap2cp_msg = <0x00>;
				mif,int_ap2cp_wakeup = <0x01>;
				mif,int_ap2cp_status = <0x02>;
				mif,int_ap2cp_active = <0x03>;
				mif,int_ap2cp_lcd_status = <0x04>;
				mif,int_ap2cp_pcie_link_ack = <0x0e>;
				mif,int_ap2cp_uart_noti = <0x0f>;
				mif,irq_cp2ap_msg = <0x00>;
				mif,irq_cp2ap_status = <0x02>;
				mif,irq_cp2ap_active = <0x03>;
				mif,irq_cp2ap_wakelock = <0x08>;
				mif,irq_cp2ap_ratmode = <0x09>;
				legacy_fmt_head_tail_offset = <0x08>;
				legacy_fmt_buffer_offset = <0x1000>;
				legacy_fmt_txq_size = <0x1000>;
				legacy_fmt_rxq_size = <0x1000>;
				legacy_raw_head_tail_offset = <0x18>;
				legacy_raw_buffer_offset = <0x3000>;
				legacy_raw_txq_size = <0x1fd000>;
				legacy_raw_rxq_size = <0x200000>;
				ap2cp_msg = <0x02 0x400>;
				cp2ap_msg = <0x02 0x404>;
				ap2cp_united_status = <0x02 0x408>;
				cp2ap_united_status = <0x02 0x40c>;
				ap2cp_kerneltime = <0x02 0x424>;
				srinfo_offset = <0x28>;
				srinfo_size = <0x3d8>;
				clk_table_offset = <0x28>;
				sbi_lcd_status_mask = <0x01>;
				sbi_lcd_status_pos = <0x1b>;
				sbi_crash_type_mask = <0x0f>;
				sbi_crash_type_pos = <0x17>;
				sbi_uart_noti_mask = <0x01>;
				sbi_uart_noti_pos = <0x10>;
				sbi_ds_det_mask = <0x03>;
				sbi_ds_det_pos = <0x0e>;
				sbi_pda_active_mask = <0x01>;
				sbi_pda_active_pos = <0x05>;
				sbi_ap_status_mask = <0x0f>;
				sbi_ap_status_pos = <0x01>;
				sbi_cp_rat_mode_mask = <0x3f>;
				sbi_cp_rat_mode_pos = <0x1a>;
				sbi_cp2ap_wakelock_mask = <0x01>;
				sbi_cp2ap_wakelock_pos = <0x06>;
				sbi_lte_active_mask = <0x01>;
				sbi_lte_active_pos = <0x05>;
				sbi_cp_status_mask = <0x0f>;
				sbi_cp_status_pos = <0x01>;
				sbi_ap2cp_kerneltime_sec_mask = <0xfff>;
				sbi_ap2cp_kerneltime_sec_pos = <0x14>;
				sbi_ap2cp_kerneltime_usec_mask = <0xfffff>;
				sbi_ap2cp_kerneltime_usec_pos = <0x00>;
				cp_btl_node_name = "ramdump_memshare";
				pktproc_support = <0x01>;
				pktproc_version = <0x02>;
				pktproc_cp_base = <0x28000000>;
				pktproc_info_rgn_offset = <0x00>;
				pktproc_info_rgn_size = <0x100>;
				pktproc_desc_rgn_offset = <0x100>;
				pktproc_desc_rgn_size = <0xfff00>;
				pktproc_data_rgn_offset = <0x100000>;
				pktproc_desc_mode = <0x01>;
				pktproc_desc_num_ratio_percent = <0x19>;
				pktproc_num_queue = <0x01>;
				pktproc_use_exclusive_irq = <0x00>;
				pktproc_use_hw_iocc = <0x01>;
				enable_rps_boost = <0x01>;
				tp_rps_threshold = <0x12c 0x1f4>;
				tp_rps_cpu_mask = <0x0e 0x30 0xd0>;
				enable_gro_boost = <0x01>;
				tp_gro_threshold = <0x64 0xc8>;
				tp_gro_flush_nsec = <0x2710 0xc350 0x186a0>;
				enable_irq_affinity_boost = <0x01>;
				tp_irq_affinity_threshold = <0x1f4>;
				tp_irq_affinity_cpu = <0x00 0x05>;
				enable_mif_boost = <0x00>;
				enable_pci_low_power_boost = <0x01>;
				tp_pci_low_power_threshold = <0x32>;
				tp_pci_low_power_enable = <0x01 0x00>;
				mif,num_iodevs = <0x16>;

				iodevs {

					io_device_0 {
						iod,name = "umts_cass";
						iod,ch = <0x23>;
						iod,format = <0x01>;
						iod,io_type = <0x01>;
						iod,link_type = <0x01>;
						iod,attrs = <0x2082>;
						iod,max_tx_size = <0x800>;
						iod,ul_num_buffers = <0x10>;
						iod,ul_buffer_size = <0x800>;
						iod,dl_num_buffers = <0x10>;
						iod,dl_buffer_size = <0x800>;
					};

					io_device_1 {
						iod,name = "umts_ipc0";
						iod,ch = <0xeb>;
						iod,format = <0x00>;
						iod,io_type = <0x01>;
						iod,link_type = <0x01>;
						iod,attrs = <0x82>;
						iod,ul_num_buffers = <0x10>;
						iod,ul_buffer_size = <0x1000>;
						iod,dl_num_buffers = <0x20>;
						iod,dl_buffer_size = <0x1000>;
					};

					io_device_2 {
						iod,name = "umts_ipc1";
						iod,ch = <0xec>;
						iod,format = <0x00>;
						iod,io_type = <0x01>;
						iod,link_type = <0x01>;
						iod,attrs = <0x82>;
						iod,ul_num_buffers = <0x10>;
						iod,ul_buffer_size = <0x1000>;
						iod,dl_num_buffers = <0x20>;
						iod,dl_buffer_size = <0x1000>;
					};

					io_device_3 {
						iod,name = "umts_rfs0";
						iod,ch = <0xf5>;
						iod,format = <0x02>;
						iod,io_type = <0x01>;
						iod,link_type = <0x01>;
						iod,attrs = <0x82>;
						iod,ul_num_buffers = <0x10>;
						iod,ul_buffer_size = <0x800>;
						iod,dl_num_buffers = <0x200>;
						iod,dl_buffer_size = <0x800>;
					};

					io_device_4 {
						iod,name = "umts_csd";
						iod,ch = <0x01>;
						iod,format = <0x01>;
						iod,io_type = <0x01>;
						iod,link_type = <0x01>;
						iod,attrs = <0x82>;
						iod,ul_num_buffers = <0x20>;
						iod,ul_buffer_size = <0x800>;
						iod,dl_num_buffers = <0x40>;
						iod,dl_buffer_size = <0x800>;
					};

					io_device_5 {
						iod,name = "umts_router";
						iod,ch = <0x19>;
						iod,format = <0x01>;
						iod,io_type = <0x01>;
						iod,link_type = <0x01>;
						iod,attrs = <0x82>;
						iod,ul_num_buffers = <0x10>;
						iod,ul_buffer_size = <0x800>;
						iod,dl_num_buffers = <0x10>;
						iod,dl_buffer_size = <0x800>;
					};

					io_device_6 {
						iod,name = "umts_dm0";
						iod,ch = <0x1c>;
						iod,format = <0x01>;
						iod,io_type = <0x01>;
						iod,link_type = <0x01>;
						iod,attrs = <0x82>;
						iod,ul_num_buffers = <0x10>;
						iod,ul_buffer_size = <0x800>;
						iod,dl_num_buffers = <0x80>;
						iod,dl_buffer_size = <0x800>;
					};

					io_device_7 {
						iod,name = "ipc_loopback0";
						iod,ch = <0xf4>;
						iod,format = <0x00>;
						iod,io_type = <0x01>;
						iod,link_type = <0x01>;
						iod,attrs = <0x82>;
						iod,ul_num_buffers = <0x10>;
						iod,ul_buffer_size = <0x800>;
						iod,dl_num_buffers = <0x20>;
						iod,dl_buffer_size = <0x800>;
					};

					io_device_8 {
						iod,name = "rmnet0";
						iod,ch = <0x0a>;
						iod,format = <0x01>;
						iod,io_type = <0x02>;
						iod,link_type = <0x01>;
						iod,attrs = <0x180>;
						iod,ul_num_buffers = <0x00>;
						iod,ul_buffer_size = <0x800>;
						iod,dl_num_buffers = <0x00>;
						iod,dl_buffer_size = <0x800>;
					};

					io_device_9 {
						iod,name = "rmnet1";
						iod,ch = <0x0b>;
						iod,format = <0x01>;
						iod,io_type = <0x02>;
						iod,link_type = <0x01>;
						iod,attrs = <0x180>;
						iod,ul_num_buffers = <0x00>;
						iod,ul_buffer_size = <0x800>;
						iod,dl_num_buffers = <0x00>;
						iod,dl_buffer_size = <0x800>;
					};

					io_device_10 {
						iod,name = "rmnet2";
						iod,ch = <0x0c>;
						iod,format = <0x01>;
						iod,io_type = <0x02>;
						iod,link_type = <0x01>;
						iod,attrs = <0x180>;
						iod,ul_num_buffers = <0x00>;
						iod,ul_buffer_size = <0x800>;
						iod,dl_num_buffers = <0x00>;
						iod,dl_buffer_size = <0x800>;
					};

					io_device_11 {
						iod,name = "rmnet3";
						iod,ch = <0x0d>;
						iod,format = <0x01>;
						iod,io_type = <0x02>;
						iod,link_type = <0x01>;
						iod,attrs = <0x180>;
						iod,ul_num_buffers = <0x00>;
						iod,ul_buffer_size = <0x800>;
						iod,dl_num_buffers = <0x00>;
						iod,dl_buffer_size = <0x800>;
					};

					io_device_12 {
						iod,name = "rmnet4";
						iod,ch = <0x0e>;
						iod,format = <0x01>;
						iod,io_type = <0x02>;
						iod,link_type = <0x01>;
						iod,attrs = <0x180>;
						iod,ul_num_buffers = <0x00>;
						iod,ul_buffer_size = <0x800>;
						iod,dl_num_buffers = <0x00>;
						iod,dl_buffer_size = <0x800>;
					};

					io_device_13 {
						iod,name = "rmnet5";
						iod,ch = <0x0f>;
						iod,format = <0x01>;
						iod,io_type = <0x02>;
						iod,link_type = <0x01>;
						iod,attrs = <0x180>;
						iod,ul_num_buffers = <0x00>;
						iod,ul_buffer_size = <0x800>;
						iod,dl_num_buffers = <0x00>;
						iod,dl_buffer_size = <0x800>;
					};

					io_device_14 {
						iod,name = "rmnet6";
						iod,ch = <0x10>;
						iod,format = <0x01>;
						iod,io_type = <0x02>;
						iod,link_type = <0x01>;
						iod,attrs = <0x180>;
						iod,ul_num_buffers = <0x00>;
						iod,ul_buffer_size = <0x800>;
						iod,dl_num_buffers = <0x00>;
						iod,dl_buffer_size = <0x800>;
					};

					io_device_15 {
						iod,name = "rmnet7";
						iod,ch = <0x11>;
						iod,format = <0x01>;
						iod,io_type = <0x02>;
						iod,link_type = <0x01>;
						iod,attrs = <0x180>;
						iod,ul_num_buffers = <0x00>;
						iod,ul_buffer_size = <0x800>;
						iod,dl_num_buffers = <0x00>;
						iod,dl_buffer_size = <0x800>;
					};

					io_device_16 {
						iod,name = "multipdp_hiprio";
						iod,ch = <0x00>;
						iod,format = <0x03>;
						iod,io_type = <0x03>;
						iod,link_type = <0x01>;
						iod,attrs = <0x180>;
						iod,ul_num_buffers = <0x400>;
						iod,ul_buffer_size = <0x800>;
						iod,dl_num_buffers = <0x100>;
						iod,dl_buffer_size = <0x800>;
					};

					io_device_17 {
						iod,name = "multipdp";
						iod,ch = <0x00>;
						iod,format = <0x03>;
						iod,io_type = <0x03>;
						iod,link_type = <0x01>;
						iod,attrs = <0x180>;
						iod,ul_num_buffers = <0x200>;
						iod,ul_buffer_size = <0x800>;
						iod,dl_num_buffers = <0x400>;
						iod,dl_buffer_size = <0x800>;
					};

					io_device_18 {
						iod,name = "umts_boot0";
						iod,ch = <0xd7>;
						iod,format = <0x04>;
						iod,io_type = <0x00>;
						iod,link_type = <0x01>;
						iod,attrs = <0x02>;
					};

					io_device_19 {
						iod,name = "umts_ramdump0";
						iod,ch = <0xe1>;
						iod,format = <0x05>;
						iod,io_type = <0x00>;
						iod,link_type = <0x01>;
						iod,attrs = <0x202>;
					};

					io_device_20 {
						iod,name = "smd4";
						iod,ch = <0x21>;
						iod,format = <0x01>;
						iod,io_type = <0x01>;
						iod,link_type = <0x01>;
						iod,attrs = <0x882>;
						iod,ul_num_buffers = <0x10>;
						iod,ul_buffer_size = <0x800>;
						iod,dl_num_buffers = <0x80>;
						iod,dl_buffer_size = <0x800>;
						iod,option_region = "kor_skt";
					};

					io_device_21 {
						iod,name = "umts_ciq0";
						iod,ch = <0x1a>;
						iod,format = <0x01>;
						iod,io_type = <0x01>;
						iod,link_type = <0x01>;
						iod,attrs = <0x882>;
						iod,ul_num_buffers = <0x10>;
						iod,ul_buffer_size = <0x800>;
						iod,dl_num_buffers = <0x80>;
						iod,dl_buffer_size = <0x800>;
						iod,option_region = "usa_spr";
					};
				};
			};

			cp_shmem {
				compatible = "samsung,exynos-cp-shmem";
				cp_num = <0x00>;
				use_mem_map_on_cp = <0x00>;

				regions {

					ipc {
						region,name = "IPC";
						region,index = <0x03>;
						region,rmem = <0x00>;
						region,offset = <0x00>;
						region,size = <0x800000>;
						region,cached = <0x01>;
					};

					msi {
						region,name = "MSI";
						region,index = <0x09>;
						region,rmem = <0x01>;
						region,offset = <0x00>;
						region,size = <0x1000>;
						region,cached = <0x00>;
					};

					pktproc {
						region,name = "PKTPROC";
						region,index = <0x06>;
						region,rmem = <0x02>;
						region,offset = <0x00>;
						region,size = <0x4000000>;
						region,cached = <0x01>;
					};
				};
			};
		};
	};

	fragment@47 {
		target = <0xffffffff>;

		__overlay__ {
			#address-cells = <0x01>;
			#size-cells = <0x00>;
			status = "okay";
			pinctrl-names = "default";
			pinctrl-0 = <0xffffffff 0xffffffff>;

			cpboot_spi@0 {
				compatible = "samsung,exynos-cp-spi";
				reg = <0x00>;
				spi-max-frequency = <0x20ce70>;

				controller-data {
					samsung,spi-feedback-delay = <0x00>;
					samsung,spi-chip-select-mode = <0x01>;
				};
			};
		};
	};

	fragment@48 {
		target = <0xffffffff>;

		__overlay__ {

			s5100_ap2cp_cp_nreset_n {
				samsung,pins = "gpm9-0";
				samsung,pin-pud = <0x00>;
				phandle = <0x1e>;
			};

			s5100_ap2cp_cp_pwr_on {
				samsung,pins = "gpm20-0";
				samsung,pin-pud = <0x00>;
				samsung,pin-pud-pdn = <0x00>;
				phandle = <0x1d>;
			};

			s5100_ap2cp_pda_active {
				samsung,pins = "gpm25-0";
				samsung,pin-pud = <0x01>;
				phandle = <0x23>;
			};

			s5100_cp2ap_phone_active {
				samsung,pins = "gpm28-0";
				samsung,pin-function = <0x0f>;
				samsung,pin-pud = <0x00>;
				phandle = <0x24>;
			};

			s5100_cp2ap_wakeup {
				samsung,pins = "gpm30-0";
				samsung,pin-function = <0x0f>;
				samsung,pin-pud = <0x00>;
				phandle = <0x21>;
			};

			s5100_cp2ap_cp_ps_hold {
				samsung,pins = "gpm31-0";
				samsung,pin-pud = <0x01>;
				phandle = <0x1f>;
			};
		};
	};

	fragment@49 {
		target = <0xffffffff>;

		__overlay__ {

			s5100_ap2cp_wakeup {
				samsung,pins = "gpg1-3";
				samsung,pin-pud = <0x01>;
				samsung,pin-con-pdn = <0x03>;
				phandle = <0x20>;
			};

			s5100_ap2cp_dump_noti {
				samsung,pins = "gpp8-6";
				samsung,pin-pud = <0x00>;
				samsung,pin-con-pdn = <0x03>;
				phandle = <0x22>;
			};
		};
	};

	fragment@50 {
		target = <0xffffffff>;

		__overlay__ {
			gpios = <0xffffffff 0x04 0x01>;
		};
	};

	fragment@51 {
		target = <0xffffffff>;

		__overlay__ {
			bootargs_ext = "console=ram root=/dev/ram0 androidboot.boot_devices=13100000.ufs";
		};
	};

	fragment@52 {
		target = <0xffffffff>;

		__overlay__ {
			usi_v2_mode = "i2c";
			status = "okay";
		};
	};

	fragment@53 {
		target = <0xffffffff>;

		__overlay__ {
			usi_v2_mode = "spi";
			status = "okay";
		};
	};

	fragment@54 {
		target = <0xffffffff>;

		__overlay__ {
			#address-cells = <0x01>;
			#size-cells = <0x00>;
			status = "okay";

			pcal6524@22 {
				compatible = "pcal6524,gpio-expander";
				gpio-controller;
				#gpio-cells = <0x02>;
				reg = <0x22>;
				pinctrl-names = "expander_reset_setting";
				pinctrl-0 = <0x25>;
				pcal6524,gpio_start = <0x12c>;
				pcal6524,ngpio = <0x18>;
				pcal6524,reset-gpio = <0xffffffff 0x00 0x00>;
				pcal6524,support_initialize = <0x01>;
				pcal6524,config = <0xffffff>;
				pcal6524,data_out = <0x00>;
				pcal6524,pull_reg_p0 = <0x00>;
				pcal6524,pull_reg_p1 = <0x00>;
				pcal6524,pull_reg_p2 = <0x00>;
				phandle = <0x26>;
			};
		};
	};

	fragment@55 {
		target = <0xffffffff>;

		__overlay__ {

			cs35l40@40 {
				pinctrl-names;
				reset-gpios = <0x26 0x13 0x00>;
			};

			cs35l40@41 {
				pinctrl-names;
				reset-gpios = <0x26 0x12 0x00>;
			};
		};
	};

	fragment@56 {
		target = <0xffffffff>;

		__overlay__ {
			status = "okay";
			use-sysmmu = "false";
			use-cache-coherency = "false";
			use-msi = "false";
			ep-device-type = <0x01>;
			pcie,wlan-gpio = <0xffffffff 0x04 0x01>;
		};
	};

	fragment@57 {
		target = <0xffffffff>;

		__overlay__ {
			status = "okay";
			chip-ver = <0x01>;
			use-sysmmu = "false";
			use-cache-coherency = "true";
			use-msi = "true";
			use-pcieon-sleep = "true";
			phy-power-off = "false";
			ep-device-type = <0x04>;
		};
	};

	fragment@58 {
		target = <0xffffffff>;

		__overlay__ {
			evt-ver = [01];
		};
	};

	fragment@59 {
		target = <0xffffffff>;

		__overlay__ {
			status = "okay";
			dp,aux_sw_oe = <0x26 0x0d 0x00>;
			dp,sbu_sw_sel = <0x26 0x0c 0x00>;
			dp,usb_con_sel = <0xffffffff 0x00 0x00>;
			pinctrl-names = "default";
		};
	};

	__symbols__ {
		m_pmic_irq = "/fragment@0/__overlay__/m-pmic-irq";
		s_pmic_irq = "/fragment@0/__overlay__/s-pmic-irq";
		dp_pmic_irq = "/fragment@0/__overlay__/dp-pmic-irq";
		sub_pmic_irq = "/fragment@1/__overlay__/sub-pmic-irq";
		smpl_warn = "/fragment@2/__overlay__/smpl-warn";
		buck1_reg = "/fragment@3/__overlay__/s2mps19mfd@00/regulators/BUCK1M";
		buck2_reg = "/fragment@3/__overlay__/s2mps19mfd@00/regulators/BUCK2M";
		buck3_reg = "/fragment@3/__overlay__/s2mps19mfd@00/regulators/BUCK3M";
		buck5_reg = "/fragment@3/__overlay__/s2mps19mfd@00/regulators/BUCK5M";
		buck6_reg = "/fragment@3/__overlay__/s2mps19mfd@00/regulators/BUCK6M";
		buck7_reg = "/fragment@3/__overlay__/s2mps19mfd@00/regulators/BUCK7M";
		buck8_reg = "/fragment@3/__overlay__/s2mps19mfd@00/regulators/BUCK8M";
		buck9_reg = "/fragment@3/__overlay__/s2mps19mfd@00/regulators/BUCK9M";
		buck10_reg = "/fragment@3/__overlay__/s2mps19mfd@00/regulators/BUCK10M";
		buck11_reg = "/fragment@3/__overlay__/s2mps19mfd@00/regulators/BUCK11M";
		buck12_reg = "/fragment@3/__overlay__/s2mps19mfd@00/regulators/BUCK12M";
		ldo1_reg = "/fragment@3/__overlay__/s2mps19mfd@00/regulators/LDO1M";
		ldo2_reg = "/fragment@3/__overlay__/s2mps19mfd@00/regulators/LDO2M";
		ldo3_reg = "/fragment@3/__overlay__/s2mps19mfd@00/regulators/LDO3M";
		ldo4_reg = "/fragment@3/__overlay__/s2mps19mfd@00/regulators/LDO4M";
		ldo5_reg = "/fragment@3/__overlay__/s2mps19mfd@00/regulators/LDO5M";
		ldo6_reg = "/fragment@3/__overlay__/s2mps19mfd@00/regulators/LDO6M";
		ldo9_reg = "/fragment@3/__overlay__/s2mps19mfd@00/regulators/LDO9M";
		ldo10_reg = "/fragment@3/__overlay__/s2mps19mfd@00/regulators/LDO10M";
		ldo11_reg = "/fragment@3/__overlay__/s2mps19mfd@00/regulators/LDO11M";
		ldo12_reg = "/fragment@3/__overlay__/s2mps19mfd@00/regulators/LDO12M";
		ldo13_reg = "/fragment@3/__overlay__/s2mps19mfd@00/regulators/LDO13M";
		ldo14_reg = "/fragment@3/__overlay__/s2mps19mfd@00/regulators/LDO14M";
		ldo15_reg = "/fragment@3/__overlay__/s2mps19mfd@00/regulators/LDO15M";
		ldo16_reg = "/fragment@3/__overlay__/s2mps19mfd@00/regulators/LDO16M";
		ldo17_reg = "/fragment@3/__overlay__/s2mps19mfd@00/regulators/LDO17M";
		ldo18_reg = "/fragment@3/__overlay__/s2mps19mfd@00/regulators/LDO18M";
		ldo19_reg = "/fragment@3/__overlay__/s2mps19mfd@00/regulators/LDO19M";
		ldo20_reg = "/fragment@3/__overlay__/s2mps19mfd@00/regulators/LDO20M";
		ldo21_reg = "/fragment@3/__overlay__/s2mps19mfd@00/regulators/LDO21M";
		ldo22_reg = "/fragment@3/__overlay__/s2mps19mfd@00/regulators/LDO22M";
		ldo23_reg = "/fragment@3/__overlay__/s2mps19mfd@00/regulators/LDO23M";
		ldo24_reg = "/fragment@3/__overlay__/s2mps19mfd@00/regulators/LDO24M";
		ldo25_reg = "/fragment@3/__overlay__/s2mps19mfd@00/regulators/LDO25M";
		ldo26_reg = "/fragment@3/__overlay__/s2mps19mfd@00/regulators/LDO26M";
		ldo27_reg = "/fragment@3/__overlay__/s2mps19mfd@00/regulators/LDO27M";
		ldo28_reg = "/fragment@3/__overlay__/s2mps19mfd@00/regulators/LDO28M";
		ldo29_reg = "/fragment@3/__overlay__/s2mps19mfd@00/regulators/LDO29M";
		s_buck1_reg = "/fragment@4/__overlay__/s2mps22mfd@00/regulators/BUCK1S";
		s_buck2_reg = "/fragment@4/__overlay__/s2mps22mfd@00/regulators/BUCK2S";
		s_buck3_reg = "/fragment@4/__overlay__/s2mps22mfd@00/regulators/BUCK3S";
		s_buck4_reg = "/fragment@4/__overlay__/s2mps22mfd@00/regulators/BUCK4S";
		s_ldo1_reg = "/fragment@4/__overlay__/s2mps22mfd@00/regulators/LDO1S";
		s_ldo2_reg = "/fragment@4/__overlay__/s2mps22mfd@00/regulators/LDO2S";
		s_ldo3_reg = "/fragment@4/__overlay__/s2mps22mfd@00/regulators/LDO3S";
		s_ldo4_reg = "/fragment@4/__overlay__/s2mps22mfd@00/regulators/LDO4S";
		s_ldo5_reg = "/fragment@4/__overlay__/s2mps22mfd@00/regulators/LDO5S";
		s_ldo6_reg = "/fragment@4/__overlay__/s2mps22mfd@00/regulators/LDO6S";
		_buck1_reg = "/fragment@5/__overlay__/s2mpb02_pmic@59/regulators/s2mpb02-buck1";
		_buck2_reg = "/fragment@5/__overlay__/s2mpb02_pmic@59/regulators/s2mpb02-buck2";
		_buckboost_reg = "/fragment@5/__overlay__/s2mpb02_pmic@59/regulators/s2mpb02-bb";
		_ldo1_reg = "/fragment@5/__overlay__/s2mpb02_pmic@59/regulators/s2mpb02-ldo1";
		_ldo2_reg = "/fragment@5/__overlay__/s2mpb02_pmic@59/regulators/s2mpb02-ldo2";
		_ldo3_reg = "/fragment@5/__overlay__/s2mpb02_pmic@59/regulators/s2mpb02-ldo3";
		_ldo4_reg = "/fragment@5/__overlay__/s2mpb02_pmic@59/regulators/s2mpb02-ldo4";
		_ldo5_reg = "/fragment@5/__overlay__/s2mpb02_pmic@59/regulators/s2mpb02-ldo5";
		_ldo6_reg = "/fragment@5/__overlay__/s2mpb02_pmic@59/regulators/s2mpb02-ldo6";
		_ldo7_reg = "/fragment@5/__overlay__/s2mpb02_pmic@59/regulators/s2mpb02-ldo7";
		_ldo8_reg = "/fragment@5/__overlay__/s2mpb02_pmic@59/regulators/s2mpb02-ldo8";
		_ldo9_reg = "/fragment@5/__overlay__/s2mpb02_pmic@59/regulators/s2mpb02-ldo9";
		_ldo10_reg = "/fragment@5/__overlay__/s2mpb02_pmic@59/regulators/s2mpb02-ldo10";
		_ldo11_reg = "/fragment@5/__overlay__/s2mpb02_pmic@59/regulators/s2mpb02-ldo11";
		_ldo12_reg = "/fragment@5/__overlay__/s2mpb02_pmic@59/regulators/s2mpb02-ldo12";
		_ldo13_reg = "/fragment@5/__overlay__/s2mpb02_pmic@59/regulators/s2mpb02-ldo13";
		_ldo14_reg = "/fragment@5/__overlay__/s2mpb02_pmic@59/regulators/s2mpb02-ldo14";
		_ldo15_reg = "/fragment@5/__overlay__/s2mpb02_pmic@59/regulators/s2mpb02-ldo15";
		_ldo16_reg = "/fragment@5/__overlay__/s2mpb02_pmic@59/regulators/s2mpb02-ldo16";
		_ldo17_reg = "/fragment@5/__overlay__/s2mpb02_pmic@59/regulators/s2mpb02-ldo17";
		_ldo18_reg = "/fragment@5/__overlay__/s2mpb02_pmic@59/regulators/s2mpb02-ldo18";
		dp_buck = "/fragment@6/__overlay__/s2dos05_pmic@60/regulators/s2dos05-buck1";
		dp_ldo1 = "/fragment@6/__overlay__/s2dos05_pmic@60/regulators/s2dos05-ldo1";
		dp_ldo2 = "/fragment@6/__overlay__/s2dos05_pmic@60/regulators/s2dos05-ldo2";
		dp_ldo3 = "/fragment@6/__overlay__/s2dos05_pmic@60/regulators/s2dos05-ldo3";
		dp_ldo4 = "/fragment@6/__overlay__/s2dos05_pmic@60/regulators/s2dos05-ldo4";
		__ldo1_reg = "/fragment@7/__overlay__/s2mpb03_pmic@56/regulators/s2mpb03-ldo1";
		__ldo2_reg = "/fragment@7/__overlay__/s2mpb03_pmic@56/regulators/s2mpb03-ldo2";
		__ldo3_reg = "/fragment@7/__overlay__/s2mpb03_pmic@56/regulators/s2mpb03-ldo3";
		__ldo4_reg = "/fragment@7/__overlay__/s2mpb03_pmic@56/regulators/s2mpb03-ldo4";
		__ldo5_reg = "/fragment@7/__overlay__/s2mpb03_pmic@56/regulators/s2mpb03-ldo5";
		__ldo6_reg = "/fragment@7/__overlay__/s2mpb03_pmic@56/regulators/s2mpb03-ldo6";
		__ldo7_reg = "/fragment@7/__overlay__/s2mpb03_pmic@56/regulators/s2mpb03-ldo7";
		wpc_int = "/fragment@8/__overlay__/wpc-int";
		wpc_det = "/fragment@8/__overlay__/wpc-det";
		jig_gpio = "/fragment@9/__overlay__/jig-gpio";
		max77705_irq = "/fragment@11/__overlay__/max77705-irq";
		usb_hs_tune = "/fragment@model/__overlay__/hs_tune";
		usb_ss_tune = "/fragment@model/__overlay__/ss_tune";
		vbat = "/fragment@model/__overlay__/vbat";
		micbias1 = "/fragment@model/__overlay__/fixedregulator@1";
		dummy_audio_codec = "/fragment@model/__overlay__/audio-codec-dummy";
		dummy_audio_cpu = "/fragment@model/__overlay__/audio-cpu-dummy";
		android = "/fragment@model/__overlay__/firmware/android";
		vendor = "/fragment@model/__overlay__/firmware/android/fstab/vendor";
		key_voldown = "/fragment@14/__overlay__/key-voldown";
		key_volup = "/fragment@14/__overlay__/key-volup";
		key_power = "/fragment@14/__overlay__/key-power";
		attn_irq = "/fragment@14/__overlay__/attn-irq";
		attn_input = "/fragment@14/__overlay__/attn-input";
		dwmmc2_cd_ext_irq = "/fragment@39/__overlay__/dwmmc2_cd_ext_irq";
		expander_reset_active = "/fragment@40/__overlay__/expander-reset-active";
		cs35l40_r_reset = "/fragment@41/__overlay__/cs35l40-r-reset";
		cs35l40_l_reset = "/fragment@41/__overlay__/cs35l40-l-reset";
		cs35l40_r = "/fragment@42/__overlay__/cs35l40@40";
		cs35l40_l = "/fragment@42/__overlay__/cs35l40@41";
		ext_bin_0 = "/fragment@45/__overlay__/ext-bin@0";
		ext_bin_1 = "/fragment@45/__overlay__/ext-bin@1";
		ext_bin_2 = "/fragment@45/__overlay__/ext-bin@2";
		ext_bin_3 = "/fragment@45/__overlay__/ext-bin@3";
		ext_bin_4 = "/fragment@45/__overlay__/ext-bin@4";
		ext_bin_5 = "/fragment@45/__overlay__/ext-bin@5";
		ext_bin_6 = "/fragment@45/__overlay__/ext-bin@6";
		ext_bin_7 = "/fragment@45/__overlay__/ext-bin@7";
		ext_bin_8 = "/fragment@45/__overlay__/ext-bin@8";
		ext_bin_9 = "/fragment@45/__overlay__/ext-bin@9";
		ext_bin_10 = "/fragment@45/__overlay__/ext-bin@10";
		ext_bin_11 = "/fragment@45/__overlay__/ext-bin@11";
		ext_bin_12 = "/fragment@45/__overlay__/ext-bin@12";
		ext_bin_13 = "/fragment@45/__overlay__/ext-bin@13";
		ext_bin_14 = "/fragment@45/__overlay__/ext-bin@14";
		ext_bin_15 = "/fragment@45/__overlay__/ext-bin@15";
		ext_bin_16 = "/fragment@45/__overlay__/ext-bin@16";
		s5100_ap2cp_cp_nreset_n = "/fragment@48/__overlay__/s5100_ap2cp_cp_nreset_n";
		s5100_ap2cp_cp_pwr_on = "/fragment@48/__overlay__/s5100_ap2cp_cp_pwr_on";
		s5100_ap2cp_pda_active = "/fragment@48/__overlay__/s5100_ap2cp_pda_active";
		s5100_cp2ap_phone_active = "/fragment@48/__overlay__/s5100_cp2ap_phone_active";
		s5100_cp2ap_wakeup = "/fragment@48/__overlay__/s5100_cp2ap_wakeup";
		s5100_cp2ap_cp_ps_hold = "/fragment@48/__overlay__/s5100_cp2ap_cp_ps_hold";
		s5100_ap2cp_wakeup = "/fragment@49/__overlay__/s5100_ap2cp_wakeup";
		s5100_ap2cp_dump_noti = "/fragment@49/__overlay__/s5100_ap2cp_dump_noti";
		expander_gpios = "/fragment@54/__overlay__/pcal6524@22";
	};

	__fixups__ {
		pinctrl_0 = "/fragment@0:target:0\0/fragment@8:target:0\0/fragment@11:target:0\0/fragment@14:target:0\0/fragment@39:target:0";
		pinctrl_5 = "/fragment@1:target:0\0/fragment@41:target:0\0/fragment@49:target:0";
		pinctrl_4 = "/fragment@2:target:0";
		speedy = "/fragment@3:target:0";
		gpa0 = "/fragment@3/__overlay__/s2mps19mfd@00:s2mps19,irq-gpio:0\0/fragment@3/__overlay__/s2mps19mfd@00:interrupt-parent:0\0/fragment@model/__overlay__/gpio_keys/button@2:gpios:0\0/fragment@model/__overlay__/gpio_keys/button@3:gpios:0";
		gpg0 = "/fragment@3/__overlay__/s2mps19mfd@00:gpios:0";
		speedy1 = "/fragment@4:target:0";
		gpa2 = "/fragment@4/__overlay__/s2mps22mfd@00:s2mps22,irq-gpio:0\0/fragment@4/__overlay__/s2mps22mfd@00:interrupt-parent:0\0/fragment@battery/__overlay__/battery:battery,wpc_det:0\0/fragment@10/__overlay__/mfc-charger@3b:battery,wpc_det:0\0/fragment@model/__overlay__/gpio_keys/button@4:gpios:0";
		hsi2c_27 = "/fragment@5:target:0";
		hsi2c_4 = "/fragment@6:target:0";
		gpa1 = "/fragment@6/__overlay__/s2dos05_pmic@60:s2dos05,s2dos05_int:0\0/fragment@12/__overlay__/max77705@66:max77705,irq-gpio:0\0/fragment@38/__overlay__/touchscreen@48:sec,irq_gpio:0\0/fragment@44/__overlay__:card-detect:0";
		hsi2c_38 = "/fragment@7:target:0";
		gpa3 = "/fragment@battery/__overlay__/battery:battery,wpc_int:0\0/fragment@10/__overlay__/mfc-charger@3b:battery,wpc_int:0\0/fragment@50/__overlay__:gpios:0";
		gpm23 = "/fragment@battery/__overlay__/max77705-fuelgauge:fuelgauge,jig_gpio:0";
		pinctrl_6 = "/fragment@9:target:0";
		hsi2c_6 = "/fragment@10:target:0";
		gpp7 = "/fragment@10/__overlay__/mfc-charger@3b:battery,mst_en:0";
		hsi2c_7 = "/fragment@12:target:0";
		udc = "/fragment@model/__overlay__/usb_notifier:udc:0\0/fragment@35:target:0";
		gpp4 = "/fragment@model/__overlay__/fixedregulator@1:gpio:0";
		clock = "/fragment@model/__overlay__/sound:clocks:0";
		vts = "/fragment@model/__overlay__/sound:samsung,codec:8\0/fragment@model/__overlay__/sound/vts0/cpu:sound-dai:0\0/fragment@model/__overlay__/sound/vts1/cpu:sound-dai:0";
		abox_effect = "/fragment@model/__overlay__/sound:samsung,aux:0";
		abox_tplg = "/fragment@model/__overlay__/sound:samsung,aux:4";
		abox_rdma_0 = "/fragment@model/__overlay__/sound/rdma0/cpu:sound-dai:0\0/fragment@model/__overlay__/sound/rdma0/platform:sound-dai:0\0/fragment@model/__overlay__/sound/rdma0_be/cpu:sound-dai:0\0/fragment@model/__overlay__/sound/rdma0_be/platform:sound-dai:0";
		abox_rdma_1 = "/fragment@model/__overlay__/sound/rdma1/cpu:sound-dai:0\0/fragment@model/__overlay__/sound/rdma1/platform:sound-dai:0\0/fragment@model/__overlay__/sound/rdma1_be/cpu:sound-dai:0\0/fragment@model/__overlay__/sound/rdma1_be/platform:sound-dai:0";
		abox_rdma_2 = "/fragment@model/__overlay__/sound/rdma2/cpu:sound-dai:0\0/fragment@model/__overlay__/sound/rdma2/platform:sound-dai:0\0/fragment@model/__overlay__/sound/rdma2_be/cpu:sound-dai:0\0/fragment@model/__overlay__/sound/rdma2_be/platform:sound-dai:0";
		abox_rdma_3 = "/fragment@model/__overlay__/sound/rdma3/cpu:sound-dai:0\0/fragment@model/__overlay__/sound/rdma3/platform:sound-dai:0\0/fragment@model/__overlay__/sound/rdma3_be/cpu:sound-dai:0\0/fragment@model/__overlay__/sound/rdma3_be/platform:sound-dai:0";
		abox_rdma_4 = "/fragment@model/__overlay__/sound/rdma4/cpu:sound-dai:0\0/fragment@model/__overlay__/sound/rdma4/platform:sound-dai:0\0/fragment@model/__overlay__/sound/rdma4_be/cpu:sound-dai:0\0/fragment@model/__overlay__/sound/rdma4_be/platform:sound-dai:0";
		abox_rdma_5 = "/fragment@model/__overlay__/sound/rdma5/cpu:sound-dai:0\0/fragment@model/__overlay__/sound/rdma5/platform:sound-dai:0\0/fragment@model/__overlay__/sound/rdma5_be/cpu:sound-dai:0\0/fragment@model/__overlay__/sound/rdma5_be/platform:sound-dai:0";
		abox_rdma_6 = "/fragment@model/__overlay__/sound/rdma6/cpu:sound-dai:0\0/fragment@model/__overlay__/sound/rdma6/platform:sound-dai:0\0/fragment@model/__overlay__/sound/rdma6_be/cpu:sound-dai:0\0/fragment@model/__overlay__/sound/rdma6_be/platform:sound-dai:0";
		abox_rdma_7 = "/fragment@model/__overlay__/sound/rdma7/cpu:sound-dai:0\0/fragment@model/__overlay__/sound/rdma7/platform:sound-dai:0\0/fragment@model/__overlay__/sound/rdma7_be/cpu:sound-dai:0\0/fragment@model/__overlay__/sound/rdma7_be/platform:sound-dai:0";
		abox_rdma_8 = "/fragment@model/__overlay__/sound/rdma8/cpu:sound-dai:0\0/fragment@model/__overlay__/sound/rdma8/platform:sound-dai:0\0/fragment@model/__overlay__/sound/rdma8_be/cpu:sound-dai:0\0/fragment@model/__overlay__/sound/rdma8_be/platform:sound-dai:0";
		abox_rdma_9 = "/fragment@model/__overlay__/sound/rdma9/cpu:sound-dai:0\0/fragment@model/__overlay__/sound/rdma9/platform:sound-dai:0\0/fragment@model/__overlay__/sound/rdma9_be/cpu:sound-dai:0\0/fragment@model/__overlay__/sound/rdma9_be/platform:sound-dai:0";
		abox_rdma_10 = "/fragment@model/__overlay__/sound/rdma10/cpu:sound-dai:0\0/fragment@model/__overlay__/sound/rdma10/platform:sound-dai:0\0/fragment@model/__overlay__/sound/rdma10_be/cpu:sound-dai:0\0/fragment@model/__overlay__/sound/rdma10_be/platform:sound-dai:0";
		abox_rdma_11 = "/fragment@model/__overlay__/sound/rdma11/cpu:sound-dai:0\0/fragment@model/__overlay__/sound/rdma11/platform:sound-dai:0\0/fragment@model/__overlay__/sound/rdma11_be/cpu:sound-dai:0\0/fragment@model/__overlay__/sound/rdma11_be/platform:sound-dai:0";
		abox_wdma_0 = "/fragment@model/__overlay__/sound/wdma0/cpu:sound-dai:0\0/fragment@model/__overlay__/sound/wdma0/platform:sound-dai:0\0/fragment@model/__overlay__/sound/wdma0_be/cpu:sound-dai:0\0/fragment@model/__overlay__/sound/wdma0_be/platform:sound-dai:0";
		abox_wdma_1 = "/fragment@model/__overlay__/sound/wdma1/cpu:sound-dai:0\0/fragment@model/__overlay__/sound/wdma1/platform:sound-dai:0\0/fragment@model/__overlay__/sound/wdma1_be/cpu:sound-dai:0\0/fragment@model/__overlay__/sound/wdma1_be/platform:sound-dai:0";
		abox_wdma_2 = "/fragment@model/__overlay__/sound/wdma2/cpu:sound-dai:0\0/fragment@model/__overlay__/sound/wdma2/platform:sound-dai:0\0/fragment@model/__overlay__/sound/wdma2_be/cpu:sound-dai:0\0/fragment@model/__overlay__/sound/wdma2_be/platform:sound-dai:0";
		abox_wdma_3 = "/fragment@model/__overlay__/sound/wdma3/cpu:sound-dai:0\0/fragment@model/__overlay__/sound/wdma3/platform:sound-dai:0\0/fragment@model/__overlay__/sound/wdma3_be/cpu:sound-dai:0\0/fragment@model/__overlay__/sound/wdma3_be/platform:sound-dai:0";
		abox_wdma_4 = "/fragment@model/__overlay__/sound/wdma4/cpu:sound-dai:0\0/fragment@model/__overlay__/sound/wdma4/platform:sound-dai:0\0/fragment@model/__overlay__/sound/wdma4_be/cpu:sound-dai:0\0/fragment@model/__overlay__/sound/wdma4_be/platform:sound-dai:0";
		displayport_adma = "/fragment@model/__overlay__/sound/dp0_audio/cpu:sound-dai:0\0/fragment@model/__overlay__/sound/dp1_audio/cpu:sound-dai:0";
		abox_dual_0 = "/fragment@model/__overlay__/sound/dual0/cpu:sound-dai:0\0/fragment@model/__overlay__/sound/dual0/platform:sound-dai:0";
		abox_dual_1 = "/fragment@model/__overlay__/sound/dual1/cpu:sound-dai:0\0/fragment@model/__overlay__/sound/dual1/platform:sound-dai:0";
		abox_dual_2 = "/fragment@model/__overlay__/sound/dual2/cpu:sound-dai:0\0/fragment@model/__overlay__/sound/dual2/platform:sound-dai:0";
		abox_dual_3 = "/fragment@model/__overlay__/sound/dual3/cpu:sound-dai:0\0/fragment@model/__overlay__/sound/dual3/platform:sound-dai:0";
		abox_dual_4 = "/fragment@model/__overlay__/sound/dual4/cpu:sound-dai:0\0/fragment@model/__overlay__/sound/dual4/platform:sound-dai:0";
		abox_ddma_0 = "/fragment@model/__overlay__/sound/ddma0/cpu:sound-dai:0\0/fragment@model/__overlay__/sound/ddma0/platform:sound-dai:0";
		abox_ddma_1 = "/fragment@model/__overlay__/sound/ddma1/cpu:sound-dai:0\0/fragment@model/__overlay__/sound/ddma1/platform:sound-dai:0";
		abox_ddma_2 = "/fragment@model/__overlay__/sound/ddma2/cpu:sound-dai:0\0/fragment@model/__overlay__/sound/ddma2/platform:sound-dai:0";
		abox_ddma_3 = "/fragment@model/__overlay__/sound/ddma3/cpu:sound-dai:0\0/fragment@model/__overlay__/sound/ddma3/platform:sound-dai:0";
		abox_ddma_4 = "/fragment@model/__overlay__/sound/ddma4/cpu:sound-dai:0\0/fragment@model/__overlay__/sound/ddma4/platform:sound-dai:0";
		abox_ddma_5 = "/fragment@model/__overlay__/sound/ddma5/cpu:sound-dai:0\0/fragment@model/__overlay__/sound/ddma5/platform:sound-dai:0";
		abox_uaif_0 = "/fragment@model/__overlay__/sound/uaif0/cpu:sound-dai:0";
		abox_uaif_1 = "/fragment@model/__overlay__/sound/uaif1/cpu:sound-dai:0";
		abox_uaif_2 = "/fragment@model/__overlay__/sound/uaif2/cpu:sound-dai:0";
		abox_uaif_3 = "/fragment@model/__overlay__/sound/uaif3/cpu:sound-dai:0";
		abox_uaif_4 = "/fragment@model/__overlay__/sound/uaif4/cpu:sound-dai:0\0/fragment@46:target:0";
		abox_uaif_5 = "/fragment@model/__overlay__/sound/uaif5/cpu:sound-dai:0";
		abox_uaif_6 = "/fragment@model/__overlay__/sound/uaif6/cpu:sound-dai:0";
		vts_s_lif = "/fragment@model/__overlay__/sound/uaif6/codec:sound-dai:0";
		abox_dsif = "/fragment@model/__overlay__/sound/dsif0/cpu:sound-dai:0";
		abox = "/fragment@model/__overlay__/sound/sifs0/cpu:sound-dai:0\0/fragment@model/__overlay__/sound/sifs1/cpu:sound-dai:0\0/fragment@model/__overlay__/sound/sifs2/cpu:sound-dai:0\0/fragment@model/__overlay__/sound/sifs3/cpu:sound-dai:0\0/fragment@model/__overlay__/sound/sifs4/cpu:sound-dai:0\0/fragment@model/__overlay__/sound/sifs5/cpu:sound-dai:0\0/fragment@model/__overlay__/sound/nsrc0/cpu:sound-dai:0\0/fragment@model/__overlay__/sound/nsrc1/cpu:sound-dai:0\0/fragment@model/__overlay__/sound/nsrc2/cpu:sound-dai:0\0/fragment@model/__overlay__/sound/nsrc3/cpu:sound-dai:0\0/fragment@model/__overlay__/sound/nsrc4/cpu:sound-dai:0\0/fragment@model/__overlay__/sound/usb/cpu:sound-dai:0\0/fragment@model/__overlay__/sound/fwd/cpu:sound-dai:0\0/fragment@36/__overlay__:abox:0\0/fragment@45:target:0";
		serial_0 = "/fragment@13:target:0";
		fmp_0 = "/fragment@15:target:0";
		usi_0 = "/fragment@16:target:0";
		usi_1 = "/fragment@17:target:0";
		usi_2 = "/fragment@18:target:0";
		usi_3 = "/fragment@19:target:0";
		usi_4 = "/fragment@20:target:0";
		usi_5 = "/fragment@21:target:0";
		usi_6 = "/fragment@22:target:0";
		usi_7 = "/fragment@23:target:0";
		usi_8 = "/fragment@24:target:0";
		usi_9 = "/fragment@25:target:0";
		usi_10 = "/fragment@26:target:0";
		usi_12 = "/fragment@27:target:0";
		usi_13 = "/fragment@28:target:0";
		usi_14 = "/fragment@29:target:0";
		usi_16 = "/fragment@30:target:0\0/fragment@53:target:0";
		usi_17 = "/fragment@31:target:0";
		usi_18 = "/fragment@32:target:0";
		usi_00_cmgp = "/fragment@33:target:0";
		serial_18 = "/fragment@34:target:0";
		uart18_bus_dual = "/fragment@34/__overlay__:pinctrl-0:0";
		usbdrd_dwc3 = "/fragment@36:target:0";
		usbdrd_phy0 = "/fragment@37:target:0";
		gpm26 = "/fragment@37/__overlay__:phy,gpio_phy_port:0\0/fragment@59/__overlay__:dp,usb_con_sel:0";
		hsi2c_15 = "/fragment@38:target:0";
		pinctrl_1 = "/fragment@40:target:0\0/fragment@48:target:0";
		hsi2c_31 = "/fragment@42:target:0\0/fragment@55:target:0";
		gpm24 = "/fragment@42/__overlay__/cs35l40@40:interrupt-parent:0\0/fragment@42/__overlay__/cs35l40@41:interrupt-parent:0";
		gpb2 = "/fragment@42/__overlay__/cs35l40@40:reset-gpios:0\0/fragment@42/__overlay__/cs35l40@41:reset-gpios:0";
		ufs = "/fragment@43:target:0\0/fragment@58:target:0";
		dwmmc_2 = "/fragment@44:target:0";
		sd2_clk = "/fragment@44/__overlay__:pinctrl-0:0\0/fragment@44/__overlay__:pinctrl-8:0";
		sd2_cmd = "/fragment@44/__overlay__:pinctrl-0:4\0/fragment@44/__overlay__:pinctrl-8:4";
		sd2_bus1 = "/fragment@44/__overlay__:pinctrl-0:8\0/fragment@44/__overlay__:pinctrl-8:8";
		sd2_bus4 = "/fragment@44/__overlay__:pinctrl-0:12\0/fragment@44/__overlay__:pinctrl-8:12";
		sd2_clk_fast_slew_rate_1x = "/fragment@44/__overlay__:pinctrl-1:0";
		sd2_clk_fast_slew_rate_1_5x = "/fragment@44/__overlay__:pinctrl-2:0";
		sd2_clk_fast_slew_rate_2x = "/fragment@44/__overlay__:pinctrl-3:0";
		sd2_clk_fast_slew_rate_2_5x = "/fragment@44/__overlay__:pinctrl-4:0";
		sd2_clk_fast_slew_rate_3x = "/fragment@44/__overlay__:pinctrl-5:0";
		sd2_clk_fast_slew_rate_4x = "/fragment@44/__overlay__:pinctrl-6:0";
		sd2_pins_as_pdn = "/fragment@44/__overlay__:pinctrl-7:0";
		gpm20 = "/fragment@modemif/__overlay__/cpif:gpio_ap2cp_cp_pwr_on:0";
		gpm9 = "/fragment@modemif/__overlay__/cpif:gpio_ap2cp_nreset_n:0";
		gpm31 = "/fragment@modemif/__overlay__/cpif:gpio_cp2ap_cp_ps_hold:0";
		gpg1 = "/fragment@modemif/__overlay__/cpif:gpio_ap2cp_wake_up:0";
		gpm30 = "/fragment@modemif/__overlay__/cpif:gpio_cp2ap_wake_up:0";
		gpp8 = "/fragment@modemif/__overlay__/cpif:gpio_ap2cp_dump_noti:0";
		gpm25 = "/fragment@modemif/__overlay__/cpif:gpio_ap2cp_pda_active:0";
		gpm28 = "/fragment@modemif/__overlay__/cpif:gpio_cp2ap_phone_active:0";
		spi_16 = "/fragment@47:target:0";
		spi16_bus = "/fragment@47/__overlay__:pinctrl-0:0";
		spi16_cs_func = "/fragment@47/__overlay__:pinctrl-0:4";
		panel_0 = "/fragment@50:target:0";
		chosen = "/fragment@51:target:0";
		usi_11 = "/fragment@52:target:0";
		hsi2c_26 = "/fragment@54:target:0";
		gpm21 = "/fragment@54/__overlay__/pcal6524@22:pcal6524,reset-gpio:0";
		pcie_0 = "/fragment@56:target:0";
		gpb0 = "/fragment@56/__overlay__:pcie,wlan-gpio:0";
		pcie_2 = "/fragment@57:target:0";
		displayport = "/fragment@59:target:0";
	};

	__local_fixups__ {

		fragment@3 {

			__overlay__ {

				s2mps19mfd@00 {
					pinctrl-0 = <0x00 0x04>;
				};
			};
		};

		fragment@4 {

			__overlay__ {

				s2mps22mfd@00 {
					pinctrl-0 = <0x00>;
				};
			};
		};

		fragment@5 {

			__overlay__ {

				s2mpb02_pmic@59 {
					pinctrl-0 = <0x00>;
				};
			};
		};

		fragment@6 {

			__overlay__ {

				s2dos05_pmic@60 {
					pinctrl-0 = <0x00>;
				};
			};
		};

		fragment@10 {

			__overlay__ {

				mfc-charger@3b {
					pinctrl-0 = <0x00 0x04>;
				};
			};
		};

		fragment@12 {

			__overlay__ {

				max77705@66 {
					pinctrl-0 = <0x00>;
				};
			};
		};

		fragment@model {

			__overlay__ {

				gpio_keys {
					pinctrl-0 = <0x00 0x04 0x08>;
				};

				fixedregulator@1 {
					vin-supply = <0x00>;
				};

				sound {
					MICBIAS1-supply = <0x00>;
					MICBIAS2-supply = <0x00>;
					MICBIAS3-supply = <0x00>;
					MICBIAS4-supply = <0x00>;
					samsung,codec = <0x00 0x04>;

					rdma0 {

						codec {
							sound-dai = <0x00>;
						};
					};

					rdma1 {

						codec {
							sound-dai = <0x00>;
						};
					};

					rdma2 {

						codec {
							sound-dai = <0x00>;
						};
					};

					rdma3 {

						codec {
							sound-dai = <0x00>;
						};
					};

					rdma4 {

						codec {
							sound-dai = <0x00>;
						};
					};

					rdma5 {

						codec {
							sound-dai = <0x00>;
						};
					};

					rdma6 {

						codec {
							sound-dai = <0x00>;
						};
					};

					rdma7 {

						codec {
							sound-dai = <0x00>;
						};
					};

					rdma8 {

						codec {
							sound-dai = <0x00>;
						};
					};

					rdma9 {

						codec {
							sound-dai = <0x00>;
						};
					};

					rdma10 {

						codec {
							sound-dai = <0x00>;
						};
					};

					rdma11 {

						codec {
							sound-dai = <0x00>;
						};
					};

					wdma0 {

						codec {
							sound-dai = <0x00>;
						};
					};

					wdma1 {

						codec {
							sound-dai = <0x00>;
						};
					};

					wdma2 {

						codec {
							sound-dai = <0x00>;
						};
					};

					wdma3 {

						codec {
							sound-dai = <0x00>;
						};
					};

					wdma4 {

						codec {
							sound-dai = <0x00>;
						};
					};

					vts0 {

						codec {
							sound-dai = <0x00>;
						};
					};

					vts1 {

						codec {
							sound-dai = <0x00>;
						};
					};

					dp0_audio {

						codec {
							sound-dai = <0x00>;
						};
					};

					dp1_audio {

						codec {
							sound-dai = <0x00>;
						};
					};

					dual0 {

						codec {
							sound-dai = <0x00>;
						};
					};

					dual1 {

						codec {
							sound-dai = <0x00>;
						};
					};

					dual2 {

						codec {
							sound-dai = <0x00>;
						};
					};

					dual3 {

						codec {
							sound-dai = <0x00>;
						};
					};

					dual4 {

						codec {
							sound-dai = <0x00>;
						};
					};

					ddma0 {

						codec {
							sound-dai = <0x00>;
						};
					};

					ddma1 {

						codec {
							sound-dai = <0x00>;
						};
					};

					ddma2 {

						codec {
							sound-dai = <0x00>;
						};
					};

					ddma3 {

						codec {
							sound-dai = <0x00>;
						};
					};

					ddma4 {

						codec {
							sound-dai = <0x00>;
						};
					};

					ddma5 {

						codec {
							sound-dai = <0x00>;
						};
					};

					uaif0 {

						codec {
							sound-dai = <0x00>;
						};
					};

					uaif1 {

						codec {
							sound-dai = <0x00>;
						};
					};

					uaif2 {

						codec {
							sound-dai = <0x00 0x08>;
						};
					};

					uaif3 {

						codec {
							sound-dai = <0x00>;
						};
					};

					uaif4 {

						codec {
							sound-dai = <0x00>;
						};
					};

					uaif5 {

						codec {
							sound-dai = <0x00>;
						};
					};

					dsif0 {

						codec {
							sound-dai = <0x00>;
						};
					};

					sifs0 {

						codec {
							sound-dai = <0x00>;
						};
					};

					sifs1 {

						codec {
							sound-dai = <0x00>;
						};
					};

					sifs2 {

						codec {
							sound-dai = <0x00>;
						};
					};

					sifs3 {

						codec {
							sound-dai = <0x00>;
						};
					};

					sifs4 {

						codec {
							sound-dai = <0x00>;
						};
					};

					sifs5 {

						codec {
							sound-dai = <0x00>;
						};
					};

					nsrc0 {

						codec {
							sound-dai = <0x00>;
						};
					};

					nsrc1 {

						codec {
							sound-dai = <0x00>;
						};
					};

					nsrc2 {

						codec {
							sound-dai = <0x00>;
						};
					};

					nsrc3 {

						codec {
							sound-dai = <0x00>;
						};
					};

					nsrc4 {

						codec {
							sound-dai = <0x00>;
						};
					};

					rdma0_be {

						codec {
							sound-dai = <0x00>;
						};
					};

					rdma1_be {

						codec {
							sound-dai = <0x00>;
						};
					};

					rdma2_be {

						codec {
							sound-dai = <0x00>;
						};
					};

					rdma3_be {

						codec {
							sound-dai = <0x00>;
						};
					};

					rdma4_be {

						codec {
							sound-dai = <0x00>;
						};
					};

					rdma5_be {

						codec {
							sound-dai = <0x00>;
						};
					};

					rdma6_be {

						codec {
							sound-dai = <0x00>;
						};
					};

					rdma7_be {

						codec {
							sound-dai = <0x00>;
						};
					};

					rdma8_be {

						codec {
							sound-dai = <0x00>;
						};
					};

					rdma9_be {

						codec {
							sound-dai = <0x00>;
						};
					};

					rdma10_be {

						codec {
							sound-dai = <0x00>;
						};
					};

					rdma11_be {

						codec {
							sound-dai = <0x00>;
						};
					};

					wdma0_be {

						codec {
							sound-dai = <0x00>;
						};
					};

					wdma1_be {

						codec {
							sound-dai = <0x00>;
						};
					};

					wdma2_be {

						codec {
							sound-dai = <0x00>;
						};
					};

					wdma3_be {

						codec {
							sound-dai = <0x00>;
						};
					};

					wdma4_be {

						codec {
							sound-dai = <0x00>;
						};
					};

					usb {

						codec {
							sound-dai = <0x00>;
						};
					};

					fwd {

						codec {
							sound-dai = <0x00>;
						};
					};
				};
			};
		};

		fragment@37 {

			__overlay__ {
				hs_tune_param = <0x00>;
				ss_tune_param = <0x00>;
			};
		};

		fragment@38 {

			__overlay__ {

				touchscreen@48 {
					pinctrl-0 = <0x00>;
					pinctrl-1 = <0x00>;
				};
			};
		};

		fragment@42 {

			__overlay__ {

				cs35l40@40 {
					pinctrl-0 = <0x00>;
					VA-supply = <0x00>;
					VP-supply = <0x00>;
				};

				cs35l40@41 {
					pinctrl-0 = <0x00>;
					VA-supply = <0x00>;
					VP-supply = <0x00>;
				};
			};
		};

		fragment@44 {

			__overlay__ {
				pinctrl-0 = <0x10>;
			};
		};

		fragment@modemif {

			__overlay__ {

				cpif {
					pinctrl-0 = <0x00 0x04 0x08 0x0c 0x10 0x14 0x18 0x1c>;
				};
			};
		};

		fragment@54 {

			__overlay__ {

				pcal6524@22 {
					pinctrl-0 = <0x00>;
				};
			};
		};

		fragment@55 {

			__overlay__ {

				cs35l40@40 {
					reset-gpios = <0x00>;
				};

				cs35l40@41 {
					reset-gpios = <0x00>;
				};
			};
		};

		fragment@59 {

			__overlay__ {
				dp,aux_sw_oe = <0x00>;
				dp,sbu_sw_sel = <0x00>;
			};
		};
	};
};
