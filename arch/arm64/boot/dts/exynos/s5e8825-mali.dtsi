/*
 * SAMSUNG EXYNOS9810 MALI device tree sourceA
 *
 * Copyright (c) 2019 Samsung Electronics Co., Ltd.
 *     http://www.samsung.com
 *
 * This program is free software; you can redistribute it and/or modify
 * it under the terms of the GNU General Public License version 2 as
 * published by the Free Software Foundation.
 */

/{
	/* mali */
	mali: mali@10300000 {
		compatible = "arm,mali";
		reg = <0x0 0x10300000 0x5000>;
		sysreg_g3d = <0x10220000>;
		interrupts = <GIC_SPI INTREQ__G3D_IRQJOB IRQ_TYPE_LEVEL_HIGH>,
		             <GIC_SPI INTREQ__G3D_IRQMMU IRQ_TYPE_LEVEL_HIGH>,
		             <GIC_SPI INTREQ__G3D_IRQGPU IRQ_TYPE_LEVEL_HIGH>;
		interrupt-names = "JOB", "MMU", "GPU";
		g3d_cmu_cal_id = <ACPM_DVFS_G3D>;
		//system-coherency = <0>;
		power-domains = <&pd_g3d>;
		g3d_genpd_name = "pd-g3d";
		#cooling-cells = <2>; /* min followed by max */
		governor = "interactive";
		interactive_info = <403000 94 0>;
		gpu_dvfs_table_size = <9 8>; /*<row col>*/
		/*  8 columns      freq  down   up  stay  mif    little  middle   big  */
		gpu_dvfs_table = <
			897000    78  100   5  1794000  1066000       0       0
			806000    78   95   5  1539000  1066000       0       0
			702000    78   95   5  1352000  1066000       0       0
			611000    78   95   5  1352000  1066000       0       0
			507000    78   95   1  1014000  1066000       0       0
			403000    78   90   1  1014000       0       0       0
			312000    78   85   1   845000       0       0       0
			208000    78   85   1   676000       0       0       0
			104000     0   85   1   676000       0       0       0 >;
		gpu_sustainable_info = <403000 95 0 0 0>;
		gpu_pmqos_cpu_cluster_num = <3>;
		gpu_pmu_status_reg_offset = <0x2804>;
		gpu_pmu_status_local_pwr_mask = <0x1>; /*0x1 << 0*/
		gpu_max_clock = <897000>;
		gpu_max_clock_limit = <897000>;
		gpu_min_clock = <104000>;
		gpu_dvfs_start_clock = <221000>;
		gpu_dvfs_bl_config_clock = <221000>;
		gpu_default_voltage = <850000>;
		gpu_cold_minimum_vol = <0>;
		gpu_voltage_offset_margin = <37500>;
		gpu_tmu_control = <1>;
		gpu_temp_throttling_level_num = <5>;
		gpu_temp_throttling = <767000 676000 585000 494000 403000>;
		gpu_power_coeff = <625>;
		ect-coeff-index = <2>;
		gpu_dvfs_time_interval = <5>; /*1 tick : 10ms*/
		gpu_default_wakeup_lock = <1>;
		gpu_dynamic_abb = <0>;
		gpu_early_clk_gating = <0>;
		gpu_dvs = <0>;
		gpu_inter_frame_pm = <1>;
		gpu_inter_frame_dynamic_util = <50>;
		gpu_inter_frame_dynamic_freq = <767000>;
		gpu_perf_gathering = <0>;
		gpu_runtime_pm_delay_time = <50>;
		gpu_dvfs_polling_time = <30>;
		gpu_pmqos_int_disable = <1>;
		gpu_pmqos_mif_max_clock = <3172000>;
		gpu_pmqos_mif_max_clock_base = <650000>;
		gpu_cl_dvfs_start_base = <221000>;
		gpu_debug_level = <3>; /*DEBUG(1) INFO(2) WARNING(3) ERROR(4)*/
		gpu_trace_level = <8>; /*TRACE_ALL*/
		gpu_mo_min_clock = <507000>;
		gpu_boost_gpu_min_lock = <0>;
		gpu_boost_egl_min_lock = <1664000>;
		gpu_vk_boost_max_lock = <312000>;
		gpu_vk_boost_mif_min_lock = <1014000>;
		gpu_neg_boost_clock = <312000>;
		gpu_bts_support = <1>;
	};
};
