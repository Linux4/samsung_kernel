// SPDX-License-Identifier: GPL-2.0
/*
 * SAMSUNG EXYNOS SoC mfc device tree source
 *
 * Copyright (c) 2021 Samsung Electronics Co., Ltd.
 *		http://www.samsung.com
 *
 * SAMSUNG EXYNOS SoC mfc device nodes are listed in this file.
 * EXYNOS based board files can include this file and provide
 * values for board specific bindings.
 *
 * This program is free software; you can redistribute it and/or modify
 * it under the terms of the GNU General Public License version 2 as
 * published by the Free Software Foundation.
 */

&mfc {
	/* Encoder timing info disable */
	enc_timing_dis = <1>;
};
