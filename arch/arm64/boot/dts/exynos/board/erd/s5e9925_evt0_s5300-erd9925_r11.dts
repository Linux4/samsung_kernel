/*
 * SAMSUNG S5E9925 board device tree source
 *
 * Copyright (c) 2020 Samsung Electronics Co., Ltd.
 *		http://www.samsung.com
 *
 * This program is free software; you can redistribute it and/or modify
 * it under the terms of the GNU General Public License version 2 as
 * published by the Free Software Foundation.
 */

/dts-v1/;
/plugin/;

#include "s5e9925_evt0_s5300-erd9925_common.dtsi"

#define BOARD_ID	0x0
#define BOARD_REV	0x11

/ {
	compatible = "samsung,s5e9925", "samsung,ERD9925";
	board_id = <BOARD_ID>;
	board_rev = <BOARD_REV>;

	fragment@model {
		target-path = "/";
		__overlay__ {
			#address-cells = <2>;
			#size-cells = <1>;

			model = "Samsung ERD9925 S5300 board based on S5E9925";

		}; /* end of __overlay__ */
	}; /* end of fragment */
}; /* end of root */

&serial_0 {
	status = "okay";
};

&s2mu106_charger {
	ERD_board = <1>;
};

&battery_r01{
	ERD_board = <1>;
};
