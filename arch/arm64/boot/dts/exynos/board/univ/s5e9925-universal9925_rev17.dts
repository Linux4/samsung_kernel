/*
 * SAMSUNG S5E9925 board device tree source
 *
 * Copyright (c) 2020 Samsung Electronics Co., Ltd.
 *		http://www.samsung.com
 *
 * This program is free software; you can redistribute it and/or modify
 * it under the terms of the GNU General Public License version 2 as
 * published by the Free Software Foundation.
 */

/dts-v1/;
/plugin/;

#include "s5e9925-universal9925_common.dtsi"

#define BOARD_ID	0x1
#define BOARD_REV	0x17

/ {
	compatible = "samsung,s5e9925", "samsung,UNIV9925";
	board_id = <BOARD_ID>;
	board_rev = <BOARD_REV>;

	fragment@model {
		target-path = "/";
		__overlay__ {
			#address-cells = <2>;
			#size-cells = <1>;

			model = "Samsung UNIV9925 board based on S5E9925";

		}; /* end of __overlay__ */
	}; /* end of fragment */
}; /* end of root */

&serial_0 {
	status = "okay";
};

&drmpanel0 {
	compatible = "samsung,s6e3fac";
	/* reset, power */
	reset-gpios = <&gpc7 0 GPIO_ACTIVE_HIGH>;
	dsim_mode = <&dsim_modes>;
	reg = <0>;
};

