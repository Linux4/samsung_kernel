/*
 * SAMSUNG EXYNOS2100 board device tree source
 *
 * Copyright (c) 2020 Samsung Electronics Co., Ltd.
 *		http://www.samsung.com
 *
 * This program is free software; you can redistribute it and/or modify
 * it under the terms of the GNU General Public License version 2 as
 * published by the Free Software Foundation.
*/

/dts-v1/;
/plugin/;

#include "exynos2100-u2s_common.dtsi"
#include "battery_data_u2s_00.dtsi"

#define BOARD_ID	0x1
#define BOARD_REV	0x0

/ {
	compatible = "samsung,U2S EUR OPENX 00", "samsung,EXYNOS2100";
	dtbo-hw_rev = <0>;
	dtbo-hw_rev_end = <255>;
	board_id = <BOARD_ID>;
	board_rev = <BOARD_REV>;

	fragment@model {
		target-path = "/";
		__overlay__ {
			#address-cells = <2>;
			#size-cells = <1>;

			model = "Samsung U2S EUR OPENX 00 based on EXYNOS2100";

		}; /* end of __overlay__ */
	}; /* end of fragment */
}; /* end of root */
