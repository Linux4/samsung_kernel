/*
 * SAMSUNG S5E8825 SoC DVFS Manager device tree source
 *
 * Copyright (c) 2014 Samsung Electronics Co., Ltd.
 *              http://www.samsung.com
 *
 * SAMSUNG S5E8825 SoC device nodes are listed in this file.
 * EXYNOS based board files can include this file and provide
 * values for board specfic bindings.
 *
 * This program is free software; you can redistribute it and/or modify
 * it under the terms of the GNU General Public License version 2 as
 * published by the Free Software Foundation.
 */

#include "s5e8825-dm.dtsi"
#include "s5e8825-devfreq.dtsi"
#include "s5e8825-thermal.dtsi"

/ {
	cal_if {
		compatible = "samsung,exynos_cal_if";
		reg = <0x0 0x12900000 0x8000>,
		    <0x0 0x14e00000 0x1000>,
		    <0x0 0x1a030000 0x1000>,
		    <0x0 0x10820000 0x1000>,
		    <0x0 0x10830000 0x1000>,
		    <0x0 0x1d060000 0x1000>,
		    <0x0 0x108a0000 0x1000>,
		    <0x0 0x10030000 0x1000>;
		acpm-ipc-channel = <0>;
	};
	exynos-ect {
		compatible = "samsung,exynos-ect";
		memory-region = <&ect_binary>;
	};
};
