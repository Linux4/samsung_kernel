/*
 * Copyright (c) 2019 Samsung Electronics Co., Ltd.
 *		http://www.samsung.com
 *
 * This program is free software; you can redistribute it and/or modify
 * it under the terms of the GNU General Public License version 2 as
 * published by the Free Software Foundation.
 */

&i2c3 {
	s2mu106@3A {
			s2mu106-haptic {
				compatible = "sec,s2mu106-haptic";
				status = "okay";
				haptic,operation_mode = <1>; /* 0 : ERM_I2C, 1 : ERM_GPIO, 2 : LRA */
				haptic,max_timeout = <10000>;
				haptic,type = "COINDC";
				haptic,motor_en = <&pio 150 150>;
			};
	};
};
