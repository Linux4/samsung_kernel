/*
 * JADELTE Battery parameters device tree file for board IDs 04 and higher
 *
 * Copyright (C) 2017 Samsung Electronics, Inc.
 *
 * This program is free software; you can redistribute it and/or
 * modify it under the terms of the GNU General Public License
 * as published by the Free Software Foundation; either version 2
 * of the License, or (at your option) any later version.
 *
 * This program is distributed in the hope that it will be useful,
 * but WITHOUT ANY WARRANTY; without even the implied warranty of
 * MERCHANTABILITY or FITNESS FOR A PARTICULAR PURPOSE.  See the
 * GNU General Public License for more details.
 *
 * You should have received a copy of the GNU General Public License
 * along with this program. If not, see <http://www.gnu.org/licenses/>.
 *
 */

#include "battery_data_jadelte_common.dtsi"

/ {
	battery {
		battery,standard_curr = <2000>; /* TA standard current or AFC current */
		battery,expired_time = <13800>; /* 160 + 70 minutes */
	};

	cable-info {
		default_input_current = <1550>;
		default_charging_current = <2000>;
	};
};
