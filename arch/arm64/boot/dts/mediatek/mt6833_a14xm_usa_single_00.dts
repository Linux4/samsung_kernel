/* 
 * Generated by Samsung 
 * If these files should be changed, then please make a sync with MTK
*/

/dts-v1/;
/plugin/;

#include "../mediatek/S96902AA1.dts"
#include "mt6833-a14xm_common.dtsi"

/* Add Samsung configuration over here */
/ {
	compatible = "Samsung,A14 5G USA SINGLE 00", "Mediatek,MT6833";
	dtbo-hw_rev = <0x0>;
	dtbo-hw_rev_end = <0x20>;	
};

/*End of this file, DO NOT ADD ANYTHING HERE*/

