/*
 * Copyright (C) 2018 MediaTek Inc.
 *
 * This program is free software; you can redistribute it and/or modify
 * it under the terms of the GNU General Public License version 2 as
 * published by the Free Software Foundation.
 *
 * This program is distributed in the hope that it will be useful,
 * but WITHOUT ANY WARRANTY; without even the implied warranty of
 * MERCHANTABILITY or FITNESS FOR A PARTICULAR PURPOSE.
 * See http://www.gnu.org/licenses/gpl-2.0.html for more details.
 */
&bat_gm30 {
	compatible = "mediatek,bat_gm30";

	RBAT_TYPE = <(100)>;
	RBAT_PULL_UP_R = <(100000)>;

	rbat_temperature_table_num = <21>;
	rbat_battery_temperature =
	<
		(-40) 4397119
		(-35) 3088598
		(-30) 2197225
		(-25) 1581880
		(-20) 1151036
		(-15) 846578
		(-10) 628988
		(-5) 471632
		0 357011
		5 272499
		10 209709
		15 162650
		20 127080
		25 100000
		30 79221
		35 63167
		40 50676
		45 40903
		50 33194
		55 27090
		60 22224 >;
/* battery temperature table type - NTC table */
	BatteryID_GPIO_1 = <&pio 21 0>;
	BatteryID_GPIO = <&pio 22 0>;
/* Battery ID distinction */
	DIFFERENCE_FULLOCV_ITH = <(300)>; /* M53 : 250mA +50mA */
/*	Charging termination current*/
	SHUTDOWN_1_TIME = <(60)>;
/*	If ui_soc shows 1% more than X minites, system will shutdown*/
	KEEP_100_PERCENT = <(1)>;
/*	The ui_soc will keep 100% until SOC drop X percents after unplugged*/
	R_FG_VALUE = <(5)>;
/*	R_sense resistance*/
	EMBEDDED_SEL = <(0)>;
/*	Configures whether using embedded battery or not*/
	PMIC_SHUTDOWN_CURRENT = <(20)>;
/*	System shutdown current*/
	FG_METER_RESISTANCE = <(100)>;
/*	The resistance of PCB*/
	CAR_TUNE_VALUE = <(100)>;
/*	Tune value for current measurement*/
	PMIC_MIN_VOL = <(33500)>;
/*	vboot voltage for gauge 0%*/
	POWERON_SYSTEM_IBOOT = <(500)>;
/*	power on system iboot*/
	SHUTDOWN_GAUGE0 = <(0)>;
/*	Shutdown condition2 switch*/
	SHUTDOWN_GAUGE0_VOLTAGE = <(34000)>;
/*	shutdown gauge 0% voltage*/
	TEMPERATURE_T0 = <(50)>;
/*	Battery temperature T0*/
	TEMPERATURE_T1 = <(25)>;
/*	Battery temperature T1*/
	TEMPERATURE_T2 = <(10)>;
/*	Battery temperature T2*/
	TEMPERATURE_T3 = <(0)>;
/*	Battery temperature T3*/
	TEMPERATURE_T4 = <(-10)>;
/*	Battery temperature T4*/
	TEMPERATURE_T5 = <(-20)>;
/*	Battery temperature T5*/
	g_FG_PSEUDO100_T0 = <(100)>;
/*	Pseudo 100% percentage at T0*/
	g_FG_PSEUDO100_T1 = <(100)>;
/*	Pseudo 100% percentage at T1*/
	g_FG_PSEUDO100_T2 = <(100)>;
/*	Pseudo 100% percentage at T2*/
	g_FG_PSEUDO100_T3 = <(100)>;
/*	Pseudo 100% percentage at T3*/
	g_FG_PSEUDO100_T4 = <(100)>;
/*	Pseudo 100% percentage at T4*/
	g_FG_PSEUDO100_T5 = <(100)>;
/*	Pseudo 100% percentage at T4*/
	Q_MAX_SYS_VOLTAGE_BAT0 = <(3350)>;
/*	Pseudo1 for hide percentage*/
	Q_MAX_SYS_VOLTAGE_BAT1 = <(3350)>;
/*	Pseudo1 for hide percentage*/
	Q_MAX_SYS_VOLTAGE_BAT2 = <(3350)>;
/*	Pseudo1 for hide percentage*/
	Q_MAX_SYS_VOLTAGE_BAT3 = <(3350)>;
/*	Pseudo1 for hide percentage*/
	COM_FG_METER_RESISTANCE = <(100)>;
/*	compensate The resistance of PCB*/
	COM_R_FG_VALUE = <(0)>;
/*	compensate R_sense resistance*/
	enable_tmp_intr_suspend = <(0)>;
/* Enable update temp when suspend */
	ACTIVE_TABLE = <(6)>;
/* Table numbers per battery*/
	MULTI_TEMP_GAUGE0 = <(1)>;
/* Multi gauge0 enable*/
	HWOCV_OLDOCV_DIFF = <(100)>;
/* Diff of HWOCV and SWOCV*/
	DYNAMIC_CV_FACTOR = <(100)>;
/* Dynamic CV offset */
	CHARGER_IEOC = <(250)>;
/* Charger termination current for Dynamic CV */
#include "battery_table.dtsi"
#include "battery_prop_dim2_ext.dtsi"
};
