/*
 * SAMSUNG board device tree source
 *
 * Copyright (c) 2019 Samsung Electronics Co., Ltd.
 *		http://www.samsung.com
 *
 * This program is free software; you can redistribute it and/or modify
 * it under the terms of the GNU General Public License version 2 as
 * published by the Free Software Foundation.
 */

/ {

	fragment@model {
		target-path = "/";
		__overlay__ {
			ssp {
				compatible = "ssp";

				ssp-acc-position = <7>;
				ssp-mag-position = <1>;
				ssp-mag-check-nfc = <&pio 52 0>;
				ssp-mag-check-mst = <&pio 78 0>;
				ssp-mag-array = /bits/ 16 <9689 (-190) (-385) 114 11577 (-298) 234 (-681) 10972>;
				ssp-mag-nfc-array = /bits/ 16 <9827 (-102) (-187) (-644) 10944 (-329) 131 (-630) 11072>;
				ssp-mag-mst-array = /bits/ 16 <9866 (-257) (-256) (-730) 10489 (-186) 179 (-845) 11137>;
				ssp-light-position = /bits/ 32 <46 27 3 21 2 8>;
				ssp-brightness-array-len = <5>;
				ssp-brightness-array = /bits/ 32 <15 40 50 77 255>;
				ssp-light-cam-lux = /bits/ 32 <100 200>;
				ssp-light-cam-br = /bits/ 32 <60 60>;
			};
		};
	};
};

