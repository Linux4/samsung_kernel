/* Generated by MediaTek 
 * If these files should be chaned, then please make a sync with MTK
*/
/* avoid recursive inclusion for MTK GED*/
/*#ifndef CONFIG_BUILD_ARM64_DTB_OVERLAY_IMAGE_NAMES
#include "../mediatek/k68v1_64_titan.dts"
#endif
*/
#include "mt6768_a31_cis_ser_nfc_00.dtsi"
#include "mt6768_a31_mst_00.dtsi"
#include "mt6768_a31_sensorhub_00.dtsi"
#include "battery-data-a31-cis-ser-common.dtsi"
#include "mt6768_a31_sensor_grip_00.dtsi"

/* Add Samsung configuration over here */
/ {
	fragment@model {
		target-path = "/";
		__overlay__ {
			usb_notifier {
				compatible = "samsung,usb-notifier";
			};
			muic {
				new_factory;
				dcd_timeout;
			};
		};
	};
};
/*End of this file, DO NOT ADD ANYTHING HERE*/
