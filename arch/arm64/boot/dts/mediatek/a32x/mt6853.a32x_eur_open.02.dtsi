/*
 * Generated by Samsung
 * If these files should be changed, then please make a sync with MTK
*/

#include "../../mediatek/k6853v1_64_titan/gpio01.dtsi"
#include "mt6853-a32x_common.dtsi"
#include "mt6853-a32x_camera_02.dtsi"
#include "mt6853-a32x_gripsensor_00.dtsi"
#include "display_lcd_a32x_common.dtsi"
/*End of this file, DO NOT ADD ANYTHING HERE*/
