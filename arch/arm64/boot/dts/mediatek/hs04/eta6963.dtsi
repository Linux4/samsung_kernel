/*hs04 code for SR-AL6398A-01-139|SR-AL6398A-01-140 by shixuanxuan at 20220708 start*/
&i2c5 {
    eta6963: eta6963@66 {
        compatible = "eta6963";
        reg = <0x66>;
        status = "okay";

        interrupt-parent = <&pio>;
        interrupts = <123 IRQ_TYPE_EDGE_FALLING>;
        charger_name = "primary_chg";

        eta6963,charge-detect-enable;
        eta6963,usb-vlim = <4600>;
        eta6963,usb-ilim = <500>;
        eta6963,usb-vreg = <4400>;
        eta6963,usb-ichg = <500>;

        eta6963,precharge-current = <480>;
        eta6963,termination-current = <180>;
        eta6963,boost-voltage = <4998>;
        eta6963,boost-current = <1200>;
        eta6963,enable_term;
        eta6963,stat-pin-ctrl = <3>;
        eta6963,vac-ovp-threshold = <6500>;
    };
};
/*hs04 code for SR-AL6398A-01-139|SR-AL6398A-01-140 by shixuanxuan at 20220708 end*/
