/* HS04_T for DEAL6398A-1879 by shixuanxuan at 20221012 start */
&i2c5 {
    upm6910: upm6910@65 {
        compatible = "upm6910";
        reg = <0x65>;
        status = "okay";

        interrupt-parent = <&pio>;
        interrupts = <123 IRQ_TYPE_EDGE_FALLING>;
        charger_name = "primary_chg";

        upm6910,charge-detect-enable;
        upm6910,usb-vlim = <4600>;
        upm6910,usb-ilim = <500>;
        upm6910,usb-vreg = <4400>;
        upm6910,usb-ichg = <500>;

        upm6910,precharge-current = <480>;
        upm6910,termination-current = <180>;
        upm6910,boost-voltage = <4998>;
        upm6910,boost-current = <1200>;
        upm6910,enable_term;
        upm6910,stat-pin-ctrl = <3>;
        upm6910,vac-ovp-threshold = <6500>;
    };
};
/* HS04_T for DEAL6398A-1879 by shixuanxuan at 20221012 end*/
