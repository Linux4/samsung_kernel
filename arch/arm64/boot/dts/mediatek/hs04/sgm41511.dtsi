&i2c5 {
	clock-frequency = <100000>;
	sgm41511: sgm41511@67 {
		compatible = "sgm41511";
		reg = <0x67>;
		status = "okay";

		interrupt-parent = <&pio>;
		interrupts = <123 IRQ_TYPE_EDGE_FALLING>;
		charger_name = "primary_chg";

		sgm41511,charge-detect-enable;
		sgm41511,usb-vlim = <4600>;
		sgm41511,usb-ilim = <500>;
		sgm41511,usb-vreg = <4400>;
		sgm41511,usb-ichg = <500>;

		sgm41511,precharge-current = <480>;
		sgm41511,termination-current = <180>;
		sgm41511,boost-voltage = <4998>;
		sgm41511,boost-current = <1200>;
		sgm41511,enable_term;
		sgm41511,stat-pin-ctrl = <3>;
		sgm41511,vac-ovp-threshold = <6500>;
	};
};