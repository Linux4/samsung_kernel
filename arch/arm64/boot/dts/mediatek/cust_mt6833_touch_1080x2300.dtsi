/*
 * Copyright (c) 2019 MediaTek Inc.
 *
 * This program is free software; you can redistribute it and/or modify
 * it under the terms of the GNU General Public License version 2 as
 * published by the Free Software Foundation.
 *
 * This program is distributed in the hope that it will be useful,
 * but WITHOUT ANY WARRANTY; without even the implied warranty of
 * MERCHANTABILITY or FITNESS FOR A PARTICULAR PURPOSE.  See the
 * GNU General Public License for more details.
 */
/* TOUCH start */
//+bug773028, fangzhihua.wt,mod, 20220628,TP bringup
&spi1 {
	status = "ok";

	/* Novatek device tree node */
	novatek@0 {
	compatible = "novatek,NVT-ts-spi","mediatek,7807s_touch","focaltech,ft8722","himax,common";
	reg = <0>; //Same as CS ID
	status = "ok";

	spi-max-frequency = <9600000>;	//4800000,9600000,15000000,19200000
	novatek,reset-gpio = <&pio 15 0x00>;
	novatek,irq-gpio = <&pio 14 0x2001>;

	/* 525 */
	//novatek,swrst-n8-addr = <0x01F01A>;

	/* 672A, 525B, 675, 526, 672C */
	novatek,swrst-n8-addr = <0x03F0FE>;
	novatek,spi-rd-fast-addr = <0x03F310>;

	/*Panel setting*/
	novatek,resolution = <1080 2408>;
	novatek,max_touch_num = <10>;
	novatek,area-size = <56 112 60>;	//indicator navigation edge
	novatek,fw_name = "novatek_ts_fw.bin", "tsp_novatek/TM_0658_FHDp_Samsung-N22_Wingtech_PID7223_TP.bin";
	novatek,fw_name_mp = "novatek_ts_mp.bin", "tsp_novatek/TM_0658_FHDp_Samsung-N22_Wingtech_PID7223_MP.bin";
	//novatek,support_ear_detect_mode;
	novatek,enable_settings_aot;

	/* MP */
	novatek,mp-support-dt;

	novatek-mp-criteria-7223@0 {
		compatible = "novatek-mp-criteria-7223";
		/* sec cmd test config */
		open_test_spec = <(-511) 5120>;
		short_test_spec = <10000 14008>;
		diff_test_frame = <50>;
		/* sec cmd fdm test config */
		fdm_x_num = <2>;
		fdm_diff_test_frame = <50>;

		/* MP Config */
		IC_X_CFG_SIZE = <16>;
		IC_Y_CFG_SIZE = <36>;
		IC_KEY_CFG_SIZE = <4>;
		X_Channel = <16>;
		Y_Channel = <36>;
		AIN_X = <0 1 2 3 4 5 6 7 8 9 10 11 12 13 14 15>;
		AIN_Y = <0 1 2 3 4 5 6 7 8 9 10 11 12 13 14 15 16 17
			18 19 20 21 22 23 24 25 26 27 28 29 30 31 32 33 34 35>;
		AIN_KEY = <0 1 2 0xFF>;

		/* MP Criteria */
		PS_Config_Lmt_Short_Rawdata_P = <
				14008 14008 14008 14008 14008 14008 14008 14008 14008 14008 14008 14008 14008 14008 14008 14008
				14008 14008 14008 14008 14008 14008 14008 14008 14008 14008 14008 14008 14008 14008 14008 14008
				14008 14008 14008 14008 14008 14008 14008 14008 14008 14008 14008 14008 14008 14008 14008 14008
				14008 14008 14008 14008 14008 14008 14008 14008 14008 14008 14008 14008 14008 14008 14008 14008
				14008 14008 14008 14008 14008 14008 14008 14008 14008 14008 14008 14008 14008 14008 14008 14008
				14008 14008 14008 14008 14008 14008 14008 14008 14008 14008 14008 14008 14008 14008 14008 14008
				14008 14008 14008 14008 14008 14008 14008 14008 14008 14008 14008 14008 14008 14008 14008 14008
				14008 14008 14008 14008 14008 14008 14008 14008 14008 14008 14008 14008 14008 14008 14008 14008
				14008 14008 14008 14008 14008 14008 14008 14008 14008 14008 14008 14008 14008 14008 14008 14008
				14008 14008 14008 14008 14008 14008 14008 14008 14008 14008 14008 14008 14008 14008 14008 14008
				14008 14008 14008 14008 14008 14008 14008 14008 14008 14008 14008 14008 14008 14008 14008 14008
				14008 14008 14008 14008 14008 14008 14008 14008 14008 14008 14008 14008 14008 14008 14008 14008
				14008 14008 14008 14008 14008 14008 14008 14008 14008 14008 14008 14008 14008 14008 14008 14008
				14008 14008 14008 14008 14008 14008 14008 14008 14008 14008 14008 14008 14008 14008 14008 14008
				14008 14008 14008 14008 14008 14008 14008 14008 14008 14008 14008 14008 14008 14008 14008 14008
				14008 14008 14008 14008 14008 14008 14008 14008 14008 14008 14008 14008 14008 14008 14008 14008
				14008 14008 14008 14008 14008 14008 14008 14008 14008 14008 14008 14008 14008 14008 14008 14008
				14008 14008 14008 14008 14008 14008 14008 14008 14008 14008 14008 14008 14008 14008 14008 14008
				14008 14008 14008 14008 14008 14008 14008 14008 14008 14008 14008 14008 14008 14008 14008 14008
				14008 14008 14008 14008 14008 14008 14008 14008 14008 14008 14008 14008 14008 14008 14008 14008
				14008 14008 14008 14008 14008 14008 14008 14008 14008 14008 14008 14008 14008 14008 14008 14008
				14008 14008 14008 14008 14008 14008 14008 14008 14008 14008 14008 14008 14008 14008 14008 14008
				14008 14008 14008 14008 14008 14008 14008 14008 14008 14008 14008 14008 14008 14008 14008 14008
				14008 14008 14008 14008 14008 14008 14008 14008 14008 14008 14008 14008 14008 14008 14008 14008
				14008 14008 14008 14008 14008 14008 14008 14008 14008 14008 14008 14008 14008 14008 14008 14008
				14008 14008 14008 14008 14008 14008 14008 14008 14008 14008 14008 14008 14008 14008 14008 14008
				14008 14008 14008 14008 14008 14008 14008 14008 14008 14008 14008 14008 14008 14008 14008 14008
				14008 14008 14008 14008 14008 14008 14008 14008 14008 14008 14008 14008 14008 14008 14008 14008
				14008 14008 14008 14008 14008 14008 14008 14008 14008 14008 14008 14008 14008 14008 14008 14008
				14008 14008 14008 14008 14008 14008 14008 14008 14008 14008 14008 14008 14008 14008 14008 14008
				14008 14008 14008 14008 14008 14008 14008 14008 14008 14008 14008 14008 14008 14008 14008 14008
				14008 14008 14008 14008 14008 14008 14008 14008 14008 14008 14008 14008 14008 14008 14008 14008
				14008 14008 14008 14008 14008 14008 14008 14008 14008 14008 14008 14008 14008 14008 14008 14008
				14008 14008 14008 14008 14008 14008 14008 14008 14008 14008 14008 14008 14008 14008 14008 14008
				14008 14008 14008 14008 14008 14008 14008 14008 14008 14008 14008 14008 14008 14008 14008 14008
				14008 14008 14008 14008 14008 14008 14008 14008 14008 14008 14008 14008 14008 14008 14008 14008
				14008 14008 14008>;

			PS_Config_Lmt_Short_Rawdata_N = <
				10100 10100 10100 10100 10100 10100 10100 10100 10100 10100 10100 10100 10100 10100 10100 10100
				10100 10100 10100 10100 10100 10100 10100 10100 10100 10100 10100 10100 10100 10100 10100 10100
				10100 10100 10100 10100 10100 10100 10100 10100 10100 10100 10100 10100 10100 10100 10100 10100
				10100 10100 10100 10100 10100 10100 10100 10100 10100 10100 10100 10100 10100 10100 10100 10100
				10100 10100 10100 10100 10100 10100 10100 10100 10100 10100 10100 10100 10100 10100 10100 10100
				10100 10100 10100 10100 10100 10100 10100 10100 10100 10100 10100 10100 10100 10100 10100 10100
				10100 10100 10100 10100 10100 10100 10100 10100 10100 10100 10100 10100 10100 10100 10100 10100
				10100 10100 10100 10100 10100 10100 10100 10100 10100 10100 10100 10100 10100 10100 10100 10100
				10100 10100 10100 10100 10100 10100 10100 10100 10100 10100 10100 10100 10100 10100 10100 10100
				10100 10100 10100 10100 10100 10100 10100 10100 10100 10100 10100 10100 10100 10100 10100 10100
				10100 10100 10100 10100 10100 10100 10100 10100 10100 10100 10100 10100 10100 10100 10100 10100
				10100 10100 10100 10100 10100 10100 10100 10100 10100 10100 10100 10100 10100 10100 10100 10100
				10100 10100 10100 10100 10100 10100 10100 10100 10100 10100 10100 10100 10100 10100 10100 10100
				10100 10100 10100 10100 10100 10100 10100 10100 10100 10100 10100 10100 10100 10100 10100 10100
				10100 10100 10100 10100 10100 10100 10100 10100 10100 10100 10100 10100 10100 10100 10100 10100
				10100 10100 10100 10100 10100 10100 10100 10100 10100 10100 10100 10100 10100 10100 10100 10100
				10100 10100 10100 10100 10100 10100 10100 10100 10100 10100 10100 10100 10100 10100 10100 10100
				10100 10100 10100 10100 10100 10100 10100 10100 10100 10100 10100 10100 10100 10100 10100 10100
				10100 10100 10100 10100 10100 10100 10100 10100 10100 10100 10100 10100 10100 10100 10100 10100
				10100 10100 10100 10100 10100 10100 10100 10100 10100 10100 10100 10100 10100 10100 10100 10100
				10100 10100 10100 10100 10100 10100 10100 10100 10100 10100 10100 10100 10100 10100 10100 10100
				10100 10100 10100 10100 10100 10100 10100 10100 10100 10100 10100 10100 10100 10100 10100 10100
				10100 10100 10100 10100 10100 10100 10100 10100 10100 10100 10100 10100 10100 10100 10100 10100
				10100 10100 10100 10100 10100 10100 10100 10100 10100 10100 10100 10100 10100 10100 10100 10100
				10100 10100 10100 10100 10100 10100 10100 10100 10100 10100 10100 10100 10100 10100 10100 10100
				10100 10100 10100 10100 10100 10100 10100 10100 10100 10100 10100 10100 10100 10100 10100 10100
				10100 10100 10100 10100 10100 10100 10100 10100 10100 10100 10100 10100 10100 10100 10100 10100
				10100 10100 10100 10100 10100 10100 10100 10100 10100 10100 10100 10100 10100 10100 10100 10100
				10100 10100 10100 10100 10100 10100 10100 10100 10100 10100 10100 10100 10100 10100 10100 10100
				10100 10100 10100 10100 10100 10100 10100 10100 10100 10100 10100 10100 10100 10100 10100 10100
				10100 10100 10100 10100 10100 10100 10100 10100 10100 10100 10100 10100 10100 10100 10100 10100
				10100 10100 10100 10100 10100 10100 10100 10100 10100 10100 10100 10100 10100 10100 10100 10100
				10100 10100 10100 10100 10100 10100 10100 10100 10100 10100 10100 10100 10100 10100 10100 10100
				10100 10100 10100 10100 10100 10100 10100 10100 10100 10100 10100 10100 10100 10100 10100 10100
				10100 10100 10100 10100 10100 10100 10100 10100 10100 10100 10100 10100 10100 10100 10100 10100
				10100 10100 10100 10100 10100 10100 10100 10100 10100 10100 10100 10100 10100 10100 10100 10100
				10000 10000 10000>;

			PS_Config_Lmt_Open_Rawdata_P = <
				3530 3633 3738 3831 3697 3717 3694 65535 65535 3763 3712 3752 3810 3760 3557 3532
				3743 3833 3845 3903 3824 3841 3796 3882 3855 3836 3788 3826 3827 3824 3738 3698
				3771 3824 3840 3921 3847 3848 3808 3789 3816 3886 3844 3883 3896 3859 3787 3754
				3810 3861 3885 3966 3889 3886 3844 3799 3855 3928 3883 3920 3924 3889 3808 3756
				3854 3914 3918 4012 3941 3945 3889 3882 3880 3964 3906 3953 3939 3903 3822 3805
				3843 3897 3907 4008 3942 3952 3883 3883 3868 3953 3890 3942 3921 3885 3806 3794
				3871 3922 3946 4032 3977 3992 3922 3918 3879 3962 3910 3946 3915 3892 3799 3795
				3859 3918 3948 4023 3988 4005 3906 3927 3927 3999 3953 3992 3950 3924 3815 3833
				3862 3911 3932 4012 3991 3997 3939 3924 3976 4040 3992 4039 3978 3948 3873 3850
				3896 3942 3959 4047 4026 4029 3971 3949 3945 4009 3955 4005 3935 3910 3833 3813
				3885 3949 3960 4057 4041 4030 3988 3985 3964 4047 3988 4047 3949 3908 3852 3841
				3922 3984 3985 4085 4071 4095 4020 4011 3970 4050 3995 4057 3960 3946 3864 3850
				3906 3957 3973 4058 4072 4097 4022 3998 4037 4110 4071 4113 4012 4006 3920 3897
				3914 3969 3988 4064 4083 4117 4039 4009 4005 4079 4034 4083 3959 3957 3873 3852
				3913 3969 3977 4054 4054 4116 4050 4009 4088 4149 4089 4149 4005 4012 3943 3910
				3967 4027 4034 4103 4146 4174 4118 4079 4085 4135 4085 4142 4012 3997 3918 3885
				3955 4020 4006 4086 4132 4179 4120 4081 4106 4163 4104 4166 4029 4012 3921 3904
				3957 4023 3998 4057 4135 4177 4134 4090 4047 4104 4053 4076 3969 3952 3850 3833
				3896 3873 3816 3819 3735 3757 3729 3753 3642 3763 3728 3754 3771 3864 3873 3984
				3913 3897 3826 3829 3750 3774 3742 3771 3627 3739 3717 3747 3766 3854 3865 3967
				3922 3927 3855 3852 3781 3798 3771 3788 3651 3749 3746 3784 3791 3885 3885 3957
				3901 3906 3817 3830 3754 3771 3752 3759 3644 3752 3728 3788 3795 3882 3875 3949
				3900 3917 3837 3833 3773 3782 3760 3764 3669 3766 3757 3820 3817 3894 3889 3953
				3885 3914 3833 3840 3761 3774 3752 3756 3675 3760 3757 3816 3813 3882 3872 3935
				3889 3927 3855 3855 3784 3803 3771 3777 3647 3742 3735 3791 3799 3878 3864 3918
				3893 3925 3868 3871 3801 3829 3791 3799 3701 3764 3777 3836 3838 3915 3903 3938
				3868 3921 3855 3855 3787 3799 3781 3782 3684 3763 3766 3813 3822 3889 3885 3900
				3879 3935 3873 3866 3802 3817 3799 3796 3691 3767 3764 3817 3815 3890 3876 3892
				3829 3920 3845 3859 3778 3798 3777 3777 3684 3784 3770 3834 3831 3904 3892 3894
				3841 3908 3838 3858 3777 3794 3780 3775 3696 3775 3757 3817 3822 3890 3875 3878
				3822 3899 3845 3857 3778 3803 3781 3774 3701 3789 3782 3824 3829 3913 3873 3876
				3577 3917 3588 3876 3533 3833 3526 3794 3467 3813 3528 3851 3577 3934 3609 3890
				3418 3620 3593 3605 3540 3564 3537 3532 3460 3533 3515 3563 3561 3626 3588 3441
				3421 3626 3600 3614 3546 3571 3546 3540 3467 3540 3514 3564 3557 3621 3578 3427
				3362 3581 3558 3577 3511 3537 3509 3512 3434 3516 3477 3536 3525 3591 3537 3383
				3131 3560 3570 3595 3525 3550 3521 3529 3448 3532 3493 3542 3539 3600 3509 3151
				5120 5120 5120>;

			PS_Config_Lmt_Open_Rawdata_N = <
				1513 1557 1602 1642 1584 1593 1583 (-65535) (-65535) 1612 1591 1608 1633 1611 1524 1513
				1604 1642 1648 1672 1639 1646 1627 1663 1652 1644 1623 1639 1640 1639 1602 1585
				1616 1639 1645 1680 1648 1649 1632 1624 1635 1665 1647 1664 1669 1654 1623 1609
				1633 1654 1665 1699 1666 1665 1647 1628 1652 1683 1664 1680 1681 1666 1632 1609
				1651 1677 1679 1719 1689 1690 1666 1663 1663 1699 1674 1694 1688 1672 1638 1630
				1647 1670 1674 1717 1689 1693 1664 1664 1657 1694 1667 1689 1680 1665 1631 1626
				1659 1681 1691 1728 1704 1711 1681 1679 1662 1698 1675 1691 1678 1668 1628 1626
				1654 1679 1692 1724 1709 1716 1674 1683 1683 1714 1694 1711 1693 1681 1635 1642
				1655 1676 1685 1719 1710 1713 1688 1681 1704 1731 1711 1731 1705 1692 1660 1650
				1669 1689 1696 1734 1725 1726 1702 1692 1690 1718 1695 1716 1686 1675 1642 1634
				1665 1692 1697 1738 1732 1727 1709 1708 1699 1734 1709 1734 1692 1675 1651 1646
				1681 1707 1708 1750 1744 1755 1723 1719 1701 1735 1712 1738 1697 1691 1656 1650
				1674 1696 1702 1739 1745 1756 1723 1713 1730 1761 1744 1762 1719 1717 1680 1670
				1677 1701 1709 1741 1750 1764 1731 1718 1716 1748 1729 1750 1696 1696 1660 1651
				1677 1701 1704 1737 1737 1764 1735 1718 1752 1778 1752 1778 1716 1719 1690 1675
				1700 1726 1729 1758 1777 1789 1765 1748 1750 1772 1750 1775 1719 1713 1679 1665
				1695 1723 1717 1751 1771 1791 1765 1749 1759 1784 1759 1785 1726 1719 1680 1673
				1696 1724 1713 1738 1772 1790 1771 1753 1734 1759 1737 1747 1701 1693 1650 1642
				1669 1660 1635 1636 1600 1610 1598 1608 1561 1612 1597 1609 1616 1656 1660 1707
				1677 1670 1639 1641 1607 1617 1603 1616 1554 1602 1593 1606 1614 1651 1656 1700
				1681 1683 1652 1651 1620 1627 1616 1623 1564 1606 1605 1621 1624 1665 1665 1696
				1672 1674 1636 1641 1609 1616 1608 1611 1561 1608 1597 1623 1626 1663 1660 1692
				1671 1678 1644 1642 1617 1621 1611 1613 1572 1614 1610 1637 1636 1669 1666 1694
				1665 1677 1642 1645 1612 1617 1608 1609 1575 1611 1610 1635 1634 1663 1659 1686
				1666 1683 1652 1652 1621 1630 1616 1618 1563 1603 1600 1624 1628 1662 1656 1679
				1668 1682 1657 1659 1629 1641 1624 1628 1586 1613 1618 1644 1645 1678 1672 1687
				1657 1680 1652 1652 1623 1628 1620 1621 1579 1612 1614 1634 1638 1666 1665 1671
				1662 1686 1660 1657 1629 1636 1628 1627 1582 1614 1613 1636 1635 1667 1661 1668
				1641 1680 1648 1654 1619 1627 1618 1618 1579 1621 1615 1643 1642 1673 1668 1669
				1646 1675 1645 1653 1618 1626 1620 1618 1584 1618 1610 1636 1638 1667 1660 1662
				1638 1671 1648 1653 1619 1630 1620 1617 1586 1624 1621 1639 1641 1677 1660 1661
				1533 1678 1537 1661 1514 1642 1511 1626 1486 1634 1512 1650 1533 1686 1546 1667
				1465 1551 1540 1545 1517 1527 1516 1513 1483 1514 1506 1527 1526 1554 1537 1474
				1466 1554 1543 1549 1519 1530 1519 1517 1486 1517 1506 1527 1524 1552 1533 1468
				1441 1534 1525 1533 1504 1516 1504 1505 1471 1507 1490 1515 1510 1539 1516 1450
				1342 1525 1530 1540 1510 1521 1509 1512 1477 1513 1497 1518 1516 1543 1504 1350
				(-511) (-511) (-511)>;

			PS_Config_Lmt_FW_Rawdata_P = <
				1150 1080 1108 1118 1107 1135 1129 65535 65535 1115 1114 1113 1108 1111 1092 1111
				1113 1122 1127 1128 1111 1125 1132 1117 1121 1117 1125 1113 1114 1122 1124 1125
				1145 1107 1117 1125 1101 1111 1114 1120 1117 1114 1108 1106 1104 1114 1120 1128
				1138 1094 1115 1115 1103 1110 1111 1131 1128 1129 1128 1132 1135 1136 1128 1097
				1096 1153 1135 1110 1141 1107 1107 1106 1111 1114 1099 1124 1103 1107 1114 1114
				1129 1107 1117 1111 1114 1106 1113 1115 1114 1122 1142 1136 1149 1131 1131 1090
				1118 1107 1115 1111 1108 1104 1103 1104 1110 1115 1115 1118 1118 1114 1103 1125
				1132 1096 1106 1108 1097 1106 1101 1113 1110 1111 1104 1101 1101 1092 1107 1117
				1110 1121 1117 1125 1117 1131 1125 1128 1107 1104 1097 1096 1093 1094 1104 1117
				1114 1120 1127 1134 1139 1141 1139 1108 1101 1104 1110 1107 1103 1100 1128 1113
				1113 1110 1100 1101 1114 1104 1096 1113 1111 1110 1104 1101 1101 1106 1097 1115
				1121 1092 1100 1107 1104 1111 1110 1127 1110 1107 1118 1120 1120 1111 1100 1124
				1129 1108 1120 1125 1120 1121 1115 1131 1104 1107 1093 1093 1093 1092 1092 1127
				1124 1114 1117 1115 1113 1131 1121 1121 1106 1121 1103 1099 1103 1092 1099 1136
				1099 1129 1128 1113 1125 1106 1101 1114 1113 1128 1083 1097 1096 1090 1089 1127
				1113 1118 1121 1122 1132 1117 1114 1122 1103 1107 1099 1103 1093 1103 1094 1120
				1118 1115 1125 1110 1106 1115 1117 1113 1122 1132 1131 1132 1129 1124 1135 1120
				1114 1115 1124 1099 1107 1124 1121 1100 1113 1132 1135 1110 1114 1115 1106 1108
				1118 1110 1110 1103 1093 1115 1110 1100 1101 1117 1111 1118 1115 1118 1122 1122
				1118 1124 1121 1115 1117 1127 1131 1125 1124 1114 1122 1118 1124 1122 1110 1117
				1120 1108 1107 1107 1115 1101 1100 1096 1120 1113 1107 1094 1111 1113 1103 1131
				1108 1127 1114 1117 1104 1099 1125 1111 1118 1115 1120 1113 1118 1118 1106 1138
				1122 1100 1110 1099 1122 1124 1097 1101 1108 1115 1117 1113 1118 1121 1129 1120
				1128 1110 1132 1120 1131 1127 1104 1103 1104 1108 1108 1111 1094 1099 1106 1127
				1138 1117 1107 1113 1099 1120 1104 1103 1117 1117 1114 1115 1122 1118 1117 1101
				1118 1128 1125 1117 1115 1118 1113 1113 1124 1117 1115 1114 1120 1127 1125 1124
				1122 1106 1100 1092 1085 1083 1082 1085 1124 1122 1122 1118 1128 1128 1128 1099
				1097 1106 1106 1108 1103 1108 1108 1117 1107 1100 1099 1097 1106 1110 1114 1134
				1114 1094 1104 1141 1143 1153 1125 1142 1122 1113 1120 1122 1108 1104 1107 1134
				1128 1117 1117 1121 1118 1117 1104 1110 1110 1113 1111 1118 1107 1111 1110 1113
				1122 1120 1121 1107 1108 1107 1120 1118 1110 1117 1108 1104 1108 1115 1107 1129
				1131 1086 1106 1099 1083 1103 1101 1078 1139 1131 1103 1121 1101 1118 1101 1134
				1113 1110 1107 1114 1115 1107 1103 1107 1124 1129 1120 1120 1115 1129 1113 1114
				1104 1122 1128 1120 1125 1128 1124 1128 1121 1108 1106 1108 1111 1113 1118 1110
				1120 1110 1120 1117 1122 1120 1120 1118 1129 1127 1117 1115 1117 1124 1129 1108
				1121 1108 1108 1107 1121 1118 1124 1114 1113 1129 1132 1128 1114 1108 1110 1093
				3840 3840 3840>;

			PS_Config_Lmt_FW_Rawdata_N = <
				493 463 475 479 474 486 484 (-65535) (-65535) 478 477 477 475 476 468 476
				477 481 483 483 476 482 485 478 480 478 482 477 477 481 481 482
				490 474 478 482 472 476 477 480 478 477 475 474 473 477 480 483
				487 469 478 478 472 475 476 484 483 484 483 485 486 487 483 470
				469 494 486 475 489 474 474 474 476 477 471 481 472 474 477 477
				484 474 478 476 477 474 477 478 477 481 489 487 492 484 484 467
				479 474 478 476 475 473 472 473 475 478 478 479 479 477 472 482
				485 469 474 475 470 474 472 477 475 476 473 472 472 468 474 478
				475 480 478 482 478 484 482 483 474 473 470 469 468 469 473 478
				477 480 483 486 488 489 488 475 472 473 475 474 472 471 483 477
				477 475 471 472 477 473 469 477 476 475 473 472 472 474 470 478
				480 468 471 474 473 476 475 483 475 474 479 480 480 476 471 481
				484 475 480 482 480 480 478 484 473 474 468 468 468 468 468 483
				481 477 478 478 477 484 480 480 474 480 472 471 472 468 471 487
				471 484 483 477 482 474 472 477 477 483 464 470 469 467 466 483
				477 479 480 481 485 478 477 481 472 474 471 472 468 472 469 480
				479 478 482 475 474 478 478 477 481 485 484 485 484 481 486 480
				477 478 481 471 474 481 480 471 477 485 486 475 477 478 474 475
				479 475 475 472 468 478 475 471 472 478 476 479 478 479 481 481
				479 481 480 478 478 483 484 482 481 477 481 479 481 481 475 478
				480 475 474 474 478 472 471 469 480 477 474 469 476 477 472 484
				475 483 477 478 473 471 482 476 479 478 480 477 479 479 474 487
				481 471 475 471 481 481 470 472 475 478 478 477 479 480 484 480
				483 475 485 480 484 483 473 472 473 475 475 476 469 471 474 483
				487 478 474 477 471 480 473 472 478 478 477 478 481 479 478 472
				479 483 482 478 478 479 477 477 481 478 478 477 480 483 482 481
				481 474 471 468 465 464 463 465 481 481 481 479 483 483 483 471
				470 474 474 475 472 475 475 478 474 471 471 470 474 475 477 486
				477 469 473 489 490 494 482 489 481 477 480 481 475 473 474 486
				483 478 478 480 479 478 473 475 475 477 476 479 474 476 475 477
				481 480 480 474 475 474 480 479 475 478 475 473 475 478 474 484
				484 465 474 471 464 472 472 462 488 484 472 480 472 479 472 486
				477 475 474 477 478 474 472 474 481 484 480 480 478 484 477 477
				473 481 483 480 482 483 481 483 480 475 474 475 476 477 479 475
				480 475 480 478 481 480 480 479 484 483 478 478 478 481 484 475
				480 475 475 474 480 479 481 477 477 484 485 483 477 475 475 468
				240 240 240>;

			PS_Config_Lmt_FW_CC_P = <
				40 41 41 41 41 41 41 65535 65535 42 42 42 42 42 41 41
				42 42 42 42 42 42 42 42 42 41 41 41 41 41 41 42
				42 41 41 41 41 41 41 41 41 42 41 41 41 42 41 42
				42 42 42 42 42 42 42 42 41 41 41 41 41 41 41 42
				42 41 41 41 41 41 41 41 42 42 42 42 42 42 42 42
				44 42 42 42 42 42 42 42 41 41 41 41 41 41 41 42
				42 42 42 42 42 42 42 42 41 42 41 41 41 41 41 42
				42 42 42 42 42 42 42 42 42 42 42 42 42 42 41 42
				42 41 41 41 41 42 41 42 42 42 42 42 42 42 41 42
				42 42 42 42 42 42 42 42 42 42 41 42 42 42 41 42
				42 42 42 42 42 42 42 42 42 42 42 42 42 42 42 42
				42 42 42 42 42 42 42 44 42 42 42 42 42 42 42 44
				42 41 41 41 41 42 41 42 42 42 42 42 42 42 42 42
				42 42 42 42 42 42 42 44 42 42 42 42 42 42 41 42
				42 41 41 42 41 42 42 42 42 42 42 42 42 42 42 42
				44 42 42 42 42 44 44 44 42 42 42 42 42 41 41 42
				42 41 41 42 42 42 42 42 42 42 42 42 42 42 41 42
				42 42 42 42 42 42 42 44 42 42 42 42 41 41 41 42
				42 41 41 41 41 41 41 41 42 41 41 41 41 41 41 42
				42 41 41 41 41 41 41 41 42 41 41 41 41 41 41 42
				42 41 41 41 41 41 41 41 42 42 42 42 42 42 42 42
				44 42 42 42 41 41 42 42 42 41 41 41 42 42 42 42
				42 41 41 41 41 41 42 41 42 42 42 42 42 42 42 42
				42 42 41 42 41 41 42 42 42 41 41 41 42 42 42 42
				42 42 42 42 42 42 42 42 42 42 42 41 42 42 42 42
				44 42 42 42 42 42 42 42 42 42 42 42 42 42 42 42
				42 41 41 41 41 41 42 42 41 41 41 41 41 42 42 42
				44 42 42 42 42 42 42 42 42 42 42 42 42 42 42 42
				42 41 41 41 41 41 41 41 41 41 41 41 41 41 41 42
				42 41 42 41 41 41 42 42 41 41 41 41 41 41 41 42
				42 41 41 41 41 41 41 41 41 42 41 41 42 42 42 42
				42 42 42 42 42 42 42 42 41 41 41 41 41 42 41 42
				41 41 41 41 41 41 41 41 41 41 41 41 41 41 41 42
				42 41 42 41 41 41 42 42 42 42 41 41 41 41 41 42
				41 41 41 41 41 41 41 41 41 41 41 41 41 41 41 41
				41 42 42 42 42 42 42 42 42 42 41 42 41 41 41 41
				314 314 314>;

			PS_Config_Lmt_FW_CC_N = <
				17 18 18 18 18 18 18 (-65535) (-65535) 19 19 19 19 19 18 18
				19 19 19 19 19 19 19 19 19 18 18 18 18 18 18 19
				19 18 18 18 18 18 18 18 18 19 18 18 18 19 18 19
				19 19 19 19 19 19 19 19 18 18 18 18 18 18 18 19
				19 18 18 18 18 18 18 18 19 19 19 19 19 19 19 19
				19 19 19 19 19 19 19 19 18 18 18 18 18 18 18 19
				19 19 19 19 19 19 19 19 18 19 18 18 18 18 18 19
				19 19 19 19 19 19 19 19 19 19 19 19 19 19 18 19
				19 18 18 18 18 19 18 19 19 19 19 19 19 19 18 19
				19 19 19 19 19 19 19 19 19 19 18 19 19 19 18 19
				19 19 19 19 19 19 19 19 19 19 19 19 19 19 19 19
				19 19 19 19 19 19 19 19 19 19 19 19 19 19 19 19
				19 18 18 18 18 19 18 19 19 19 19 19 19 19 19 19
				19 19 19 19 19 19 19 19 19 19 19 19 19 19 18 19
				19 18 18 19 18 19 19 19 19 19 19 19 19 19 19 19
				19 19 19 19 19 19 19 19 19 19 19 19 19 18 18 19
				19 18 18 19 19 19 19 19 19 19 19 19 19 19 18 19
				19 19 19 19 19 19 19 19 19 19 19 19 18 18 18 19
				19 18 18 18 18 18 18 18 19 18 18 18 18 18 18 19
				19 18 18 18 18 18 18 18 19 18 18 18 18 18 18 19
				19 18 18 18 18 18 18 18 19 19 19 19 19 19 19 19
				19 19 19 19 18 18 19 19 19 18 18 18 19 19 19 19
				19 18 18 18 18 18 19 18 19 19 19 19 19 19 19 19
				19 19 18 19 18 18 19 19 19 18 18 18 19 19 19 19
				19 19 19 19 19 19 19 19 19 19 19 18 19 19 19 19
				19 19 19 19 19 19 19 19 19 19 19 19 19 19 19 19
				19 18 18 18 18 18 19 19 18 18 18 18 18 19 19 19
				19 19 19 19 19 19 19 19 19 19 19 19 19 19 19 19
				19 18 18 18 18 18 18 18 18 18 18 18 18 18 18 19
				19 18 19 18 18 18 19 19 18 18 18 18 18 18 18 19
				19 18 18 18 18 18 18 18 18 19 18 18 19 19 19 19
				19 19 19 19 19 19 19 19 18 18 18 18 18 19 18 19
				18 18 18 18 18 18 18 18 18 18 18 18 18 18 18 19
				19 18 19 18 18 18 19 19 19 19 18 18 18 18 18 19
				18 18 18 18 18 18 18 18 18 18 18 18 18 18 18 18
				18 19 19 19 19 19 19 19 19 19 18 19 18 18 18 18
				0 0 0>;

			PS_Config_Lmt_FW_Diff_P = <
				50 50 50 50 50 50 50 65535 65535 50 50 50 50 50 50 50
				50 50 50 50 50 50 50 50 50 50 50 50 50 50 50 50
				50 50 50 50 50 50 50 50 50 50 50 50 50 50 50 50
				50 50 50 50 50 50 50 50 50 50 50 50 50 50 50 50
				50 50 50 50 50 50 50 50 50 50 50 50 50 50 50 50
				50 50 50 50 50 50 50 50 50 50 50 50 50 50 50 50
				50 50 50 50 50 50 50 50 50 50 50 50 50 50 50 50
				50 50 50 50 50 50 50 50 50 50 50 50 50 50 50 50
				50 50 50 50 50 50 50 50 50 50 50 50 50 50 50 50
				50 50 50 50 50 50 50 50 50 50 50 50 50 50 50 50
				50 50 50 50 50 50 50 50 50 50 50 50 50 50 50 50
				50 50 50 50 50 50 50 50 50 50 50 50 50 50 50 50
				50 50 50 50 50 50 50 50 50 50 50 50 50 50 50 50
				50 50 50 50 50 50 50 50 50 50 50 50 50 50 50 50
				50 50 50 50 50 50 50 50 50 50 50 50 50 50 50 50
				50 50 50 50 50 50 50 50 50 50 50 50 50 50 50 50
				50 50 50 50 50 50 50 50 50 50 50 50 50 50 50 50
				50 50 50 50 50 50 50 50 50 50 50 50 50 50 50 50
				50 50 50 50 50 50 50 50 50 50 50 50 50 50 50 50
				50 50 50 50 50 50 50 50 50 50 50 50 50 50 50 50
				50 50 50 50 50 50 50 50 50 50 50 50 50 50 50 50
				50 50 50 50 50 50 50 50 50 50 50 50 50 50 50 50
				50 50 50 50 50 50 50 50 50 50 50 50 50 50 50 50
				50 50 50 50 50 50 50 50 50 50 50 50 50 50 50 50
				50 50 50 50 50 50 50 50 50 50 50 50 50 50 50 50
				50 50 50 50 50 50 50 50 50 50 50 50 50 50 50 50
				50 50 50 50 50 50 50 50 50 50 50 50 50 50 50 50
				50 50 50 50 50 50 50 50 50 50 50 50 50 50 50 50
				50 50 50 50 50 50 50 50 50 50 50 50 50 50 50 50
				50 50 50 50 50 50 50 50 50 50 50 50 50 50 50 50
				50 50 50 50 50 50 50 50 50 50 50 50 50 50 50 50
				50 50 50 50 50 50 50 50 50 50 50 50 50 50 50 50
				50 50 50 50 50 50 50 50 50 50 50 50 50 50 50 50
				50 50 50 50 50 50 50 50 50 50 50 50 50 50 50 50
				50 50 50 50 50 50 50 50 50 50 50 50 50 50 50 50
				50 50 50 50 50 50 50 50 50 50 50 50 50 50 50 50
				75 75 75>;

			PS_Config_Lmt_FW_Diff_N = <
				(-50) (-50) (-50) (-50) (-50) (-50) (-50) (-65535) (-65535) (-50) (-50) (-50) (-50) (-50) (-50) (-50)
				(-50) (-50) (-50) (-50) (-50) (-50) (-50) (-50) (-50) (-50) (-50) (-50) (-50) (-50) (-50) (-50)
				(-50) (-50) (-50) (-50) (-50) (-50) (-50) (-50) (-50) (-50) (-50) (-50) (-50) (-50) (-50) (-50)
				(-50) (-50) (-50) (-50) (-50) (-50) (-50) (-50) (-50) (-50) (-50) (-50) (-50) (-50) (-50) (-50)
				(-50) (-50) (-50) (-50) (-50) (-50) (-50) (-50) (-50) (-50) (-50) (-50) (-50) (-50) (-50) (-50)
				(-50) (-50) (-50) (-50) (-50) (-50) (-50) (-50) (-50) (-50) (-50) (-50) (-50) (-50) (-50) (-50)
				(-50) (-50) (-50) (-50) (-50) (-50) (-50) (-50) (-50) (-50) (-50) (-50) (-50) (-50) (-50) (-50)
				(-50) (-50) (-50) (-50) (-50) (-50) (-50) (-50) (-50) (-50) (-50) (-50) (-50) (-50) (-50) (-50)
				(-50) (-50) (-50) (-50) (-50) (-50) (-50) (-50) (-50) (-50) (-50) (-50) (-50) (-50) (-50) (-50)
				(-50) (-50) (-50) (-50) (-50) (-50) (-50) (-50) (-50) (-50) (-50) (-50) (-50) (-50) (-50) (-50)
				(-50) (-50) (-50) (-50) (-50) (-50) (-50) (-50) (-50) (-50) (-50) (-50) (-50) (-50) (-50) (-50)
				(-50) (-50) (-50) (-50) (-50) (-50) (-50) (-50) (-50) (-50) (-50) (-50) (-50) (-50) (-50) (-50)
				(-50) (-50) (-50) (-50) (-50) (-50) (-50) (-50) (-50) (-50) (-50) (-50) (-50) (-50) (-50) (-50)
				(-50) (-50) (-50) (-50) (-50) (-50) (-50) (-50) (-50) (-50) (-50) (-50) (-50) (-50) (-50) (-50)
				(-50) (-50) (-50) (-50) (-50) (-50) (-50) (-50) (-50) (-50) (-50) (-50) (-50) (-50) (-50) (-50)
				(-50) (-50) (-50) (-50) (-50) (-50) (-50) (-50) (-50) (-50) (-50) (-50) (-50) (-50) (-50) (-50)
				(-50) (-50) (-50) (-50) (-50) (-50) (-50) (-50) (-50) (-50) (-50) (-50) (-50) (-50) (-50) (-50)
				(-50) (-50) (-50) (-50) (-50) (-50) (-50) (-50) (-50) (-50) (-50) (-50) (-50) (-50) (-50) (-50)
				(-50) (-50) (-50) (-50) (-50) (-50) (-50) (-50) (-50) (-50) (-50) (-50) (-50) (-50) (-50) (-50)
				(-50) (-50) (-50) (-50) (-50) (-50) (-50) (-50) (-50) (-50) (-50) (-50) (-50) (-50) (-50) (-50)
				(-50) (-50) (-50) (-50) (-50) (-50) (-50) (-50) (-50) (-50) (-50) (-50) (-50) (-50) (-50) (-50)
				(-50) (-50) (-50) (-50) (-50) (-50) (-50) (-50) (-50) (-50) (-50) (-50) (-50) (-50) (-50) (-50)
				(-50) (-50) (-50) (-50) (-50) (-50) (-50) (-50) (-50) (-50) (-50) (-50) (-50) (-50) (-50) (-50)
				(-50) (-50) (-50) (-50) (-50) (-50) (-50) (-50) (-50) (-50) (-50) (-50) (-50) (-50) (-50) (-50)
				(-50) (-50) (-50) (-50) (-50) (-50) (-50) (-50) (-50) (-50) (-50) (-50) (-50) (-50) (-50) (-50)
				(-50) (-50) (-50) (-50) (-50) (-50) (-50) (-50) (-50) (-50) (-50) (-50) (-50) (-50) (-50) (-50)
				(-50) (-50) (-50) (-50) (-50) (-50) (-50) (-50) (-50) (-50) (-50) (-50) (-50) (-50) (-50) (-50)
				(-50) (-50) (-50) (-50) (-50) (-50) (-50) (-50) (-50) (-50) (-50) (-50) (-50) (-50) (-50) (-50)
				(-50) (-50) (-50) (-50) (-50) (-50) (-50) (-50) (-50) (-50) (-50) (-50) (-50) (-50) (-50) (-50)
				(-50) (-50) (-50) (-50) (-50) (-50) (-50) (-50) (-50) (-50) (-50) (-50) (-50) (-50) (-50) (-50)
				(-50) (-50) (-50) (-50) (-50) (-50) (-50) (-50) (-50) (-50) (-50) (-50) (-50) (-50) (-50) (-50)
				(-50) (-50) (-50) (-50) (-50) (-50) (-50) (-50) (-50) (-50) (-50) (-50) (-50) (-50) (-50) (-50)
				(-50) (-50) (-50) (-50) (-50) (-50) (-50) (-50) (-50) (-50) (-50) (-50) (-50) (-50) (-50) (-50)
				(-50) (-50) (-50) (-50) (-50) (-50) (-50) (-50) (-50) (-50) (-50) (-50) (-50) (-50) (-50) (-50)
				(-50) (-50) (-50) (-50) (-50) (-50) (-50) (-50) (-50) (-50) (-50) (-50) (-50) (-50) (-50) (-50)
				(-50) (-50) (-50) (-50) (-50) (-50) (-50) (-50) (-50) (-50) (-50) (-50) (-50) (-50) (-50) (-50)
				(-75) (-75) (-75)>;

			PS_Config_Diff_Test_Frame = <50>;

			PS_Config_Lmt_LPWG_Rawdata_P = <
				3000 3000 3000 3000 3000 3000 3000 3000 3000 3000 3000 3000 3000 3000 3000 3000
				3000 3000 3000 3000 3000 3000 3000 3000 3000 3000 3000 3000 3000 3000 3000 3000
				3000 3000 3000 3000 3000 3000 3000 3000 3000 3000 3000 3000 3000 3000 3000 3000
				3000 3000 3000 3000 3000 3000 3000 3000 3000 3000 3000 3000 3000 3000 3000 3000
				3000 3000 3000 3000 3000 3000 3000 3000 3000 3000 3000 3000 3000 3000 3000 3000
				3000 3000 3000 3000 3000 3000 3000 3000 3000 3000 3000 3000 3000 3000 3000 3000
				3000 3000 3000 3000 3000 3000 3000 3000 3000 3000 3000 3000 3000 3000 3000 3000
				3000 3000 3000 3000 3000 3000 3000 3000 3000 3000 3000 3000 3000 3000 3000 3000
				3000 3000 3000 3000 3000 3000 3000 3000 3000 3000 3000 3000 3000 3000 3000 3000
				3000 3000 3000 3000 3000 3000 3000 3000 3000 3000 3000 3000 3000 3000 3000 3000
				3000 3000 3000 3000 3000 3000 3000 3000 3000 3000 3000 3000 3000 3000 3000 3000
				3000 3000 3000 3000 3000 3000 3000 3000 3000 3000 3000 3000 3000 3000 3000 3000
				3000 3000 3000 3000 3000 3000 3000 3000 3000 3000 3000 3000 3000 3000 3000 3000
				3000 3000 3000 3000 3000 3000 3000 3000 3000 3000 3000 3000 3000 3000 3000 3000
				3000 3000 3000 3000 3000 3000 3000 3000 3000 3000 3000 3000 3000 3000 3000 3000
				3000 3000 3000 3000 3000 3000 3000 3000 3000 3000 3000 3000 3000 3000 3000 3000
				3000 3000 3000 3000 3000 3000 3000 3000 3000 3000 3000 3000 3000 3000 3000 3000
				3000 3000 3000 3000 3000 3000 3000 3000 3000 3000 3000 3000 3000 3000 3000 3000
				3000 3000 3000 3000 3000 3000 3000 3000 3000 3000 3000 3000 3000 3000 3000 3000
				3000 3000 3000 3000 3000 3000 3000 3000 3000 3000 3000 3000 3000 3000 3000 3000
				3000 3000 3000 3000 3000 3000 3000 3000 3000 3000 3000 3000 3000 3000 3000 3000
				3000 3000 3000 3000 3000 3000 3000 3000 3000 3000 3000 3000 3000 3000 3000 3000
				3000 3000 3000 3000 3000 3000 3000 3000 3000 3000 3000 3000 3000 3000 3000 3000
				3000 3000 3000 3000 3000 3000 3000 3000 3000 3000 3000 3000 3000 3000 3000 3000
				3000 3000 3000 3000 3000 3000 3000 3000 3000 3000 3000 3000 3000 3000 3000 3000
				3000 3000 3000 3000 3000 3000 3000 3000 3000 3000 3000 3000 3000 3000 3000 3000
				3000 3000 3000 3000 3000 3000 3000 3000 3000 3000 3000 3000 3000 3000 3000 3000
				3000 3000 3000 3000 3000 3000 3000 3000 3000 3000 3000 3000 3000 3000 3000 3000
				3000 3000 3000 3000 3000 3000 3000 3000 3000 3000 3000 3000 3000 3000 3000 3000
				3000 3000 3000 3000 3000 3000 3000 3000 3000 3000 3000 3000 3000 3000 3000 3000
				3000 3000 3000 3000 3000 3000 3000 3000 3000 3000 3000 3000 3000 3000 3000 3000
				3000 3000 3000 3000 3000 3000 3000 3000 3000 3000 3000 3000 3000 3000 3000 3000
				3000 3000 3000 3000 3000 3000 3000 3000 3000 3000 3000 3000 3000 3000 3000 3000
				3000 3000 3000 3000 3000 3000 3000 3000 3000 3000 3000 3000 3000 3000 3000 3000
				3000 3000 3000 3000 3000 3000 3000 3000 3000 3000 3000 3000 3000 3000 3000 3000
				3000 3000 3000 3000 3000 3000 3000 3000 3000 3000 3000 3000 3000 3000 3000 3000
				3000 3000 3000>;

			PS_Config_Lmt_LPWG_Rawdata_N = <
				240 240 240 240 240 240 240 240 240 240 240 240 240 240 240 240
				240 240 240 240 240 240 240 240 240 240 240 240 240 240 240 240
				240 240 240 240 240 240 240 240 240 240 240 240 240 240 240 240
				240 240 240 240 240 240 240 240 240 240 240 240 240 240 240 240
				240 240 240 240 240 240 240 240 240 240 240 240 240 240 240 240
				240 240 240 240 240 240 240 240 240 240 240 240 240 240 240 240
				240 240 240 240 240 240 240 240 240 240 240 240 240 240 240 240
				240 240 240 240 240 240 240 240 240 240 240 240 240 240 240 240
				240 240 240 240 240 240 240 240 240 240 240 240 240 240 240 240
				240 240 240 240 240 240 240 240 240 240 240 240 240 240 240 240
				240 240 240 240 240 240 240 240 240 240 240 240 240 240 240 240
				240 240 240 240 240 240 240 240 240 240 240 240 240 240 240 240
				240 240 240 240 240 240 240 240 240 240 240 240 240 240 240 240
				240 240 240 240 240 240 240 240 240 240 240 240 240 240 240 240
				240 240 240 240 240 240 240 240 240 240 240 240 240 240 240 240
				240 240 240 240 240 240 240 240 240 240 240 240 240 240 240 240
				240 240 240 240 240 240 240 240 240 240 240 240 240 240 240 240
				240 240 240 240 240 240 240 240 240 240 240 240 240 240 240 240
				240 240 240 240 240 240 240 240 240 240 240 240 240 240 240 240
				240 240 240 240 240 240 240 240 240 240 240 240 240 240 240 240
				240 240 240 240 240 240 240 240 240 240 240 240 240 240 240 240
				240 240 240 240 240 240 240 240 240 240 240 240 240 240 240 240
				240 240 240 240 240 240 240 240 240 240 240 240 240 240 240 240
				240 240 240 240 240 240 240 240 240 240 240 240 240 240 240 240
				240 240 240 240 240 240 240 240 240 240 240 240 240 240 240 240
				240 240 240 240 240 240 240 240 240 240 240 240 240 240 240 240
				240 240 240 240 240 240 240 240 240 240 240 240 240 240 240 240
				240 240 240 240 240 240 240 240 240 240 240 240 240 240 240 240
				240 240 240 240 240 240 240 240 240 240 240 240 240 240 240 240
				240 240 240 240 240 240 240 240 240 240 240 240 240 240 240 240
				240 240 240 240 240 240 240 240 240 240 240 240 240 240 240 240
				240 240 240 240 240 240 240 240 240 240 240 240 240 240 240 240
				240 240 240 240 240 240 240 240 240 240 240 240 240 240 240 240
				240 240 240 240 240 240 240 240 240 240 240 240 240 240 240 240
				240 240 240 240 240 240 240 240 240 240 240 240 240 240 240 240
				240 240 240 240 240 240 240 240 240 240 240 240 240 240 240 240
				240 240 240>;

			PS_Config_Lmt_LPWG_Diff_P = <
				75 75 75 75 75 75 75 75 75 75 75 75 75 75 75 75
				75 75 75 75 75 75 75 75 75 75 75 75 75 75 75 75
				75 75 75 75 75 75 75 75 75 75 75 75 75 75 75 75
				75 75 75 75 75 75 75 75 75 75 75 75 75 75 75 75
				75 75 75 75 75 75 75 75 75 75 75 75 75 75 75 75
				75 75 75 75 75 75 75 75 75 75 75 75 75 75 75 75
				75 75 75 75 75 75 75 75 75 75 75 75 75 75 75 75
				75 75 75 75 75 75 75 75 75 75 75 75 75 75 75 75
				75 75 75 75 75 75 75 75 75 75 75 75 75 75 75 75
				75 75 75 75 75 75 75 75 75 75 75 75 75 75 75 75
				75 75 75 75 75 75 75 75 75 75 75 75 75 75 75 75
				75 75 75 75 75 75 75 75 75 75 75 75 75 75 75 75
				75 75 75 75 75 75 75 75 75 75 75 75 75 75 75 75
				75 75 75 75 75 75 75 75 75 75 75 75 75 75 75 75
				75 75 75 75 75 75 75 75 75 75 75 75 75 75 75 75
				75 75 75 75 75 75 75 75 75 75 75 75 75 75 75 75
				75 75 75 75 75 75 75 75 75 75 75 75 75 75 75 75
				75 75 75 75 75 75 75 75 75 75 75 75 75 75 75 75
				75 75 75 75 75 75 75 75 75 75 75 75 75 75 75 75
				75 75 75 75 75 75 75 75 75 75 75 75 75 75 75 75
				75 75 75 75 75 75 75 75 75 75 75 75 75 75 75 75
				75 75 75 75 75 75 75 75 75 75 75 75 75 75 75 75
				75 75 75 75 75 75 75 75 75 75 75 75 75 75 75 75
				75 75 75 75 75 75 75 75 75 75 75 75 75 75 75 75
				75 75 75 75 75 75 75 75 75 75 75 75 75 75 75 75
				75 75 75 75 75 75 75 75 75 75 75 75 75 75 75 75
				75 75 75 75 75 75 75 75 75 75 75 75 75 75 75 75
				75 75 75 75 75 75 75 75 75 75 75 75 75 75 75 75
				75 75 75 75 75 75 75 75 75 75 75 75 75 75 75 75
				75 75 75 75 75 75 75 75 75 75 75 75 75 75 75 75
				75 75 75 75 75 75 75 75 75 75 75 75 75 75 75 75
				75 75 75 75 75 75 75 75 75 75 75 75 75 75 75 75
				75 75 75 75 75 75 75 75 75 75 75 75 75 75 75 75
				75 75 75 75 75 75 75 75 75 75 75 75 75 75 75 75
				75 75 75 75 75 75 75 75 75 75 75 75 75 75 75 75
				75 75 75 75 75 75 75 75 75 75 75 75 75 75 75 75
				75 75 75>;

			PS_Config_Lmt_LPWG_Diff_N = <
				(-75) (-75) (-75) (-75) (-75) (-75) (-75) (-75) (-75) (-75) (-75) (-75) (-75) (-75) (-75) (-75)
				(-75) (-75) (-75) (-75) (-75) (-75) (-75) (-75) (-75) (-75) (-75) (-75) (-75) (-75) (-75) (-75)
				(-75) (-75) (-75) (-75) (-75) (-75) (-75) (-75) (-75) (-75) (-75) (-75) (-75) (-75) (-75) (-75)
				(-75) (-75) (-75) (-75) (-75) (-75) (-75) (-75) (-75) (-75) (-75) (-75) (-75) (-75) (-75) (-75)
				(-75) (-75) (-75) (-75) (-75) (-75) (-75) (-75) (-75) (-75) (-75) (-75) (-75) (-75) (-75) (-75)
				(-75) (-75) (-75) (-75) (-75) (-75) (-75) (-75) (-75) (-75) (-75) (-75) (-75) (-75) (-75) (-75)
				(-75) (-75) (-75) (-75) (-75) (-75) (-75) (-75) (-75) (-75) (-75) (-75) (-75) (-75) (-75) (-75)
				(-75) (-75) (-75) (-75) (-75) (-75) (-75) (-75) (-75) (-75) (-75) (-75) (-75) (-75) (-75) (-75)
				(-75) (-75) (-75) (-75) (-75) (-75) (-75) (-75) (-75) (-75) (-75) (-75) (-75) (-75) (-75) (-75)
				(-75) (-75) (-75) (-75) (-75) (-75) (-75) (-75) (-75) (-75) (-75) (-75) (-75) (-75) (-75) (-75)
				(-75) (-75) (-75) (-75) (-75) (-75) (-75) (-75) (-75) (-75) (-75) (-75) (-75) (-75) (-75) (-75)
				(-75) (-75) (-75) (-75) (-75) (-75) (-75) (-75) (-75) (-75) (-75) (-75) (-75) (-75) (-75) (-75)
				(-75) (-75) (-75) (-75) (-75) (-75) (-75) (-75) (-75) (-75) (-75) (-75) (-75) (-75) (-75) (-75)
				(-75) (-75) (-75) (-75) (-75) (-75) (-75) (-75) (-75) (-75) (-75) (-75) (-75) (-75) (-75) (-75)
				(-75) (-75) (-75) (-75) (-75) (-75) (-75) (-75) (-75) (-75) (-75) (-75) (-75) (-75) (-75) (-75)
				(-75) (-75) (-75) (-75) (-75) (-75) (-75) (-75) (-75) (-75) (-75) (-75) (-75) (-75) (-75) (-75)
				(-75) (-75) (-75) (-75) (-75) (-75) (-75) (-75) (-75) (-75) (-75) (-75) (-75) (-75) (-75) (-75)
				(-75) (-75) (-75) (-75) (-75) (-75) (-75) (-75) (-75) (-75) (-75) (-75) (-75) (-75) (-75) (-75)
				(-75) (-75) (-75) (-75) (-75) (-75) (-75) (-75) (-75) (-75) (-75) (-75) (-75) (-75) (-75) (-75)
				(-75) (-75) (-75) (-75) (-75) (-75) (-75) (-75) (-75) (-75) (-75) (-75) (-75) (-75) (-75) (-75)
				(-75) (-75) (-75) (-75) (-75) (-75) (-75) (-75) (-75) (-75) (-75) (-75) (-75) (-75) (-75) (-75)
				(-75) (-75) (-75) (-75) (-75) (-75) (-75) (-75) (-75) (-75) (-75) (-75) (-75) (-75) (-75) (-75)
				(-75) (-75) (-75) (-75) (-75) (-75) (-75) (-75) (-75) (-75) (-75) (-75) (-75) (-75) (-75) (-75)
				(-75) (-75) (-75) (-75) (-75) (-75) (-75) (-75) (-75) (-75) (-75) (-75) (-75) (-75) (-75) (-75)
				(-75) (-75) (-75) (-75) (-75) (-75) (-75) (-75) (-75) (-75) (-75) (-75) (-75) (-75) (-75) (-75)
				(-75) (-75) (-75) (-75) (-75) (-75) (-75) (-75) (-75) (-75) (-75) (-75) (-75) (-75) (-75) (-75)
				(-75) (-75) (-75) (-75) (-75) (-75) (-75) (-75) (-75) (-75) (-75) (-75) (-75) (-75) (-75) (-75)
				(-75) (-75) (-75) (-75) (-75) (-75) (-75) (-75) (-75) (-75) (-75) (-75) (-75) (-75) (-75) (-75)
				(-75) (-75) (-75) (-75) (-75) (-75) (-75) (-75) (-75) (-75) (-75) (-75) (-75) (-75) (-75) (-75)
				(-75) (-75) (-75) (-75) (-75) (-75) (-75) (-75) (-75) (-75) (-75) (-75) (-75) (-75) (-75) (-75)
				(-75) (-75) (-75) (-75) (-75) (-75) (-75) (-75) (-75) (-75) (-75) (-75) (-75) (-75) (-75) (-75)
				(-75) (-75) (-75) (-75) (-75) (-75) (-75) (-75) (-75) (-75) (-75) (-75) (-75) (-75) (-75) (-75)
				(-75) (-75) (-75) (-75) (-75) (-75) (-75) (-75) (-75) (-75) (-75) (-75) (-75) (-75) (-75) (-75)
				(-75) (-75) (-75) (-75) (-75) (-75) (-75) (-75) (-75) (-75) (-75) (-75) (-75) (-75) (-75) (-75)
				(-75) (-75) (-75) (-75) (-75) (-75) (-75) (-75) (-75) (-75) (-75) (-75) (-75) (-75) (-75) (-75)
				(-75) (-75) (-75) (-75) (-75) (-75) (-75) (-75) (-75) (-75) (-75) (-75) (-75) (-75) (-75) (-75)
				(-75) (-75) (-75)>;

			/* FDM config */
			FDM_X_Channel = <2>;

			PS_Config_Lmt_FDM_Rawdata_P = <
				900 900
				900 900
				900 900
				900 900
				900 900
				900 900
				900 900
				900 900
				900 900
				900 900
				900 900
				900 900
				900 900
				900 900
				900 900
				900 900
				900 900
				900 900
				900 900
				900 900
				900 900
				900 900
				900 900
				900 900
				900 900
				900 900
				900 900
				900 900
				900 900
				900 900
				900 900
				900 900
				900 900
				900 900
				900 900
				900 900
				900 900
				900 900
				900 900
				900 900>;

			PS_Config_Lmt_FDM_Rawdata_N = <
				50 50
				50 50
				50 50
				50 50
				50 50
				50 50
				50 50
				50 50
				50 50
				50 50
				50 50
				50 50
				50 50
				50 50
				50 50
				50 50
				50 50
				50 50
				50 50
				50 50
				50 50
				50 50
				50 50
				50 50
				50 50
				50 50
				50 50
				50 50
				50 50
				50 50
				50 50
				50 50
				50 50
				50 50
				50 50
				50 50
				50 50
				50 50
				50 50
				50 50>;

			PS_Config_FDM_Noise_Test_Frame = <50>;
			PS_Config_Lmt_FDM_Diff_P = <
				180 180
				180 180
				180 180
				180 180
				180 180
				180 180
				180 180
				180 180
				180 180
				180 180
				180 180
				180 180
				180 180
				180 180
				180 180
				180 180
				180 180
				180 180
				180 180
				180 180
				180 180
				180 180
				180 180
				180 180
				180 180
				180 180
				180 180
				180 180
				180 180
				180 180
				180 180
				180 180
				180 180
				180 180
				180 180
				180 180
				180 180
				180 180
				180 180
				180 180>;

			PS_Config_Lmt_FDM_Diff_N = <
				(-180) (-180)
				(-180) (-180)
				(-180) (-180)
				(-180) (-180)
				(-180) (-180)
				(-180) (-180)
				(-180) (-180)
				(-180) (-180)
				(-180) (-180)
				(-180) (-180)
				(-180) (-180)
				(-180) (-180)
				(-180) (-180)
				(-180) (-180)
				(-180) (-180)
				(-180) (-180)
				(-180) (-180)
				(-180) (-180)
				(-180) (-180)
				(-180) (-180)
				(-180) (-180)
				(-180) (-180)
				(-180) (-180)
				(-180) (-180)
				(-180) (-180)
				(-180) (-180)
				(-180) (-180)
				(-180) (-180)
				(-180) (-180)
				(-180) (-180)
				(-180) (-180)
				(-180) (-180)
				(-180) (-180)
				(-180) (-180)
				(-180) (-180)
				(-180) (-180)
				(-180) (-180)
				(-180) (-180)
				(-180) (-180)
				(-180) (-180)>;
		};
	};
};

/* TOUCH end */
