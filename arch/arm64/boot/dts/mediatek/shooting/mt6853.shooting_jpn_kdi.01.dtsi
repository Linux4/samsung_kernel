/*
 * Generated by Samsung
 * If these files should be changed, then please make a sync with MTK
*/

#include "../../mediatek/k6853v1_64_titan_mhs/gpio01.dtsi"
#include "mt6853-shooting_common.dtsi"

/* enable USB super speed */
&mtu3_0 {
    mediatek,usb3-drd = "1";
};

/*End of this file, DO NOT ADD ANYTHING HERE*/
