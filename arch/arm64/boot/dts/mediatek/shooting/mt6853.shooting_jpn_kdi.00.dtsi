/*
 * Generated by Samsung
 * If these files should be changed, then please make a sync with MTK
*/

#include "../../mediatek/k6853v1_64_titan_mhs/gpio00.dtsi"
#include "mt6853-shooting_common.dtsi"

/*End of this file, DO NOT ADD ANYTHING HERE*/
