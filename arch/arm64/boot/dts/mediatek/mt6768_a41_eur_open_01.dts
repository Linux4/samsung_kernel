/* Generated by MediaTek 
 * If these files should be chaned, then please make a sync with MTK
*/

/dts-v1/;
/plugin/;

#include "../mediatek/k68v1_64_titan.dts"
#include "mt6768-a41_common.dtsi"
#include "cust_a41_eur_open-gpio01.dtsi"
#include "mt6768_a41_camera_01.dtsi"
#include "battery-data-a41-cis-ser-common.dtsi"
#include "battery-data-a41-cis-ser-rev01.dtsi"
#include "mt6768_a41_fingerprint-sensor_00.dtsi"
#include "s2mu106_motor.dtsi"
#include "mt6768_a41_sensor_grip_00.dtsi"
#include "mt6768_a41_mst_00.dtsi"
#include "mt6768_a31_nfc_02.dtsi"
#include "mt6768_a41_input_common.dtsi"
#include "mt6768_a41_sensorhub_00.dtsi"
#include "mt6768_a41_pm_common.dtsi"
#include "mt6768_a41_audio_common.dtsi"

/* Add Samsung configuration over here */
/ {
	compatible = "Samsung,A41 EUR OPEN 01", "Mediatek,MT6768";
	dtbo-hw_rev = <1>;
	dtbo-hw_rev_end = <1>;
};

&msdc1 {
	cd_level = /bits/ 8 <MSDC_CD_LOW>;
};

/*End of this file, DO NOT ADD ANYTHING HERE*/
