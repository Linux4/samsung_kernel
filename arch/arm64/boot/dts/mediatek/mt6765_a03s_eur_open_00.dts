/* 
 * Generated by Samsung 
 * If these files should be changed, then please make a sync with MTK
*/

/dts-v1/;
/plugin/;

#include "../mediatek/hs03s.dts"
#include "mt6765-a03s_common.dtsi"

/* Add Samsung configuration over here */
/ {
	compatible = "Samsung,A03s EUR OPEN 00", "Mediatek,MT6765";
	dtbo-hw_rev = <0x0>;
	dtbo-hw_rev_end = <0x20>;	
};

/*End of this file, DO NOT ADD ANYTHING HERE*/

