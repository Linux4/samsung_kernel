/*
 * Generated by Samsung
 * If these files should be changed, then please make a sync with MTK
*/

#include "mt6877-a34x_common.dtsi"
#include "mt6877-a34x_camera_01.dtsi"

&pio {
	hiccup_switch: hiccup_switch {
		pins_cmd_dat {
			pinmux = <PINMUX_GPIO97__FUNC_GPIO97>;
			slew-rate = <1>;
			bias-disable;
		};
	};
};

&gpio_afc {
	pinctrl-names = "default";
	pinctrl-0 = <&afc_switch &afc_output &hiccup_switch>;
	gpio_hiccup_en = <&pio 97 0x0>;
};

/*End of this file, DO NOT ADD ANYTHING HERE*/
