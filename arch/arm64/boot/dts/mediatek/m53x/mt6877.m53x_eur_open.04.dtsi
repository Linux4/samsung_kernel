/*
 * Generated by Samsung
 * If these files should be changed, then please make a sync with MTK
*/

#include "mt6877-m53x_common.dtsi"
#include "mt6877-m53x_camera_00.dtsi"

/*End of this file, DO NOT ADD ANYTHING HERE*/
