/* 
 * Generated by Samsung 
 * If these files should be changed, then please make a sync with MTK
*/

#include "mt6769t-m32_common.dtsi"
#include "mt6769t-m32_camera_00.dtsi"
#include "mt6769t-m32_audio_00.dtsi"

&tsp_melfas {
	status = "disabled";
};

/*End of this file, DO NOT ADD ANYTHING HERE*/
