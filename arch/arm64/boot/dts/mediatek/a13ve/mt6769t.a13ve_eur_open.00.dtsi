/* 
 * Generated by Samsung 
 * If these files should be changed, then please make a sync with MTK
*/

#include "mt6769t-a13ve_common.dtsi"
#include "mt6769t-a13ve_camera_00.dtsi"

/*End of this file, DO NOT ADD ANYTHING HERE*/
