/*
 * Generated by Samsung
 * If these files should be changed, then please make a sync with MTK
*/

#include "mt8791t-birdiewifi_common.dtsi"
#include "mt8791t-birdiewifi_camera_00.dtsi"

/*End of this file, DO NOT ADD ANYTHING HERE*/
