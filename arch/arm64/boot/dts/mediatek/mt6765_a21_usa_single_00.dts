/* 
 * Generated by Samsung 
 * If these files should be changed, then please make a sync with WINGTECH
*/

/dts-v1/;
/plugin/;

#include "../mediatek/S96717RA1.dts"
#include "mt6765-a21_common.dtsi"

/* Add Samsung configuration over here */
/ {
	compatible = "Samsung,A21 USA SINGLE 00", "Mediatek,MT6765";
	dtbo-hw_rev = <0x0>;
	dtbo-hw_rev_end = <0x20>;	
};
/*End of this file, DO NOT ADD ANYTHING HERE*/
