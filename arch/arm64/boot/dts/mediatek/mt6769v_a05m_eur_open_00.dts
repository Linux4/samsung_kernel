/* 
 * Generated by Samsung 
 * If these files should be changed, then please make a sync with MTK
*/

/dts-v1/;
/plugin/;

#include "../mediatek/S96818AA1.dts"
#include "mt6769v-a05m_common.dtsi"

/* Add Samsung configuration over here */
/ {
	compatible = "Samsung,A05M EUR OPEN 00", "Mediatek,MT6769V";
	dtbo-hw_rev = <0x0>;
	dtbo-hw_rev_end = <0x20>;	
};

/*End of this file, DO NOT ADD ANYTHING HERE*/

