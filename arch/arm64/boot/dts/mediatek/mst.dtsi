/* Copyright (c) 2019, Samsung Electronics Corporation. All rights reserved.
 *
 * This program is free software; you can redistribute it and/or modify
 * it under the terms of the GNU General Public License version 2 and
 * only version 2 as published by the Free Software Foundation.
 *
 * This program is distributed in the hope that it will be useful,
 * but WITHOUT ANY WARRANTY; without even the implied warranty of
 * MERCHANTABILITY or FITNESS FOR A PARTICULAR PURPOSE.  See the
 * GNU General Public License for more details.
 */

/ {
	fragment@model {
		target-path = "/";
		__overlay__ {
			sec-mst{
				compatible = "sec-mst";
				sec-mst,mst-data-gpio = <&pio 56 0>;
				sec-mst,mst-pwr-gpio = <&pio 55 0 0>;
				sec-mst,mst-en-gpio = <&pio 58 0>;
				sec-mst,mst-vcc-gpio = <&pio 57 0>;
			};
		};
	};
};
