/* Copyright (c) 2019, Samsung Electronics Corporation. All rights reserved.
 *
 * This program is free software; you can redistribute it and/or modify
 * it under the terms of the GNU General Public License version 2 and
 * only version 2 as published by the Free Software Foundation.
 *
 * This program is distributed in the hope that it will be useful,
 * but WITHOUT ANY WARRANTY; without even the implied warranty of
 * MERCHANTABILITY or FITNESS FOR A PARTICULAR PURPOSE.  See the
 * GNU General Public License for more details.
 */

/ {
	fragment@model {
		target-path = "/";
		__overlay__ {
			sec-mst{
				compatible = "sec-mst";
				//sec-mst,mst-pwr-gpio = <&gpm18 0 0>;
				sec-mst,mst-en-gpio = <&pio 23 0>;
				sec-mst,mst-data-gpio = <&pio 21 0>;

				//pinctrl-names = "default";
				//pinctrl-0 = <&mst_en &mst_data>;
			};
		};
	};
};

/*
//pinctrl_5: pinctrl@10730000
&pinctrl_5 {
	mst_en: sec-mst,mst-en-gpio {
		samsung,pins ="gpp7-7";
		samsung,pin-function = <1>;
		samsung,pin-pud = <1>;
		samsung,pin-con-pdn = <0>;
		samsung,pin-pud-pdn = <1>;
	};

	mst_data: sec-mst,mst-data-gpio {
		samsung,pins ="gpp7-6";
		samsung,pin-function = <1>;
		samsung,pin-pud = <1>;
		samsung,pin-con-pdn = <0>;
		samsung,pin-pud-pdn = <1>;
	};
};
*/
