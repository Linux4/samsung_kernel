/* 
 * Generated by Samsung 
 * If these files should be changed, then please make a sync with MTK
*/

#include "../../mediatek/k69v1_64_titan_marmot/gpio04.dtsi"
#include "mt6769t-a32_common.dtsi"
#include "mt6769t-a32_camera_00.dtsi"
#include "mt6769_a32_sensor_grip_00.dtsi"

&tsp_melfas {
	status = "disabled";
};

/*End of this file, DO NOT ADD ANYTHING HERE*/
