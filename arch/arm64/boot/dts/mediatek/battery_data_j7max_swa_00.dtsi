/*
 * Copyright (c) 2017 Samsung Electronics Co., Ltd.
 *		http://www.samsung.com
 *
 * This program is free software; you can redistribute it and/or modify
 * it under the terms of the GNU General Public License version 2 as
 * published by the Free Software Foundation.
*/

#include "battery_data_j7max_common.dtsi"

/ {
	battery {
		battery,temp_check_type = <0>; /* SEC_BATTERY_TEMP_CHECK_NONE */

		battery,thermal_source = <0>; /* SEC_BATTERY_THERMAL_SOURCE_FG */
	};
};
