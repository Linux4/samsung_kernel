/* 
 * Generated by Samsung 
 * If these files should be changed, then please make a sync with MTK
*/

/dts-v1/;
/plugin/;

#include "../mediatek/hs04.dts"
#include "mt6765-a04e_common.dtsi"

/* Add Samsung configuration over here */
/ {
	compatible = "Samsung,A04e EUR OPEN 00", "Mediatek,MT6765";
	dtbo-hw_rev = <0x0>;
	dtbo-hw_rev_end = <0x20>;	
};

/*End of this file, DO NOT ADD ANYTHING HERE*/

