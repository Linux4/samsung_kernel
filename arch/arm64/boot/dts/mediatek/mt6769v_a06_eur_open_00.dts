/* 
 * Generated by Samsung 
 * If these files should be changed, then please make a sync with MTK
*/

/dts-v1/;
/plugin/;

#include "../mediatek/o8.dts"
#include "mt6769v-a06_common.dtsi"

/* Add Samsung configuration over here */
/ {
	compatible = "Samsung,A06 EUR OPEN 00", "Mediatek,MT6769V";
	dtbo-hw_rev = <0x0>;
	dtbo-hw_rev_end = <0x20>;	
};

/*End of this file, DO NOT ADD ANYTHING HERE*/

