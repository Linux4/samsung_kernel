/ {
	fragment@smd {
		target-path = "/";
		__overlay__ {
			samsung_mobile_device {
				sec_lp_thermistor: sec_thermistor@3 {
					compatible = "samsung,sec-thermistor";
					status = "okay";
					thermistor_name = "sec-lp-thermistor";
					id = <3>;

					io-channels = SEC_ADC(auxadc,4);
					io-channel-names = "lp_therm";
					io-channel-ranges;
				};
			};
		};
	};
};
