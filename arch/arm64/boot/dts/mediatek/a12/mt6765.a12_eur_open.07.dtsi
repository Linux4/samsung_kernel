/* 
 * Generated by Samsung 
 * If these files should be changed, then please make a sync with MTK
*/

#include "../../mediatek/k65v1_64_bsp_titan_rat/gpio07.dtsi"
#include "mt6765-a12_common.dtsi"
#include "mt6765_a12_camera_04.dtsi"
#include "mt6765_input_a12_07.dtsi"

/*End of this file, DO NOT ADD ANYTHING HERE*/
