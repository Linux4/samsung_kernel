/* Generated by WT for S1 project board 
 * If these files should be chaned, then please make a sync with WT or MTK
*/
#include "../mediatek/S96116CA1.dts"
#include "mt6765-a10s_common.dtsi"

/*End of this file, DO NOT ADD ANYTHING HERE*/
