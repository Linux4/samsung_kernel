/*
 * Generated by Samsung
 * If these files should be changed, then please make a sync with MTK
*/

#include "../../mediatek/k68v1_64_titan/gpio01_a41.dtsi"
#include "mt6768-a41_common.dtsi"
#include "mt6768-a41_camera_02.dtsi"
#include "s2mu106_motor.dtsi"
#include "mt6768-a41_sensor_grip_00.dtsi"
#include "mt6768-a41_input_common.dtsi"
#include "mt6768-a41_pm_common.dtsi"
#include "mt6768-a41_audio_common.dtsi"

/* Add Samsung configuration over here */

&msdc1 {
	cd_level = /bits/ 8 <MSDC_CD_LOW>;
};

/*End of this file, DO NOT ADD ANYTHING HERE*/
