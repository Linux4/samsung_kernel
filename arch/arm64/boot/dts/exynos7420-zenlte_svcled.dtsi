/*
 * SAMSUNG UNIVERSAL7420 board device tree source
 *
 * Copyright (c) 2014 Samsung Electronics Co., Ltd.
 *		http://www.samsung.com
 *
 * This program is free software; you can redistribute it and/or modify
 * it under the terms of the GNU General Public License version 2 as
 * published by the Free Software Foundation.
*/

/ {
	rgb {
		device_type = <3>;
		normal_powermode_current = <10>;
		low_powermode_current = <2>;
		br_ratio_r = <240>;
		br_ratio_g = <80>;
		br_ratio_b = <550>;

		normal_powermode_current_wh = <10>;
		low_powermode_current_wh = <2>;
		br_ratio_r_wh = <420>;
		br_ratio_g_wh = <130>;
		br_ratio_b_wh = <430>;

		normal_powermode_current_bk = <10>;
		low_powermode_current_bk = <2>;
		br_ratio_r_bk = <600>;
		br_ratio_g_bk = <80>;
		br_ratio_b_bk = <250>;

		normal_powermode_current_gd = <10>;
		low_powermode_current_gd = <2>;
		br_ratio_r_gd = <240>;
		br_ratio_g_gd = <80>;
		br_ratio_b_gd = <550>;

		normal_powermode_current_bl = <10>;
		low_powermode_current_bl = <2>;
		br_ratio_r_bl = <240>;
		br_ratio_g_bl = <80>;
		br_ratio_b_bl = <550>;

		normal_powermode_current_rd = <10>;
		low_powermode_current_rd = <2>;
		br_ratio_r_rd = <240>;
		br_ratio_g_rd = <80>;
		br_ratio_b_rd = <550>;

		normal_powermode_current_sv = <10>;
		low_powermode_current_sv = <2>;
		br_ratio_r_sv = <400>;
		br_ratio_g_sv = <80>;
		br_ratio_b_sv = <420>;
	};
};
