/*
 * Copyright (C) 2015 Marvell
 * Yi Zhang <yizhang@marvell.com>
 */

/* ocv table is for RosaM battery */
/* ntc table is for NCP03XH223E05RL */

&pmic0 {
	charger {
		prechg-current = <450>;
		prechg-voltage = <3000>;
		status = "okay";
	};

	battery {
		sleep-period = <1000>;		/* second */
		low-threshold = <30>;		/* % */
		high-threshold = <50>;		/* % */
		alart-percent = <5>;		/* % */

		cc-fixup = <100>;

		power-off-th = <3350>;		/* mv */
		safe-power-off-th = <3000>;	/* mv */

		io-channels = <&gpadc 7>,  /* vbat */
			           <&gpadc 13>, /* vbat_slp */
				   <&gpadc 14>, /* gpadc0_res */
				   <&gpadc 15>, /* gpadc1_res */
				   <&gpadc 16>, /* gpadc2_res */
				   <&gpadc 17>; /* gpadc3_res */
		io-channel-names = "vbat",
				   "vbat_slp",
				   "gpadc0_res",
				   "gpadc1_res",
				   "gpadc2_res",
				   "gpadc3_res";

		bat-capacity = <1900>;	/* mAh */
		ocv-table = <
			3380
			3488
			3564
			3620
			3657
			3673
			3680
			3683
			3685
			3687
			3688
			3689
			3691
			3693
			3699
			3708
			3717
			3725
			3731
			3737
			3742
			3747
			3751
			3754
			3758
			3761
			3764
			3767
			3770
			3772
			3775
			3778
			3781
			3783
			3786
			3789
			3792
			3795
			3798
			3801
			3805
			3808
			3812
			3816
			3820
			3824
			3828
			3832
			3837
			3841
			3846
			3851
			3856
			3861
			3867
			3873
			3879
			3885
			3892
			3901
			3910
			3920
			3932
			3943
			3953
			3963
			3973
			3981
			3990
			3998
			4006
			4015
			4024
			4033
			4042
			4051
			4059
			4068
			4077
			4087
			4096
			4106
			4115
			4125
			4135
			4145
			4155
			4165
			4175
			4186
			4196
			4207
			4217
			4228
			4239
			4250
			4261
			4273
			4285
			4300
			4318
		>;

		abs-lowest-temp = <20>;
		t1-degree = <0>;	/* -20C */
		t2-degree = <20>;	/* 0C */
		t3-degree = <50>;	/* 30C */
		t4-degree = <65>;	/* 45C */

		times-in-minus-ten = <2>;
		offset-in-minus-ten = <100>;
		times-in-zero = <1>;
		offset-in-zero = <0>;

		soc-low-th-cycle = <15>;
		soc-high-th-cycle = <85>;

		default-temp-ohm = <22000>;

		zero-degree-ohm = <59881>;

		/* -25C, -24C, ..., 64C, 65C */
		ntc-table =
			<192629 25>,/* -25 ~ -21 */
			<183133 24>,
			<174166 23>,
			<165695 22>,
			<157689 21>,
			<150121 20>,/* -20 ~ -11 */
			<142980 19>,
			<136222 18>,
			<129825 17>,
			<123767 16>,
			<118029 15>,
			<112591 14>,
			<107437 13>,
			<102549 12>,
			<97913 11>,
			<93514 10>,/* -10 ~ -1 */
			<89319 9>,
			<85339 8>,
			<81560 7>,
			<77972 6>,
			<74563 5>,
			<71323 4>,
			<68244 3>,
			<65316 2>,
			<62531 1>,/* negative temperature */
			<59881 0>,/* 0 ~ 9 */
			<57367 1>,
			<54973 2>,
			<52692 3>,
			<50518 4>,
			<48446 5>,
			<46471 6>,
			<44586 7>,
			<42789 8>,
			<41074 9>,
			<39436 10>,/* 10 ~ 19 */
			<37871 11>,
			<36376 12>,
			<34948 13>,
			<33585 14>,
			<32282 15>,
			<31037 16>,
			<29846 17>,
			<28708 18>,
			<27619 19>,
			<26577 20>,/* 20 ~ 29 */
			<25582 21>,
			<24628 22>,
			<23715 23>,
			<22839 24>,
			<22000 25>,
			<21195 26>,
			<20424 27>,
			<19683 28>,
			<18973 29>,
			<18292 30>,/* 30 ~ 39 */
			<17640 31>,
			<17014 32>,
			<16414 33>,
			<15838 34>,
			<15285 35>,
			<14755 36>,
			<14245 37>,
			<13756 38>,
			<13286 39>,
			<12834 40>,/* 40 ~ 49 */
			<12400 41>,
			<11980 42>,
			<11577 43>,
			<11190 44>,
			<10817 45>,
			<10459 46>,
			<10114 47>,
			<9782 48>,
			<9462 49>,
			<9154 50>,/* 50 ~ 59 */
			<8858 51>,
			<8572 52>,
			<8297 53>,
			<8032 54>,
			<7777 55>,
			<7531 56>,
			<7294 57>,
			<7065 58>,
			<6844 59>,
			<6631 60>,/* 60 ~ 65 */
			<6429 61>,
			<6429 62>,
			<6046 63>,
			<5865 64>,
			<5690 65>;
		};
};
