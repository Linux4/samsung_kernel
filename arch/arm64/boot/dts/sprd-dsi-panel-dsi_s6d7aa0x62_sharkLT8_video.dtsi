&gen_panel {
	dsi_s6d7aa0x62_sharkLT8_59b810_vid: gen-panel-s6d7aa0x62-sharkLT8-59b810-video {
		gen-panel-manu = "BOE";			/* condensed manufacturer name */
		gen-panel-name = "lcd_s6d7aa0x62_59b810_mipi";
		gen-panel-id = <0x59b810>;
		gen-panel-dev-id = <0>;			/* SPRDFB_MAINLCD_ID : MAIN 0, SUB 1 */
		gen-panel-type = <2>;			/* LCD_MODE_DSI: MCU 0, RGB 1, DSI 2 */
		gen-panel-refresh = <60>;
		gen-panel-xres = <720>;
		gen-panel-yres = <1280>;
		gen-panel-width = <64>;			/* screen width in mm */
		gen-panel-height = <110>;		/* screen height in mm */
		gen-panel-work-mode = <1>;		/* SPRDFB_MIPI_MODE_VIDEO : CMD 0, VIDEO 1*/
		gen-panel-direction = <0>;		/* LCD_DIRECT_NORMAL : Normal 0, ROT90 1, ROT180 2, ROT270 3 */
		gen-panel-suspend-mode = <1>;	/* SEND_SLEEP_CMD : RST 0, SLEEP 1 */
		gen-panel-bus-width = <24>;
		gen-panel-lanes = <4>;
		gen-panel-phy-feq = <481000>;
		gen-panel-h-sync-pol = <0>;		/*SPRDFB_POLARITY_POS : POS 0, NEG 1 */
		gen-panel-v-sync-pol = <0>;		/*SPRDFB_POLARITY_POS : POS 0, NEG 1 */
		gen-panel-de-pol = <0>;			/*SPRDFB_POLARITY_POS : POS 0, NEG 1 */
		gen-panel-te-pol = <0>;			/*SPRDFB_POLARITY_POS : POS 0, NEG 1 */
		gen-panel-color-mode-pol = <1>;	/*SPRDFB_POLARITY_POS : POS 0, NEG 1 */
		gen-panel-shut-down-pol = <1>;	/*SPRDFB_POLARITY_POS : POS 0, NEG 1 */
		gen-panel-h-front-porch = <104>;	/* hfp */
		gen-panel-h-back-porch = <154>;	/* hbp */
		gen-panel-h-sync-width = <42>;	/* hsync */
		gen-panel-v-front-porch = <16>;	/* vfp */
		gen-panel-v-back-porch = <12>;	/* vbp */
		gen-panel-v-sync-width = <4>;	/* vsync */
		gen-panel-rst-high-in-sleep;

		/*
		 * DSI PACKET HEADER INFO
		 * @ delay(msec) : 2byte
		 * @ size of data : 2byte
		 */
		gen-panel-pkt-dinfo-addr-offset = <0>;
		gen-panel-pkt-dinfo-addr-length = <1>;
		gen-panel-pkt-dinfo-data-offset = <1>;
		gen-panel-pkt-dinfo-data-length = <1>;
		gen-panel-init-cmds = [
			39 00 00 00 00 03		F0 5A 5A
			39 00 00 00 00 03		F1 5A 5A
			39 00 00 00 00 03		FC A5 A5
			39 00 00 00 00 03		D0 00 10
			15 00 00 00 00 02		B1 12
			39 00 00 00 00 05		B2 14 22 2F 18
			15 00 00 00 00 02		B3 11
			39 00 00 00 00 0A		BA 03 19 19 11 03 05 18 18 77
			39 00 00 00 00 04		BC 00 4E 0B
			39 00 00 00 00 04		C0 80 80 30
			15 00 00 00 00 02		C1 03
			15 00 00 00 00 02		C2 00
			39 00 00 00 00 04		C3 40 00 28
			39 00 00 00 00 06		E1 03 10 1C A0 10
			39 00 00 00 00 09		EE A5 00 98 00 A5 00 98 00
			39 00 00 00 00 06		F2 02 10 10 44 10
			39 00 00 00 00 0B		F3 01 93 20 22 80 05 25 3C 26 00
			39 00 00 00 00 2E		F4 02 02 10 26 10 02 03 03 03 10 16 03
			             00 0C 0C 03 04 05 13 1E 09 0A 05 05 01 04 02
			             61 74 75 72 83 80 80 00 00 01 01 28 04 03 28
			             01 D1 32
			39 00 00 00 00 21		F7 01 1B 08 0C 09 0D 01 01 01 04 06 01 01
			             00 00 1A 01 1B 0A 0E 0B 0F 01 01 01 05 07 01 01
			             00 00 1A
			39 00 00 00 00 07		F6 60 25 05 00 00 00
			39 00 00 00 00 06		FD 16 10 11 23 09
			39 00 00 00 00 07		FE 00 02 03 21 80 78
			39 00 00 00 00 12		EF 34 12 98 BA 10 80 24 80 80 80 00 00 00
			             44 A0 82 00
			39 00 00 00 00 0E		CD 2E 2E 2E 2E 2E 2E 2E 2E 2E 2E 2E 2E 2E
			39 00 00 00 00 0E		CE 00 00 00 00 00 00 00 00 00 00 00 00 00
			15 00 00 00 00 02		51 FF
			15 00 00 00 00 02		53 2C
			15 00 00 00 00 02		55 01
			39 00 00 00 00 12		FA 08 3F 0D 12 07 0C 11 0F 11 18 1D 1E 21
			             23 24 27 30
			39 00 00 00 00 12		F8 08 3F 0C 12 07 0C 10 0F 11 18 1D 1E 21
			             23 23 26 2F
			39 00 00 00 00 03		F0 A5 A5
			39 00 00 00 00 03		F1 A5 A5
			39 00 00 00 00 03		FC 5A 5A
		];
		gen-panel-post-enable-cmds = [
			05 00 00 78 00 01		11
			05 00 00 14 00 01		29
		];
		gen-panel-disable-cmds = [
			05 00 00 96 00 01		28
			05 00 00 96 00 01		10
		];
		gen-panel-read-id = [
			DA 00 01
			DB 00 01
			DC 00 01
		];
		gen-panel-read-status-reg = [0A];
		gen-panel-read-status-ok = [9A];
		status = "okay";
	};
};
