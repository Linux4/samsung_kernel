/*Tab A8 code for SR-AX6300-01-23 by fengzhigang at 2021/08/04 start*/
#include "../lcd/Tab_A8/lcd_hx83102e_inx_mipi_hdp.dtsi"
/*Tab A8 code for ASL6215DEV-2427 by huangzhongjie at 2021/10/13 start*/
#include "../lcd/Tab_A8/lcd_tab_a8_default_panel_mipi.dtsi"
/*Tab A8 code for ASL6215DEV-2427 by huangzhongjie at 2021/10/13 end*/
/*Tab A8 code for SR-AX6300-01-23 by fengzhigang at 2021/08/04 end*/
/*Tab A8 code for SR-AX6300-01-43 by fengzhigang at 2021/08/30 start*/
#include "../lcd/Tab_A8/lcd_hx83102e_xy_hsd_mipi_hdp.dtsi"
/*Tab A8 code for SR-AX6300-01-43 by fengzhigang at 2021/08/30 end*/
/*Tab A8 code for SR-AX6300-01-35 by hehaoran at 2021/08/31 start*/
#include "../lcd/Tab_A8/lcd_hx83102e_ls_hsd_mipi_hdp.dtsi"
/*Tab A8 code for SR-AX6300-01-35 by hehaoran at 2021/08/31 end*/
/*Tab A8 code for SR-AX6300-01-394 by hehaoran at 2021/09/03 start*/
#include "../lcd/Tab_A8/lcd_nt36523b_qc_inx_mipi_hdp.dtsi"
/*Tab A8 code for SR-AX6300-01-394 by hehaoran at 2021/09/03 end*/
/*#Tab A8 code for AX6300DEV-3657 by fengzhigang at 2021/12/09 start*/
#include "../lcd/Tab_A8/lcd_nt36523b_qc_inx_swid45_mipi_hdp.dtsi"
/*#Tab A8 code for AX6300DEV-3657 by fengzhigang at 2021/12/09 end*/
/*Tab A8 code for SR-AX6300-01-377 by fengzhigang at 2021/09/15 start*/
#include "../lcd/Tab_A8/lcd_hx83102e_xy_inx_mipi_hdp.dtsi"
/*Tab A8 code for SR-AX6300-01-377 by fengzhigang at 2021/09/15 end*/
/*Tab A8 code for SR-AX6300-01-438 by huangzhongjie at 2021/11/17 start*/
#include "../lcd/Tab_A8/lcd_ft8201ab_boe_boe_mipi_hdp.dtsi"
/*Tab A8 code for SR-AX6300-01-438 by huangzhongjie at 2021/11/17 end*/

/*Tab A8 code for SR-AX6300-01-23 by fengzhigang at 2021/08/12 start*/
&vddvib {
	regulator-always-on;
};
/*Tab A8 code for SR-AX6300-01-23 by fengzhigang at 2021/08/12 end*/
&panel {
	/*Tab A8 code for SR-AX6300-01-23 by fengzhigang at 2021/08/06 start*/
	avdd-gpio = <&ap_gpio 139 GPIO_ACTIVE_HIGH>;
	avee-gpio = <&ap_gpio 138 GPIO_ACTIVE_HIGH>;
	/*Tab A8 code for SR-AX6300-01-23 by fengzhigang at 2021/08/06 end*/
	reset-gpio = <&ap_gpio 50 GPIO_ACTIVE_HIGH>;
};

&dpu {
	/*Tab A8 code for SR-AX6300-01-23 by fengzhigang at 2021/08/04 start*/
	sprd,dpi-clk-div = <6>;
	/*Tab A8 code for SR-AX6300-01-23 by fengzhigang at 2021/08/04 end*/
};