nvt-mp-criteria@7234 {
			#address-cells = <1>;
			#size-cells = <0>;
			compatible = "nvt-mp-criteria-7234";

			/* MP Config */
			IC_X_CFG_SIZE = <18>;
			IC_Y_CFG_SIZE = <32>;
			IC_KEY_CFG_SIZE = <4>;
			X_Channel = <18>;
			Y_Channel = <32>;
			AIN_X = <0 1 2 3 4 5 6 7 8 9 10 11 12 13 14 15 16 17>;
			AIN_Y = <0 1 2 3 4 5 6 7 8 9 10 11 12 13 14 15 16 17 18 19 20 21 22 23 24 25 26 27 28 29 30 31>;
			AIN_KEY = <0 1 2 0xFF>;

			/* MP Criteria */
			PS_Config_Lmt_Short_Rawdata_P = <
				14008 14008 14008 14008 14008 14008 14008 14008 14008 14008 14008 14008 14008 14008 14008 14008 14008 14008
				14008 14008 14008 14008 14008 14008 14008 14008 14008 14008 14008 14008 14008 14008 14008 14008 14008 14008
				14008 14008 14008 14008 14008 14008 14008 14008 14008 14008 14008 14008 14008 14008 14008 14008 14008 14008
				14008 14008 14008 14008 14008 14008 14008 14008 14008 14008 14008 14008 14008 14008 14008 14008 14008 14008
				14008 14008 14008 14008 14008 14008 14008 14008 14008 14008 14008 14008 14008 14008 14008 14008 14008 14008
				14008 14008 14008 14008 14008 14008 14008 14008 14008 14008 14008 14008 14008 14008 14008 14008 14008 14008
				14008 14008 14008 14008 14008 14008 14008 14008 14008 14008 14008 14008 14008 14008 14008 14008 14008 14008
				14008 14008 14008 14008 14008 14008 14008 14008 14008 14008 14008 14008 14008 14008 14008 14008 14008 14008
				14008 14008 14008 14008 14008 14008 14008 14008 14008 14008 14008 14008 14008 14008 14008 14008 14008 14008
				14008 14008 14008 14008 14008 14008 14008 14008 14008 14008 14008 14008 14008 14008 14008 14008 14008 14008
				14008 14008 14008 14008 14008 14008 14008 14008 14008 14008 14008 14008 14008 14008 14008 14008 14008 14008
				14008 14008 14008 14008 14008 14008 14008 14008 14008 14008 14008 14008 14008 14008 14008 14008 14008 14008
				14008 14008 14008 14008 14008 14008 14008 14008 14008 14008 14008 14008 14008 14008 14008 14008 14008 14008
				14008 14008 14008 14008 14008 14008 14008 14008 14008 14008 14008 14008 14008 14008 14008 14008 14008 14008
				14008 14008 14008 14008 14008 14008 14008 14008 14008 14008 14008 14008 14008 14008 14008 14008 14008 14008
				14008 14008 14008 14008 14008 14008 14008 14008 14008 14008 14008 14008 14008 14008 14008 14008 14008 14008
				14008 14008 14008 14008 14008 14008 14008 14008 14008 14008 14008 14008 14008 14008 14008 14008 14008 14008
				14008 14008 14008 14008 14008 14008 14008 14008 14008 14008 14008 14008 14008 14008 14008 14008 14008 14008
				14008 14008 14008 14008 14008 14008 14008 14008 14008 14008 14008 14008 14008 14008 14008 14008 14008 14008
				14008 14008 14008 14008 14008 14008 14008 14008 14008 14008 14008 14008 14008 14008 14008 14008 14008 14008
				14008 14008 14008 14008 14008 14008 14008 14008 14008 14008 14008 14008 14008 14008 14008 14008 14008 14008
				14008 14008 14008 14008 14008 14008 14008 14008 14008 14008 14008 14008 14008 14008 14008 14008 14008 14008
				14008 14008 14008 14008 14008 14008 14008 14008 14008 14008 14008 14008 14008 14008 14008 14008 14008 14008
				14008 14008 14008 14008 14008 14008 14008 14008 14008 14008 14008 14008 14008 14008 14008 14008 14008 14008
				14008 14008 14008 14008 14008 14008 14008 14008 14008 14008 14008 14008 14008 14008 14008 14008 14008 14008
				14008 14008 14008 14008 14008 14008 14008 14008 14008 14008 14008 14008 14008 14008 14008 14008 14008 14008
				14008 14008 14008 14008 14008 14008 14008 14008 14008 14008 14008 14008 14008 14008 14008 14008 14008 14008
				14008 14008 14008 14008 14008 14008 14008 14008 14008 14008 14008 14008 14008 14008 14008 14008 14008 14008
				14008 14008 14008 14008 14008 14008 14008 14008 14008 14008 14008 14008 14008 14008 14008 14008 14008 14008
				14008 14008 14008 14008 14008 14008 14008 14008 14008 14008 14008 14008 14008 14008 14008 14008 14008 14008
				14008 14008 14008 14008 14008 14008 14008 14008 14008 14008 14008 14008 14008 14008 14008 14008 14008 14008
				14008 14008 14008 14008 14008 14008 14008 14008 14008 14008 14008 14008 14008 14008 14008 14008 14008 14008>;

			PS_Config_Lmt_Short_Rawdata_N = <
				11376	11376	11376	11376	11376	11376	11376	11376	11376	11376	11376	11376	11376	11376	11376	11376	11376	11376
				11376	11376	11376	11376	11376	11376	11376	11376	11376	11376	11376	11376	11376	11376	11376	11376	11376	11376
				11376	11376	11376	11376	11376	11376	11376	11376	11376	11376	11376	11376	11376	11376	11376	11376	11376	11376
				11376	11376	11376	11376	11376	11376	11376	11376	11376	11376	11376	11376	11376	11376	11376	11376	11376	11376
				11376	11376	11376	11376	11376	11376	11376	11376	11376	11376	11376	11376	11376	11376	11376	11376	11376	11376
				11376	11376	11376	11376	11376	11376	11376	11376	11376	11376	11376	11376	11376	11376	11376	11376	11376	11376
				11376	11376	11376	11376	11376	11376	11376	11376	11376	11376	11376	11376	11376	11376	11376	11376	11376	11376
				11376	11376	11376	11376	11376	11376	11376	11376	11376	11376	11376	11376	11376	11376	11376	11376	11376	11376
				11376	11376	11376	11376	11376	11376	11376	11376	11376	11376	11376	11376	11376	11376	11376	11376	11376	11376
				11376	11376	11376	11376	11376	11376	11376	11376	11376	11376	11376	11376	11376	11376	11376	11376	11376	11376
				11376	11376	11376	11376	11376	11376	11376	11376	11376	11376	11376	11376	11376	11376	11376	11376	11376	11376
				11376	11376	11376	11376	11376	11376	11376	11376	11376	11376	11376	11376	11376	11376	11376	11376	11376	11376
				11376	11376	11376	11376	11376	11376	11376	11376	11376	11376	11376	11376	11376	11376	11376	11376	11376	11376
				11376	11376	11376	11376	11376	11376	11376	11376	11376	11376	11376	11376	11376	11376	11376	11376	11376	11376
				11376	11376	11376	11376	11376	11376	11376	11376	11376	11376	11376	11376	11376	11376	11376	11376	11376	11376
				11376	11376	11376	11376	11376	11376	11376	11376	11376	11376	11376	11376	11376	11376	11376	11376	11376	11376
				11376	11376	11376	11376	11376	11376	11376	11376	11376	11376	11376	11376	11376	11376	11376	11376	11376	11376
				11376	11376	11376	11376	11376	11376	11376	11376	11376	11376	11376	11376	11376	11376	11376	11376	11376	11376
				11376	11376	11376	11376	11376	11376	11376	11376	11376	11376	11376	11376	11376	11376	11376	11376	11376	11376
				11376	11376	11376	11376	11376	11376	11376	11376	11376	11376	11376	11376	11376	11376	11376	11376	11376	11376
				11376	11376	11376	11376	11376	11376	11376	11376	11376	11376	11376	11376	11376	11376	11376	11376	11376	11376
				11376	11376	11376	11376	11376	11376	11376	11376	11376	11376	11376	11376	11376	11376	11376	11376	11376	11376
				11376	11376	11376	11376	11376	11376	11376	11376	11376	11376	11376	11376	11376	11376	11376	11376	11376	11376
				11376	11376	11376	11376	11376	11376	11376	11376	11376	11376	11376	11376	11376	11376	11376	11376	11376	11376
				11376	11376	11376	11376	11376	11376	11376	11376	11376	11376	11376	11376	11376	11376	11376	11376	11376	11376
				11376	11376	11376	11376	11376	11376	11376	11376	11376	11376	11376	11376	11376	11376	11376	11376	11376	11376
				11376	11376	11376	11376	11376	11376	11376	11376	11376	11376	11376	11376	11376	11376	11376	11376	11376	11376
				11376	11376	11376	11376	11376	11376	11376	11376	11376	11376	11376	11376	11376	11376	11376	11376	11376	11376
				11376	11376	11376	11376	11376	11376	11376	11376	11376	11376	11376	11376	11376	11376	11376	11376	11376	11376
				11376	11376	11376	11376	11376	11376	11376	11376	11376	11376	11376	11376	11376	11376	11376	11376	11376	11376
				11376	11376	11376	11376	11376	11376	11376	11376	11376	11376	11376	11376	11376	11376	11376	11376	11376	11376
				11376	11376	11376	11376	11376	11376	11376	11376	11376	11376	11376	11376	11376	11376	11376	11376	11376	11376>;

			PS_Config_Lmt_Open_Rawdata_P = <
				3158	3166	3175	3203	3232	3197	3171	3246	3246	3152	3152	3075	3109	3147	3193	3243	3257	3199
				2895	2907	2952	3017	3080	3074	3056	3043	2996	2962	3024	3032	3061	3070	3087	3106	3077	3015
				2972	2989	3031	3105	3175	3172	3147	3134	3075	2954	3012	3031	3050	3064	3077	3102	3071	3024
				2991	2997	3040	3115	3192	3192	3165	3154	3089	3019	3087	3105	3124	3136	3148	3169	3141	3099
				3014	3022	3064	3138	3215	3210	3183	3172	3108	2989	3059	3078	3098	3112	3122	3143	3123	3081
				2998	3003	3045	3120	3197	3210	3185	3173	3103	3054	3131	3151	3172	3190	3200	3220	3208	3165
				3102	3120	3151	3165	3166	3155	3162	3144	3113	3236	3255	3281	3270	3259	3169	3075	3011	2965
				3144	3161	3197	3211	3204	3200	3190	3179	3147	3277	3298	3315	3316	3319	3235	3137	3073	3026
				3158	3178	3217	3239	3232	3231	3211	3206	3171	3276	3302	3316	3330	3332	3250	3147	3085	3036
				3201	3220	3266	3284	3280	3278	3264	3246	3210	3336	3364	3389	3400	3404	3319	3218	3155	3099
				3246	3266	3316	3332	3319	3311	3295	3276	3249	3347	3369	3392	3406	3411	3340	3239	3175	3123
				3297	3318	3374	3396	3388	3382	3355	3339	3313	3418	3441	3465	3491	3500	3428	3323	3259	3204
				3287	3302	3390	3402	3397	3385	3364	3347	3330	3417	3435	3456	3480	3495	3424	3330	3238	3186
				3337	3360	3441	3463	3448	3439	3417	3400	3382	3470	3488	3508	3532	3543	3491	3395	3305	3250
				3395	3417	3494	3514	3502	3483	3469	3456	3430	3500	3519	3540	3549	3577	3521	3434	3343	3287
				3434	3460	3536	3568	3547	3540	3512	3497	3466	3556	3579	3602	3624	3640	3602	3509	3417	3357
				3448	3473	3553	3571	3563	3551	3529	3512	3481	3544	3568	3593	3614	3631	3595	3516	3425	3367
				3488	3515	3585	3609	3598	3586	3563	3549	3516	3602	3630	3656	3679	3700	3668	3593	3508	3444
				3543	3561	3640	3648	3648	3640	3620	3595	3564	3609	3649	3670	3700	3708	3680	3610	3535	3462
				3589	3610	3687	3708	3704	3690	3670	3647	3614	3675	3715	3739	3770	3785	3771	3700	3621	3549
				3620	3631	3705	3733	3724	3715	3696	3672	3635	3665	3708	3728	3757	3767	3763	3690	3617	3554
				3672	3680	3754	3785	3773	3760	3738	3712	3675	3732	3778	3799	3827	3838	3845	3777	3698	3634
				3728	3740	3798	3868	3872	3861	3836	3815	3768	3731	3781	3801	3833	3843	3865	3829	3768	3708
				3736	3746	3802	3865	3872	3861	3836	3815	3768	3806	3858	3879	3907	3917	3938	3915	3852	3789
				3796	3796	3852	3908	3922	3913	3893	3869	3822	3784	3836	3859	3887	3900	3922	3914	3851	3802
				3822	3816	3869	3918	3935	3922	3903	3880	3834	3852	3903	3929	3950	3962	3980	3976	3914	3866
				3693	3892	3936	3988	4005	3997	3999	3983	3936	3878	3925	3948	3946	3962	3978	3977	3928	3673
				3690	3893	3941	3977	3997	3987	3991	3969	3924	3942	3994	4015	4016	4030	4048	4064	4018	3747
				3728	3941	3980	4020	4040	4033	4026	4012	3963	3904	3960	3977	3983	3992	4011	4026	3988	3718
				3728	3943	3983	4018	4039	4032	4027	4011	3963	3959	4013	4032	4036	4046	4065	4090	4051	3770
				3803	4026	4061	4088	4111	4103	4103	4085	4041	3952	4006	4025	4029	4043	4061	4089	4060	3777
				3872	3938	4055	4078	4100	4090	4093	4076	4023	4012	4068	4082	4088	4100	4123	4156	4044	3922>;

			PS_Config_Lmt_Open_Rawdata_N = <
				1353	1357	1360	1372	1385	1370	1359	1391	1391	1351	1351	1318	1332	1348	1368	1390	1396	1371
				1240	1246	1265	1293	1320	1317	1309	1304	1284	1269	1296	1299	1312	1315	1323	1331	1318	1292
				1273	1281	1299	1330	1360	1359	1348	1343	1318	1266	1291	1299	1307	1313	1318	1329	1316	1296
				1282	1284	1303	1335	1368	1368	1356	1351	1324	1294	1323	1330	1339	1344	1349	1358	1346	1328
				1291	1295	1313	1345	1378	1375	1364	1359	1332	1281	1311	1319	1327	1333	1338	1347	1338	1320
				1285	1287	1305	1337	1370	1375	1365	1360	1330	1309	1342	1350	1359	1367	1371	1380	1375	1356
				1329	1337	1350	1356	1357	1352	1355	1347	1334	1387	1395	1406	1401	1396	1358	1318	1290	1270
				1347	1354	1370	1376	1373	1371	1367	1362	1348	1404	1413	1420	1421	1422	1386	1344	1317	1297
				1353	1362	1378	1388	1385	1384	1376	1374	1359	1404	1415	1421	1427	1428	1393	1348	1322	1301
				1372	1380	1399	1407	1405	1405	1399	1391	1375	1429	1441	1452	1457	1459	1422	1379	1352	1328
				1391	1399	1421	1428	1422	1419	1412	1404	1392	1434	1444	1453	1459	1462	1431	1388	1360	1338
				1413	1422	1446	1455	1452	1449	1438	1431	1420	1465	1474	1485	1496	1500	1469	1424	1396	1373
				1408	1415	1453	1458	1456	1450	1441	1434	1427	1464	1472	1481	1491	1498	1467	1427	1387	1365
				1430	1440	1474	1484	1477	1474	1464	1457	1449	1487	1495	1503	1513	1518	1496	1455	1416	1393
				1455	1464	1497	1506	1501	1492	1486	1481	1470	1500	1508	1517	1521	1533	1509	1471	1432	1408
				1471	1483	1515	1529	1520	1517	1505	1498	1485	1524	1534	1543	1553	1560	1543	1504	1464	1438
				1477	1488	1522	1530	1527	1522	1512	1505	1492	1519	1529	1540	1549	1556	1540	1507	1468	1443
				1495	1506	1536	1546	1542	1537	1527	1521	1507	1543	1555	1567	1576	1585	1572	1540	1503	1476
				1518	1526	1560	1563	1563	1560	1551	1540	1527	1546	1564	1573	1585	1589	1577	1547	1515	1483
				1538	1547	1580	1589	1587	1581	1573	1563	1549	1575	1592	1602	1615	1622	1616	1585	1552	1521
				1551	1556	1588	1600	1596	1592	1584	1573	1558	1570	1589	1597	1610	1614	1612	1581	1550	1523
				1573	1577	1609	1622	1617	1611	1602	1591	1575	1599	1619	1628	1640	1645	1648	1618	1585	1557
				1597	1603	1627	1657	1659	1654	1644	1635	1615	1599	1620	1629	1642	1647	1656	1641	1615	1589
				1601	1605	1629	1656	1659	1654	1644	1635	1615	1631	1653	1662	1674	1678	1687	1678	1651	1624
				1627	1627	1651	1675	1681	1677	1668	1658	1638	1621	1644	1654	1666	1671	1681	1677	1650	1629
				1638	1635	1658	1679	1686	1681	1672	1663	1643	1651	1672	1684	1693	1698	1705	1704	1677	1657
				1582	1668	1687	1709	1716	1713	1714	1707	1687	1662	1682	1692	1691	1698	1705	1704	1683	1574
				1581	1668	1689	1704	1713	1708	1710	1701	1681	1689	1711	1720	1721	1727	1735	1741	1722	1606
				1597	1689	1705	1723	1731	1728	1725	1719	1698	1673	1697	1704	1707	1711	1719	1725	1709	1593
				1597	1690	1707	1722	1731	1728	1726	1719	1698	1696	1720	1728	1729	1734	1742	1753	1736	1615
				1630	1725	1740	1752	1762	1758	1758	1750	1732	1693	1717	1725	1726	1732	1740	1752	1740	1618
				1659	1687	1738	1747	1757	1753	1754	1747	1724	1719	1743	1749	1752	1757	1767	1781	1733	1681>;

			PS_Config_Lmt_FW_Rawdata_P = <
				3362	3399	3392	3367	3369	3360	3361	3362	3362	3396	3396	3402	3346	3382	3357	3353	3364	3351
				3375	3341	3362	3361	3385	3368	3355	3358	3367	3385	3368	3372	3368	3395	3381	3322	3351	3379
				3383	3330	3357	3347	3376	3367	3368	3367	3341	3358	3390	3386	3374	3402	3403	3368	3388	3371
				3375	3367	3351	3376	3367	3385	3388	3392	3362	3411	3371	3385	3374	3417	3381	3358	3316	3382
				3383	3319	3344	3337	3350	3333	3332	3347	3386	3386	3341	3372	3375	3368	3400	3406	3357	3360
				3371	3364	3350	3362	3319	3354	3348	3355	3351	3367	3378	3372	3372	3358	3382	3393	3357	3351
				3395	3358	3381	3382	3337	3376	3344	3357	3340	3379	3367	3372	3365	3393	3376	3305	3372	3372
				3374	3351	3372	3358	3320	3375	3346	3348	3327	3344	3353	3347	3351	3357	3344	3382	3403	3348
				3374	3347	3354	3361	3371	3376	3385	3362	3372	3337	3336	3315	3332	3339	3372	3395	3368	3357
				3378	3369	3346	3368	3371	3365	3371	3344	3360	3374	3367	3374	3374	3367	3315	3344	3350	3388
				3397	3332	3407	3381	3396	3393	3378	3379	3382	3334	3355	3333	3350	3369	3403	3385	3403	3351
				3379	3409	3383	3390	3326	3354	3340	3355	3357	3376	3365	3389	3369	3393	3348	3334	3330	3333
				3365	3357	3382	3361	3360	3362	3353	3361	3365	3339	3346	3347	3353	3346	3364	3365	3353	3376
				3379	3344	3350	3325	3353	3376	3362	3327	3327	3353	3369	3357	3351	3355	3357	3375	3354	3393
				3347	3361	3343	3333	3340	3378	3336	3347	3347	3368	3353	3348	3348	3358	3383	3382	3343	3372
				3389	3364	3354	3348	3379	3360	3361	3339	3365	3355	3346	3364	3357	3379	3361	3334	3341	3343
				3329	3388	3361	3343	3339	3368	3357	3334	3365	3396	3376	3369	3388	3375	3346	3369	3382	3379
				3354	3378	3390	3390	3393	3375	3372	3396	3371	3388	3364	3378	3354	3371	3361	3360	3347	3358
				3332	3375	3344	3334	3358	3347	3350	3351	3375	3409	3347	3357	3351	3368	3362	3379	3375	3367
				3386	3392	3353	3388	3355	3371	3362	3357	3351	3367	3329	3323	3354	3357	3326	3355	3378	3353
				3354	3383	3319	3323	3329	3404	3403	3374	3360	3341	3318	3329	3339	3341	3334	3346	3350	3372
				3346	3369	3367	3358	3365	3393	3376	3374	3368	3348	3355	3355	3320	3396	3339	3407	3322	3348
				3353	3353	3336	3351	3358	3333	3339	3364	3367	3385	3347	3346	3357	3332	3360	3340	3382	3347
				3347	3334	3334	3344	3346	3393	3389	3339	3334	3368	3337	3343	3362	3336	3334	3341	3337	3340
				3346	3360	3340	3344	3368	3367	3365	3353	3343	3361	3357	3348	3294	3383	3341	3360	3315	3343
				3354	3344	3313	3340	3329	3360	3374	3358	3350	3368	3357	3365	3360	3371	3351	3355	3360	3367
				3364	3348	3340	3341	3334	3382	3346	3358	3378	3340	3333	3339	3327	3360	3347	3339	3348	3346
				3379	3357	3362	3364	3371	3360	3385	3378	3347	3360	3347	3355	3344	3355	3360	3362	3411	3361
				3313	3337	3353	3355	3354	3346	3348	3327	3336	3347	3340	3343	3350	3353	3355	3361	3347	3390
				3355	3364	3336	3343	3347	3369	3360	3368	3399	3350	3339	3346	3358	3411	3406	3372	3369	3354
				3325	3354	3382	3374	3355	3378	3386	3353	3346	3354	3369	3358	3361	3379	3389	3368	3339	3383
				3354	3376	3371	3340	3393	3389	3369	3367	3360	3371	3354	3358	3362	3362	3358	3385	3400	3423>;

			PS_Config_Lmt_FW_Rawdata_N = <
				1441	1456	1453	1443	1444	1440	1440	1441	1441	1455	1455	1458	1434	1449	1438	1437	1441	1436
				1446	1432	1441	1440	1450	1443	1438	1439	1443	1450	1443	1445	1443	1455	1449	1423	1436	1448
				1450	1427	1438	1434	1447	1443	1443	1443	1432	1439	1453	1451	1446	1458	1458	1443	1452	1444
				1446	1443	1436	1447	1443	1450	1452	1453	1441	1462	1444	1450	1446	1464	1449	1439	1421	1449
				1450	1422	1433	1430	1435	1428	1428	1434	1451	1451	1432	1445	1446	1443	1457	1459	1438	1440
				1444	1441	1435	1441	1422	1437	1435	1438	1436	1443	1447	1445	1445	1439	1449	1454	1438	1436
				1455	1439	1449	1449	1430	1447	1433	1438	1431	1448	1443	1445	1442	1454	1447	1416	1445	1445
				1446	1436	1445	1439	1423	1446	1434	1435	1426	1433	1437	1434	1436	1438	1433	1449	1458	1435
				1446	1434	1437	1440	1444	1447	1450	1441	1445	1430	1429	1420	1428	1431	1445	1455	1443	1438
				1447	1444	1434	1443	1444	1442	1444	1433	1440	1446	1443	1446	1446	1443	1420	1433	1435	1452
				1456	1428	1460	1449	1455	1454	1447	1448	1449	1429	1438	1428	1435	1444	1458	1450	1458	1436
				1448	1461	1450	1453	1425	1437	1431	1438	1438	1447	1442	1452	1444	1454	1435	1429	1427	1428
				1442	1438	1449	1440	1440	1441	1437	1440	1442	1431	1434	1434	1437	1434	1441	1442	1437	1447
				1448	1433	1435	1425	1437	1447	1441	1426	1426	1437	1444	1438	1436	1438	1438	1446	1437	1454
				1434	1440	1432	1428	1431	1447	1429	1434	1434	1443	1437	1435	1435	1439	1450	1449	1432	1445
				1452	1441	1437	1435	1448	1440	1440	1431	1442	1438	1434	1441	1438	1448	1440	1429	1432	1432
				1426	1452	1440	1432	1431	1443	1438	1429	1442	1455	1447	1444	1452	1446	1434	1444	1449	1448
				1437	1447	1453	1453	1454	1446	1445	1455	1444	1452	1441	1447	1437	1444	1440	1440	1434	1439
				1428	1446	1433	1429	1439	1434	1435	1436	1446	1461	1434	1438	1436	1443	1441	1448	1446	1443
				1451	1453	1437	1452	1438	1444	1441	1438	1436	1443	1426	1424	1437	1438	1425	1438	1447	1437
				1437	1450	1422	1424	1426	1459	1458	1446	1440	1432	1422	1426	1431	1432	1429	1434	1435	1445
				1434	1444	1443	1439	1442	1454	1447	1446	1443	1435	1438	1438	1423	1455	1431	1460	1423	1435
				1437	1437	1429	1436	1439	1428	1431	1441	1443	1450	1434	1434	1438	1428	1440	1431	1449	1434
				1434	1429	1429	1433	1434	1454	1452	1431	1429	1443	1430	1432	1441	1429	1429	1432	1430	1431
				1434	1440	1431	1433	1443	1443	1442	1437	1432	1440	1438	1435	1411	1450	1432	1440	1420	1432
				1437	1433	1420	1431	1426	1440	1446	1439	1435	1443	1438	1442	1440	1444	1436	1438	1440	1443
				1441	1435	1431	1432	1429	1449	1434	1439	1447	1431	1428	1431	1426	1440	1434	1431	1435	1434
				1448	1438	1441	1441	1444	1440	1450	1447	1434	1440	1434	1438	1433	1438	1440	1441	1462	1440
				1420	1430	1437	1438	1437	1434	1435	1426	1429	1434	1431	1432	1435	1437	1438	1440	1434	1453
				1438	1441	1429	1432	1434	1444	1440	1443	1456	1435	1431	1434	1439	1462	1459	1445	1444	1437
				1425	1437	1449	1446	1438	1447	1451	1437	1434	1437	1444	1439	1440	1448	1452	1443	1431	1450
				1437	1447	1444	1431	1454	1452	1444	1443	1440	1444	1437	1439	1441	1441	1439	1450	1457	1467>;

			PS_Config_Lmt_FW_CC_P = <
				93	92	92	93	95	95	95	95	95	96	96	96	96	95	95	95	95	95
				95	93	93	93	93	93	93	93	96	102	99	99	100	99	99	100	100	102
				97	96	96	96	96	96	96	96	99	99	96	96	96	96	96	96	97	99
				96	95	95	95	95	95	95	95	99	103	100	100	100	100	100	100	102	102
				99	97	96	97	97	97	97	97	100	100	97	97	97	97	97	97	97	100
				97	95	95	96	96	96	96	96	99	103	100	102	102	100	100	102	102	103
				99	97	96	97	96	96	96	96	100	103	102	102	102	100	100	100	100	102
				100	99	99	99	99	97	99	99	102	107	104	104	104	103	103	102	103	104
				100	97	97	97	97	97	97	97	100	103	100	100	100	100	99	99	99	102
				102	100	99	99	99	99	99	99	102	106	104	104	104	103	103	103	103	104
				99	97	97	97	96	96	96	96	99	103	102	102	102	100	100	100	100	102
				102	100	99	100	99	99	99	99	102	107	104	104	104	104	104	103	103	106
				99	97	97	97	97	96	97	97	100	103	102	102	102	100	100	100	100	102
				103	100	100	100	100	99	100	100	103	107	104	104	104	104	104	103	104	106
				100	99	97	97	97	97	97	97	100	103	100	100	100	100	100	99	100	102
				103	100	100	100	100	100	100	100	103	107	104	104	104	104	104	104	104	107
				100	99	99	99	97	97	97	99	100	104	102	102	102	102	102	102	102	103
				103	102	100	100	100	100	100	100	103	107	104	104	104	104	104	104	104	106
				100	99	97	99	97	97	97	97	100	104	102	102	102	102	102	102	102	104
				104	102	102	102	102	100	100	102	104	107	104	104	104	104	104	104	104	107
				100	99	97	99	97	97	97	97	100	104	103	103	103	102	103	102	103	104
				104	103	103	103	102	102	102	102	106	109	106	106	106	106	106	106	106	109
				102	100	99	100	99	99	99	99	102	103	100	100	100	100	100	100	100	103
				100	97	97	97	97	97	97	97	100	106	103	103	104	103	104	103	104	106
				102	100	100	100	100	99	99	100	103	104	102	102	102	102	102	102	103	104
				100	99	99	99	99	97	97	99	102	107	104	104	104	104	104	104	104	107
				100	100	100	100	100	100	100	100	103	104	102	102	102	102	102	102	102	102
				100	100	99	99	99	99	99	99	103	107	104	104	104	104	104	104	106	106
				100	100	100	100	100	100	100	100	103	106	103	103	103	103	103	103	104	103
				100	100	99	99	99	99	99	99	102	107	104	104	104	104	104	104	106	104
				102	102	100	100	100	100	100	100	104	106	102	102	102	102	102	102	103	103
				99	99	99	99	99	99	99	99	103	109	106	106	106	104	104	106	106	106>;

			PS_Config_Lmt_FW_CC_N = <
				42	41	41	42	42	42	42	42	42	43	43	43	43	42	42	42	42	42
				42	42	42	42	42	42	42	42	43	45	44	44	45	44	44	45	45	45
				44	43	43	43	43	43	43	43	44	44	43	43	43	43	43	43	44	44
				43	42	42	42	42	42	42	42	44	46	45	45	45	45	45	45	45	45
				44	44	43	44	44	44	44	44	45	45	44	44	44	44	44	44	44	45
				44	42	42	43	43	43	43	43	44	46	45	45	45	45	45	45	45	46
				44	44	43	44	43	43	43	43	45	46	45	45	45	45	45	45	45	45
				45	44	44	44	44	44	44	44	45	48	47	47	47	46	46	45	46	47
				45	44	44	44	44	44	44	44	45	46	45	45	45	45	44	44	44	45
				45	45	44	44	44	44	44	44	45	47	47	47	47	46	46	46	46	47
				44	44	44	44	43	43	43	43	44	46	45	45	45	45	45	45	45	45
				45	45	44	45	44	44	44	44	45	48	47	47	47	47	47	46	46	47
				44	44	44	44	44	43	44	44	45	46	45	45	45	45	45	45	45	45
				46	45	45	45	45	44	45	45	46	48	47	47	47	47	47	46	47	47
				45	44	44	44	44	44	44	44	45	46	45	45	45	45	45	44	45	45
				46	45	45	45	45	45	45	45	46	48	47	47	47	47	47	47	47	48
				45	44	44	44	44	44	44	44	45	47	45	45	45	45	45	45	45	46
				46	45	45	45	45	45	45	45	46	48	47	47	47	47	47	47	47	47
				45	44	44	44	44	44	44	44	45	47	45	45	45	45	45	45	45	47
				47	45	45	45	45	45	45	45	47	48	47	47	47	47	47	47	47	48
				45	44	44	44	44	44	44	44	45	47	46	46	46	45	46	45	46	47
				47	46	46	46	45	45	45	45	47	48	47	47	47	47	47	47	47	48
				45	45	44	45	44	44	44	44	45	46	45	45	45	45	45	45	45	46
				45	44	44	44	44	44	44	44	45	47	46	46	47	46	47	46	47	47
				45	45	45	45	45	44	44	45	46	47	45	45	45	45	45	45	46	47
				45	44	44	44	44	44	44	44	45	48	47	47	47	47	47	47	47	48
				45	45	45	45	45	45	45	45	46	47	45	45	45	45	45	45	45	45
				45	45	44	44	44	44	44	44	46	48	47	47	47	47	47	47	47	47
				45	45	45	45	45	45	45	45	46	47	46	46	46	46	46	46	47	46
				45	45	44	44	44	44	44	44	45	48	47	47	47	47	47	47	47	47
				45	45	45	45	45	45	45	45	47	47	45	45	45	45	45	45	46	46
				44	44	44	44	44	44	44	44	46	48	47	47	47	47	47	47	47	47>;

			PS_Config_Lmt_FW_Diff_P = <
				50	50	50	50	50	50	50	50	50	50	50	50	50	50	50	50	50	50
				50	50	50	50	50	50	50	50	50	50	50	50	50	50	50	50	50	50
				50	50	50	50	50	50	50	50	50	50	50	50	50	50	50	50	50	50
				50	50	50	50	50	50	50	50	50	50	50	50	50	50	50	50	50	50
				50	50	50	50	50	50	50	50	50	50	50	50	50	50	50	50	50	50
				50	50	50	50	50	50	50	50	50	50	50	50	50	50	50	50	50	50
				50	50	50	50	50	50	50	50	50	50	50	50	50	50	50	50	50	50
				50	50	50	50	50	50	50	50	50	50	50	50	50	50	50	50	50	50
				50	50	50	50	50	50	50	50	50	50	50	50	50	50	50	50	50	50
				50	50	50	50	50	50	50	50	50	50	50	50	50	50	50	50	50	50
				50	50	50	50	50	50	50	50	50	50	50	50	50	50	50	50	50	50
				50	50	50	50	50	50	50	50	50	50	50	50	50	50	50	50	50	50
				50	50	50	50	50	50	50	50	50	50	50	50	50	50	50	50	50	50
				50	50	50	50	50	50	50	50	50	50	50	50	50	50	50	50	50	50
				50	50	50	50	50	50	50	50	50	50	50	50	50	50	50	50	50	50
				50	50	50	50	50	50	50	50	50	50	50	50	50	50	50	50	50	50
				50	50	50	50	50	50	50	50	50	50	50	50	50	50	50	50	50	50
				50	50	50	50	50	50	50	50	50	50	50	50	50	50	50	50	50	50
				50	50	50	50	50	50	50	50	50	50	50	50	50	50	50	50	50	50
				50	50	50	50	50	50	50	50	50	50	50	50	50	50	50	50	50	50
				50	50	50	50	50	50	50	50	50	50	50	50	50	50	50	50	50	50
				50	50	50	50	50	50	50	50	50	50	50	50	50	50	50	50	50	50
				50	50	50	50	50	50	50	50	50	50	50	50	50	50	50	50	50	50
				50	50	50	50	50	50	50	50	50	50	50	50	50	50	50	50	50	50
				50	50	50	50	50	50	50	50	50	50	50	50	50	50	50	50	50	50
				50	50	50	50	50	50	50	50	50	50	50	50	50	50	50	50	50	50
				50	50	50	50	50	50	50	50	50	50	50	50	50	50	50	50	50	50
				50	50	50	50	50	50	50	50	50	50	50	50	50	50	50	50	50	50
				50	50	50	50	50	50	50	50	50	50	50	50	50	50	50	50	50	50
				50	50	50	50	50	50	50	50	50	50	50	50	50	50	50	50	50	50
				50	50	50	50	50	50	50	50	50	50	50	50	50	50	50	50	50	50
				50	50	50	50	50	50	50	50	50	50	50	50	50	50	50	50	50	50>;

			PS_Config_Lmt_FW_Diff_N = <
				(-50)	(-50)	(-50)	(-50)	(-50)	(-50)	(-50)	(-50)	(-50)	(-50)	(-50)	(-50)	(-50)	(-50)	(-50)	(-50)	(-50)	(-50)
				(-50)	(-50)	(-50)	(-50)	(-50)	(-50)	(-50)	(-50)	(-50)	(-50)	(-50)	(-50)	(-50)	(-50)	(-50)	(-50)	(-50)	(-50)
				(-50)	(-50)	(-50)	(-50)	(-50)	(-50)	(-50)	(-50)	(-50)	(-50)	(-50)	(-50)	(-50)	(-50)	(-50)	(-50)	(-50)	(-50)
				(-50)	(-50)	(-50)	(-50)	(-50)	(-50)	(-50)	(-50)	(-50)	(-50)	(-50)	(-50)	(-50)	(-50)	(-50)	(-50)	(-50)	(-50)
				(-50)	(-50)	(-50)	(-50)	(-50)	(-50)	(-50)	(-50)	(-50)	(-50)	(-50)	(-50)	(-50)	(-50)	(-50)	(-50)	(-50)	(-50)
				(-50)	(-50)	(-50)	(-50)	(-50)	(-50)	(-50)	(-50)	(-50)	(-50)	(-50)	(-50)	(-50)	(-50)	(-50)	(-50)	(-50)	(-50)
				(-50)	(-50)	(-50)	(-50)	(-50)	(-50)	(-50)	(-50)	(-50)	(-50)	(-50)	(-50)	(-50)	(-50)	(-50)	(-50)	(-50)	(-50)
				(-50)	(-50)	(-50)	(-50)	(-50)	(-50)	(-50)	(-50)	(-50)	(-50)	(-50)	(-50)	(-50)	(-50)	(-50)	(-50)	(-50)	(-50)
				(-50)	(-50)	(-50)	(-50)	(-50)	(-50)	(-50)	(-50)	(-50)	(-50)	(-50)	(-50)	(-50)	(-50)	(-50)	(-50)	(-50)	(-50)
				(-50)	(-50)	(-50)	(-50)	(-50)	(-50)	(-50)	(-50)	(-50)	(-50)	(-50)	(-50)	(-50)	(-50)	(-50)	(-50)	(-50)	(-50)
				(-50)	(-50)	(-50)	(-50)	(-50)	(-50)	(-50)	(-50)	(-50)	(-50)	(-50)	(-50)	(-50)	(-50)	(-50)	(-50)	(-50)	(-50)
				(-50)	(-50)	(-50)	(-50)	(-50)	(-50)	(-50)	(-50)	(-50)	(-50)	(-50)	(-50)	(-50)	(-50)	(-50)	(-50)	(-50)	(-50)
				(-50)	(-50)	(-50)	(-50)	(-50)	(-50)	(-50)	(-50)	(-50)	(-50)	(-50)	(-50)	(-50)	(-50)	(-50)	(-50)	(-50)	(-50)
				(-50)	(-50)	(-50)	(-50)	(-50)	(-50)	(-50)	(-50)	(-50)	(-50)	(-50)	(-50)	(-50)	(-50)	(-50)	(-50)	(-50)	(-50)
				(-50)	(-50)	(-50)	(-50)	(-50)	(-50)	(-50)	(-50)	(-50)	(-50)	(-50)	(-50)	(-50)	(-50)	(-50)	(-50)	(-50)	(-50)
				(-50)	(-50)	(-50)	(-50)	(-50)	(-50)	(-50)	(-50)	(-50)	(-50)	(-50)	(-50)	(-50)	(-50)	(-50)	(-50)	(-50)	(-50)
				(-50)	(-50)	(-50)	(-50)	(-50)	(-50)	(-50)	(-50)	(-50)	(-50)	(-50)	(-50)	(-50)	(-50)	(-50)	(-50)	(-50)	(-50)
				(-50)	(-50)	(-50)	(-50)	(-50)	(-50)	(-50)	(-50)	(-50)	(-50)	(-50)	(-50)	(-50)	(-50)	(-50)	(-50)	(-50)	(-50)
				(-50)	(-50)	(-50)	(-50)	(-50)	(-50)	(-50)	(-50)	(-50)	(-50)	(-50)	(-50)	(-50)	(-50)	(-50)	(-50)	(-50)	(-50)
				(-50)	(-50)	(-50)	(-50)	(-50)	(-50)	(-50)	(-50)	(-50)	(-50)	(-50)	(-50)	(-50)	(-50)	(-50)	(-50)	(-50)	(-50)
				(-50)	(-50)	(-50)	(-50)	(-50)	(-50)	(-50)	(-50)	(-50)	(-50)	(-50)	(-50)	(-50)	(-50)	(-50)	(-50)	(-50)	(-50)
				(-50)	(-50)	(-50)	(-50)	(-50)	(-50)	(-50)	(-50)	(-50)	(-50)	(-50)	(-50)	(-50)	(-50)	(-50)	(-50)	(-50)	(-50)
				(-50)	(-50)	(-50)	(-50)	(-50)	(-50)	(-50)	(-50)	(-50)	(-50)	(-50)	(-50)	(-50)	(-50)	(-50)	(-50)	(-50)	(-50)
				(-50)	(-50)	(-50)	(-50)	(-50)	(-50)	(-50)	(-50)	(-50)	(-50)	(-50)	(-50)	(-50)	(-50)	(-50)	(-50)	(-50)	(-50)
				(-50)	(-50)	(-50)	(-50)	(-50)	(-50)	(-50)	(-50)	(-50)	(-50)	(-50)	(-50)	(-50)	(-50)	(-50)	(-50)	(-50)	(-50)
				(-50)	(-50)	(-50)	(-50)	(-50)	(-50)	(-50)	(-50)	(-50)	(-50)	(-50)	(-50)	(-50)	(-50)	(-50)	(-50)	(-50)	(-50)
				(-50)	(-50)	(-50)	(-50)	(-50)	(-50)	(-50)	(-50)	(-50)	(-50)	(-50)	(-50)	(-50)	(-50)	(-50)	(-50)	(-50)	(-50)
				(-50)	(-50)	(-50)	(-50)	(-50)	(-50)	(-50)	(-50)	(-50)	(-50)	(-50)	(-50)	(-50)	(-50)	(-50)	(-50)	(-50)	(-50)
				(-50)	(-50)	(-50)	(-50)	(-50)	(-50)	(-50)	(-50)	(-50)	(-50)	(-50)	(-50)	(-50)	(-50)	(-50)	(-50)	(-50)	(-50)
				(-50)	(-50)	(-50)	(-50)	(-50)	(-50)	(-50)	(-50)	(-50)	(-50)	(-50)	(-50)	(-50)	(-50)	(-50)	(-50)	(-50)	(-50)
				(-50)	(-50)	(-50)	(-50)	(-50)	(-50)	(-50)	(-50)	(-50)	(-50)	(-50)	(-50)	(-50)	(-50)	(-50)	(-50)	(-50)	(-50)
				(-50)	(-50)	(-50)	(-50)	(-50)	(-50)	(-50)	(-50)	(-50)	(-50)	(-50)	(-50)	(-50)	(-50)	(-50)	(-50)	(-50)	(-50)>;

	PS_Config_Diff_Test_Frame = <50>;
};