novatek-mp-criteria-7237@0 {
	#address-cells = <1>;
	#size-cells = <0>;
	compatible = "novatek-mp-criteria-7237";

	/* sec cmd test config */
	open_test_spec = <(-511) 5120>;
	short_test_spec = <10000 14008>;
	diff_test_frame = <50>;
	/* sec cmd fdm test config */
	fdm_x_num = <2>;
	fdm_diff_test_frame = <50>;

	/* MP Config */
	IC_X_CFG_SIZE = <18>;
	IC_Y_CFG_SIZE = <32>;
	IC_KEY_CFG_SIZE = <4>;
	X_Channel = <18>;
	Y_Channel = <32>;
	AIN_X = <0 1 2 3 4 5 6 7 8 9 10 11 12 13 14 15 16 17>;
	AIN_Y = <0 1 2 3 4 5 6 7 8 9 10 11 12 13 14 15 16 17
				18 19 20 21 22 23 24 25 26 27 28 29 30 31>;
	AIN_KEY = <0 1 2 0xFF>;

	/* MP Criteria */
	PS_Config_Lmt_Short_Rawdata_P = <
		14008 14008 14008 14008 14008 14008 14008 14008 14008 14008 14008 14008 14008 14008 14008 14008 14008 14008
		14008 14008 14008 14008 14008 14008 14008 14008 14008 14008 14008 14008 14008 14008 14008 14008 14008 14008
		14008 14008 14008 14008 14008 14008 14008 14008 14008 14008 14008 14008 14008 14008 14008 14008 14008 14008
		14008 14008 14008 14008 14008 14008 14008 14008 14008 14008 14008 14008 14008 14008 14008 14008 14008 14008
		14008 14008 14008 14008 14008 14008 14008 14008 14008 14008 14008 14008 14008 14008 14008 14008 14008 14008
		14008 14008 14008 14008 14008 14008 14008 14008 14008 14008 14008 14008 14008 14008 14008 14008 14008 14008
		14008 14008 14008 14008 14008 14008 14008 14008 14008 14008 14008 14008 14008 14008 14008 14008 14008 14008
		14008 14008 14008 14008 14008 14008 14008 14008 14008 14008 14008 14008 14008 14008 14008 14008 14008 14008
		14008 14008 14008 14008 14008 14008 14008 14008 14008 14008 14008 14008 14008 14008 14008 14008 14008 14008
		14008 14008 14008 14008 14008 14008 14008 14008 14008 14008 14008 14008 14008 14008 14008 14008 14008 14008
		14008 14008 14008 14008 14008 14008 14008 14008 14008 14008 14008 14008 14008 14008 14008 14008 14008 14008
		14008 14008 14008 14008 14008 14008 14008 14008 14008 14008 14008 14008 14008 14008 14008 14008 14008 14008
		14008 14008 14008 14008 14008 14008 14008 14008 14008 14008 14008 14008 14008 14008 14008 14008 14008 14008
		14008 14008 14008 14008 14008 14008 14008 14008 14008 14008 14008 14008 14008 14008 14008 14008 14008 14008
		14008 14008 14008 14008 14008 14008 14008 14008 14008 14008 14008 14008 14008 14008 14008 14008 14008 14008
		14008 14008 14008 14008 14008 14008 14008 14008 14008 14008 14008 14008 14008 14008 14008 14008 14008 14008
		14008 14008 14008 14008 14008 14008 14008 14008 14008 14008 14008 14008 14008 14008 14008 14008 14008 14008
		14008 14008 14008 14008 14008 14008 14008 14008 14008 14008 14008 14008 14008 14008 14008 14008 14008 14008
		14008 14008 14008 14008 14008 14008 14008 14008 14008 14008 14008 14008 14008 14008 14008 14008 14008 14008
		14008 14008 14008 14008 14008 14008 14008 14008 14008 14008 14008 14008 14008 14008 14008 14008 14008 14008
		14008 14008 14008 14008 14008 14008 14008 14008 14008 14008 14008 14008 14008 14008 14008 14008 14008 14008
		14008 14008 14008 14008 14008 14008 14008 14008 14008 14008 14008 14008 14008 14008 14008 14008 14008 14008
		14008 14008 14008 14008 14008 14008 14008 14008 14008 14008 14008 14008 14008 14008 14008 14008 14008 14008
		14008 14008 14008 14008 14008 14008 14008 14008 14008 14008 14008 14008 14008 14008 14008 14008 14008 14008
		14008 14008 14008 14008 14008 14008 14008 14008 14008 14008 14008 14008 14008 14008 14008 14008 14008 14008
		14008 14008 14008 14008 14008 14008 14008 14008 14008 14008 14008 14008 14008 14008 14008 14008 14008 14008
		14008 14008 14008 14008 14008 14008 14008 14008 14008 14008 14008 14008 14008 14008 14008 14008 14008 14008
		14008 14008 14008 14008 14008 14008 14008 14008 14008 14008 14008 14008 14008 14008 14008 14008 14008 14008
		14008 14008 14008 14008 14008 14008 14008 14008 14008 14008 14008 14008 14008 14008 14008 14008 14008 14008
		14008 14008 14008 14008 14008 14008 14008 14008 14008 14008 14008 14008 14008 14008 14008 14008 14008 14008
		14008 14008 14008 14008 14008 14008 14008 14008 14008 14008 14008 14008 14008 14008 14008 14008 14008 14008
		14008 14008 14008 14008 14008 14008 14008 14008 14008 14008 14008 14008 14008 14008 14008 14008 14008 14008
		14008 14008 14008>;

	PS_Config_Lmt_Short_Rawdata_N = <
		10000 10000 10000 10000 10000 10000 10000 10000 10000 10000 10000 10000 10000 10000 10000 10000 10000 10000
		10000 10000 10000 10000 10000 10000 10000 10000 10000 10000 10000 10000 10000 10000 10000 10000 10000 10000
		10000 10000 10000 10000 10000 10000 10000 10000 10000 10000 10000 10000 10000 10000 10000 10000 10000 10000
		10000 10000 10000 10000 10000 10000 10000 10000 10000 10000 10000 10000 10000 10000 10000 10000 10000 10000
		10000 10000 10000 10000 10000 10000 10000 10000 10000 10000 10000 10000 10000 10000 10000 10000 10000 10000
		10000 10000 10000 10000 10000 10000 10000 10000 10000 10000 10000 10000 10000 10000 10000 10000 10000 10000
		10000 10000 10000 10000 10000 10000 10000 10000 10000 10000 10000 10000 10000 10000 10000 10000 10000 10000
		10000 10000 10000 10000 10000 10000 10000 10000 10000 10000 10000 10000 10000 10000 10000 10000 10000 10000
		10000 10000 10000 10000 10000 10000 10000 10000 10000 10000 10000 10000 10000 10000 10000 10000 10000 10000
		10000 10000 10000 10000 10000 10000 10000 10000 10000 10000 10000 10000 10000 10000 10000 10000 10000 10000
		10000 10000 10000 10000 10000 10000 10000 10000 10000 10000 10000 10000 10000 10000 10000 10000 10000 10000
		10000 10000 10000 10000 10000 10000 10000 10000 10000 10000 10000 10000 10000 10000 10000 10000 10000 10000
		10000 10000 10000 10000 10000 10000 10000 10000 10000 10000 10000 10000 10000 10000 10000 10000 10000 10000
		10000 10000 10000 10000 10000 10000 10000 10000 10000 10000 10000 10000 10000 10000 10000 10000 10000 10000
		10000 10000 10000 10000 10000 10000 10000 10000 10000 10000 10000 10000 10000 10000 10000 10000 10000 10000
		10000 10000 10000 10000 10000 10000 10000 10000 10000 10000 10000 10000 10000 10000 10000 10000 10000 10000
		10000 10000 10000 10000 10000 10000 10000 10000 10000 10000 10000 10000 10000 10000 10000 10000 10000 10000
		10000 10000 10000 10000 10000 10000 10000 10000 10000 10000 10000 10000 10000 10000 10000 10000 10000 10000
		10000 10000 10000 10000 10000 10000 10000 10000 10000 10000 10000 10000 10000 10000 10000 10000 10000 10000
		10000 10000 10000 10000 10000 10000 10000 10000 10000 10000 10000 10000 10000 10000 10000 10000 10000 10000
		10000 10000 10000 10000 10000 10000 10000 10000 10000 10000 10000 10000 10000 10000 10000 10000 10000 10000
		10000 10000 10000 10000 10000 10000 10000 10000 10000 10000 10000 10000 10000 10000 10000 10000 10000 10000
		10000 10000 10000 10000 10000 10000 10000 10000 10000 10000 10000 10000 10000 10000 10000 10000 10000 10000
		10000 10000 10000 10000 10000 10000 10000 10000 10000 10000 10000 10000 10000 10000 10000 10000 10000 10000
		10000 10000 10000 10000 10000 10000 10000 10000 10000 10000 10000 10000 10000 10000 10000 10000 10000 10000
		10000 10000 10000 10000 10000 10000 10000 10000 10000 10000 10000 10000 10000 10000 10000 10000 10000 10000
		10000 10000 10000 10000 10000 10000 10000 10000 10000 10000 10000 10000 10000 10000 10000 10000 10000 10000
		10000 10000 10000 10000 10000 10000 10000 10000 10000 10000 10000 10000 10000 10000 10000 10000 10000 10000
		10000 10000 10000 10000 10000 10000 10000 10000 10000 10000 10000 10000 10000 10000 10000 10000 10000 10000
		10000 10000 10000 10000 10000 10000 10000 10000 10000 10000 10000 10000 10000 10000 10000 10000 10000 10000
		10000 10000 10000 10000 10000 10000 10000 10000 10000 10000 10000 10000 10000 10000 10000 10000 10000 10000
		10000 10000 10000 10000 10000 10000 10000 10000 10000 10000 10000 10000 10000 10000 10000 10000 10000 10000
		10000 10000 10000>;

	PS_Config_Lmt_Open_Rawdata_P = <
		5120 5120 5120 5120 5120 5120 5120 5120 5120 5120 5120 5120 5120 5120 5120 5120 5120 5120
		5120 5120 5120 5120 5120 5120 5120 5120 5120 5120 5120 5120 5120 5120 5120 5120 5120 5120
		5120 5120 5120 5120 5120 5120 5120 5120 5120 5120 5120 5120 5120 5120 5120 5120 5120 5120
		5120 5120 5120 5120 5120 5120 5120 5120 5120 5120 5120 5120 5120 5120 5120 5120 5120 5120
		5120 5120 5120 5120 5120 5120 5120 5120 5120 5120 5120 5120 5120 5120 5120 5120 5120 5120
		5120 5120 5120 5120 5120 5120 5120 5120 5120 5120 5120 5120 5120 5120 5120 5120 5120 5120
		5120 5120 5120 5120 5120 5120 5120 5120 5120 5120 5120 5120 5120 5120 5120 5120 5120 5120
		5120 5120 5120 5120 5120 5120 5120 5120 5120 5120 5120 5120 5120 5120 5120 5120 5120 5120
		5120 5120 5120 5120 5120 5120 5120 5120 5120 5120 5120 5120 5120 5120 5120 5120 5120 5120
		5120 5120 5120 5120 5120 5120 5120 5120 5120 5120 5120 5120 5120 5120 5120 5120 5120 5120
		5120 5120 5120 5120 5120 5120 5120 5120 5120 5120 5120 5120 5120 5120 5120 5120 5120 5120
		5120 5120 5120 5120 5120 5120 5120 5120 5120 5120 5120 5120 5120 5120 5120 5120 5120 5120
		5120 5120 5120 5120 5120 5120 5120 5120 5120 5120 5120 5120 5120 5120 5120 5120 5120 5120
		5120 5120 5120 5120 5120 5120 5120 5120 5120 5120 5120 5120 5120 5120 5120 5120 5120 5120
		5120 5120 5120 5120 5120 5120 5120 5120 5120 5120 5120 5120 5120 5120 5120 5120 5120 5120
		5120 5120 5120 5120 5120 5120 5120 5120 5120 5120 5120 5120 5120 5120 5120 5120 5120 5120
		5120 5120 5120 5120 5120 5120 5120 5120 5120 5120 5120 5120 5120 5120 5120 5120 5120 5120
		5120 5120 5120 5120 5120 5120 5120 5120 5120 5120 5120 5120 5120 5120 5120 5120 5120 5120
		5120 5120 5120 5120 5120 5120 5120 5120 5120 5120 5120 5120 5120 5120 5120 5120 5120 5120
		5120 5120 5120 5120 5120 5120 5120 5120 5120 5120 5120 5120 5120 5120 5120 5120 5120 5120
		5120 5120 5120 5120 5120 5120 5120 5120 5120 5120 5120 5120 5120 5120 5120 5120 5120 5120
		5120 5120 5120 5120 5120 5120 5120 5120 5120 5120 5120 5120 5120 5120 5120 5120 5120 5120
		5120 5120 5120 5120 5120 5120 5120 5120 5120 5120 5120 5120 5120 5120 5120 5120 5120 5120
		5120 5120 5120 5120 5120 5120 5120 5120 5120 5120 5120 5120 5120 5120 5120 5120 5120 5120
		5120 5120 5120 5120 5120 5120 5120 5120 5120 5120 5120 5120 5120 5120 5120 5120 5120 5120
		5120 5120 5120 5120 5120 5120 5120 5120 5120 5120 5120 5120 5120 5120 5120 5120 5120 5120
		5120 5120 5120 5120 5120 5120 5120 5120 5120 5120 5120 5120 5120 5120 5120 5120 5120 5120
		5120 5120 5120 5120 5120 5120 5120 5120 5120 5120 5120 5120 5120 5120 5120 5120 5120 5120
		5120 5120 5120 5120 5120 5120 5120 5120 5120 5120 5120 5120 5120 5120 5120 5120 5120 5120
		5120 5120 5120 5120 5120 5120 5120 5120 5120 5120 5120 5120 5120 5120 5120 5120 5120 5120
		5120 5120 5120 5120 5120 5120 5120 5120 5120 5120 5120 5120 5120 5120 5120 5120 5120 5120
		5120 5120 5120 5120 5120 5120 5120 5120 5120 5120 5120 5120 5120 5120 5120 5120 5120 5120
		5120 5120 5120>;

	PS_Config_Lmt_Open_Rawdata_N = <
		(-511) (-511) (-511) (-511) (-511) (-511) (-511) (-511) (-511) (-511) (-511) (-511) (-511) (-511) (-511) (-511) (-511) (-511)
		(-511) (-511) (-511) (-511) (-511) (-511) (-511) (-511) (-511) (-511) (-511) (-511) (-511) (-511) (-511) (-511) (-511) (-511)
		(-511) (-511) (-511) (-511) (-511) (-511) (-511) (-511) (-511) (-511) (-511) (-511) (-511) (-511) (-511) (-511) (-511) (-511)
		(-511) (-511) (-511) (-511) (-511) (-511) (-511) (-511) (-511) (-511) (-511) (-511) (-511) (-511) (-511) (-511) (-511) (-511)
		(-511) (-511) (-511) (-511) (-511) (-511) (-511) (-511) (-511) (-511) (-511) (-511) (-511) (-511) (-511) (-511) (-511) (-511)
		(-511) (-511) (-511) (-511) (-511) (-511) (-511) (-511) (-511) (-511) (-511) (-511) (-511) (-511) (-511) (-511) (-511) (-511)
		(-511) (-511) (-511) (-511) (-511) (-511) (-511) (-511) (-511) (-511) (-511) (-511) (-511) (-511) (-511) (-511) (-511) (-511)
		(-511) (-511) (-511) (-511) (-511) (-511) (-511) (-511) (-511) (-511) (-511) (-511) (-511) (-511) (-511) (-511) (-511) (-511)
		(-511) (-511) (-511) (-511) (-511) (-511) (-511) (-511) (-511) (-511) (-511) (-511) (-511) (-511) (-511) (-511) (-511) (-511)
		(-511) (-511) (-511) (-511) (-511) (-511) (-511) (-511) (-511) (-511) (-511) (-511) (-511) (-511) (-511) (-511) (-511) (-511)
		(-511) (-511) (-511) (-511) (-511) (-511) (-511) (-511) (-511) (-511) (-511) (-511) (-511) (-511) (-511) (-511) (-511) (-511)
		(-511) (-511) (-511) (-511) (-511) (-511) (-511) (-511) (-511) (-511) (-511) (-511) (-511) (-511) (-511) (-511) (-511) (-511)
		(-511) (-511) (-511) (-511) (-511) (-511) (-511) (-511) (-511) (-511) (-511) (-511) (-511) (-511) (-511) (-511) (-511) (-511)
		(-511) (-511) (-511) (-511) (-511) (-511) (-511) (-511) (-511) (-511) (-511) (-511) (-511) (-511) (-511) (-511) (-511) (-511)
		(-511) (-511) (-511) (-511) (-511) (-511) (-511) (-511) (-511) (-511) (-511) (-511) (-511) (-511) (-511) (-511) (-511) (-511)
		(-511) (-511) (-511) (-511) (-511) (-511) (-511) (-511) (-511) (-511) (-511) (-511) (-511) (-511) (-511) (-511) (-511) (-511)
		(-511) (-511) (-511) (-511) (-511) (-511) (-511) (-511) (-511) (-511) (-511) (-511) (-511) (-511) (-511) (-511) (-511) (-511)
		(-511) (-511) (-511) (-511) (-511) (-511) (-511) (-511) (-511) (-511) (-511) (-511) (-511) (-511) (-511) (-511) (-511) (-511)
		(-511) (-511) (-511) (-511) (-511) (-511) (-511) (-511) (-511) (-511) (-511) (-511) (-511) (-511) (-511) (-511) (-511) (-511)
		(-511) (-511) (-511) (-511) (-511) (-511) (-511) (-511) (-511) (-511) (-511) (-511) (-511) (-511) (-511) (-511) (-511) (-511)
		(-511) (-511) (-511) (-511) (-511) (-511) (-511) (-511) (-511) (-511) (-511) (-511) (-511) (-511) (-511) (-511) (-511) (-511)
		(-511) (-511) (-511) (-511) (-511) (-511) (-511) (-511) (-511) (-511) (-511) (-511) (-511) (-511) (-511) (-511) (-511) (-511)
		(-511) (-511) (-511) (-511) (-511) (-511) (-511) (-511) (-511) (-511) (-511) (-511) (-511) (-511) (-511) (-511) (-511) (-511)
		(-511) (-511) (-511) (-511) (-511) (-511) (-511) (-511) (-511) (-511) (-511) (-511) (-511) (-511) (-511) (-511) (-511) (-511)
		(-511) (-511) (-511) (-511) (-511) (-511) (-511) (-511) (-511) (-511) (-511) (-511) (-511) (-511) (-511) (-511) (-511) (-511)
		(-511) (-511) (-511) (-511) (-511) (-511) (-511) (-511) (-511) (-511) (-511) (-511) (-511) (-511) (-511) (-511) (-511) (-511)
		(-511) (-511) (-511) (-511) (-511) (-511) (-511) (-511) (-511) (-511) (-511) (-511) (-511) (-511) (-511) (-511) (-511) (-511)
		(-511) (-511) (-511) (-511) (-511) (-511) (-511) (-511) (-511) (-511) (-511) (-511) (-511) (-511) (-511) (-511) (-511) (-511)
		(-511) (-511) (-511) (-511) (-511) (-511) (-511) (-511) (-511) (-511) (-511) (-511) (-511) (-511) (-511) (-511) (-511) (-511)
		(-511) (-511) (-511) (-511) (-511) (-511) (-511) (-511) (-511) (-511) (-511) (-511) (-511) (-511) (-511) (-511) (-511) (-511)
		(-511) (-511) (-511) (-511) (-511) (-511) (-511) (-511) (-511) (-511) (-511) (-511) (-511) (-511) (-511) (-511) (-511) (-511)
		(-511) (-511) (-511) (-511) (-511) (-511) (-511) (-511) (-511) (-511) (-511) (-511) (-511) (-511) (-511) (-511) (-511) (-511)
		(-511) (-511) (-511)>;

	PS_Config_Lmt_FW_Rawdata_P = <
		3750 3750 3750 3750 3750 3750 3750 3750 3750 3750 3750 3750 3750 3750 3750 3750 3750 3750
		3750 3750 3750 3750 3750 3750 3750 3750 3750 3750 3750 3750 3750 3750 3750 3750 3750 3750
		3750 3750 3750 3750 3750 3750 3750 3750 3750 3750 3750 3750 3750 3750 3750 3750 3750 3750
		3750 3750 3750 3750 3750 3750 3750 3750 3750 3750 3750 3750 3750 3750 3750 3750 3750 3750
		3750 3750 3750 3750 3750 3750 3750 3750 3750 3750 3750 3750 3750 3750 3750 3750 3750 3750
		3750 3750 3750 3750 3750 3750 3750 3750 3750 3750 3750 3750 3750 3750 3750 3750 3750 3750
		3750 3750 3750 3750 3750 3750 3750 3750 3750 3750 3750 3750 3750 3750 3750 3750 3750 3750
		3750 3750 3750 3750 3750 3750 3750 3750 3750 3750 3750 3750 3750 3750 3750 3750 3750 3750
		3750 3750 3750 3750 3750 3750 3750 3750 3750 3750 3750 3750 3750 3750 3750 3750 3750 3750
		3750 3750 3750 3750 3750 3750 3750 3750 3750 3750 3750 3750 3750 3750 3750 3750 3750 3750
		3750 3750 3750 3750 3750 3750 3750 3750 3750 3750 3750 3750 3750 3750 3750 3750 3750 3750
		3750 3750 3750 3750 3750 3750 3750 3750 3750 3750 3750 3750 3750 3750 3750 3750 3750 3750
		3750 3750 3750 3750 3750 3750 3750 3750 3750 3750 3750 3750 3750 3750 3750 3750 3750 3750
		3750 3750 3750 3750 3750 3750 3750 3750 3750 3750 3750 3750 3750 3750 3750 3750 3750 3750
		3750 3750 3750 3750 3750 3750 3750 3750 3750 3750 3750 3750 3750 3750 3750 3750 3750 3750
		3750 3750 3750 3750 3750 3750 3750 3750 3750 3750 3750 3750 3750 3750 3750 3750 3750 3750
		3750 3750 3750 3750 3750 3750 3750 3750 3750 3750 3750 3750 3750 3750 3750 3750 3750 3750
		3750 3750 3750 3750 3750 3750 3750 3750 3750 3750 3750 3750 3750 3750 3750 3750 3750 3750
		3750 3750 3750 3750 3750 3750 3750 3750 3750 3750 3750 3750 3750 3750 3750 3750 3750 3750
		3750 3750 3750 3750 3750 3750 3750 3750 3750 3750 3750 3750 3750 3750 3750 3750 3750 3750
		3750 3750 3750 3750 3750 3750 3750 3750 3750 3750 3750 3750 3750 3750 3750 3750 3750 3750
		3750 3750 3750 3750 3750 3750 3750 3750 3750 3750 3750 3750 3750 3750 3750 3750 3750 3750
		3750 3750 3750 3750 3750 3750 3750 3750 3750 3750 3750 3750 3750 3750 3750 3750 3750 3750
		3750 3750 3750 3750 3750 3750 3750 3750 3750 3750 3750 3750 3750 3750 3750 3750 3750 3750
		3750 3750 3750 3750 3750 3750 3750 3750 3750 3750 3750 3750 3750 3750 3750 3750 3750 3750
		3750 3750 3750 3750 3750 3750 3750 3750 3750 3750 3750 3750 3750 3750 3750 3750 3750 3750
		3750 3750 3750 3750 3750 3750 3750 3750 3750 3750 3750 3750 3750 3750 3750 3750 3750 3750
		3750 3750 3750 3750 3750 3750 3750 3750 3750 3750 3750 3750 3750 3750 3750 3750 3750 3750
		3750 3750 3750 3750 3750 3750 3750 3750 3750 3750 3750 3750 3750 3750 3750 3750 3750 3750
		3750 3750 3750 3750 3750 3750 3750 3750 3750 3750 3750 3750 3750 3750 3750 3750 3750 3750
		3750 3750 3750 3750 3750 3750 3750 3750 3750 3750 3750 3750 3750 3750 3750 3750 3750 3750
		3750 3750 3750 3750 3750 3750 3750 3750 3750 3750 3750 3750 3750 3750 3750 3750 3750 3750
		3750 3750 3750>;

	PS_Config_Lmt_FW_Rawdata_N = <
		240 240 240 240 240 240 240 240 240 240 240 240 240 240 240 240 240 240
		240 240 240 240 240 240 240 240 240 240 240 240 240 240 240 240 240 240
		240 240 240 240 240 240 240 240 240 240 240 240 240 240 240 240 240 240
		240 240 240 240 240 240 240 240 240 240 240 240 240 240 240 240 240 240
		240 240 240 240 240 240 240 240 240 240 240 240 240 240 240 240 240 240
		240 240 240 240 240 240 240 240 240 240 240 240 240 240 240 240 240 240
		240 240 240 240 240 240 240 240 240 240 240 240 240 240 240 240 240 240
		240 240 240 240 240 240 240 240 240 240 240 240 240 240 240 240 240 240
		240 240 240 240 240 240 240 240 240 240 240 240 240 240 240 240 240 240
		240 240 240 240 240 240 240 240 240 240 240 240 240 240 240 240 240 240
		240 240 240 240 240 240 240 240 240 240 240 240 240 240 240 240 240 240
		240 240 240 240 240 240 240 240 240 240 240 240 240 240 240 240 240 240
		240 240 240 240 240 240 240 240 240 240 240 240 240 240 240 240 240 240
		240 240 240 240 240 240 240 240 240 240 240 240 240 240 240 240 240 240
		240 240 240 240 240 240 240 240 240 240 240 240 240 240 240 240 240 240
		240 240 240 240 240 240 240 240 240 240 240 240 240 240 240 240 240 240
		240 240 240 240 240 240 240 240 240 240 240 240 240 240 240 240 240 240
		240 240 240 240 240 240 240 240 240 240 240 240 240 240 240 240 240 240
		240 240 240 240 240 240 240 240 240 240 240 240 240 240 240 240 240 240
		240 240 240 240 240 240 240 240 240 240 240 240 240 240 240 240 240 240
		240 240 240 240 240 240 240 240 240 240 240 240 240 240 240 240 240 240
		240 240 240 240 240 240 240 240 240 240 240 240 240 240 240 240 240 240
		240 240 240 240 240 240 240 240 240 240 240 240 240 240 240 240 240 240
		240 240 240 240 240 240 240 240 240 240 240 240 240 240 240 240 240 240
		240 240 240 240 240 240 240 240 240 240 240 240 240 240 240 240 240 240
		240 240 240 240 240 240 240 240 240 240 240 240 240 240 240 240 240 240
		240 240 240 240 240 240 240 240 240 240 240 240 240 240 240 240 240 240
		240 240 240 240 240 240 240 240 240 240 240 240 240 240 240 240 240 240
		240 240 240 240 240 240 240 240 240 240 240 240 240 240 240 240 240 240
		240 240 240 240 240 240 240 240 240 240 240 240 240 240 240 240 240 240
		240 240 240 240 240 240 240 240 240 240 240 240 240 240 240 240 240 240
		240 240 240 240 240 240 240 240 240 240 240 240 240 240 240 240 240 240
		240 240 240>;

	PS_Config_Lmt_FW_CC_P = <
		314 314 314 314 314 314 314 314 314 314 314 314 314 314 314 314 314 314
		314 314 314 314 314 314 314 314 314 314 314 314 314 314 314 314 314 314
		314 314 314 314 314 314 314 314 314 314 314 314 314 314 314 314 314 314
		314 314 314 314 314 314 314 314 314 314 314 314 314 314 314 314 314 314
		314 314 314 314 314 314 314 314 314 314 314 314 314 314 314 314 314 314
		314 314 314 314 314 314 314 314 314 314 314 314 314 314 314 314 314 314
		314 314 314 314 314 314 314 314 314 314 314 314 314 314 314 314 314 314
		314 314 314 314 314 314 314 314 314 314 314 314 314 314 314 314 314 314
		314 314 314 314 314 314 314 314 314 314 314 314 314 314 314 314 314 314
		314 314 314 314 314 314 314 314 314 314 314 314 314 314 314 314 314 314
		314 314 314 314 314 314 314 314 314 314 314 314 314 314 314 314 314 314
		314 314 314 314 314 314 314 314 314 314 314 314 314 314 314 314 314 314
		314 314 314 314 314 314 314 314 314 314 314 314 314 314 314 314 314 314
		314 314 314 314 314 314 314 314 314 314 314 314 314 314 314 314 314 314
		314 314 314 314 314 314 314 314 314 314 314 314 314 314 314 314 314 314
		314 314 314 314 314 314 314 314 314 314 314 314 314 314 314 314 314 314
		314 314 314 314 314 314 314 314 314 314 314 314 314 314 314 314 314 314
		314 314 314 314 314 314 314 314 314 314 314 314 314 314 314 314 314 314
		314 314 314 314 314 314 314 314 314 314 314 314 314 314 314 314 314 314
		314 314 314 314 314 314 314 314 314 314 314 314 314 314 314 314 314 314
		314 314 314 314 314 314 314 314 314 314 314 314 314 314 314 314 314 314
		314 314 314 314 314 314 314 314 314 314 314 314 314 314 314 314 314 314
		314 314 314 314 314 314 314 314 314 314 314 314 314 314 314 314 314 314
		314 314 314 314 314 314 314 314 314 314 314 314 314 314 314 314 314 314
		314 314 314 314 314 314 314 314 314 314 314 314 314 314 314 314 314 314
		314 314 314 314 314 314 314 314 314 314 314 314 314 314 314 314 314 314
		314 314 314 314 314 314 314 314 314 314 314 314 314 314 314 314 314 314
		314 314 314 314 314 314 314 314 314 314 314 314 314 314 314 314 314 314
		314 314 314 314 314 314 314 314 314 314 314 314 314 314 314 314 314 314
		314 314 314 314 314 314 314 314 314 314 314 314 314 314 314 314 314 314
		314 314 314 314 314 314 314 314 314 314 314 314 314 314 314 314 314 314
		314 314 314 314 314 314 314 314 314 314 314 314 314 314 314 314 314 314
		314 314 314>;

	PS_Config_Lmt_FW_CC_N = <
		0 0 0 0 0 0 0 0 0 0 0 0 0 0 0 0 0 0
		0 0 0 0 0 0 0 0 0 0 0 0 0 0 0 0 0 0
		0 0 0 0 0 0 0 0 0 0 0 0 0 0 0 0 0 0
		0 0 0 0 0 0 0 0 0 0 0 0 0 0 0 0 0 0
		0 0 0 0 0 0 0 0 0 0 0 0 0 0 0 0 0 0
		0 0 0 0 0 0 0 0 0 0 0 0 0 0 0 0 0 0
		0 0 0 0 0 0 0 0 0 0 0 0 0 0 0 0 0 0
		0 0 0 0 0 0 0 0 0 0 0 0 0 0 0 0 0 0
		0 0 0 0 0 0 0 0 0 0 0 0 0 0 0 0 0 0
		0 0 0 0 0 0 0 0 0 0 0 0 0 0 0 0 0 0
		0 0 0 0 0 0 0 0 0 0 0 0 0 0 0 0 0 0
		0 0 0 0 0 0 0 0 0 0 0 0 0 0 0 0 0 0
		0 0 0 0 0 0 0 0 0 0 0 0 0 0 0 0 0 0
		0 0 0 0 0 0 0 0 0 0 0 0 0 0 0 0 0 0
		0 0 0 0 0 0 0 0 0 0 0 0 0 0 0 0 0 0
		0 0 0 0 0 0 0 0 0 0 0 0 0 0 0 0 0 0
		0 0 0 0 0 0 0 0 0 0 0 0 0 0 0 0 0 0
		0 0 0 0 0 0 0 0 0 0 0 0 0 0 0 0 0 0
		0 0 0 0 0 0 0 0 0 0 0 0 0 0 0 0 0 0
		0 0 0 0 0 0 0 0 0 0 0 0 0 0 0 0 0 0
		0 0 0 0 0 0 0 0 0 0 0 0 0 0 0 0 0 0
		0 0 0 0 0 0 0 0 0 0 0 0 0 0 0 0 0 0
		0 0 0 0 0 0 0 0 0 0 0 0 0 0 0 0 0 0
		0 0 0 0 0 0 0 0 0 0 0 0 0 0 0 0 0 0
		0 0 0 0 0 0 0 0 0 0 0 0 0 0 0 0 0 0
		0 0 0 0 0 0 0 0 0 0 0 0 0 0 0 0 0 0
		0 0 0 0 0 0 0 0 0 0 0 0 0 0 0 0 0 0
		0 0 0 0 0 0 0 0 0 0 0 0 0 0 0 0 0 0
		0 0 0 0 0 0 0 0 0 0 0 0 0 0 0 0 0 0
		0 0 0 0 0 0 0 0 0 0 0 0 0 0 0 0 0 0
		0 0 0 0 0 0 0 0 0 0 0 0 0 0 0 0 0 0
		0 0 0 0 0 0 0 0 0 0 0 0 0 0 0 0 0 0
		0 0 0>;

	PS_Config_Lmt_FW_Diff_P = <
		75 75 75 75 75 75 75 75 75 75 75 75 75 75 75 75 75 75
		75 75 75 75 75 75 75 75 75 75 75 75 75 75 75 75 75 75
		75 75 75 75 75 75 75 75 75 75 75 75 75 75 75 75 75 75
		75 75 75 75 75 75 75 75 75 75 75 75 75 75 75 75 75 75
		75 75 75 75 75 75 75 75 75 75 75 75 75 75 75 75 75 75
		75 75 75 75 75 75 75 75 75 75 75 75 75 75 75 75 75 75
		75 75 75 75 75 75 75 75 75 75 75 75 75 75 75 75 75 75
		75 75 75 75 75 75 75 75 75 75 75 75 75 75 75 75 75 75
		75 75 75 75 75 75 75 75 75 75 75 75 75 75 75 75 75 75
		75 75 75 75 75 75 75 75 75 75 75 75 75 75 75 75 75 75
		75 75 75 75 75 75 75 75 75 75 75 75 75 75 75 75 75 75
		75 75 75 75 75 75 75 75 75 75 75 75 75 75 75 75 75 75
		75 75 75 75 75 75 75 75 75 75 75 75 75 75 75 75 75 75
		75 75 75 75 75 75 75 75 75 75 75 75 75 75 75 75 75 75
		75 75 75 75 75 75 75 75 75 75 75 75 75 75 75 75 75 75
		75 75 75 75 75 75 75 75 75 75 75 75 75 75 75 75 75 75
		75 75 75 75 75 75 75 75 75 75 75 75 75 75 75 75 75 75
		75 75 75 75 75 75 75 75 75 75 75 75 75 75 75 75 75 75
		75 75 75 75 75 75 75 75 75 75 75 75 75 75 75 75 75 75
		75 75 75 75 75 75 75 75 75 75 75 75 75 75 75 75 75 75
		75 75 75 75 75 75 75 75 75 75 75 75 75 75 75 75 75 75
		75 75 75 75 75 75 75 75 75 75 75 75 75 75 75 75 75 75
		75 75 75 75 75 75 75 75 75 75 75 75 75 75 75 75 75 75
		75 75 75 75 75 75 75 75 75 75 75 75 75 75 75 75 75 75
		75 75 75 75 75 75 75 75 75 75 75 75 75 75 75 75 75 75
		75 75 75 75 75 75 75 75 75 75 75 75 75 75 75 75 75 75
		75 75 75 75 75 75 75 75 75 75 75 75 75 75 75 75 75 75
		75 75 75 75 75 75 75 75 75 75 75 75 75 75 75 75 75 75
		75 75 75 75 75 75 75 75 75 75 75 75 75 75 75 75 75 75
		75 75 75 75 75 75 75 75 75 75 75 75 75 75 75 75 75 75
		75 75 75 75 75 75 75 75 75 75 75 75 75 75 75 75 75 75
		75 75 75 75 75 75 75 75 75 75 75 75 75 75 75 75 75 75
		75 75 75>;

	PS_Config_Lmt_FW_Diff_N = <
		(-75) (-75) (-75) (-75) (-75) (-75) (-75) (-75) (-75) (-75) (-75) (-75) (-75) (-75) (-75) (-75) (-75) (-75)
		(-75) (-75) (-75) (-75) (-75) (-75) (-75) (-75) (-75) (-75) (-75) (-75) (-75) (-75) (-75) (-75) (-75) (-75)
		(-75) (-75) (-75) (-75) (-75) (-75) (-75) (-75) (-75) (-75) (-75) (-75) (-75) (-75) (-75) (-75) (-75) (-75)
		(-75) (-75) (-75) (-75) (-75) (-75) (-75) (-75) (-75) (-75) (-75) (-75) (-75) (-75) (-75) (-75) (-75) (-75)
		(-75) (-75) (-75) (-75) (-75) (-75) (-75) (-75) (-75) (-75) (-75) (-75) (-75) (-75) (-75) (-75) (-75) (-75)
		(-75) (-75) (-75) (-75) (-75) (-75) (-75) (-75) (-75) (-75) (-75) (-75) (-75) (-75) (-75) (-75) (-75) (-75)
		(-75) (-75) (-75) (-75) (-75) (-75) (-75) (-75) (-75) (-75) (-75) (-75) (-75) (-75) (-75) (-75) (-75) (-75)
		(-75) (-75) (-75) (-75) (-75) (-75) (-75) (-75) (-75) (-75) (-75) (-75) (-75) (-75) (-75) (-75) (-75) (-75)
		(-75) (-75) (-75) (-75) (-75) (-75) (-75) (-75) (-75) (-75) (-75) (-75) (-75) (-75) (-75) (-75) (-75) (-75)
		(-75) (-75) (-75) (-75) (-75) (-75) (-75) (-75) (-75) (-75) (-75) (-75) (-75) (-75) (-75) (-75) (-75) (-75)
		(-75) (-75) (-75) (-75) (-75) (-75) (-75) (-75) (-75) (-75) (-75) (-75) (-75) (-75) (-75) (-75) (-75) (-75)
		(-75) (-75) (-75) (-75) (-75) (-75) (-75) (-75) (-75) (-75) (-75) (-75) (-75) (-75) (-75) (-75) (-75) (-75)
		(-75) (-75) (-75) (-75) (-75) (-75) (-75) (-75) (-75) (-75) (-75) (-75) (-75) (-75) (-75) (-75) (-75) (-75)
		(-75) (-75) (-75) (-75) (-75) (-75) (-75) (-75) (-75) (-75) (-75) (-75) (-75) (-75) (-75) (-75) (-75) (-75)
		(-75) (-75) (-75) (-75) (-75) (-75) (-75) (-75) (-75) (-75) (-75) (-75) (-75) (-75) (-75) (-75) (-75) (-75)
		(-75) (-75) (-75) (-75) (-75) (-75) (-75) (-75) (-75) (-75) (-75) (-75) (-75) (-75) (-75) (-75) (-75) (-75)
		(-75) (-75) (-75) (-75) (-75) (-75) (-75) (-75) (-75) (-75) (-75) (-75) (-75) (-75) (-75) (-75) (-75) (-75)
		(-75) (-75) (-75) (-75) (-75) (-75) (-75) (-75) (-75) (-75) (-75) (-75) (-75) (-75) (-75) (-75) (-75) (-75)
		(-75) (-75) (-75) (-75) (-75) (-75) (-75) (-75) (-75) (-75) (-75) (-75) (-75) (-75) (-75) (-75) (-75) (-75)
		(-75) (-75) (-75) (-75) (-75) (-75) (-75) (-75) (-75) (-75) (-75) (-75) (-75) (-75) (-75) (-75) (-75) (-75)
		(-75) (-75) (-75) (-75) (-75) (-75) (-75) (-75) (-75) (-75) (-75) (-75) (-75) (-75) (-75) (-75) (-75) (-75)
		(-75) (-75) (-75) (-75) (-75) (-75) (-75) (-75) (-75) (-75) (-75) (-75) (-75) (-75) (-75) (-75) (-75) (-75)
		(-75) (-75) (-75) (-75) (-75) (-75) (-75) (-75) (-75) (-75) (-75) (-75) (-75) (-75) (-75) (-75) (-75) (-75)
		(-75) (-75) (-75) (-75) (-75) (-75) (-75) (-75) (-75) (-75) (-75) (-75) (-75) (-75) (-75) (-75) (-75) (-75)
		(-75) (-75) (-75) (-75) (-75) (-75) (-75) (-75) (-75) (-75) (-75) (-75) (-75) (-75) (-75) (-75) (-75) (-75)
		(-75) (-75) (-75) (-75) (-75) (-75) (-75) (-75) (-75) (-75) (-75) (-75) (-75) (-75) (-75) (-75) (-75) (-75)
		(-75) (-75) (-75) (-75) (-75) (-75) (-75) (-75) (-75) (-75) (-75) (-75) (-75) (-75) (-75) (-75) (-75) (-75)
		(-75) (-75) (-75) (-75) (-75) (-75) (-75) (-75) (-75) (-75) (-75) (-75) (-75) (-75) (-75) (-75) (-75) (-75)
		(-75) (-75) (-75) (-75) (-75) (-75) (-75) (-75) (-75) (-75) (-75) (-75) (-75) (-75) (-75) (-75) (-75) (-75)
		(-75) (-75) (-75) (-75) (-75) (-75) (-75) (-75) (-75) (-75) (-75) (-75) (-75) (-75) (-75) (-75) (-75) (-75)
		(-75) (-75) (-75) (-75) (-75) (-75) (-75) (-75) (-75) (-75) (-75) (-75) (-75) (-75) (-75) (-75) (-75) (-75)
		(-75) (-75) (-75) (-75) (-75) (-75) (-75) (-75) (-75) (-75) (-75) (-75) (-75) (-75) (-75) (-75) (-75) (-75)
		(-75) (-75) (-75)>;

	PS_Config_Diff_Test_Frame = <50>;

	PS_Config_Lmt_LPWG_Rawdata_P = <
		3000 3000 3000 3000 3000 3000 3000 3000 3000 3000 3000 3000 3000 3000 3000 3000 3000 3000
		3000 3000 3000 3000 3000 3000 3000 3000 3000 3000 3000 3000 3000 3000 3000 3000 3000 3000
		3000 3000 3000 3000 3000 3000 3000 3000 3000 3000 3000 3000 3000 3000 3000 3000 3000 3000
		3000 3000 3000 3000 3000 3000 3000 3000 3000 3000 3000 3000 3000 3000 3000 3000 3000 3000
		3000 3000 3000 3000 3000 3000 3000 3000 3000 3000 3000 3000 3000 3000 3000 3000 3000 3000
		3000 3000 3000 3000 3000 3000 3000 3000 3000 3000 3000 3000 3000 3000 3000 3000 3000 3000
		3000 3000 3000 3000 3000 3000 3000 3000 3000 3000 3000 3000 3000 3000 3000 3000 3000 3000
		3000 3000 3000 3000 3000 3000 3000 3000 3000 3000 3000 3000 3000 3000 3000 3000 3000 3000
		3000 3000 3000 3000 3000 3000 3000 3000 3000 3000 3000 3000 3000 3000 3000 3000 3000 3000
		3000 3000 3000 3000 3000 3000 3000 3000 3000 3000 3000 3000 3000 3000 3000 3000 3000 3000
		3000 3000 3000 3000 3000 3000 3000 3000 3000 3000 3000 3000 3000 3000 3000 3000 3000 3000
		3000 3000 3000 3000 3000 3000 3000 3000 3000 3000 3000 3000 3000 3000 3000 3000 3000 3000
		3000 3000 3000 3000 3000 3000 3000 3000 3000 3000 3000 3000 3000 3000 3000 3000 3000 3000
		3000 3000 3000 3000 3000 3000 3000 3000 3000 3000 3000 3000 3000 3000 3000 3000 3000 3000
		3000 3000 3000 3000 3000 3000 3000 3000 3000 3000 3000 3000 3000 3000 3000 3000 3000 3000
		3000 3000 3000 3000 3000 3000 3000 3000 3000 3000 3000 3000 3000 3000 3000 3000 3000 3000
		3000 3000 3000 3000 3000 3000 3000 3000 3000 3000 3000 3000 3000 3000 3000 3000 3000 3000
		3000 3000 3000 3000 3000 3000 3000 3000 3000 3000 3000 3000 3000 3000 3000 3000 3000 3000
		3000 3000 3000 3000 3000 3000 3000 3000 3000 3000 3000 3000 3000 3000 3000 3000 3000 3000
		3000 3000 3000 3000 3000 3000 3000 3000 3000 3000 3000 3000 3000 3000 3000 3000 3000 3000
		3000 3000 3000 3000 3000 3000 3000 3000 3000 3000 3000 3000 3000 3000 3000 3000 3000 3000
		3000 3000 3000 3000 3000 3000 3000 3000 3000 3000 3000 3000 3000 3000 3000 3000 3000 3000
		3000 3000 3000 3000 3000 3000 3000 3000 3000 3000 3000 3000 3000 3000 3000 3000 3000 3000
		3000 3000 3000 3000 3000 3000 3000 3000 3000 3000 3000 3000 3000 3000 3000 3000 3000 3000
		3000 3000 3000 3000 3000 3000 3000 3000 3000 3000 3000 3000 3000 3000 3000 3000 3000 3000
		3000 3000 3000 3000 3000 3000 3000 3000 3000 3000 3000 3000 3000 3000 3000 3000 3000 3000
		3000 3000 3000 3000 3000 3000 3000 3000 3000 3000 3000 3000 3000 3000 3000 3000 3000 3000
		3000 3000 3000 3000 3000 3000 3000 3000 3000 3000 3000 3000 3000 3000 3000 3000 3000 3000
		3000 3000 3000 3000 3000 3000 3000 3000 3000 3000 3000 3000 3000 3000 3000 3000 3000 3000
		3000 3000 3000 3000 3000 3000 3000 3000 3000 3000 3000 3000 3000 3000 3000 3000 3000 3000
		3000 3000 3000 3000 3000 3000 3000 3000 3000 3000 3000 3000 3000 3000 3000 3000 3000 3000
		3000 3000 3000 3000 3000 3000 3000 3000 3000 3000 3000 3000 3000 3000 3000 3000 3000 3000
		3000 3000 3000>;

	PS_Config_Lmt_LPWG_Rawdata_N = <
		240 240 240 240 240 240 240 240 240 240 240 240 240 240 240 240 240 240
		240 240 240 240 240 240 240 240 240 240 240 240 240 240 240 240 240 240
		240 240 240 240 240 240 240 240 240 240 240 240 240 240 240 240 240 240
		240 240 240 240 240 240 240 240 240 240 240 240 240 240 240 240 240 240
		240 240 240 240 240 240 240 240 240 240 240 240 240 240 240 240 240 240
		240 240 240 240 240 240 240 240 240 240 240 240 240 240 240 240 240 240
		240 240 240 240 240 240 240 240 240 240 240 240 240 240 240 240 240 240
		240 240 240 240 240 240 240 240 240 240 240 240 240 240 240 240 240 240
		240 240 240 240 240 240 240 240 240 240 240 240 240 240 240 240 240 240
		240 240 240 240 240 240 240 240 240 240 240 240 240 240 240 240 240 240
		240 240 240 240 240 240 240 240 240 240 240 240 240 240 240 240 240 240
		240 240 240 240 240 240 240 240 240 240 240 240 240 240 240 240 240 240
		240 240 240 240 240 240 240 240 240 240 240 240 240 240 240 240 240 240
		240 240 240 240 240 240 240 240 240 240 240 240 240 240 240 240 240 240
		240 240 240 240 240 240 240 240 240 240 240 240 240 240 240 240 240 240
		240 240 240 240 240 240 240 240 240 240 240 240 240 240 240 240 240 240
		240 240 240 240 240 240 240 240 240 240 240 240 240 240 240 240 240 240
		240 240 240 240 240 240 240 240 240 240 240 240 240 240 240 240 240 240
		240 240 240 240 240 240 240 240 240 240 240 240 240 240 240 240 240 240
		240 240 240 240 240 240 240 240 240 240 240 240 240 240 240 240 240 240
		240 240 240 240 240 240 240 240 240 240 240 240 240 240 240 240 240 240
		240 240 240 240 240 240 240 240 240 240 240 240 240 240 240 240 240 240
		240 240 240 240 240 240 240 240 240 240 240 240 240 240 240 240 240 240
		240 240 240 240 240 240 240 240 240 240 240 240 240 240 240 240 240 240
		240 240 240 240 240 240 240 240 240 240 240 240 240 240 240 240 240 240
		240 240 240 240 240 240 240 240 240 240 240 240 240 240 240 240 240 240
		240 240 240 240 240 240 240 240 240 240 240 240 240 240 240 240 240 240
		240 240 240 240 240 240 240 240 240 240 240 240 240 240 240 240 240 240
		240 240 240 240 240 240 240 240 240 240 240 240 240 240 240 240 240 240
		240 240 240 240 240 240 240 240 240 240 240 240 240 240 240 240 240 240
		240 240 240 240 240 240 240 240 240 240 240 240 240 240 240 240 240 240
		240 240 240 240 240 240 240 240 240 240 240 240 240 240 240 240 240 240
		240 240 240>;

	PS_Config_Lmt_LPWG_Diff_P = <
		75 75 75 75 75 75 75 75 75 75 75 75 75 75 75 75 75 75
		75 75 75 75 75 75 75 75 75 75 75 75 75 75 75 75 75 75
		75 75 75 75 75 75 75 75 75 75 75 75 75 75 75 75 75 75
		75 75 75 75 75 75 75 75 75 75 75 75 75 75 75 75 75 75
		75 75 75 75 75 75 75 75 75 75 75 75 75 75 75 75 75 75
		75 75 75 75 75 75 75 75 75 75 75 75 75 75 75 75 75 75
		75 75 75 75 75 75 75 75 75 75 75 75 75 75 75 75 75 75
		75 75 75 75 75 75 75 75 75 75 75 75 75 75 75 75 75 75
		75 75 75 75 75 75 75 75 75 75 75 75 75 75 75 75 75 75
		75 75 75 75 75 75 75 75 75 75 75 75 75 75 75 75 75 75
		75 75 75 75 75 75 75 75 75 75 75 75 75 75 75 75 75 75
		75 75 75 75 75 75 75 75 75 75 75 75 75 75 75 75 75 75
		75 75 75 75 75 75 75 75 75 75 75 75 75 75 75 75 75 75
		75 75 75 75 75 75 75 75 75 75 75 75 75 75 75 75 75 75
		75 75 75 75 75 75 75 75 75 75 75 75 75 75 75 75 75 75
		75 75 75 75 75 75 75 75 75 75 75 75 75 75 75 75 75 75
		75 75 75 75 75 75 75 75 75 75 75 75 75 75 75 75 75 75
		75 75 75 75 75 75 75 75 75 75 75 75 75 75 75 75 75 75
		75 75 75 75 75 75 75 75 75 75 75 75 75 75 75 75 75 75
		75 75 75 75 75 75 75 75 75 75 75 75 75 75 75 75 75 75
		75 75 75 75 75 75 75 75 75 75 75 75 75 75 75 75 75 75
		75 75 75 75 75 75 75 75 75 75 75 75 75 75 75 75 75 75
		75 75 75 75 75 75 75 75 75 75 75 75 75 75 75 75 75 75
		75 75 75 75 75 75 75 75 75 75 75 75 75 75 75 75 75 75
		75 75 75 75 75 75 75 75 75 75 75 75 75 75 75 75 75 75
		75 75 75 75 75 75 75 75 75 75 75 75 75 75 75 75 75 75
		75 75 75 75 75 75 75 75 75 75 75 75 75 75 75 75 75 75
		75 75 75 75 75 75 75 75 75 75 75 75 75 75 75 75 75 75
		75 75 75 75 75 75 75 75 75 75 75 75 75 75 75 75 75 75
		75 75 75 75 75 75 75 75 75 75 75 75 75 75 75 75 75 75
		75 75 75 75 75 75 75 75 75 75 75 75 75 75 75 75 75 75
		75 75 75 75 75 75 75 75 75 75 75 75 75 75 75 75 75 75
		75 75 75>;

	PS_Config_Lmt_LPWG_Diff_N = <
		(-75) (-75) (-75) (-75) (-75) (-75) (-75) (-75) (-75) (-75) (-75) (-75) (-75) (-75) (-75) (-75) (-75) (-75)
		(-75) (-75) (-75) (-75) (-75) (-75) (-75) (-75) (-75) (-75) (-75) (-75) (-75) (-75) (-75) (-75) (-75) (-75)
		(-75) (-75) (-75) (-75) (-75) (-75) (-75) (-75) (-75) (-75) (-75) (-75) (-75) (-75) (-75) (-75) (-75) (-75)
		(-75) (-75) (-75) (-75) (-75) (-75) (-75) (-75) (-75) (-75) (-75) (-75) (-75) (-75) (-75) (-75) (-75) (-75)
		(-75) (-75) (-75) (-75) (-75) (-75) (-75) (-75) (-75) (-75) (-75) (-75) (-75) (-75) (-75) (-75) (-75) (-75)
		(-75) (-75) (-75) (-75) (-75) (-75) (-75) (-75) (-75) (-75) (-75) (-75) (-75) (-75) (-75) (-75) (-75) (-75)
		(-75) (-75) (-75) (-75) (-75) (-75) (-75) (-75) (-75) (-75) (-75) (-75) (-75) (-75) (-75) (-75) (-75) (-75)
		(-75) (-75) (-75) (-75) (-75) (-75) (-75) (-75) (-75) (-75) (-75) (-75) (-75) (-75) (-75) (-75) (-75) (-75)
		(-75) (-75) (-75) (-75) (-75) (-75) (-75) (-75) (-75) (-75) (-75) (-75) (-75) (-75) (-75) (-75) (-75) (-75)
		(-75) (-75) (-75) (-75) (-75) (-75) (-75) (-75) (-75) (-75) (-75) (-75) (-75) (-75) (-75) (-75) (-75) (-75)
		(-75) (-75) (-75) (-75) (-75) (-75) (-75) (-75) (-75) (-75) (-75) (-75) (-75) (-75) (-75) (-75) (-75) (-75)
		(-75) (-75) (-75) (-75) (-75) (-75) (-75) (-75) (-75) (-75) (-75) (-75) (-75) (-75) (-75) (-75) (-75) (-75)
		(-75) (-75) (-75) (-75) (-75) (-75) (-75) (-75) (-75) (-75) (-75) (-75) (-75) (-75) (-75) (-75) (-75) (-75)
		(-75) (-75) (-75) (-75) (-75) (-75) (-75) (-75) (-75) (-75) (-75) (-75) (-75) (-75) (-75) (-75) (-75) (-75)
		(-75) (-75) (-75) (-75) (-75) (-75) (-75) (-75) (-75) (-75) (-75) (-75) (-75) (-75) (-75) (-75) (-75) (-75)
		(-75) (-75) (-75) (-75) (-75) (-75) (-75) (-75) (-75) (-75) (-75) (-75) (-75) (-75) (-75) (-75) (-75) (-75)
		(-75) (-75) (-75) (-75) (-75) (-75) (-75) (-75) (-75) (-75) (-75) (-75) (-75) (-75) (-75) (-75) (-75) (-75)
		(-75) (-75) (-75) (-75) (-75) (-75) (-75) (-75) (-75) (-75) (-75) (-75) (-75) (-75) (-75) (-75) (-75) (-75)
		(-75) (-75) (-75) (-75) (-75) (-75) (-75) (-75) (-75) (-75) (-75) (-75) (-75) (-75) (-75) (-75) (-75) (-75)
		(-75) (-75) (-75) (-75) (-75) (-75) (-75) (-75) (-75) (-75) (-75) (-75) (-75) (-75) (-75) (-75) (-75) (-75)
		(-75) (-75) (-75) (-75) (-75) (-75) (-75) (-75) (-75) (-75) (-75) (-75) (-75) (-75) (-75) (-75) (-75) (-75)
		(-75) (-75) (-75) (-75) (-75) (-75) (-75) (-75) (-75) (-75) (-75) (-75) (-75) (-75) (-75) (-75) (-75) (-75)
		(-75) (-75) (-75) (-75) (-75) (-75) (-75) (-75) (-75) (-75) (-75) (-75) (-75) (-75) (-75) (-75) (-75) (-75)
		(-75) (-75) (-75) (-75) (-75) (-75) (-75) (-75) (-75) (-75) (-75) (-75) (-75) (-75) (-75) (-75) (-75) (-75)
		(-75) (-75) (-75) (-75) (-75) (-75) (-75) (-75) (-75) (-75) (-75) (-75) (-75) (-75) (-75) (-75) (-75) (-75)
		(-75) (-75) (-75) (-75) (-75) (-75) (-75) (-75) (-75) (-75) (-75) (-75) (-75) (-75) (-75) (-75) (-75) (-75)
		(-75) (-75) (-75) (-75) (-75) (-75) (-75) (-75) (-75) (-75) (-75) (-75) (-75) (-75) (-75) (-75) (-75) (-75)
		(-75) (-75) (-75) (-75) (-75) (-75) (-75) (-75) (-75) (-75) (-75) (-75) (-75) (-75) (-75) (-75) (-75) (-75)
		(-75) (-75) (-75) (-75) (-75) (-75) (-75) (-75) (-75) (-75) (-75) (-75) (-75) (-75) (-75) (-75) (-75) (-75)
		(-75) (-75) (-75) (-75) (-75) (-75) (-75) (-75) (-75) (-75) (-75) (-75) (-75) (-75) (-75) (-75) (-75) (-75)
		(-75) (-75) (-75) (-75) (-75) (-75) (-75) (-75) (-75) (-75) (-75) (-75) (-75) (-75) (-75) (-75) (-75) (-75)
		(-75) (-75) (-75) (-75) (-75) (-75) (-75) (-75) (-75) (-75) (-75) (-75) (-75) (-75) (-75) (-75) (-75) (-75)
		(-75) (-75) (-75)>;

	/* FDM config */
	FDM_X_Channel = <2>;

	PS_Config_Lmt_FDM_Rawdata_P = <
		900 900
		900 900
		900 900
		900 900
		900 900
		900 900
		900 900
		900 900
		900 900
		900 900
		900 900
		900 900
		900 900
		900 900
		900 900
		900 900
		900 900
		900 900
		900 900
		900 900
		900 900
		900 900
		900 900
		900 900
		900 900
		900 900
		900 900
		900 900
		900 900
		900 900
		900 900
		900 900
		900 900
		900 900
		900 900
		900 900>;

	PS_Config_Lmt_FDM_Rawdata_N = <
		50 50
		50 50
		50 50
		50 50
		50 50
		50 50
		50 50
		50 50
		50 50
		50 50
		50 50
		50 50
		50 50
		50 50
		50 50
		50 50
		50 50
		50 50
		50 50
		50 50
		50 50
		50 50
		50 50
		50 50
		50 50
		50 50
		50 50
		50 50
		50 50
		50 50
		50 50
		50 50
		50 50
		50 50
		50 50
		50 50>;

	PS_Config_FDM_Noise_Test_Frame = <50>;
	PS_Config_Lmt_FDM_Diff_P = <
		180 180
		180 180
		180 180
		180 180
		180 180
		180 180
		180 180
		180 180
		180 180
		180 180
		180 180
		180 180
		180 180
		180 180
		180 180
		180 180
		180 180
		180 180
		180 180
		180 180
		180 180
		180 180
		180 180
		180 180
		180 180
		180 180
		180 180
		180 180
		180 180
		180 180
		180 180
		180 180
		180 180
		180 180
		180 180
		180 180>;

	PS_Config_Lmt_FDM_Diff_N = <
		(-180) (-180)
		(-180) (-180)
		(-180) (-180)
		(-180) (-180)
		(-180) (-180)
		(-180) (-180)
		(-180) (-180)
		(-180) (-180)
		(-180) (-180)
		(-180) (-180)
		(-180) (-180)
		(-180) (-180)
		(-180) (-180)
		(-180) (-180)
		(-180) (-180)
		(-180) (-180)
		(-180) (-180)
		(-180) (-180)
		(-180) (-180)
		(-180) (-180)
		(-180) (-180)
		(-180) (-180)
		(-180) (-180)
		(-180) (-180)
		(-180) (-180)
		(-180) (-180)
		(-180) (-180)
		(-180) (-180)
		(-180) (-180)
		(-180) (-180)
		(-180) (-180)
		(-180) (-180)
		(-180) (-180)
		(-180) (-180)
		(-180) (-180)
		(-180) (-180)>;
};