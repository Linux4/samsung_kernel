&spi2 {
       /*used for touchscreen*/
      sprd,dma-mode = <0>;
       status = "okay";
       touch@0 {
               compatible = "novatek,NVT-ts-spi","himax,hxcommon";
               reg = <0x0>;
               spi-max-frequency = <9600000>;
               interrupt-parent = <&ap_gpio>;
               interrupts = <144 0x2000>;
               novatek,reset-gpio = <&ap_gpio 33 GPIO_ACTIVE_HIGH>;
               novatek,irq-gpio = <&eic_async 0 GPIO_ACTIVE_HIGH>;
               status = "okay";
               /* 672A, 525B, 675, 526, 672C, 523 */
               novatek,swrst-n8-addr = <0x03F0FE>;
               novatek,spi-rd-fast-addr = <0x03F310>;

               /*himax device tree node*/
               himax,panel-coords = <0 1200 0 2000>;
               himax,display-coords = <0 1200 0 2000>;
               himax,irq-gpio = <&eic_async 0 0x2008>;
               himax,rst-gpio = <&ap_gpio 33 0x00>;
               report_type = <1>;

               /* MP */
               novatek,mp-support-dt;
               novatek-mp-criteria-723F@0 {
			   #address-cells = <1>;
			   #size-cells = <0>;
			   compatible = "novatek-mp-criteria-723F";

			   /* MP Config */
			  IC_X_CFG_SIZE = <30>;
			  IC_Y_CFG_SIZE = <48>;
			  IC_KEY_CFG_SIZE = <4>;
			  X_Channel = <30>;
			  Y_Channel = <48>;
			  AIN_X = <0 1 2 3 4 5 6 7 8 9 10 11 12 13 14 15 16 17 18 19 20 21 22 23 24 25 26 27 28 29>;
			  AIN_Y = <0 1 2 3 4 5 6 7 8 9 10 11 12 13 14 15 16 17 18 19 20 21 22 23 24 25 26 27 28 29 30 31 32 33 34 35 36 37 38 39 40 41 42 43 44 45 46 47>;
			  AIN_KEY = <0 1 2 0xFF>;

			/* MP Criteria */
			PS_Config_Lmt_Short_Rawdata_P = <
				14008 14008 14008 14008 14008 14008 14008 14008 14008 14008 14008 14008 14008 14008 14008 14008 14008 14008 14008 14008 14008 14008 14008 14008 14008 14008 14008 14008 14008 14008
				14008 14008 14008 14008 14008 14008 14008 14008 14008 14008 14008 14008 14008 14008 14008 14008 14008 14008 14008 14008 14008 14008 14008 14008 14008 14008 14008 14008 14008 14008
				14008 14008 14008 14008 14008 14008 14008 14008 14008 14008 14008 14008 14008 14008 14008 14008 14008 14008 14008 14008 14008 14008 14008 14008 14008 14008 14008 14008 14008 14008
				14008 14008 14008 14008 14008 14008 14008 14008 14008 14008 14008 14008 14008 14008 14008 14008 14008 14008 14008 14008 14008 14008 14008 14008 14008 14008 14008 14008 14008 14008
				14008 14008 14008 14008 14008 14008 14008 14008 14008 14008 14008 14008 14008 14008 14008 14008 14008 14008 14008 14008 14008 14008 14008 14008 14008 14008 14008 14008 14008 14008
				14008 14008 14008 14008 14008 14008 14008 14008 14008 14008 14008 14008 14008 14008 14008 14008 14008 14008 14008 14008 14008 14008 14008 14008 14008 14008 14008 14008 14008 14008
				14008 14008 14008 14008 14008 14008 14008 14008 14008 14008 14008 14008 14008 14008 14008 14008 14008 14008 14008 14008 14008 14008 14008 14008 14008 14008 14008 14008 14008 14008
				14008 14008 14008 14008 14008 14008 14008 14008 14008 14008 14008 14008 14008 14008 14008 14008 14008 14008 14008 14008 14008 14008 14008 14008 14008 14008 14008 14008 14008 14008
				14008 14008 14008 14008 14008 14008 14008 14008 14008 14008 14008 14008 14008 14008 14008 14008 14008 14008 14008 14008 14008 14008 14008 14008 14008 14008 14008 14008 14008 14008
				14008 14008 14008 14008 14008 14008 14008 14008 14008 14008 14008 14008 14008 14008 14008 14008 14008 14008 14008 14008 14008 14008 14008 14008 14008 14008 14008 14008 14008 14008
				14008 14008 14008 14008 14008 14008 14008 14008 14008 14008 14008 14008 14008 14008 14008 14008 14008 14008 14008 14008 14008 14008 14008 14008 14008 14008 14008 14008 14008 14008
				14008 14008 14008 14008 14008 14008 14008 14008 14008 14008 14008 14008 14008 14008 14008 14008 14008 14008 14008 14008 14008 14008 14008 14008 14008 14008 14008 14008 14008 14008
				14008 14008 14008 14008 14008 14008 14008 14008 14008 14008 14008 14008 14008 14008 14008 14008 14008 14008 14008 14008 14008 14008 14008 14008 14008 14008 14008 14008 14008 14008
				14008 14008 14008 14008 14008 14008 14008 14008 14008 14008 14008 14008 14008 14008 14008 14008 14008 14008 14008 14008 14008 14008 14008 14008 14008 14008 14008 14008 14008 14008
				14008 14008 14008 14008 14008 14008 14008 14008 14008 14008 14008 14008 14008 14008 14008 14008 14008 14008 14008 14008 14008 14008 14008 14008 14008 14008 14008 14008 14008 14008
				14008 14008 14008 14008 14008 14008 14008 14008 14008 14008 14008 14008 14008 14008 14008 14008 14008 14008 14008 14008 14008 14008 14008 14008 14008 14008 14008 14008 14008 14008
				14008 14008 14008 14008 14008 14008 14008 14008 14008 14008 14008 14008 14008 14008 14008 14008 14008 14008 14008 14008 14008 14008 14008 14008 14008 14008 14008 14008 14008 14008
				14008 14008 14008 14008 14008 14008 14008 14008 14008 14008 14008 14008 14008 14008 14008 14008 14008 14008 14008 14008 14008 14008 14008 14008 14008 14008 14008 14008 14008 14008
				14008 14008 14008 14008 14008 14008 14008 14008 14008 14008 14008 14008 14008 14008 14008 14008 14008 14008 14008 14008 14008 14008 14008 14008 14008 14008 14008 14008 14008 14008
				14008 14008 14008 14008 14008 14008 14008 14008 14008 14008 14008 14008 14008 14008 14008 14008 14008 14008 14008 14008 14008 14008 14008 14008 14008 14008 14008 14008 14008 14008
				14008 14008 14008 14008 14008 14008 14008 14008 14008 14008 14008 14008 14008 14008 14008 14008 14008 14008 14008 14008 14008 14008 14008 14008 14008 14008 14008 14008 14008 14008
				14008 14008 14008 14008 14008 14008 14008 14008 14008 14008 14008 14008 14008 14008 14008 14008 14008 14008 14008 14008 14008 14008 14008 14008 14008 14008 14008 14008 14008 14008
				14008 14008 14008 14008 14008 14008 14008 14008 14008 14008 14008 14008 14008 14008 14008 14008 14008 14008 14008 14008 14008 14008 14008 14008 14008 14008 14008 14008 14008 14008
				14008 14008 14008 14008 14008 14008 14008 14008 14008 14008 14008 14008 14008 14008 14008 14008 14008 14008 14008 14008 14008 14008 14008 14008 14008 14008 14008 14008 14008 14008
				14008 14008 14008 14008 14008 14008 14008 14008 14008 14008 14008 14008 14008 14008 14008 14008 14008 14008 14008 14008 14008 14008 14008 14008 14008 14008 14008 14008 14008 14008
				14008 14008 14008 14008 14008 14008 14008 14008 14008 14008 14008 14008 14008 14008 14008 14008 14008 14008 14008 14008 14008 14008 14008 14008 14008 14008 14008 14008 14008 14008
				14008 14008 14008 14008 14008 14008 14008 14008 14008 14008 14008 14008 14008 14008 14008 14008 14008 14008 14008 14008 14008 14008 14008 14008 14008 14008 14008 14008 14008 14008
				14008 14008 14008 14008 14008 14008 14008 14008 14008 14008 14008 14008 14008 14008 14008 14008 14008 14008 14008 14008 14008 14008 14008 14008 14008 14008 14008 14008 14008 14008
				14008 14008 14008 14008 14008 14008 14008 14008 14008 14008 14008 14008 14008 14008 14008 14008 14008 14008 14008 14008 14008 14008 14008 14008 14008 14008 14008 14008 14008 14008
				14008 14008 14008 14008 14008 14008 14008 14008 14008 14008 14008 14008 14008 14008 14008 14008 14008 14008 14008 14008 14008 14008 14008 14008 14008 14008 14008 14008 14008 14008
				14008 14008 14008 14008 14008 14008 14008 14008 14008 14008 14008 14008 14008 14008 14008 14008 14008 14008 14008 14008 14008 14008 14008 14008 14008 14008 14008 14008 14008 14008
				14008 14008 14008 14008 14008 14008 14008 14008 14008 14008 14008 14008 14008 14008 14008 14008 14008 14008 14008 14008 14008 14008 14008 14008 14008 14008 14008 14008 14008 14008
				14008 14008 14008 14008 14008 14008 14008 14008 14008 14008 14008 14008 14008 14008 14008 14008 14008 14008 14008 14008 14008 14008 14008 14008 14008 14008 14008 14008 14008 14008
				14008 14008 14008 14008 14008 14008 14008 14008 14008 14008 14008 14008 14008 14008 14008 14008 14008 14008 14008 14008 14008 14008 14008 14008 14008 14008 14008 14008 14008 14008
				14008 14008 14008 14008 14008 14008 14008 14008 14008 14008 14008 14008 14008 14008 14008 14008 14008 14008 14008 14008 14008 14008 14008 14008 14008 14008 14008 14008 14008 14008
				14008 14008 14008 14008 14008 14008 14008 14008 14008 14008 14008 14008 14008 14008 14008 14008 14008 14008 14008 14008 14008 14008 14008 14008 14008 14008 14008 14008 14008 14008
				14008 14008 14008 14008 14008 14008 14008 14008 14008 14008 14008 14008 14008 14008 14008 14008 14008 14008 14008 14008 14008 14008 14008 14008 14008 14008 14008 14008 14008 14008
				14008 14008 14008 14008 14008 14008 14008 14008 14008 14008 14008 14008 14008 14008 14008 14008 14008 14008 14008 14008 14008 14008 14008 14008 14008 14008 14008 14008 14008 14008
				14008 14008 14008 14008 14008 14008 14008 14008 14008 14008 14008 14008 14008 14008 14008 14008 14008 14008 14008 14008 14008 14008 14008 14008 14008 14008 14008 14008 14008 14008
				14008 14008 14008 14008 14008 14008 14008 14008 14008 14008 14008 14008 14008 14008 14008 14008 14008 14008 14008 14008 14008 14008 14008 14008 14008 14008 14008 14008 14008 14008
				14008 14008 14008 14008 14008 14008 14008 14008 14008 14008 14008 14008 14008 14008 14008 14008 14008 14008 14008 14008 14008 14008 14008 14008 14008 14008 14008 14008 14008 14008
				14008 14008 14008 14008 14008 14008 14008 14008 14008 14008 14008 14008 14008 14008 14008 14008 14008 14008 14008 14008 14008 14008 14008 14008 14008 14008 14008 14008 14008 14008
				14008 14008 14008 14008 14008 14008 14008 14008 14008 14008 14008 14008 14008 14008 14008 14008 14008 14008 14008 14008 14008 14008 14008 14008 14008 14008 14008 14008 14008 14008
				14008 14008 14008 14008 14008 14008 14008 14008 14008 14008 14008 14008 14008 14008 14008 14008 14008 14008 14008 14008 14008 14008 14008 14008 14008 14008 14008 14008 14008 14008
				14008 14008 14008 14008 14008 14008 14008 14008 14008 14008 14008 14008 14008 14008 14008 14008 14008 14008 14008 14008 14008 14008 14008 14008 14008 14008 14008 14008 14008 14008
				14008 14008 14008 14008 14008 14008 14008 14008 14008 14008 14008 14008 14008 14008 14008 14008 14008 14008 14008 14008 14008 14008 14008 14008 14008 14008 14008 14008 14008 14008
				14008 14008 14008 14008 14008 14008 14008 14008 14008 14008 14008 14008 14008 14008 14008 14008 14008 14008 14008 14008 14008 14008 14008 14008 14008 14008 14008 14008 14008 14008
				14008 14008 14008 14008 14008 14008 14008 14008 14008 14008 14008 14008 14008 14008 14008 14008 14008 14008 14008 14008 14008 14008 14008 14008 14008 14008 14008 14008 14008 14008
				14008 14008 14008>;

			PS_Config_Lmt_Short_Rawdata_N = <
				10100 10100 10100 10100 10100 10100 10100 10100 10100 10100 10100 10100 10100 10100 10100 10100 10100 10100 10100 10100 10100 10100 10100 10100 10100 10100 10100 10100 10100 10100
				10100 10100 10100 10100 10100 10100 10100 10100 10100 10100 10100 10100 10100 10100 10100 10100 10100 10100 10100 10100 10100 10100 10100 10100 10100 10100 10100 10100 10100 10100
				10100 10100 10100 10100 10100 10100 10100 10100 10100 10100 10100 10100 10100 10100 10100 10100 10100 10100 10100 10100 10100 10100 10100 10100 10100 10100 10100 10100 10100 10100
				10100 10100 10100 10100 10100 10100 10100 10100 10100 10100 10100 10100 10100 10100 10100 10100 10100 10100 10100 10100 10100 10100 10100 10100 10100 10100 10100 10100 10100 10100
				10100 10100 10100 10100 10100 10100 10100 10100 10100 10100 10100 10100 10100 10100 10100 10100 10100 10100 10100 10100 10100 10100 10100 10100 10100 10100 10100 10100 10100 10100
				10100 10100 10100 10100 10100 10100 10100 10100 10100 10100 10100 10100 10100 10100 10100 10100 10100 10100 10100 10100 10100 10100 10100 10100 10100 10100 10100 10100 10100 10100
				10100 10100 10100 10100 10100 10100 10100 10100 10100 10100 10100 10100 10100 10100 10100 10100 10100 10100 10100 10100 10100 10100 10100 10100 10100 10100 10100 10100 10100 10100
				10100 10100 10100 10100 10100 10100 10100 10100 10100 10100 10100 10100 10100 10100 10100 10100 10100 10100 10100 10100 10100 10100 10100 10100 10100 10100 10100 10100 10100 10100
				10100 10100 10100 10100 10100 10100 10100 10100 10100 10100 10100 10100 10100 10100 10100 10100 10100 10100 10100 10100 10100 10100 10100 10100 10100 10100 10100 10100 10100 10100
				10100 10100 10100 10100 10100 10100 10100 10100 10100 10100 10100 10100 10100 10100 10100 10100 10100 10100 10100 10100 10100 10100 10100 10100 10100 10100 10100 10100 10100 10100
				10100 10100 10100 10100 10100 10100 10100 10100 10100 10100 10100 10100 10100 10100 10100 10100 10100 10100 10100 10100 10100 10100 10100 10100 10100 10100 10100 10100 10100 10100
				10100 10100 10100 10100 10100 10100 10100 10100 10100 10100 10100 10100 10100 10100 10100 10100 10100 10100 10100 10100 10100 10100 10100 10100 10100 10100 10100 10100 10100 10100
				10100 10100 10100 10100 10100 10100 10100 10100 10100 10100 10100 10100 10100 10100 10100 10100 10100 10100 10100 10100 10100 10100 10100 10100 10100 10100 10100 10100 10100 10100
				10100 10100 10100 10100 10100 10100 10100 10100 10100 10100 10100 10100 10100 10100 10100 10100 10100 10100 10100 10100 10100 10100 10100 10100 10100 10100 10100 10100 10100 10100
				10100 10100 10100 10100 10100 10100 10100 10100 10100 10100 10100 10100 10100 10100 10100 10100 10100 10100 10100 10100 10100 10100 10100 10100 10100 10100 10100 10100 10100 10100
				10100 10100 10100 10100 10100 10100 10100 10100 10100 10100 10100 10100 10100 10100 10100 10100 10100 10100 10100 10100 10100 10100 10100 10100 10100 10100 10100 10100 10100 10100
				10100 10100 10100 10100 10100 10100 10100 10100 10100 10100 10100 10100 10100 10100 10100 10100 10100 10100 10100 10100 10100 10100 10100 10100 10100 10100 10100 10100 10100 10100
				10100 10100 10100 10100 10100 10100 10100 10100 10100 10100 10100 10100 10100 10100 10100 10100 10100 10100 10100 10100 10100 10100 10100 10100 10100 10100 10100 10100 10100 10100
				10100 10100 10100 10100 10100 10100 10100 10100 10100 10100 10100 10100 10100 10100 10100 10100 10100 10100 10100 10100 10100 10100 10100 10100 10100 10100 10100 10100 10100 10100
				10100 10100 10100 10100 10100 10100 10100 10100 10100 10100 10100 10100 10100 10100 10100 10100 10100 10100 10100 10100 10100 10100 10100 10100 10100 10100 10100 10100 10100 10100
				10100 10100 10100 10100 10100 10100 10100 10100 10100 10100 10100 10100 10100 10100 10100 10100 10100 10100 10100 10100 10100 10100 10100 10100 10100 10100 10100 10100 10100 10100
				10100 10100 10100 10100 10100 10100 10100 10100 10100 10100 10100 10100 10100 10100 10100 10100 10100 10100 10100 10100 10100 10100 10100 10100 10100 10100 10100 10100 10100 10100
				10100 10100 10100 10100 10100 10100 10100 10100 10100 10100 10100 10100 10100 10100 10100 10100 10100 10100 10100 10100 10100 10100 10100 10100 10100 10100 10100 10100 10100 10100
				10100 10100 10100 10100 10100 10100 10100 10100 10100 10100 10100 10100 10100 10100 10100 10100 10100 10100 10100 10100 10100 10100 10100 10100 10100 10100 10100 10100 10100 10100
				10100 10100 10100 10100 10100 10100 10100 10100 10100 10100 10100 10100 10100 10100 10100 10100 10100 10100 10100 10100 10100 10100 10100 10100 10100 10100 10100 10100 10100 10100
				10100 10100 10100 10100 10100 10100 10100 10100 10100 10100 10100 10100 10100 10100 10100 10100 10100 10100 10100 10100 10100 10100 10100 10100 10100 10100 10100 10100 10100 10100
				10100 10100 10100 10100 10100 10100 10100 10100 10100 10100 10100 10100 10100 10100 10100 10100 10100 10100 10100 10100 10100 10100 10100 10100 10100 10100 10100 10100 10100 10100
				10100 10100 10100 10100 10100 10100 10100 10100 10100 10100 10100 10100 10100 10100 10100 10100 10100 10100 10100 10100 10100 10100 10100 10100 10100 10100 10100 10100 10100 10100
				10100 10100 10100 10100 10100 10100 10100 10100 10100 10100 10100 10100 10100 10100 10100 10100 10100 10100 10100 10100 10100 10100 10100 10100 10100 10100 10100 10100 10100 10100
				10100 10100 10100 10100 10100 10100 10100 10100 10100 10100 10100 10100 10100 10100 10100 10100 10100 10100 10100 10100 10100 10100 10100 10100 10100 10100 10100 10100 10100 10100
				10100 10100 10100 10100 10100 10100 10100 10100 10100 10100 10100 10100 10100 10100 10100 10100 10100 10100 10100 10100 10100 10100 10100 10100 10100 10100 10100 10100 10100 10100
				10100 10100 10100 10100 10100 10100 10100 10100 10100 10100 10100 10100 10100 10100 10100 10100 10100 10100 10100 10100 10100 10100 10100 10100 10100 10100 10100 10100 10100 10100
				10100 10100 10100 10100 10100 10100 10100 10100 10100 10100 10100 10100 10100 10100 10100 10100 10100 10100 10100 10100 10100 10100 10100 10100 10100 10100 10100 10100 10100 10100
				10100 10100 10100 10100 10100 10100 10100 10100 10100 10100 10100 10100 10100 10100 10100 10100 10100 10100 10100 10100 10100 10100 10100 10100 10100 10100 10100 10100 10100 10100
				10100 10100 10100 10100 10100 10100 10100 10100 10100 10100 10100 10100 10100 10100 10100 10100 10100 10100 10100 10100 10100 10100 10100 10100 10100 10100 10100 10100 10100 10100
				10100 10100 10100 10100 10100 10100 10100 10100 10100 10100 10100 10100 10100 10100 10100 10100 10100 10100 10100 10100 10100 10100 10100 10100 10100 10100 10100 10100 10100 10100
				10100 10100 10100 10100 10100 10100 10100 10100 10100 10100 10100 10100 10100 10100 10100 10100 10100 10100 10100 10100 10100 10100 10100 10100 10100 10100 10100 10100 10100 10100
				10100 10100 10100 10100 10100 10100 10100 10100 10100 10100 10100 10100 10100 10100 10100 10100 10100 10100 10100 10100 10100 10100 10100 10100 10100 10100 10100 10100 10100 10100
				10100 10100 10100 10100 10100 10100 10100 10100 10100 10100 10100 10100 10100 10100 10100 10100 10100 10100 10100 10100 10100 10100 10100 10100 10100 10100 10100 10100 10100 10100
				10100 10100 10100 10100 10100 10100 10100 10100 10100 10100 10100 10100 10100 10100 10100 10100 10100 10100 10100 10100 10100 10100 10100 10100 10100 10100 10100 10100 10100 10100
				10100 10100 10100 10100 10100 10100 10100 10100 10100 10100 10100 10100 10100 10100 10100 10100 10100 10100 10100 10100 10100 10100 10100 10100 10100 10100 10100 10100 10100 10100
				10100 10100 10100 10100 10100 10100 10100 10100 10100 10100 10100 10100 10100 10100 10100 10100 10100 10100 10100 10100 10100 10100 10100 10100 10100 10100 10100 10100 10100 10100
				10100 10100 10100 10100 10100 10100 10100 10100 10100 10100 10100 10100 10100 10100 10100 10100 10100 10100 10100 10100 10100 10100 10100 10100 10100 10100 10100 10100 10100 10100
				10100 10100 10100 10100 10100 10100 10100 10100 10100 10100 10100 10100 10100 10100 10100 10100 10100 10100 10100 10100 10100 10100 10100 10100 10100 10100 10100 10100 10100 10100
				10100 10100 10100 10100 10100 10100 10100 10100 10100 10100 10100 10100 10100 10100 10100 10100 10100 10100 10100 10100 10100 10100 10100 10100 10100 10100 10100 10100 10100 10100
				10100 10100 10100 10100 10100 10100 10100 10100 10100 10100 10100 10100 10100 10100 10100 10100 10100 10100 10100 10100 10100 10100 10100 10100 10100 10100 10100 10100 10100 10100
				10100 10100 10100 10100 10100 10100 10100 10100 10100 10100 10100 10100 10100 10100 10100 10100 10100 10100 10100 10100 10100 10100 10100 10100 10100 10100 10100 10100 10100 10100
				10100 10100 10100 10100 10100 10100 10100 10100 10100 10100 10100 10100 10100 10100 10100 10100 10100 10100 10100 10100 10100 10100 10100 10100 10100 10100 10100 10100 10100 10100
				10000 10000 10000>;

			PS_Config_Lmt_Open_Rawdata_P = <
				3880	4074	4037	4012	3960	3913	3857	3635	3816	3865	3918	3957	3981	4018	3978	3939	4156	4127	4100	4048	3998	3941	3698	4079	4128	4186	4228	4256	4302	4319
				3866	4043	4008	3980	3925	3880	3815	3612	3782	3830	3879	3927	3953	3984	3950	3892	4103	4076	4051	3995	3946	3883	3686	3976	4027	4079	4128	4162	4207	4230
				3871	4033	3990	3966	3900	3851	3791	3522	3708	3756	3803	3850	3887	3917	3873	3952	4151	4121	4099	4036	3988	3924	3617	3948	3999	4051	4102	4142	4187	4215
				3792	3953	3911	3878	3823	3773	3717	3596	3764	3812	3864	3913	3953	3980	3941	3872	4075	4041	4009	3952	3897	3840	3642	3966	4013	4068	4120	4160	4201	4219
				3864	4018	3974	3934	3880	3827	3774	3537	3700	3745	3795	3848	3889	3915	3871	3900	4099	4068	4030	3971	3918	3861	3585	3935	3984	4041	4100	4144	4184	4201
				3809	3956	3922	3879	3820	3771	3710	3558	3756	3803	3857	3908	3956	3974	3936	3834	4022	3995	3953	3893	3845	3780	3609	3998	4043	4102	4153	4204	4236	4268
				3822	3959	3918	3875	3815	3767	3698	3504	3649	3703	3753	3795	3851	3869	3833	3857	4036	4012	3969	3910	3861	3792	3574	3876	3931	3984	4029	4089	4125	4148
				3844	3981	3941	3893	3840	3788	3714	3512	3715	3768	3824	3865	3917	3943	3904	3894	4074	4044	3998	3945	3896	3824	3619	3935	3992	4047	4090	4142	4187	4218
				3777	3910	3865	3815	3760	3703	3651	3481	3655	3708	3754	3803	3848	3882	3848	3829	4009	3978	3932	3879	3817	3767	3564	3873	3929	3981	4033	4079	4135	4158
				3848	3977	3938	3885	3831	3771	3721	3396	3689	3745	3792	3841	3887	3921	3886	3866	4044	4015	3967	3918	3852	3802	3465	3894	3953	4005	4055	4110	4162	4187
				3803	3932	3889	3834	3766	3722	3669	3417	3669	3715	3768	3803	3865	3901	3865	3816	3988	3959	3907	3847	3792	3742	3467	3845	3896	3953	3999	4061	4104	4124
				3837	3953	3924	3862	3796	3757	3694	3409	3609	3658	3714	3754	3824	3848	3815	3841	4006	3987	3929	3872	3829	3767	3488	3862	3911	3969	4009	4082	4120	4144
				3774	3886	3851	3785	3725	3684	3624	3364	3613	3668	3718	3750	3830	3857	3810	3801	3962	3931	3869	3805	3771	3710	3474	3822	3880	3936	3964	4055	4100	4110
				3781	3893	3857	3784	3740	3689	3623	3368	3575	3631	3673	3721	3789	3820	3773	3855	4012	3985	3911	3871	3819	3752	3453	3822	3882	3924	3977	4048	4096	4103
				3753	3859	3819	3732	3700	3654	3585	3357	3627	3686	3718	3780	3848	3868	3829	3817	3969	3939	3859	3823	3774	3707	3462	3869	3928	3963	4030	4102	4138	4155
				3764	3864	3823	3746	3703	3645	3588	3341	3570	3609	3642	3717	3789	3808	3771	3836	3980	3943	3868	3834	3780	3718	3417	3808	3862	3903	3969	4043	4076	4089
				3767	3866	3812	3745	3696	3637	3577	3344	3547	3579	3647	3696	3773	3802	3760	3827	3967	3921	3855	3806	3747	3686	3442	3761	3798	3868	3920	4002	4044	4057
				3732	3812	3767	3701	3641	3596	3537	3297	3549	3585	3648	3696	3778	3805	3766	3794	3913	3875	3816	3754	3708	3651	3358	3816	3861	3927	3976	4061	4106	4113
				3742	3808	3768	3700	3641	3592	3536	3308	3507	3554	3613	3659	3740	3774	3733	3777	3876	3857	3787	3725	3676	3620	3438	3757	3801	3872	3922	4005	4058	4068
				3707	3777	3742	3661	3612	3563	3497	3277	3502	3572	3624	3670	3754	3794	3754	3778	3890	3855	3782	3733	3682	3616	3364	3739	3802	3859	3906	3990	4046	4051
				3698	3754	3725	3645	3595	3549	3484	3267	3439	3516	3565	3612	3690	3732	3679	3752	3858	3824	3750	3698	3651	3585	3381	3708	3788	3841	3893	3974	4029	4027
				3719	3798	3743	3665	3614	3556	3507	3238	3511	3564	3614	3661	3742	3782	3722	3822	3935	3886	3808	3757	3700	3647	3306	3724	3785	3840	3889	3974	4034	4026
				3687	3756	3691	3609	3558	3500	3444	3201	3448	3501	3549	3603	3668	3717	3666	3732	3834	3782	3705	3656	3599	3543	3309	3707	3766	3820	3879	3949	4011	4006
				3714	3777	3715	3635	3577	3530	3476	3189	3418	3470	3523	3581	3659	3697	3631	3787	3866	3822	3745	3686	3638	3586	3264	3710	3766	3820	3880	3962	4018	4001
				3651	3691	3605	3539	3479	3432	3382	3367	3434	3488	3546	3589	3670	3739	3658	3705	3771	3697	3640	3578	3528	3477	3655	3697	3754	3816	3866	3946	4032	3994
				3679	3719	3630	3551	3500	3455	3397	3350	3353	3396	3456	3504	3581	3652	3563	3707	3780	3704	3627	3581	3533	3476	3602	3633	3689	3753	3802	3882	3969	3918
				3680	3710	3617	3539	3488	3441	3385	3297	3334	3381	3441	3487	3567	3642	3537	3738	3796	3714	3637	3592	3544	3486	3574	3607	3665	3732	3781	3861	3952	3890
				3617	3642	3553	3473	3427	3376	3319	3341	3369	3427	3476	3523	3599	3679	3558	3721	3771	3687	3607	3560	3507	3449	3596	3607	3676	3728	3778	3857	3953	3873
				3640	3651	3551	3477	3428	3376	3301	3270	3297	3361	3410	3462	3533	3596	3519	3711	3749	3661	3585	3537	3483	3411	3564	3537	3610	3663	3721	3792	3864	3841
				3640	3635	3547	3466	3414	3362	3292	3305	3312	3361	3409	3467	3542	3598	3522	3731	3753	3673	3593	3544	3487	3420	3585	3606	3668	3719	3781	3862	3921	3904
				3621	3616	3523	3449	3399	3340	3271	3252	3280	3334	3396	3441	3516	3579	3497	3682	3700	3617	3543	3494	3437	3375	3533	3533	3592	3661	3710	3789	3861	3833
				3617	3600	3514	3439	3383	3316	3285	3179	3271	3330	3388	3431	3490	3585	3486	3705	3715	3635	3564	3509	3448	3407	3459	3549	3613	3675	3725	3789	3896	3830
				3536	3522	3441	3365	3309	3238	3210	3123	3222	3288	3336	3382	3428	3533	3427	3584	3592	3512	3445	3395	3315	3297	3365	3473	3543	3598	3651	3700	3823	3760
				3540	3535	3432	3357	3312	3255	3211	3124	3194	3260	3311	3358	3438	3514	3404	3663	3675	3585	3507	3463	3399	3357	3417	3456	3528	3578	3630	3696	3798	3729
				3508	3501	3414	3326	3270	3231	3175	3087	3189	3255	3304	3325	3427	3507	3390	3586	3599	3518	3430	3365	3334	3277	3360	3417	3487	3542	3570	3666	3759	3684
				3498	3487	3400	3326	3242	3220	3178	3089	3179	3235	3281	3305	3407	3483	3361	3605	3612	3533	3460	3388	3354	3311	3357	3389	3452	3507	3539	3635	3724	3641
				3481	3449	3365	3267	3229	3189	3143	3025	3200	3252	3292	3348	3428	3500	3383	3547	3535	3459	3374	3332	3284	3239	3323	3423	3479	3519	3589	3670	3754	3686
				3446	3417	3333	3236	3210	3165	3106	3078	3148	3200	3236	3306	3378	3459	3329	3547	3539	3458	3364	3334	3288	3232	3323	3382	3438	3463	3553	3627	3717	3635
				3434	3396	3312	3211	3185	3147	3091	3017	3165	3215	3246	3322	3396	3473	3343	3502	3493	3414	3323	3297	3255	3197	3298	3392	3451	3500	3568	3642	3733	3649
				3431	3392	3292	3238	3201	3147	3094	2933	3091	3130	3201	3253	3325	3399	3274	3505	3486	3389	3333	3295	3245	3189	3204	3337	3382	3460	3518	3591	3679	3586
				3423	3390	3252	3222	3182	3130	3071	2903	3063	3105	3175	3234	3308	3378	3263	3509	3497	3385	3336	3298	3246	3190	3185	3320	3357	3439	3504	3577	3656	3572
				3410	3364	3281	3214	3166	3108	3059	2965	3120	3169	3236	3294	3368	3441	3316	3477	3455	3368	3306	3260	3203	3155	3192	3320	3390	3451	3512	3586	3675	3585
				3374	3315	3243	3172	3122	3068	3026	2914	3068	3131	3183	3235	3305	3379	3255	3490	3439	3386	3319	3270	3214	3169	3143	3263	3346	3403	3458	3533	3617	3516
				3403	3325	3284	3211	3161	3112	3066	2892	3021	3105	3158	3218	3287	3358	3234	3448	3399	3351	3278	3228	3179	3131	3131	3246	3326	3386	3449	3516	3600	3494
				3315	3281	3199	3130	3077	3035	2983	2828	3005	3080	3127	3186	3256	3329	3190	3402	3385	3320	3249	3200	3155	3101	3095	3241	3315	3371	3434	3504	3593	3472
				3312	3297	3214	3144	3095	3047	2996	2837	3025	3082	3137	3186	3262	3333	3189	3421	3420	3344	3271	3225	3175	3120	3087	3249	3312	3374	3430	3505	3586	3459
				3270	3242	3159	3089	3043	2987	2933	2802	2990	3050	3099	3154	3232	3298	3148	3330	3327	3250	3183	3137	3084	3032	3046	3203	3264	3322	3382	3455	3535	3386
				3305	3276	3193	3122	3077	3025	2973	2779	2954	3001	3049	3109	3182	3249	3095	3400	3385	3304	3232	3186	3131	3087	3042	3196	3252	3308	3369	3444	3522	3367
				5120 5120 5120>;

			PS_Config_Lmt_Open_Rawdata_N = <
				1663	1746	1730	1719	1697	1677	1653	1558	1635	1656	1679	1696	1706	1722	1705	1688	1781	1768	1757	1735	1713	1689	1585	1748	1769	1794	1812	1824	1843	1851
				1657	1732	1717	1705	1682	1663	1635	1548	1621	1641	1662	1683	1694	1707	1693	1668	1758	1747	1736	1712	1691	1664	1579	1704	1726	1748	1769	1783	1803	1813
				1659	1728	1710	1699	1671	1650	1624	1509	1589	1609	1630	1650	1666	1678	1660	1693	1779	1766	1756	1729	1709	1681	1550	1692	1714	1736	1758	1775	1794	1806
				1625	1694	1676	1662	1638	1617	1593	1541	1613	1633	1656	1677	1694	1705	1689	1659	1746	1732	1718	1693	1670	1645	1561	1699	1720	1743	1765	1783	1800	1808
				1656	1722	1703	1686	1663	1640	1617	1516	1585	1605	1626	1649	1666	1678	1659	1671	1756	1743	1727	1702	1679	1654	1536	1686	1707	1732	1757	1776	1793	1800
				1632	1695	1681	1662	1637	1616	1590	1525	1609	1630	1653	1675	1695	1703	1687	1643	1723	1712	1694	1668	1648	1620	1546	1713	1732	1758	1780	1801	1815	1829
				1638	1696	1679	1660	1635	1614	1585	1501	1564	1587	1608	1626	1650	1658	1642	1653	1729	1719	1701	1675	1654	1625	1531	1661	1684	1707	1726	1752	1768	1777
				1647	1706	1689	1668	1645	1623	1591	1505	1592	1615	1639	1656	1678	1690	1673	1669	1746	1733	1713	1690	1669	1639	1551	1686	1711	1734	1753	1775	1794	1807
				1618	1675	1656	1635	1611	1587	1564	1492	1566	1589	1609	1630	1649	1663	1649	1641	1718	1705	1685	1662	1636	1614	1527	1660	1684	1706	1728	1748	1772	1782
				1649	1704	1687	1665	1642	1616	1594	1455	1581	1605	1625	1646	1666	1680	1665	1657	1733	1720	1700	1679	1651	1629	1485	1669	1694	1716	1738	1761	1783	1794
				1630	1685	1666	1643	1614	1595	1572	1464	1572	1592	1615	1630	1656	1672	1656	1635	1709	1696	1674	1648	1625	1603	1486	1648	1669	1694	1714	1740	1759	1767
				1644	1694	1681	1655	1627	1610	1583	1461	1546	1567	1591	1609	1639	1649	1635	1646	1717	1708	1684	1659	1641	1614	1495	1655	1676	1701	1718	1749	1765	1776
				1617	1665	1650	1622	1596	1579	1553	1441	1548	1572	1593	1607	1641	1653	1633	1629	1698	1684	1658	1630	1616	1590	1489	1638	1663	1687	1699	1738	1757	1761
				1620	1668	1653	1621	1603	1581	1552	1443	1532	1556	1574	1594	1624	1637	1617	1652	1719	1708	1676	1659	1636	1608	1480	1638	1663	1681	1704	1735	1755	1758
				1608	1654	1636	1599	1585	1566	1536	1438	1554	1579	1593	1620	1649	1657	1641	1636	1701	1688	1654	1638	1617	1588	1483	1658	1683	1698	1727	1758	1773	1780
				1613	1656	1638	1605	1587	1562	1537	1432	1530	1546	1561	1593	1624	1632	1616	1644	1705	1690	1657	1643	1620	1593	1464	1632	1655	1672	1701	1732	1747	1752
				1614	1657	1633	1605	1584	1558	1533	1433	1520	1534	1563	1584	1617	1629	1611	1640	1700	1680	1652	1631	1606	1579	1475	1612	1627	1657	1680	1715	1733	1738
				1599	1633	1614	1586	1560	1541	1516	1413	1521	1536	1563	1584	1619	1630	1614	1626	1677	1660	1635	1609	1589	1564	1439	1635	1654	1683	1704	1740	1759	1762
				1603	1632	1615	1585	1560	1539	1515	1417	1503	1523	1548	1568	1603	1617	1600	1618	1661	1653	1623	1596	1575	1551	1473	1610	1629	1659	1681	1716	1739	1743
				1588	1618	1603	1569	1548	1527	1498	1404	1501	1531	1553	1573	1609	1626	1609	1619	1667	1652	1621	1600	1578	1549	1441	1602	1629	1654	1674	1710	1734	1736
				1585	1609	1596	1562	1540	1521	1493	1400	1474	1507	1528	1548	1581	1599	1576	1608	1653	1639	1607	1585	1564	1536	1449	1589	1623	1646	1668	1703	1726	1726
				1594	1627	1604	1570	1549	1524	1503	1387	1504	1527	1549	1569	1603	1621	1595	1638	1686	1665	1632	1610	1585	1563	1417	1596	1622	1645	1666	1703	1729	1725
				1580	1609	1582	1546	1525	1500	1476	1372	1477	1500	1521	1544	1572	1593	1571	1599	1643	1621	1588	1567	1542	1518	1418	1588	1614	1637	1662	1692	1719	1717
				1591	1618	1592	1558	1533	1513	1489	1366	1465	1487	1510	1534	1568	1584	1556	1623	1657	1638	1605	1579	1559	1537	1399	1590	1614	1637	1663	1698	1722	1714
				1564	1582	1545	1516	1491	1471	1449	1443	1471	1495	1519	1538	1573	1602	1567	1588	1616	1584	1560	1533	1512	1490	1566	1584	1609	1635	1657	1691	1728	1711
				1576	1594	1555	1522	1500	1480	1456	1435	1437	1455	1481	1501	1534	1565	1527	1588	1620	1587	1554	1534	1514	1489	1543	1557	1581	1608	1629	1663	1701	1679
				1577	1590	1550	1516	1495	1474	1450	1413	1429	1449	1474	1494	1528	1561	1516	1602	1627	1591	1558	1539	1519	1494	1531	1546	1570	1599	1620	1654	1693	1667
				1550	1561	1522	1488	1468	1447	1422	1432	1444	1468	1489	1510	1542	1576	1525	1594	1616	1580	1546	1525	1503	1478	1541	1546	1575	1597	1619	1653	1694	1660
				1560	1564	1522	1490	1469	1447	1414	1401	1413	1440	1461	1483	1514	1541	1508	1590	1606	1569	1536	1516	1492	1462	1527	1516	1547	1570	1594	1625	1656	1646
				1560	1558	1520	1485	1463	1441	1411	1416	1419	1440	1461	1486	1518	1542	1509	1599	1608	1574	1540	1519	1494	1465	1536	1545	1572	1594	1620	1655	1680	1673
				1552	1549	1510	1478	1456	1431	1402	1393	1405	1429	1455	1474	1507	1534	1498	1578	1585	1550	1518	1497	1473	1446	1514	1514	1539	1569	1590	1624	1654	1642
				1550	1543	1506	1474	1450	1421	1408	1362	1402	1427	1452	1470	1495	1536	1494	1588	1592	1558	1527	1504	1477	1460	1482	1521	1548	1575	1596	1624	1669	1641
				1515	1509	1474	1442	1418	1387	1375	1338	1381	1409	1429	1449	1469	1514	1468	1536	1539	1505	1476	1455	1420	1413	1442	1488	1518	1542	1564	1585	1638	1611
				1517	1515	1471	1438	1419	1395	1376	1339	1369	1397	1419	1439	1473	1506	1459	1570	1575	1536	1503	1484	1456	1438	1464	1481	1512	1533	1555	1584	1627	1598
				1503	1500	1463	1425	1401	1384	1360	1323	1366	1395	1416	1425	1468	1503	1453	1537	1542	1507	1470	1442	1429	1404	1440	1464	1494	1518	1530	1571	1611	1579
				1499	1494	1457	1425	1389	1380	1362	1324	1362	1386	1406	1416	1460	1492	1440	1545	1548	1514	1483	1452	1437	1419	1438	1452	1479	1503	1516	1558	1596	1560
				1492	1478	1442	1400	1384	1366	1347	1296	1371	1393	1411	1435	1469	1500	1450	1520	1515	1482	1446	1428	1407	1388	1424	1467	1491	1508	1538	1573	1609	1579
				1477	1464	1428	1387	1375	1356	1331	1319	1349	1371	1387	1417	1447	1482	1426	1520	1516	1482	1441	1429	1409	1385	1424	1449	1473	1484	1522	1554	1593	1558
				1471	1455	1419	1376	1365	1348	1324	1293	1356	1378	1391	1423	1455	1488	1432	1501	1497	1463	1424	1413	1395	1370	1413	1453	1479	1500	1529	1561	1600	1564
				1470	1453	1411	1387	1372	1348	1326	1257	1324	1341	1372	1394	1425	1456	1403	1502	1494	1452	1428	1412	1390	1366	1373	1430	1449	1483	1507	1539	1576	1537
				1467	1453	1393	1381	1363	1341	1316	1244	1312	1330	1360	1386	1417	1447	1398	1504	1498	1450	1429	1413	1391	1367	1365	1423	1438	1474	1501	1533	1567	1531
				1461	1441	1406	1377	1357	1332	1311	1270	1337	1358	1387	1411	1443	1474	1421	1490	1480	1443	1417	1397	1372	1352	1368	1423	1453	1479	1505	1537	1575	1536
				1446	1420	1390	1359	1338	1315	1297	1249	1315	1342	1364	1386	1416	1448	1395	1495	1474	1451	1422	1401	1377	1358	1347	1398	1434	1458	1482	1514	1550	1507
				1458	1425	1407	1376	1354	1333	1314	1239	1294	1330	1353	1379	1408	1439	1386	1477	1456	1436	1405	1383	1362	1342	1342	1391	1425	1451	1478	1507	1543	1497
				1420	1406	1371	1341	1318	1300	1278	1212	1288	1320	1340	1365	1395	1426	1367	1458	1450	1423	1392	1371	1352	1329	1326	1389	1420	1444	1471	1501	1540	1488
				1419	1413	1377	1347	1326	1306	1284	1216	1296	1321	1344	1365	1398	1428	1366	1466	1465	1433	1402	1382	1360	1337	1323	1392	1419	1446	1470	1502	1537	1482
				1401	1389	1354	1324	1304	1280	1257	1201	1281	1307	1328	1351	1385	1413	1349	1427	1426	1393	1364	1344	1321	1299	1305	1372	1399	1423	1449	1480	1515	1451
				1416	1404	1368	1338	1318	1296	1274	1191	1266	1286	1306	1332	1363	1392	1326	1457	1450	1416	1385	1365	1342	1323	1303	1369	1393	1417	1444	1476	1509	1443
				(-511) (-511) (-511)>;

			PS_Config_Lmt_FW_Rawdata_P = <
				1124	1118	1108	1107	1110	1103	1100	1141	1128	1118	1121	1111	1113	1115	1115	1134	1129	1134	1132	1127	1131	1115	1122	1118	1121	1122	1120	1114	1115	1131
				1124	1125	1128	1131	1131	1136	1131	1128	1115	1118	1115	1110	1106	1110	1107	1124	1125	1127	1120	1128	1131	1122	1121	1117	1121	1122	1120	1115	1120	1125
				1131	1141	1124	1103	1106	1106	1097	1136	1121	1114	1113	1114	1107	1108	1113	1143	1094	1093	1087	1089	1093	1094	1115	1106	1110	1108	1107	1111	1118	1108
				1135	1125	1127	1117	1115	1110	1117	1131	1111	1111	1110	1107	1106	1114	1121	1114	1122	1115	1127	1125	1127	1127	1121	1108	1113	1108	1115	1127	1128	1134
				1117	1117	1111	1107	1103	1104	1113	1125	1129	1135	1135	1131	1129	1127	1125	1132	1135	1138	1128	1104	1111	1113	1129	1117	1114	1107	1110	1121	1125	1122
				1113	1117	1106	1108	1108	1110	1106	1136	1108	1115	1114	1113	1106	1121	1122	1120	1117	1128	1131	1124	1120	1113	1120	1114	1111	1113	1107	1106	1103	1107
				1120	1141	1124	1121	1124	1118	1103	1125	1099	1103	1100	1101	1097	1101	1103	1117	1132	1141	1134	1128	1134	1117	1115	1115	1106	1107	1110	1106	1104	1104
				1114	1132	1132	1129	1131	1135	1132	1125	1104	1113	1120	1107	1115	1114	1124	1135	1117	1120	1121	1117	1117	1124	1124	1124	1135	1135	1132	1124	1124	1125
				1128	1121	1138	1134	1135	1134	1132	1143	1118	1115	1113	1114	1120	1118	1111	1142	1117	1121	1127	1128	1128	1136	1113	1120	1111	1117	1115	1104	1115	1122
				1120	1111	1122	1124	1128	1128	1128	1121	1114	1113	1111	1113	1111	1114	1111	1124	1113	1124	1132	1129	1131	1129	1125	1107	1104	1103	1103	1121	1113	1120
				1124	1110	1120	1127	1129	1138	1138	1106	1103	1111	1111	1094	1107	1129	1139	1110	1118	1110	1107	1106	1108	1110	1118	1111	1118	1121	1124	1127	1127	1122
				1117	1113	1128	1124	1129	1129	1132	1136	1113	1111	1114	1117	1115	1118	1118	1138	1124	1138	1136	1132	1132	1134	1124	1110	1113	1114	1120	1117	1118	1131
				1107	1121	1131	1139	1138	1129	1121	1124	1115	1114	1117	1120	1110	1111	1118	1114	1120	1110	1111	1113	1107	1111	1131	1107	1108	1108	1108	1104	1118	1113
				1124	1104	1113	1108	1117	1113	1115	1115	1124	1128	1127	1128	1128	1127	1125	1121	1118	1120	1120	1124	1121	1125	1099	1106	1100	1103	1108	1099	1138	1122
				1117	1128	1121	1124	1114	1117	1118	1113	1125	1118	1108	1108	1115	1134	1142	1127	1127	1110	1115	1113	1106	1113	1128	1132	1128	1134	1125	1122	1106	1110
				1122	1128	1129	1122	1122	1128	1120	1110	1120	1118	1120	1125	1128	1113	1120	1125	1124	1108	1107	1108	1113	1107	1114	1121	1118	1121	1115	1118	1125	1124
				1121	1118	1128	1132	1129	1124	1128	1114	1131	1136	1128	1134	1129	1127	1132	1114	1103	1117	1114	1113	1114	1114	1107	1142	1141	1139	1136	1136	1131	1131
				1115	1118	1117	1115	1120	1122	1113	1120	1132	1129	1124	1107	1099	1118	1138	1104	1106	1117	1118	1115	1115	1118	1120	1125	1129	1132	1131	1127	1124	1122
				1111	1117	1122	1121	1121	1118	1125	1134	1125	1120	1122	1115	1124	1118	1124	1132	1129	1125	1124	1121	1122	1113	1131	1113	1108	1110	1110	1115	1113	1115
				1127	1114	1120	1122	1118	1122	1121	1107	1117	1121	1118	1124	1114	1122	1125	1115	1118	1131	1128	1127	1125	1127	1113	1117	1114	1114	1114	1117	1101	1100
				1127	1134	1131	1127	1129	1129	1128	1122	1108	1110	1113	1120	1115	1115	1111	1122	1107	1104	1110	1107	1108	1104	1129	1127	1124	1124	1125	1125	1121	1120
				1125	1114	1114	1107	1110	1114	1117	1134	1110	1115	1110	1113	1114	1111	1124	1118	1122	1118	1122	1125	1129	1127	1134	1125	1122	1121	1122	1118	1122	1125
				1121	1124	1128	1142	1138	1129	1135	1113	1132	1131	1127	1125	1129	1128	1108	1110	1110	1107	1113	1110	1104	1111	1128	1110	1111	1108	1103	1107	1108	1114
				1132	1132	1124	1115	1132	1131	1135	1115	1111	1117	1117	1124	1127	1121	1115	1122	1132	1132	1139	1128	1129	1132	1113	1111	1121	1117	1114	1120	1120	1125
				1120	1115	1115	1120	1129	1129	1124	1104	1124	1122	1125	1127	1121	1124	1128	1108	1110	1108	1104	1101	1103	1106	1115	1127	1125	1127	1122	1134	1128	1110
				1099	1100	1114	1120	1124	1113	1117	1121	1108	1104	1107	1114	1118	1122	1120	1113	1110	1108	1115	1122	1121	1115	1121	1114	1115	1121	1127	1124	1122	1120
				1106	1100	1101	1108	1120	1106	1103	1120	1135	1138	1129	1120	1111	1114	1111	1141	1132	1135	1128	1131	1127	1132	1111	1127	1122	1125	1125	1128	1127	1107
				1135	1138	1134	1131	1125	1125	1127	1127	1134	1129	1131	1122	1121	1111	1117	1107	1111	1121	1132	1131	1125	1122	1129	1127	1127	1127	1131	1118	1122	1127
				1124	1121	1122	1106	1111	1113	1108	1108	1117	1114	1114	1117	1121	1128	1127	1121	1121	1120	1124	1129	1139	1127	1108	1128	1127	1117	1099	1100	1094	1136
				1138	1131	1128	1121	1124	1120	1128	1108	1134	1132	1129	1121	1108	1101	1103	1122	1121	1125	1125	1124	1120	1120	1117	1115	1124	1118	1120	1114	1120	1106
				1106	1111	1113	1110	1129	1125	1120	1108	1122	1114	1121	1120	1125	1128	1125	1136	1134	1125	1127	1121	1122	1127	1121	1093	1093	1093	1096	1100	1101	1114
				1128	1127	1120	1118	1113	1115	1111	1113	1134	1132	1134	1121	1118	1111	1111	1124	1118	1111	1111	1110	1110	1111	1103	1128	1127	1128	1131	1128	1125	1122
				1122	1115	1107	1104	1101	1100	1097	1120	1117	1121	1120	1108	1117	1120	1124	1124	1122	1117	1114	1111	1107	1117	1120	1115	1120	1115	1114	1113	1113	1120
				1129	1125	1135	1132	1128	1131	1118	1134	1113	1111	1110	1110	1113	1117	1122	1114	1117	1128	1131	1135	1135	1129	1118	1110	1101	1111	1100	1101	1103	1115
				1139	1132	1128	1124	1120	1118	1122	1118	1110	1110	1108	1120	1118	1122	1127	1121	1121	1120	1118	1121	1115	1121	1120	1128	1131	1132	1132	1135	1129	1121
				1114	1104	1103	1100	1100	1104	1103	1132	1131	1135	1138	1131	1122	1113	1110	1111	1106	1113	1128	1132	1136	1132	1139	1104	1115	1124	1120	1113	1113	1124
				1121	1118	1129	1135	1132	1135	1129	1113	1125	1122	1124	1134	1142	1131	1121	1134	1124	1121	1117	1110	1108	1114	1125	1108	1117	1103	1110	1113	1113	1104
				1110	1121	1127	1127	1114	1115	1113	1108	1135	1129	1132	1131	1138	1120	1107	1141	1127	1121	1121	1110	1110	1108	1134	1111	1110	1111	1110	1113	1117	1136
				1132	1120	1110	1110	1100	1097	1103	1117	1150	1150	1146	1136	1117	1113	1122	1115	1107	1111	1117	1124	1132	1125	1118	1124	1129	1131	1127	1131	1129	1129
				1118	1128	1124	1120	1113	1117	1115	1115	1132	1132	1134	1139	1146	1124	1122	1128	1118	1128	1121	1121	1118	1117	1113	1120	1120	1115	1114	1118	1122	1117
				1120	1128	1125	1120	1124	1125	1121	1136	1111	1113	1117	1125	1120	1124	1117	1114	1121	1128	1132	1128	1141	1131	1121	1110	1129	1120	1111	1114	1113	1124
				1124	1110	1111	1111	1120	1120	1107	1117	1128	1122	1114	1127	1107	1107	1117	1131	1129	1122	1115	1120	1115	1121	1128	1136	1135	1139	1138	1136	1141	1124
				1127	1115	1120	1132	1125	1127	1131	1117	1107	1106	1117	1117	1118	1118	1127	1128	1120	1124	1127	1131	1122	1120	1125	1132	1132	1134	1129	1129	1132	1120
				1125	1127	1127	1129	1128	1125	1129	1136	1107	1107	1106	1117	1121	1122	1127	1117	1097	1110	1127	1129	1129	1134	1127	1127	1131	1132	1121	1131	1128	1121
				1127	1125	1117	1117	1113	1120	1117	1110	1125	1124	1129	1121	1128	1125	1120	1148	1136	1124	1121	1114	1108	1108	1125	1120	1118	1120	1124	1127	1129	1107
				1132	1122	1125	1121	1114	1118	1118	1118	1128	1131	1128	1125	1120	1118	1111	1120	1118	1113	1106	1106	1104	1110	1128	1127	1134	1129	1128	1128	1117	1121
				1117	1122	1122	1120	1128	1136	1132	1114	1124	1124	1125	1124	1129	1128	1117	1122	1114	1103	1104	1113	1121	1114	1104	1101	1104	1103	1100	1106	1111	1111
				1131	1139	1135	1127	1114	1108	1122	1120	1129	1127	1115	1094	1096	1100	1139	1117	1111	1111	1114	1125	1143	1128	1120	1113	1114	1118	1110	1114	1115	1125
				3840 3840 3840>;

			PS_Config_Lmt_FW_Rawdata_N = <
				481	479	475	474	475	472	471	489	483	479	480	476	477	478	478	486	484	486	485	483	484	478	481	479	480	481	480	477	478	484
				481	482	483	484	484	487	484	483	478	479	478	475	474	475	474	481	482	483	480	483	484	481	480	478	480	481	480	478	480	482
				484	489	481	472	474	474	470	487	480	477	477	477	474	475	477	490	469	468	466	466	468	469	478	474	475	475	474	476	479	475
				486	482	483	478	478	475	478	484	476	476	475	474	474	477	480	477	481	478	483	482	483	483	480	475	477	475	478	483	483	486
				478	478	476	474	472	473	477	482	484	486	486	484	484	483	482	485	486	487	483	473	476	477	484	478	477	474	475	480	482	481
				477	478	474	475	475	475	474	487	475	478	477	477	474	480	481	480	478	483	484	481	480	477	480	477	476	477	474	474	472	474
				480	489	481	480	481	479	472	482	471	472	471	472	470	472	472	478	485	489	486	483	486	478	478	478	474	474	475	474	473	473
				477	485	485	484	484	486	485	482	473	477	480	474	478	477	481	486	478	480	480	478	478	481	481	481	486	486	485	481	481	482
				483	480	487	486	486	486	485	490	479	478	477	477	480	479	476	489	478	480	483	483	483	487	477	480	476	478	478	473	478	481
				480	476	481	481	483	483	483	480	477	477	476	477	476	477	476	481	477	481	485	484	484	484	482	474	473	472	472	480	477	480
				481	475	480	483	484	487	487	474	472	476	476	469	474	484	488	475	479	475	474	474	475	475	479	476	479	480	481	483	483	481
				478	477	483	481	484	484	485	487	477	476	477	478	478	479	479	487	481	487	487	485	485	486	481	475	477	477	480	478	479	484
				474	480	484	488	487	484	480	481	478	477	478	480	475	476	479	477	480	475	476	477	474	476	484	474	475	475	475	473	479	477
				481	473	477	475	478	477	478	478	481	483	483	483	483	483	482	480	479	480	480	481	480	482	471	474	471	472	475	471	487	481
				478	483	480	481	477	478	479	477	482	479	475	475	478	486	489	483	483	475	478	477	474	477	483	485	483	486	482	481	474	475
				481	483	484	481	481	483	480	475	480	479	480	482	483	477	480	482	481	475	474	475	477	474	477	480	479	480	478	479	482	481
				480	479	483	485	484	481	483	477	484	487	483	486	484	483	485	477	472	478	477	477	477	477	474	489	489	488	487	487	484	484
				478	479	478	478	480	481	477	480	485	484	481	474	471	479	487	473	474	478	479	478	478	479	480	482	484	485	484	483	481	481
				476	478	481	480	480	479	482	486	482	480	481	478	481	479	481	485	484	482	481	480	481	477	484	477	475	475	475	478	477	478
				483	477	480	481	479	481	480	474	478	480	479	481	477	481	482	478	479	484	483	483	482	483	477	478	477	477	477	478	472	471
				483	486	484	483	484	484	483	481	475	475	477	480	478	478	476	481	474	473	475	474	475	473	484	483	481	481	482	482	480	480
				482	477	477	474	475	477	478	486	475	478	475	477	477	476	481	479	481	479	481	482	484	483	486	482	481	480	481	479	481	482
				480	481	483	489	487	484	486	477	485	484	483	482	484	483	475	475	475	474	477	475	473	476	483	475	476	475	472	474	475	477
				485	485	481	478	485	484	486	478	476	478	478	481	483	480	478	481	485	485	488	483	484	485	477	476	480	478	477	480	480	482
				480	478	478	480	484	484	481	473	481	481	482	483	480	481	483	475	475	475	473	472	472	474	478	483	482	483	481	486	483	475
				471	471	477	480	481	477	478	480	475	473	474	477	479	481	480	477	475	475	478	481	480	478	480	477	478	480	483	481	481	480
				474	471	472	475	480	474	472	480	486	487	484	480	476	477	476	489	485	486	483	484	483	485	476	483	481	482	482	483	483	474
				486	487	486	484	482	482	483	483	486	484	484	481	480	476	478	474	476	480	485	484	482	481	484	483	483	483	484	479	481	483
				481	480	481	474	476	477	475	475	478	477	477	478	480	483	483	480	480	480	481	484	488	483	475	483	483	478	471	471	469	487
				487	484	483	480	481	480	483	475	486	485	484	480	475	472	472	481	480	482	482	481	480	480	478	478	481	479	480	477	480	474
				474	476	477	475	484	482	480	475	481	477	480	480	482	483	482	487	486	482	483	480	481	483	480	468	468	468	469	471	472	477
				483	483	480	479	477	478	476	477	486	485	486	480	479	476	476	481	479	476	476	475	475	476	472	483	483	483	484	483	482	481
				481	478	474	473	472	471	470	480	478	480	480	475	478	480	481	481	481	478	477	476	474	478	480	478	480	478	477	477	477	480
				484	482	486	485	483	484	479	486	477	476	475	475	477	478	481	477	478	483	484	486	486	484	479	475	472	476	471	472	472	478
				488	485	483	481	480	479	481	479	475	475	475	480	479	481	483	480	480	480	479	480	478	480	480	483	484	485	485	486	484	480
				477	473	472	471	471	473	472	485	484	486	487	484	481	477	475	476	474	477	483	485	487	485	488	473	478	481	480	477	477	481
				480	479	484	486	485	486	484	477	482	481	481	486	489	484	480	486	481	480	478	475	475	477	482	475	478	472	475	477	477	473
				475	480	483	483	477	478	477	475	486	484	485	484	487	480	474	489	483	480	480	475	475	475	486	476	475	476	475	477	478	487
				485	480	475	475	471	470	472	478	493	493	491	487	478	477	481	478	474	476	478	481	485	482	479	481	484	484	483	484	484	484
				479	483	481	480	477	478	478	478	485	485	486	488	491	481	481	483	479	483	480	480	479	478	477	480	480	478	477	479	481	478
				480	483	482	480	481	482	480	487	476	477	478	482	480	481	478	477	480	483	485	483	489	484	480	475	484	480	476	477	477	481
				481	475	476	476	480	480	474	478	483	481	477	483	474	474	478	484	484	481	478	480	478	480	483	487	486	488	487	487	489	481
				483	478	480	485	482	483	484	478	474	474	478	478	479	479	483	483	480	481	483	484	481	480	482	485	485	486	484	484	485	480
				482	483	483	484	483	482	484	487	474	474	474	478	480	481	483	478	470	475	483	484	484	486	483	483	484	485	480	484	483	480
				483	482	478	478	477	480	478	475	482	481	484	480	483	482	480	492	487	481	480	477	475	475	482	480	479	480	481	483	484	474
				485	481	482	480	477	479	479	479	483	484	483	482	480	479	476	480	479	477	474	474	473	475	483	483	486	484	483	483	478	480
				478	481	481	480	483	487	485	477	481	481	482	481	484	483	478	481	477	472	473	477	480	477	473	472	473	472	471	474	476	476
				484	488	486	483	477	475	481	480	484	483	478	469	469	471	488	478	476	476	477	482	490	483	480	477	477	479	475	477	478	482
				240 240 240>;

			PS_Config_Lmt_FW_CC_P = <
				71	64	64	64	64	64	64	64	64	64	64	64	64	64	66	67	64	64	64	64	64	64	64	64	64	64	64	64	64	66
				70	64	64	64	64	64	64	63	64	64	64	64	64	64	64	66	64	64	64	64	64	64	63	64	64	64	64	64	64	64
				70	64	64	64	64	64	66	63	64	64	64	64	64	64	64	66	64	66	66	66	66	66	63	64	64	64	64	64	64	64
				69	64	64	64	64	64	64	64	66	66	66	66	64	64	64	66	64	64	64	64	64	64	64	66	66	66	66	66	66	66
				69	64	64	64	64	64	64	64	64	64	64	64	64	64	64	66	64	64	64	64	64	64	63	64	64	64	64	64	64	64
				69	64	64	64	64	64	64	63	66	66	66	66	66	64	64	66	64	64	64	64	64	64	64	66	66	66	66	66	64	66
				69	64	64	64	64	64	66	64	66	64	64	66	64	64	64	66	64	64	64	64	64	64	64	66	66	66	66	64	64	64
				67	63	63	64	64	64	64	64	64	64	64	64	64	64	64	64	64	64	64	64	64	64	64	64	64	64	64	64	64	64
				67	63	63	63	63	63	63	63	64	64	64	64	64	64	64	63	63	63	63	63	63	63	63	64	64	64	64	64	64	64
				69	64	64	64	64	64	66	63	64	64	64	64	64	64	64	64	64	64	64	64	64	64	63	64	64	64	64	64	64	64
				67	64	64	64	64	64	64	63	64	64	64	64	64	64	64	64	64	64	64	64	64	64	63	64	64	64	64	64	64	64
				66	63	63	64	64	64	64	63	64	64	64	64	64	63	63	64	64	64	64	64	64	64	63	64	64	64	64	64	64	64
				66	63	64	64	64	64	64	63	64	64	64	64	64	64	64	64	64	64	64	64	64	64	64	64	64	64	64	64	64	64
				66	64	64	64	64	64	64	63	64	64	64	64	64	64	63	64	64	64	64	64	64	64	63	64	64	64	64	64	63	64
				66	63	64	64	64	64	64	63	64	64	64	64	64	64	64	64	64	64	64	64	64	64	63	64	64	64	64	64	64	64
				66	63	64	64	64	64	64	64	63	63	63	63	63	63	63	64	64	64	64	64	64	64	63	64	64	64	64	64	64	64
				66	63	63	63	63	63	63	63	63	63	63	63	63	63	63	64	64	64	64	64	64	64	63	63	63	63	63	63	63	63
				64	63	63	63	63	63	63	63	64	64	64	64	64	64	64	63	63	63	63	63	63	63	62	64	64	64	64	64	64	64
				66	64	64	64	64	64	64	63	64	64	64	64	64	64	64	64	64	64	64	64	64	64	63	64	64	64	64	64	64	64
				64	63	63	63	63	63	63	62	63	63	63	63	63	63	63	63	63	63	63	63	63	63	62	63	63	63	63	63	63	63
				63	63	63	63	63	63	63	63	63	63	63	63	63	63	63	63	63	63	63	63	63	63	62	63	63	63	63	63	63	63
				63	63	63	63	63	63	63	62	64	64	64	64	64	64	64	63	64	64	64	63	63	64	62	64	64	64	64	64	64	64
				63	63	63	63	62	62	62	62	63	63	63	63	63	63	63	63	63	63	63	63	63	63	62	63	63	63	63	63	63	64
				63	62	62	63	62	62	62	62	62	62	62	62	62	62	62	63	63	63	63	63	63	63	62	63	63	63	63	63	63	63
				63	63	63	63	63	63	63	63	63	63	63	63	63	63	63	63	63	63	63	63	63	63	64	63	63	63	63	63	63	64
				63	63	63	63	63	63	63	62	62	62	62	62	62	62	62	63	63	63	63	63	62	63	63	63	63	63	63	63	63	63
				63	63	63	63	62	63	63	62	62	62	62	62	62	62	62	63	63	63	63	63	63	63	64	63	63	63	63	63	63	64
				62	62	62	62	62	62	62	63	62	62	62	63	63	63	63	63	63	63	63	63	63	63	64	63	63	63	63	63	63	64
				62	62	62	62	62	62	62	62	62	62	62	62	62	62	62	62	62	62	62	62	62	62	63	63	63	63	63	63	63	63
				62	62	62	62	62	62	62	63	62	62	62	62	62	62	62	62	62	62	62	62	62	62	64	63	63	63	63	63	63	64
				63	63	63	63	62	62	62	63	62	62	62	62	62	63	63	62	62	62	62	62	62	62	64	63	63	63	63	63	63	64
				62	62	62	62	62	62	62	62	62	62	62	62	62	62	62	62	62	62	62	62	62	62	63	62	62	62	62	62	63	64
				62	62	62	62	62	62	62	62	62	62	62	62	62	62	62	62	62	62	62	62	62	62	63	62	62	62	62	62	63	64
				62	62	62	62	62	62	62	62	62	62	62	62	62	62	62	63	63	63	62	62	62	63	63	63	63	63	63	63	63	66
				60	60	60	60	60	60	60	62	62	62	62	62	62	62	62	62	62	62	62	60	60	60	63	62	62	62	62	62	62	64
				62	62	62	62	62	62	62	62	60	60	60	60	62	62	62	62	62	62	62	62	62	62	63	62	62	62	62	62	62	64
				62	62	62	62	62	62	62	62	62	62	62	62	62	62	62	62	62	62	62	62	62	62	63	62	62	62	62	62	62	64
				62	62	62	62	62	62	62	63	60	60	60	60	60	62	62	62	62	62	62	62	62	62	63	62	62	62	62	62	62	64
				62	62	60	60	60	60	60	60	62	62	62	62	62	62	62	62	62	62	62	62	62	62	63	63	63	63	63	63	63	66
				62	62	62	62	62	60	62	60	60	60	60	60	60	60	62	62	62	62	62	62	62	62	62	62	62	62	62	62	62	64
				60	60	60	60	60	60	60	60	60	60	60	60	60	60	62	62	62	62	62	62	60	62	62	62	60	62	62	62	62	64
				62	60	60	60	60	60	60	60	60	60	60	60	60	62	62	62	62	62	60	60	60	60	62	62	62	62	62	62	62	66
				62	60	60	60	60	60	60	60	62	60	60	62	62	62	63	62	62	62	62	62	62	62	62	62	62	62	62	62	62	66
				60	60	60	60	60	60	60	59	60	60	60	60	60	60	62	60	60	60	60	60	60	60	62	62	62	62	62	62	62	66
				60	60	60	60	60	59	59	59	59	59	59	60	60	60	62	60	60	60	60	60	60	60	60	60	60	60	60	60	60	66
				62	60	60	60	60	60	60	60	62	62	62	62	62	62	64	63	62	62	62	62	62	62	62	62	62	62	62	62	62	67
				56	56	56	56	56	56	56	56	56	56	56	56	56	56	59	56	56	56	56	56	56	56	56	56	56	56	56	57	57	62
				56	55	55	55	55	55	55	55	55	55	55	55	55	56	57	56	56	56	56	56	56	56	56	56	56	56	56	56	56	62
				314 314 314>;

			PS_Config_Lmt_FW_CC_N = <
				32	29	29	29	29	29	29	29	29	29	29	29	29	29	29	30	29	29	29	29	29	29	29	29	29	29	29	29	29	29
				31	29	29	29	29	29	29	28	29	29	29	29	29	29	29	29	29	29	29	29	29	29	28	29	29	29	29	29	29	29
				31	29	29	29	29	29	29	28	29	29	29	29	29	29	29	29	29	29	29	29	29	29	28	29	29	29	29	29	29	29
				31	29	29	29	29	29	29	29	29	29	29	29	29	29	29	29	29	29	29	29	29	29	29	29	29	29	29	29	29	29
				31	29	29	29	29	29	29	29	29	29	29	29	29	29	29	29	29	29	29	29	29	29	28	29	29	29	29	29	29	29
				31	29	29	29	29	29	29	28	29	29	29	29	29	29	29	29	29	29	29	29	29	29	29	29	29	29	29	29	29	29
				31	29	29	29	29	29	29	29	29	29	29	29	29	29	29	29	29	29	29	29	29	29	29	29	29	29	29	29	29	29
				30	28	28	29	29	29	29	29	29	29	29	29	29	29	29	29	29	29	29	29	29	29	29	29	29	29	29	29	29	29
				30	28	28	28	28	28	28	28	29	29	29	29	29	29	29	28	28	28	28	28	28	28	28	29	29	29	29	29	29	29
				31	29	29	29	29	29	29	28	29	29	29	29	29	29	29	29	29	29	29	29	29	29	28	29	29	29	29	29	29	29
				30	29	29	29	29	29	29	28	29	29	29	29	29	29	29	29	29	29	29	29	29	29	28	29	29	29	29	29	29	29
				29	28	28	29	29	29	29	28	29	29	29	29	29	28	28	29	29	29	29	29	29	29	28	29	29	29	29	29	29	29
				29	28	29	29	29	29	29	28	29	29	29	29	29	29	29	29	29	29	29	29	29	29	29	29	29	29	29	29	29	29
				29	29	29	29	29	29	29	28	29	29	29	29	29	29	28	29	29	29	29	29	29	29	28	29	29	29	29	29	28	29
				29	28	29	29	29	29	29	28	29	29	29	29	29	29	29	29	29	29	29	29	29	29	28	29	29	29	29	29	29	29
				29	28	29	29	29	29	29	29	28	28	28	28	28	28	28	29	29	29	29	29	29	29	28	29	29	29	29	29	29	29
				29	28	28	28	28	28	28	28	28	28	28	28	28	28	28	29	29	29	29	29	29	29	28	28	28	28	28	28	28	28
				29	28	28	28	28	28	28	28	29	29	29	29	29	29	29	28	28	28	28	28	28	28	27	29	29	29	29	29	29	29
				29	29	29	29	29	29	29	28	29	29	29	29	29	29	29	29	29	29	29	29	29	29	28	29	29	29	29	29	29	29
				29	28	28	28	28	28	28	27	28	28	28	28	28	28	28	28	28	28	28	28	28	28	27	28	28	28	28	28	28	28
				28	28	28	28	28	28	28	28	28	28	28	28	28	28	28	28	28	28	28	28	28	28	27	28	28	28	28	28	28	28
				28	28	28	28	28	28	28	27	29	29	29	29	29	29	29	28	29	29	29	28	28	29	27	29	29	29	29	29	29	29
				28	28	28	28	27	27	27	27	28	28	28	28	28	28	28	28	28	28	28	28	28	28	27	28	28	28	28	28	28	29
				28	27	27	28	27	27	27	27	27	27	27	27	27	27	27	28	28	28	28	28	28	28	27	28	28	28	28	28	28	28
				28	28	28	28	28	28	28	28	28	28	28	28	28	28	28	28	28	28	28	28	28	28	29	28	28	28	28	28	28	29
				28	28	28	28	28	28	28	27	27	27	27	27	27	27	27	28	28	28	28	28	27	28	28	28	28	28	28	28	28	28
				28	28	28	28	27	28	28	27	27	27	27	27	27	27	27	28	28	28	28	28	28	28	29	28	28	28	28	28	28	29
				27	27	27	27	27	27	27	28	27	27	27	28	28	28	28	28	28	28	28	28	28	28	29	28	28	28	28	28	28	29
				27	27	27	27	27	27	27	27	27	27	27	27	27	27	27	27	27	27	27	27	27	27	28	28	28	28	28	28	28	28
				27	27	27	27	27	27	27	28	27	27	27	27	27	27	27	27	27	27	27	27	27	27	29	28	28	28	28	28	28	29
				28	28	28	28	27	27	27	28	27	27	27	27	27	28	28	27	27	27	27	27	27	27	29	28	28	28	28	28	28	29
				27	27	27	27	27	27	27	27	27	27	27	27	27	27	27	27	27	27	27	27	27	27	28	27	27	27	27	27	28	29
				27	27	27	27	27	27	27	27	27	27	27	27	27	27	27	27	27	27	27	27	27	27	28	27	27	27	27	27	28	29
				27	27	27	27	27	27	27	27	27	27	27	27	27	27	27	28	28	28	27	27	27	28	28	28	28	28	28	28	28	29
				27	27	27	27	27	27	27	27	27	27	27	27	27	27	27	27	27	27	27	27	27	27	28	27	27	27	27	27	27	29
				27	27	27	27	27	27	27	27	27	27	27	27	27	27	27	27	27	27	27	27	27	27	28	27	27	27	27	27	27	29
				27	27	27	27	27	27	27	27	27	27	27	27	27	27	27	27	27	27	27	27	27	27	28	27	27	27	27	27	27	29
				27	27	27	27	27	27	27	28	27	27	27	27	27	27	27	27	27	27	27	27	27	27	28	27	27	27	27	27	27	29
				27	27	27	27	27	27	27	27	27	27	27	27	27	27	27	27	27	27	27	27	27	27	28	28	28	28	28	28	28	29
				27	27	27	27	27	27	27	27	27	27	27	27	27	27	27	27	27	27	27	27	27	27	27	27	27	27	27	27	27	29
				27	27	27	27	27	27	27	27	27	27	27	27	27	27	27	27	27	27	27	27	27	27	27	27	27	27	27	27	27	29
				27	27	27	27	27	27	27	27	27	27	27	27	27	27	27	27	27	27	27	27	27	27	27	27	27	27	27	27	27	29
				27	27	27	27	27	27	27	27	27	27	27	27	27	27	28	27	27	27	27	27	27	27	27	27	27	27	27	27	27	29
				27	27	27	27	27	27	27	26	27	27	27	27	27	27	27	27	27	27	27	27	27	27	27	27	27	27	27	27	27	29
				27	27	27	27	27	26	26	26	26	26	26	27	27	27	27	27	27	27	27	27	27	27	27	27	27	27	27	27	27	29
				27	27	27	27	27	27	27	27	27	27	27	27	27	27	29	28	27	27	27	27	27	27	27	27	27	27	27	27	27	30
				25	25	25	25	25	25	25	25	25	25	25	25	25	25	26	25	25	25	25	25	25	25	25	25	25	25	25	26	26	27
				25	24	24	24	24	24	24	24	24	24	24	24	24	25	26	25	25	25	25	25	25	25	25	25	25	25	25	25	25	27
				0 0 0>;

			PS_Config_Lmt_FW_Diff_P = <
				50 50 50 50 50 50 50 50 50 50 50 50 50 50 50 50 50 50 50 50 50 50 50 50 50 50 50 50 50 50
				50 50 50 50 50 50 50 50 50 50 50 50 50 50 50 50 50 50 50 50 50 50 50 50 50 50 50 50 50 50
				50 50 50 50 50 50 50 50 50 50 50 50 50 50 50 50 50 50 50 50 50 50 50 50 50 50 50 50 50 50
				50 50 50 50 50 50 50 50 50 50 50 50 50 50 50 50 50 50 50 50 50 50 50 50 50 50 50 50 50 50
				50 50 50 50 50 50 50 50 50 50 50 50 50 50 50 50 50 50 50 50 50 50 50 50 50 50 50 50 50 50
				50 50 50 50 50 50 50 50 50 50 50 50 50 50 50 50 50 50 50 50 50 50 50 50 50 50 50 50 50 50
				50 50 50 50 50 50 50 50 50 50 50 50 50 50 50 50 50 50 50 50 50 50 50 50 50 50 50 50 50 50
				50 50 50 50 50 50 50 50 50 50 50 50 50 50 50 50 50 50 50 50 50 50 50 50 50 50 50 50 50 50
				50 50 50 50 50 50 50 50 50 50 50 50 50 50 50 50 50 50 50 50 50 50 50 50 50 50 50 50 50 50
				50 50 50 50 50 50 50 50 50 50 50 50 50 50 50 50 50 50 50 50 50 50 50 50 50 50 50 50 50 50
				50 50 50 50 50 50 50 50 50 50 50 50 50 50 50 50 50 50 50 50 50 50 50 50 50 50 50 50 50 50
				50 50 50 50 50 50 50 50 50 50 50 50 50 50 50 50 50 50 50 50 50 50 50 50 50 50 50 50 50 50
				50 50 50 50 50 50 50 50 50 50 50 50 50 50 50 50 50 50 50 50 50 50 50 50 50 50 50 50 50 50
				50 50 50 50 50 50 50 50 50 50 50 50 50 50 50 50 50 50 50 50 50 50 50 50 50 50 50 50 50 50
				50 50 50 50 50 50 50 50 50 50 50 50 50 50 50 50 50 50 50 50 50 50 50 50 50 50 50 50 50 50
				50 50 50 50 50 50 50 50 50 50 50 50 50 50 50 50 50 50 50 50 50 50 50 50 50 50 50 50 50 50
				50 50 50 50 50 50 50 50 50 50 50 50 50 50 50 50 50 50 50 50 50 50 50 50 50 50 50 50 50 50
				50 50 50 50 50 50 50 50 50 50 50 50 50 50 50 50 50 50 50 50 50 50 50 50 50 50 50 50 50 50
				50 50 50 50 50 50 50 50 50 50 50 50 50 50 50 50 50 50 50 50 50 50 50 50 50 50 50 50 50 50
				50 50 50 50 50 50 50 50 50 50 50 50 50 50 50 50 50 50 50 50 50 50 50 50 50 50 50 50 50 50
				50 50 50 50 50 50 50 50 50 50 50 50 50 50 50 50 50 50 50 50 50 50 50 50 50 50 50 50 50 50
				50 50 50 50 50 50 50 50 50 50 50 50 50 50 50 50 50 50 50 50 50 50 50 50 50 50 50 50 50 50
				50 50 50 50 50 50 50 50 50 50 50 50 50 50 50 50 50 50 50 50 50 50 50 50 50 50 50 50 50 50
				50 50 50 50 50 50 50 50 50 50 50 50 50 50 50 50 50 50 50 50 50 50 50 50 50 50 50 50 50 50
				50 50 50 50 50 50 50 50 50 50 50 50 50 50 50 50 50 50 50 50 50 50 50 50 50 50 50 50 50 50
				50 50 50 50 50 50 50 50 50 50 50 50 50 50 50 50 50 50 50 50 50 50 50 50 50 50 50 50 50 50
				50 50 50 50 50 50 50 50 50 50 50 50 50 50 50 50 50 50 50 50 50 50 50 50 50 50 50 50 50 50
				50 50 50 50 50 50 50 50 50 50 50 50 50 50 50 50 50 50 50 50 50 50 50 50 50 50 50 50 50 50
				50 50 50 50 50 50 50 50 50 50 50 50 50 50 50 50 50 50 50 50 50 50 50 50 50 50 50 50 50 50
				50 50 50 50 50 50 50 50 50 50 50 50 50 50 50 50 50 50 50 50 50 50 50 50 50 50 50 50 50 50
				50 50 50 50 50 50 50 50 50 50 50 50 50 50 50 50 50 50 50 50 50 50 50 50 50 50 50 50 50 50
				50 50 50 50 50 50 50 50 50 50 50 50 50 50 50 50 50 50 50 50 50 50 50 50 50 50 50 50 50 50
				50 50 50 50 50 50 50 50 50 50 50 50 50 50 50 50 50 50 50 50 50 50 50 50 50 50 50 50 50 50
				50 50 50 50 50 50 50 50 50 50 50 50 50 50 50 50 50 50 50 50 50 50 50 50 50 50 50 50 50 50
				50 50 50 50 50 50 50 50 50 50 50 50 50 50 50 50 50 50 50 50 50 50 50 50 50 50 50 50 50 50
				50 50 50 50 50 50 50 50 50 50 50 50 50 50 50 50 50 50 50 50 50 50 50 50 50 50 50 50 50 50
				50 50 50 50 50 50 50 50 50 50 50 50 50 50 50 50 50 50 50 50 50 50 50 50 50 50 50 50 50 50
				50 50 50 50 50 50 50 50 50 50 50 50 50 50 50 50 50 50 50 50 50 50 50 50 50 50 50 50 50 50
				50 50 50 50 50 50 50 50 50 50 50 50 50 50 50 50 50 50 50 50 50 50 50 50 50 50 50 50 50 50
				50 50 50 50 50 50 50 50 50 50 50 50 50 50 50 50 50 50 50 50 50 50 50 50 50 50 50 50 50 50
				50 50 50 50 50 50 50 50 50 50 50 50 50 50 50 50 50 50 50 50 50 50 50 50 50 50 50 50 50 50
				50 50 50 50 50 50 50 50 50 50 50 50 50 50 50 50 50 50 50 50 50 50 50 50 50 50 50 50 50 50
				50 50 50 50 50 50 50 50 50 50 50 50 50 50 50 50 50 50 50 50 50 50 50 50 50 50 50 50 50 50
				50 50 50 50 50 50 50 50 50 50 50 50 50 50 50 50 50 50 50 50 50 50 50 50 50 50 50 50 50 50
				50 50 50 50 50 50 50 50 50 50 50 50 50 50 50 50 50 50 50 50 50 50 50 50 50 50 50 50 50 50
				50 50 50 50 50 50 50 50 50 50 50 50 50 50 50 50 50 50 50 50 50 50 50 50 50 50 50 50 50 50
				50 50 50 50 50 50 50 50 50 50 50 50 50 50 50 50 50 50 50 50 50 50 50 50 50 50 50 50 50 50
				50 50 50 50 50 50 50 50 50 50 50 50 50 50 50 50 50 50 50 50 50 50 50 50 50 50 50 50 50 50
				75 75 75>;

			PS_Config_Lmt_FW_Diff_N = <
				(-50) (-50) (-50) (-50) (-50) (-50) (-50) (-50) (-50) (-50) (-50) (-50) (-50) (-50) (-50) (-50) (-50) (-50) (-50) (-50) (-50) (-50) (-50) (-50) (-50) (-50) (-50) (-50) (-50) (-50)
				(-50) (-50) (-50) (-50) (-50) (-50) (-50) (-50) (-50) (-50) (-50) (-50) (-50) (-50) (-50) (-50) (-50) (-50) (-50) (-50) (-50) (-50) (-50) (-50) (-50) (-50) (-50) (-50) (-50) (-50)
				(-50) (-50) (-50) (-50) (-50) (-50) (-50) (-50) (-50) (-50) (-50) (-50) (-50) (-50) (-50) (-50) (-50) (-50) (-50) (-50) (-50) (-50) (-50) (-50) (-50) (-50) (-50) (-50) (-50) (-50)
				(-50) (-50) (-50) (-50) (-50) (-50) (-50) (-50) (-50) (-50) (-50) (-50) (-50) (-50) (-50) (-50) (-50) (-50) (-50) (-50) (-50) (-50) (-50) (-50) (-50) (-50) (-50) (-50) (-50) (-50)
				(-50) (-50) (-50) (-50) (-50) (-50) (-50) (-50) (-50) (-50) (-50) (-50) (-50) (-50) (-50) (-50) (-50) (-50) (-50) (-50) (-50) (-50) (-50) (-50) (-50) (-50) (-50) (-50) (-50) (-50)
				(-50) (-50) (-50) (-50) (-50) (-50) (-50) (-50) (-50) (-50) (-50) (-50) (-50) (-50) (-50) (-50) (-50) (-50) (-50) (-50) (-50) (-50) (-50) (-50) (-50) (-50) (-50) (-50) (-50) (-50)
				(-50) (-50) (-50) (-50) (-50) (-50) (-50) (-50) (-50) (-50) (-50) (-50) (-50) (-50) (-50) (-50) (-50) (-50) (-50) (-50) (-50) (-50) (-50) (-50) (-50) (-50) (-50) (-50) (-50) (-50)
				(-50) (-50) (-50) (-50) (-50) (-50) (-50) (-50) (-50) (-50) (-50) (-50) (-50) (-50) (-50) (-50) (-50) (-50) (-50) (-50) (-50) (-50) (-50) (-50) (-50) (-50) (-50) (-50) (-50) (-50)
				(-50) (-50) (-50) (-50) (-50) (-50) (-50) (-50) (-50) (-50) (-50) (-50) (-50) (-50) (-50) (-50) (-50) (-50) (-50) (-50) (-50) (-50) (-50) (-50) (-50) (-50) (-50) (-50) (-50) (-50)
				(-50) (-50) (-50) (-50) (-50) (-50) (-50) (-50) (-50) (-50) (-50) (-50) (-50) (-50) (-50) (-50) (-50) (-50) (-50) (-50) (-50) (-50) (-50) (-50) (-50) (-50) (-50) (-50) (-50) (-50)
				(-50) (-50) (-50) (-50) (-50) (-50) (-50) (-50) (-50) (-50) (-50) (-50) (-50) (-50) (-50) (-50) (-50) (-50) (-50) (-50) (-50) (-50) (-50) (-50) (-50) (-50) (-50) (-50) (-50) (-50)
				(-50) (-50) (-50) (-50) (-50) (-50) (-50) (-50) (-50) (-50) (-50) (-50) (-50) (-50) (-50) (-50) (-50) (-50) (-50) (-50) (-50) (-50) (-50) (-50) (-50) (-50) (-50) (-50) (-50) (-50)
				(-50) (-50) (-50) (-50) (-50) (-50) (-50) (-50) (-50) (-50) (-50) (-50) (-50) (-50) (-50) (-50) (-50) (-50) (-50) (-50) (-50) (-50) (-50) (-50) (-50) (-50) (-50) (-50) (-50) (-50)
				(-50) (-50) (-50) (-50) (-50) (-50) (-50) (-50) (-50) (-50) (-50) (-50) (-50) (-50) (-50) (-50) (-50) (-50) (-50) (-50) (-50) (-50) (-50) (-50) (-50) (-50) (-50) (-50) (-50) (-50)
				(-50) (-50) (-50) (-50) (-50) (-50) (-50) (-50) (-50) (-50) (-50) (-50) (-50) (-50) (-50) (-50) (-50) (-50) (-50) (-50) (-50) (-50) (-50) (-50) (-50) (-50) (-50) (-50) (-50) (-50)
				(-50) (-50) (-50) (-50) (-50) (-50) (-50) (-50) (-50) (-50) (-50) (-50) (-50) (-50) (-50) (-50) (-50) (-50) (-50) (-50) (-50) (-50) (-50) (-50) (-50) (-50) (-50) (-50) (-50) (-50)
				(-50) (-50) (-50) (-50) (-50) (-50) (-50) (-50) (-50) (-50) (-50) (-50) (-50) (-50) (-50) (-50) (-50) (-50) (-50) (-50) (-50) (-50) (-50) (-50) (-50) (-50) (-50) (-50) (-50) (-50)
				(-50) (-50) (-50) (-50) (-50) (-50) (-50) (-50) (-50) (-50) (-50) (-50) (-50) (-50) (-50) (-50) (-50) (-50) (-50) (-50) (-50) (-50) (-50) (-50) (-50) (-50) (-50) (-50) (-50) (-50)
				(-50) (-50) (-50) (-50) (-50) (-50) (-50) (-50) (-50) (-50) (-50) (-50) (-50) (-50) (-50) (-50) (-50) (-50) (-50) (-50) (-50) (-50) (-50) (-50) (-50) (-50) (-50) (-50) (-50) (-50)
				(-50) (-50) (-50) (-50) (-50) (-50) (-50) (-50) (-50) (-50) (-50) (-50) (-50) (-50) (-50) (-50) (-50) (-50) (-50) (-50) (-50) (-50) (-50) (-50) (-50) (-50) (-50) (-50) (-50) (-50)
				(-50) (-50) (-50) (-50) (-50) (-50) (-50) (-50) (-50) (-50) (-50) (-50) (-50) (-50) (-50) (-50) (-50) (-50) (-50) (-50) (-50) (-50) (-50) (-50) (-50) (-50) (-50) (-50) (-50) (-50)
				(-50) (-50) (-50) (-50) (-50) (-50) (-50) (-50) (-50) (-50) (-50) (-50) (-50) (-50) (-50) (-50) (-50) (-50) (-50) (-50) (-50) (-50) (-50) (-50) (-50) (-50) (-50) (-50) (-50) (-50)
				(-50) (-50) (-50) (-50) (-50) (-50) (-50) (-50) (-50) (-50) (-50) (-50) (-50) (-50) (-50) (-50) (-50) (-50) (-50) (-50) (-50) (-50) (-50) (-50) (-50) (-50) (-50) (-50) (-50) (-50)
				(-50) (-50) (-50) (-50) (-50) (-50) (-50) (-50) (-50) (-50) (-50) (-50) (-50) (-50) (-50) (-50) (-50) (-50) (-50) (-50) (-50) (-50) (-50) (-50) (-50) (-50) (-50) (-50) (-50) (-50)
				(-50) (-50) (-50) (-50) (-50) (-50) (-50) (-50) (-50) (-50) (-50) (-50) (-50) (-50) (-50) (-50) (-50) (-50) (-50) (-50) (-50) (-50) (-50) (-50) (-50) (-50) (-50) (-50) (-50) (-50)
				(-50) (-50) (-50) (-50) (-50) (-50) (-50) (-50) (-50) (-50) (-50) (-50) (-50) (-50) (-50) (-50) (-50) (-50) (-50) (-50) (-50) (-50) (-50) (-50) (-50) (-50) (-50) (-50) (-50) (-50)
				(-50) (-50) (-50) (-50) (-50) (-50) (-50) (-50) (-50) (-50) (-50) (-50) (-50) (-50) (-50) (-50) (-50) (-50) (-50) (-50) (-50) (-50) (-50) (-50) (-50) (-50) (-50) (-50) (-50) (-50)
				(-50) (-50) (-50) (-50) (-50) (-50) (-50) (-50) (-50) (-50) (-50) (-50) (-50) (-50) (-50) (-50) (-50) (-50) (-50) (-50) (-50) (-50) (-50) (-50) (-50) (-50) (-50) (-50) (-50) (-50)
				(-50) (-50) (-50) (-50) (-50) (-50) (-50) (-50) (-50) (-50) (-50) (-50) (-50) (-50) (-50) (-50) (-50) (-50) (-50) (-50) (-50) (-50) (-50) (-50) (-50) (-50) (-50) (-50) (-50) (-50)
				(-50) (-50) (-50) (-50) (-50) (-50) (-50) (-50) (-50) (-50) (-50) (-50) (-50) (-50) (-50) (-50) (-50) (-50) (-50) (-50) (-50) (-50) (-50) (-50) (-50) (-50) (-50) (-50) (-50) (-50)
				(-50) (-50) (-50) (-50) (-50) (-50) (-50) (-50) (-50) (-50) (-50) (-50) (-50) (-50) (-50) (-50) (-50) (-50) (-50) (-50) (-50) (-50) (-50) (-50) (-50) (-50) (-50) (-50) (-50) (-50)
				(-50) (-50) (-50) (-50) (-50) (-50) (-50) (-50) (-50) (-50) (-50) (-50) (-50) (-50) (-50) (-50) (-50) (-50) (-50) (-50) (-50) (-50) (-50) (-50) (-50) (-50) (-50) (-50) (-50) (-50)
				(-50) (-50) (-50) (-50) (-50) (-50) (-50) (-50) (-50) (-50) (-50) (-50) (-50) (-50) (-50) (-50) (-50) (-50) (-50) (-50) (-50) (-50) (-50) (-50) (-50) (-50) (-50) (-50) (-50) (-50)
				(-50) (-50) (-50) (-50) (-50) (-50) (-50) (-50) (-50) (-50) (-50) (-50) (-50) (-50) (-50) (-50) (-50) (-50) (-50) (-50) (-50) (-50) (-50) (-50) (-50) (-50) (-50) (-50) (-50) (-50)
				(-50) (-50) (-50) (-50) (-50) (-50) (-50) (-50) (-50) (-50) (-50) (-50) (-50) (-50) (-50) (-50) (-50) (-50) (-50) (-50) (-50) (-50) (-50) (-50) (-50) (-50) (-50) (-50) (-50) (-50)
				(-50) (-50) (-50) (-50) (-50) (-50) (-50) (-50) (-50) (-50) (-50) (-50) (-50) (-50) (-50) (-50) (-50) (-50) (-50) (-50) (-50) (-50) (-50) (-50) (-50) (-50) (-50) (-50) (-50) (-50)
				(-50) (-50) (-50) (-50) (-50) (-50) (-50) (-50) (-50) (-50) (-50) (-50) (-50) (-50) (-50) (-50) (-50) (-50) (-50) (-50) (-50) (-50) (-50) (-50) (-50) (-50) (-50) (-50) (-50) (-50)
				(-50) (-50) (-50) (-50) (-50) (-50) (-50) (-50) (-50) (-50) (-50) (-50) (-50) (-50) (-50) (-50) (-50) (-50) (-50) (-50) (-50) (-50) (-50) (-50) (-50) (-50) (-50) (-50) (-50) (-50)
				(-50) (-50) (-50) (-50) (-50) (-50) (-50) (-50) (-50) (-50) (-50) (-50) (-50) (-50) (-50) (-50) (-50) (-50) (-50) (-50) (-50) (-50) (-50) (-50) (-50) (-50) (-50) (-50) (-50) (-50)
				(-50) (-50) (-50) (-50) (-50) (-50) (-50) (-50) (-50) (-50) (-50) (-50) (-50) (-50) (-50) (-50) (-50) (-50) (-50) (-50) (-50) (-50) (-50) (-50) (-50) (-50) (-50) (-50) (-50) (-50)
				(-50) (-50) (-50) (-50) (-50) (-50) (-50) (-50) (-50) (-50) (-50) (-50) (-50) (-50) (-50) (-50) (-50) (-50) (-50) (-50) (-50) (-50) (-50) (-50) (-50) (-50) (-50) (-50) (-50) (-50)
				(-50) (-50) (-50) (-50) (-50) (-50) (-50) (-50) (-50) (-50) (-50) (-50) (-50) (-50) (-50) (-50) (-50) (-50) (-50) (-50) (-50) (-50) (-50) (-50) (-50) (-50) (-50) (-50) (-50) (-50)
				(-50) (-50) (-50) (-50) (-50) (-50) (-50) (-50) (-50) (-50) (-50) (-50) (-50) (-50) (-50) (-50) (-50) (-50) (-50) (-50) (-50) (-50) (-50) (-50) (-50) (-50) (-50) (-50) (-50) (-50)
				(-50) (-50) (-50) (-50) (-50) (-50) (-50) (-50) (-50) (-50) (-50) (-50) (-50) (-50) (-50) (-50) (-50) (-50) (-50) (-50) (-50) (-50) (-50) (-50) (-50) (-50) (-50) (-50) (-50) (-50)
				(-50) (-50) (-50) (-50) (-50) (-50) (-50) (-50) (-50) (-50) (-50) (-50) (-50) (-50) (-50) (-50) (-50) (-50) (-50) (-50) (-50) (-50) (-50) (-50) (-50) (-50) (-50) (-50) (-50) (-50)
				(-50) (-50) (-50) (-50) (-50) (-50) (-50) (-50) (-50) (-50) (-50) (-50) (-50) (-50) (-50) (-50) (-50) (-50) (-50) (-50) (-50) (-50) (-50) (-50) (-50) (-50) (-50) (-50) (-50) (-50)
				(-50) (-50) (-50) (-50) (-50) (-50) (-50) (-50) (-50) (-50) (-50) (-50) (-50) (-50) (-50) (-50) (-50) (-50) (-50) (-50) (-50) (-50) (-50) (-50) (-50) (-50) (-50) (-50) (-50) (-50)
				(-50) (-50) (-50) (-50) (-50) (-50) (-50) (-50) (-50) (-50) (-50) (-50) (-50) (-50) (-50) (-50) (-50) (-50) (-50) (-50) (-50) (-50) (-50) (-50) (-50) (-50) (-50) (-50) (-50) (-50)
				(-75) (-75) (-75)>;

			PS_Config_Diff_Test_Frame = <50>;
		};
	};
};
