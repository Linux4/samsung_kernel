/*
 * Copyright (C) 2014 Marvell
 * Yi Zhang <yizhang@marvell.com>
 */

/* ocv table is for RosaM battery */
/* ntc table is for NCP03XH223E05RL */

&pmic0 {
	charger {
		prechg-current = <450>;
		prechg-voltage = <3000>;
		status = "okay";
	};

	battery {
		sleep-period = <1000>;		/* second */
		low-threshold = <30>;		/* % */
		high-threshold = <50>;		/* % */
		alart-percent = <5>;		/* % */

		cc-fixup = <100>;

		power-off-th = <3400>;		/* mv */
		safe-power-off-th = <3000>;	/* mv */

		io-channels = <&gpadc 7>,  /* vbat */
			           <&gpadc 13>, /* vbat_slp */
				   <&gpadc 14>, /* gpadc0_res */
				   <&gpadc 15>, /* gpadc1_res */
				   <&gpadc 16>, /* gpadc2_res */
				   <&gpadc 17>; /* gpadc3_res */
		io-channel-names = "vbat",
				   "vbat_slp",
				   "gpadc0_res",
				   "gpadc1_res",
				   "gpadc2_res",
				   "gpadc3_res";

		bat-capacity = <2000>;	/* mAh */
		ocv-table = <
			3376 3484 3559 3615 3654 3671 3676 3679 3681 3683
			3685 3686 3689 3697 3707 3715 3723 3731 3737 3743
			3747 3752 3757 3761 3764 3767 3770 3772 3773 3775
			3777 3779 3781 3784 3787 3790 3793 3796 3799 3803
			3806 3810 3814 3818 3822 3827 3831 3836 3841 3846
			3851 3857 3863 3870 3878 3887 3898 3909 3922 3934
			3944 3953 3962 3970 3977 3985 3993 4002 4011 4021
			4032 4043 4054 4064 4074 4083 4092 4103 4113 4124
			4135 4146 4157 4168 4179 4191 4202 4213 4225 4237
			4248 4260 4272 4284 4295 4307 4319 4331 4343 4355 4368
		>;

		abs-lowest-temp = <20>;
		t1-degree = <0>;	/* -20C */
		t2-degree = <20>;	/* 0C */
		t3-degree = <50>;	/* 30C */
		t4-degree = <65>;	/* 45C */

		times-in-minus-ten = <2>;
		offset-in-minus-ten = <100>;
		times-in-zero = <1>;
		offset-in-zero = <0>;

		soc-low-th-cycle = <15>;
		soc-high-th-cycle = <85>;

		default-temp-ohm = <22000>;

		zero-degree-ohm = <59881>;

		/* -25C, -24C, ..., 64C, 65C */
		ntc-table =
			<192629 25>,/* -25 ~ -21 */
			<183133 24>,
			<174166 23>,
			<165695 22>,
			<157689 21>,
			<147216 20>,/* -20 ~ -11 */
			<142980 19>,
			<136222 18>,
			<129825 17>,
			<123767 16>,
			<115418 15>,
			<112591 14>,
			<107437 13>,
			<102549 12>,
			<97913 11>,
			<91748 10>,/* -10 ~ -1 */
			<87319 9>,
			<84339 8>,
			<81560 7>,
			<77972 6>,
			<74563 5>,
			<71323 4>,
			<68244 3>,
			<64283 2>,
			<61324 1>,/* negative temperature */
			<58599 0>,/* 0 ~ 9 */
			<56342 1>,
			<53921 2>,
			<52692 3>,
			<50518 4>,
			<48213 5>,
			<46471 6>,
			<44586 7>,
			<42789 8>,
			<41074 9>,
			<39436 10>,/* 10 ~ 19 */
			<37871 11>,
			<36376 12>,
			<34948 13>,
			<33585 14>,
			<32282 15>,
			<31037 16>,
			<29846 17>,
			<28708 18>,
			<27619 19>,
			<26023 20>,/* 20 ~ 29 */
			<25582 21>,
			<24628 22>,
			<23715 23>,
			<22839 24>,
			<21898 25>,
			<21195 26>,
			<20424 27>,
			<19683 28>,
			<18973 29>,
			<18092 30>,/* 30 ~ 39 */
			<17540 31>,
			<17014 32>,
			<16414 33>,
			<15838 34>,
			<15285 35>,
			<14755 36>,
			<14245 37>,
			<13756 38>,
			<13086 39>,
			<12534 40>,/* 40 ~ 49 */
			<12200 41>,
			<11880 42>,
			<11577 43>,
			<11190 44>,
			<10617 45>,
			<10388 46>,
			<10114 47>,
			<9782 48>,
			<9462 49>,
			<9043 50>,/* 50 ~ 59 */
			<8838 51>,
			<8572 52>,
			<8297 53>,
			<8032 54>,
			<7777 55>,
			<7531 56>,
			<7294 57>,
			<7065 58>,
			<6844 59>,
			<6631 60>,/* 60 ~ 65 */
			<6429 61>,
			<6429 62>,
			<6046 63>,
			<5865 64>,
			<5690 65>,
			<5515 66>,/* 66 ~ 80 */
			<5340 67>,
			<5165 68>,
			<4990 69>,
			<4815 70>,
			<4640 71>,
			<4465 72>,
			<4290 73>,
			<4115 74>,
			<3940 75>,
			<3765 76>,
			<3590 77>,
			<3415 78>,
			<3240 79>,
			<3065 80>;
		};
};
