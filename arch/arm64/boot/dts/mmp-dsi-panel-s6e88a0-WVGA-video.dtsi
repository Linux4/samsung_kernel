&gen_panel {
	gen-panel-s6e88a0-WVGA-video {
		gen-panel-manu = "SMD";		/* condensed manufacturer name */
		gen-panel-name = "s6e88a0";
		gen-panel-id = <0x400000>;
		gen-panel-type = "video_mode";
		gen-panel-refresh = <60>;
		gen-panel-xres = <480>;
		gen-panel-yres = <800>;
		gen-panel-width= <56>;		/* screen width in mm */
		gen-panel-height = <94>;	/* screen height in mm */
		gen-panel-h-front-porch = <70>;	/* right margin */
		gen-panel-h-back-porch = <62>;	/* left margin */
		gen-panel-h-sync-width = <9>;	/* hsync len */
		gen-panel-v-front-porch = <13>;	/* lower margin */
		gen-panel-v-back-porch = <2>;	/* upper margin */
		gen-panel-v-sync-width = <1>;	/* vsync len */
		gen-panel-hsync-invert = <0>;	/* hsync invert */
		gen-panel-vsync-invert = <0>;	/* vsync invert */
		gen-panel-lanes = <2>;
		gen-panel-burst-mode = <2>;
		gen-panel-master-mode;
		/* gen-panel-hfp-en; */
		/* gen-panel-hbp-en; */

		/*
		 * DSI PACKET HEADER INFO
		 * @ data type : 1byte
		 * @ tx mode : 1byte
		 * @ delay(msec) : 2byte
		 * @ size of data : 2byte
		 */
		gen-panel-pkt-dinfo-addr-offset = <0>;
		gen-panel-pkt-dinfo-addr-length = <1>;
		gen-panel-pkt-dinfo-data-offset = <1>;
		gen-panel-pkt-dinfo-data-length = <1>;
		gen-panel-post-enable-cmds = [
			05 00 00 20 00 01	11
		];
		gen-panel-post-enable-1-cmds = [
			39 00 00 78 00 04	B8 38 0B 30
			05 00 00 10 00 01	29
		];
		gen-panel-disable-cmds = [
			05 00 00 20 00 01	28
			05 00 00 96 00 01	10
		];
		gen-panel-nv-read-enable-cmds = [
			39 00 00 00 00 03	F0 5A 5A
		];
		gen-panel-nv-read-disable-cmds = [
		/*	39 00 00 00 00 03	F0 A5 A5	*/
		];
		gen-panel-acl-on-cmds = [
			39 00 00 00 00 02	55 02
		];
		gen-panel-acl-off-cmds = [
			39 00 00 00 00 02	55 00
		];
		gen-panel-elvss-cmds = [
			39 00 00 00 00 03	B6 28 0B
		];
		gen-panel-aid-cmds = [
			39 00 00 00 00 06	B2 40 08 20 00 08
		];

		/* VREGOUT VOLTAGE 6.3 * 2^22 */
		gen-panel-octa-vregout = <26424115>;

		gen-panel-candela-table = <
			5	6	7	8	9	10	11	12	13	14
			15	16	17	19	20	21	22	24	25	27
			29	30	32	34	37	39	41	44	47	50
			53	56	60	64	68	72	77	82	87	93
			98	105	111	119	126	134	143	152	162	172
			183	195	207	220	234	249	265	282	300	316
			333	350
		>;

		gen-panel-aid-table = <
			0x311	0x307	0x302	0x2F7	0x2F4	0x2E8	0x2E4	0x2E2	0x2D7	0x2D2
			0x2C6	0x2C4	0x2B8	0x2B3	0x2A7	0x2A2	0x296	0x289	0x284	0x276
			0x267	0x262	0x254	0x245	0x232	0x223	0x20C	0x201	0x1E7	0x1D4
			0x1BD	0x1A6	0x187	0x171	0x149	0x134	0x134	0x134	0x134	0x134
			0x134	0x134	0x134	0x134	0x134	0x134	0x134	0x134	0x134	0x113
			0x0E8	0x0C3	0x097	0x066	0x037	0x008	0x008	0x008	0x008	0x008
			0x008	0x008
		>;

		gen-panel-elvss-table = <
			0x13	0x13	0x13	0x13	0x13	0x13	0x13	0x13	0x13	0x13
			0x13	0x13	0x13	0x13	0x13	0x13	0x13	0x13	0x13	0x13
			0x13	0x13	0x13	0x13	0x13	0x13	0x13	0x13	0x13	0x13
			0x13	0x13	0x13	0x13	0x13	0x13	0x13	0x13	0x13	0x13
			0x13	0x13	0x13	0x12	0x12	0x11	0x11	0x10	0x10	0x10
			0x10	0x10	0x0F	0x0F	0x0F	0x0F	0x0E	0x0E	0x0D	0x0C
			0x0C	0x0B
		>;

		gen-panel-candela-compensation-table = <
			/* V255 V203    V151    V87     V51     V35     V23     V11     V3 */
			(-1) 	6 	13 	23 	31 	36 	40 	44 	44
			(-1) 	5 	12 	21 	29 	34 	38 	42 	42
			(-1) 	4 	10 	18 	24 	29 	33 	37 	37
			(-1) 	3 	8 	16 	23 	27 	32 	35 	35
			(-1) 	3 	8 	15 	21 	26 	30 	33 	33
			(-1) 	2 	7 	14 	20 	24 	28 	31 	31
			(-1) 	2 	7 	13 	18 	22 	26 	29 	29
			(-1) 	2 	6 	12 	17 	21 	25 	28 	28
			(-1) 	2 	6 	11 	16 	20 	24 	26 	27
			(-1) 	2 	6 	11 	15 	18 	22 	25 	26
			(-1) 	2 	6 	10 	14 	17 	21 	24 	25
			(-1) 	2 	5 	9 	13 	16 	20 	22 	23
			(-1) 	2 	5 	8 	12 	15 	18 	21 	22
			(-1) 	2 	5 	8 	11 	14 	17 	19 	20
			(-1) 	2 	5 	8 	10 	12 	16 	18 	19
			(-1) 	1 	3 	6 	9 	11 	15 	17 	17
			(-1) 	1 	3 	6 	9 	11 	14 	16 	20
			(-1) 	2 	3 	6 	8 	10 	13 	15 	16
			(-1) 	1 	3 	5 	8 	10 	13 	15 	19
			(-1) 	2 	3 	5 	7 	9 	12 	14 	17
			(-1) 	1 	2 	4 	6 	8 	11 	13 	17
			(-1) 	1 	2 	4 	6 	8 	11 	13 	15
			(-1) 	2 	3 	4 	6 	8 	10 	12 	16
			(-1) 	1 	2 	4 	6 	7 	10 	12 	10
			(-1) 	1 	2 	4 	5 	7 	9 	11 	12
			(-1) 	1 	2 	3 	4 	6 	8 	10 	11
			(-1) 	1 	2 	3 	4 	5 	8 	10 	8
			(-1) 	1 	2 	2 	4 	5 	8 	9 	13
			(-1) 	1 	2 	2 	3 	4 	7 	9 	9
			(-1) 	1 	2 	2 	3 	4 	7 	8 	10
			(-1) 	1 	2 	2 	3 	4 	6 	8 	8
			(-1) 	1 	2 	2 	3 	3 	6 	7 	8
			(-1) 	1 	1 	2 	2 	3 	6 	7 	6
			(-1) 	1 	1 	2 	2 	3 	5 	6 	8
			(-1) 	1 	2 	1 	2 	2 	5 	6 	5
			(-1) 	1 	1 	1 	2 	2 	5 	5 	8
			0 	2 	1 	1 	1 	2 	4 	5 	7
			0 	1 	2 	1 	1 	2 	4 	6 	5
			0 	1 	2 	2 	3 	2 	3 	5 	4
			0 	1 	1 	1 	1 	1 	4 	5 	4
			0 	1 	1 	1 	2 	3 	3 	5 	6
			0 	0 	1 	2 	1 	2 	3 	5 	6
			0 	0 	1 	1 	2 	2 	3 	4 	7
			0 	0 	2 	1 	2 	2 	3 	4 	6
			0 	0 	2 	2 	1 	2 	2 	4 	7
			0 	1 	2 	1 	2 	2 	3 	5 	4
			0 	0 	1 	2 	1 	1 	2 	4 	3
			0 	0 	1 	1 	2 	1 	2 	4 	2
			0 	1 	1 	1 	2 	2 	2 	4 	3
			0 	0 	1 	1 	2 	2 	1 	3 	4
			0 	1 	1 	0 	1 	1 	1 	3 	4
			0 	0 	1 	0 	1 	1 	1 	2 	6
			0 	0 	1 	0 	1 	1 	1 	2 	2
			0 	0 	1 	0 	1 	1 	1 	2 	1
			0 	0 	1 	0 	1 	1 	0 	1 	2
			0 	0 	1 	0 	1 	1 	0 	1 	3
			0 	0 	0 	0 	0 	0 	1 	1 	2
			0 	1 	0 	0 	0 	0 	0 	0 	4
			0 	1 	1 	0 	0 	0 	0 	1 	0
			0 	(-1) 	(-1) 	0 	0 	0 	0 	1 	0
			0 	0 	(-1) 	(-1) 	(-1) 	(-1) 	(-1) 	0 	0
			0 	0 	0 	0 	0 	0 	0 	0 	0
		>;

		gen-panel-rgb-compensation-table = <
			/* R255 G255 B255 R203 G203 B203 R151 G151 B151 R87 G87 B87 R51 G51 B51 R35 G35 B35 R23 G23 B23 R11 G11 B11 */
			(-5) 0 (-4) (-4) 1 (-4) (-5) 1 (-6) (-8) 3 (-10) (-11) 2 (-9) (-5) 3 (-9) (-4) 3 (-5) (-4) 0 (-6)
			(-3) 1 (-2) (-5) 0 (-5) (-5) 1 (-6) (-10) 3 (-11) (-13) 3 (-12) (-6) 3 (-10) (-5) 3 (-6) (-2) 0 (-7)
			(-2) 0 (-1) (-5) 0 (-6) (-5) 0 (-5) (-10) 3 (-10) (-12) 2 (-10) (-9) 2 (-12) (-4) 4 (-9) (-2) 1 (-9)
			(-2) 0 (-1) (-4) 0 (-5) (-4) 0 (-5) (-10) 3 (-11) (-14) 3 (-10) (-8) 2 (-13) (-3) 3 (-4) (-2) 1 (-11)
			(-1) 0 0 (-3) 0 (-4) (-4) 0 (-5) (-9) 2 (-10) (-13) 3 (-9) (-8) 2 (-13) (-6) 3 (-8) (-2) 2 (-11)
			(-1) 0 0 (-3) 0 (-4) (-4) 0 (-5) (-9) 2 (-9) (-13) 3 (-9) (-7) 2 (-14) (-5) 3 (-8) (-4) 2 (-10)
			(-1) 0 0 (-2) 0 (-3) (-4) 0 (-4) (-8) 1 (-9) (-13) 3 (-9) (-8) 3 (-15) (-5) 3 (-9) (-4) 2 (-10)
			(-1) 0 0 (-2) 0 (-3) (-4) 0 (-4) (-8) 1 (-9) (-13) 3 (-9) (-7) 3 (-14) (-5) 3 (-9) (-4) 2 (-9)
			(-1) 0 0 (-1) 0 (-2) (-4) 0 (-4) (-9) 1 (-9) (-12) 2 (-9) (-7) 2 (-13) (-6) 3 (-8) (-3) 3 (-11)
			(-1) 0 0 (-1) 0 (-2) (-4) 0 (-4) (-7) 1 (-7) (-12) 2 (-9) (-9) 3 (-16) (-6) 3 (-8) (-3) 3 (-8)
			(-1) 0 0 0 0 (-1) (-3) 0 (-4) (-8) 1 (-8) (-12) 2 (-9) (-8) 3 (-15) (-5) 3 (-6) (-3) 3 (-8)
			(-1) 0 0 (-1) 0 (-1) (-3) 0 (-4) (-6) 1 (-6) (-12) 2 (-9) (-7) 3 (-14) (-6) 3 (-6) (-4) 3 (-11)
			(-1) 0 0 (-1) 0 (-1) (-2) 0 (-3) (-6) 1 (-6) (-10) 2 (-7) (-6) 3 (-14) (-7) 3 (-9) (-3) 3 (-8)
			(-1) 0 0 (-1) 0 (-1) (-2) 0 (-2) (-4) 1 (-5) (-11) 2 (-10) (-7) 3 (-11) (-5) 3 (-7) (-5) 3 (-11)
			(-1) 0 0 (-2) 0 (-2) (-3) 0 (-2) (-4) 1 (-4) (-8) 2 (-9) (-8) 3 (-12) (-4) 3 (-6) (-5) 3 (-11)
			0 0 0 (-2) 0 (-2) 0 0 (-2) (-3) 2 (-4) (-6) 4 (-9) (-6) 4 (-8) (-6) 4 (-7) (-4) 4 (-8)
			0 0 0 (-1) 0 (-1) 0 0 (-3) (-4) 2 (-4) (-6) 4 (-9) (-7) 3 (-8) (-5) 3 (-8) (-5) 4 (-10)
			0 0 0 (-1) 0 (-1) 0 0 (-2) (-3) 1 (-4) (-5) 4 (-8) (-7) 3 (-7) (-5) 3 (-8) (-6) 4 (-10)
			0 0 0 (-1) 0 (-1) 0 0 (-3) (-4) 1 (-4) (-7) 4 (-8) (-8) 3 (-8) (-5) 3 (-8) (-5) 4 (-9)
			0 0 0 (-1) 0 (-1) 1 0 (-1) (-4) 1 (-4) (-5) 4 (-8) (-6) 3 (-6) (-5) 3 (-8) (-5) 4 (-10)
			0 0 0 (-1) 0 (-1) 0 0 (-1) (-2) 1 (-2) (-5) 4 (-8) (-6) 2 (-6) (-6) 2 (-8) (-5) 4 (-9)
			0 0 0 (-1) 0 (-1) 0 0 (-1) (-1) 1 (-2) (-6) 3 (-8) (-6) 2 (-6) (-6) 2 (-7) (-5) 4 (-9)
			0 0 0 (-1) 0 (-1) (-1) 0 (-2) 0 0 (-2) (-5) 3 (-7) (-6) 2 (-5) (-5) 2 (-8) (-5) 5 (-11)
			0 0 0 0 0 (-1) (-1) 0 (-2) (-1) 0 (-1) (-6) 3 (-8) (-6) 2 (-5) (-4) 2 (-6) (-3) 4 (-8)
			0 0 0 0 0 0 (-1) 0 (-2) (-1) 0 (-2) (-5) 3 (-8) (-5) 1 (-4) (-5) 1 (-8) (-5) 4 (-10)
			0 0 0 0 0 0 0 0 (-1) (-1) 1 (-2) (-4) 3 (-8) (-6) 1 (-4) (-6) 1 (-8) (-4) 4 (-10)
			0 0 0 0 0 0 0 0 (-1) (-1) 1 (-2) (-3) 3 (-7) (-5) 1 (-4) (-5) 1 (-6) (-3) 4 (-8)
			0 0 0 0 0 0 0 0 (-1) (-1) 0 (-2) (-4) 3 (-7) (-5) 1 (-4) (-5) 1 (-6) (-3) 4 (-10)
			0 0 0 0 0 0 0 0 (-1) 0 0 (-1) (-4) 3 (-7) (-6) 1 (-4) (-4) 1 (-6) (-3) 3 (-8)
			0 0 0 0 0 0 0 0 (-1) 0 0 (-1) (-3) 3 (-6) (-5) 1 (-3) (-4) 1 (-6) (-4) 5 (-10)
			0 0 0 0 0 0 0 0 (-1) 0 0 (-1) (-3) 2 (-6) (-6) 1 (-3) (-3) 1 (-6) (-5) 4 (-10)
			0 0 0 0 0 0 0 0 (-1) 0 0 0 (-2) 3 (-6) (-4) 1 (-3) (-4) 1 (-5) (-4) 4 (-9)
			0 0 0 0 0 0 0 0 (-1) 0 0 (-1) (-3) 2 (-6) (-5) 1 (-3) (-3) 1 (-4) (-3) 4 (-8)
			0 0 0 0 0 0 0 0 0 0 0 (-2) (-3) 2 (-6) (-4) 1 (-2) (-3) 1 (-4) (-4) 4 (-10)
			0 0 0 0 0 0 0 0 0 0 0 0 (-2) 2 (-6) (-4) 0 (-2) (-3) 0 (-5) (-4) 3 (-8)
			0 0 0 0 0 0 0 0 0 0 0 (-2) (-3) 2 (-6) (-4) 0 (-2) (-2) 0 (-4) (-4) 4 (-10)
			0 0 0 0 0 0 0 0 0 1 0 0 0 2 (-5) (-3) 0 (-2) (-4) 0 (-4) (-4) 5 (-10)
			0 0 0 0 0 0 0 0 0 1 0 0 (-1) 2 (-6) (-5) 0 (-2) (-3) 0 (-4) (-4) 3 (-8)
			0 0 0 0 0 0 0 0 0 0 0 (-1) 0 2 (-4) (-4) 0 (-2) (-2) 0 (-4) (-4) 3 (-8)
			0 0 0 0 0 0 0 0 0 0 0 (-1) 0 2 (-4) (-4) 0 (-1) (-2) 0 (-4) (-4) 4 (-8)
			0 0 0 0 0 0 0 0 0 0 0 0 0 2 (-5) (-3) 0 (-2) (-3) 0 (-4) (-4) 4 (-8)
			0 0 0 0 0 0 0 0 0 0 0 (-1) 0 2 (-4) (-2) 0 (-2) (-3) 0 (-4) (-4) 4 (-8)
			0 0 0 0 0 0 0 0 0 0 0 (-1) 0 1 (-3) (-2) 1 (-2) (-4) 1 (-4) (-4) 4 (-8)
			0 0 0 0 0 0 0 0 0 0 0 (-1) 0 1 (-3) (-1) 1 (-2) (-3) 1 (-3) (-4) 4 (-8)
			0 0 0 0 0 0 0 0 0 0 0 (-1) 0 1 (-3) (-1) 1 (-2) (-3) 1 (-3) (-5) 3 (-8)
			0 0 0 0 0 0 0 0 0 0 0 (-1) 0 0 (-2) (-3) 1 (-4) (-3) 1 (-2) (-5) 3 (-8)
			0 0 0 0 0 0 0 0 0 0 0 (-1) 0 0 0 (-1) 1 (-4) (-3) 1 (-2) (-5) 3 (-8)
			0 0 0 0 0 0 0 0 0 0 0 0 1 1 (-2) 0 2 (-4) (-4) 2 (-2) (-3) 3 (-6)
			0 0 0 0 0 0 0 0 0 0 0 0 0 1 (-2) 0 1 (-4) (-2) 1 (-1) (-4) 3 (-8)
			0 0 0 0 0 0 0 0 0 0 0 0 0 1 (-2) 0 2 (-4) (-4) 2 (-2) (-2) 3 (-6)
			0 0 0 0 0 0 0 0 0 0 0 0 1 0 (-2) 0 1 (-4) (-3) 1 (-2) (-3) 2 (-6)
			0 0 0 0 0 0 0 0 0 0 0 0 0 1 (-2) 0 1 (-4) (-1) 1 0 (-5) 3 (-8)
			0 0 0 0 0 0 0 0 0 0 0 0 0 1 (-2) 1 1 (-3) (-1) 1 0 (-4) 2 (-6)
			0 0 0 0 0 0 0 0 0 0 0 0 0 0 (-2) 1 1 (-3) (-1) 1 0 (-4) 2 (-6)
			0 0 0 0 0 0 0 0 0 0 0 0 0 0 (-2) 1 1 (-3) (-1) 1 0 (-2) 2 (-4)
			0 0 0 0 0 0 0 0 0 0 0 0 0 0 0 0 0 0 0 0 0 0 0 0
			0 0 0 0 0 0 0 0 0 0 0 0 0 0 0 0 0 0 0 0 0 0 0 0
			0 0 0 0 0 0 0 0 0 0 0 0 0 0 0 0 0 0 0 0 0 0 0 0
			0 0 0 0 0 0 0 0 0 0 0 0 0 0 0 0 0 0 0 0 0 0 0 0
			0 0 0 0 0 0 0 0 0 0 0 0 0 0 0 0 0 0 0 0 0 0 0 0
			0 0 0 0 0 0 0 0 0 0 0 0 0 0 0 0 0 0 0 0 0 0 0 0
			0 0 0 0 0 0 0 0 0 0 0 0 0 0 0 0 0 0 0 0 0 0 0 0
		>;

		gen-panel-base-lux-table = <
			112	112	112	112	112	112	112	112	112	112
			112	112	112	112	112	112	112	112	112	112
			112	112	112	112	112	112	112	112	112	112
			112	112	112	112	112	112	120	129	136	146
			155	165	172	185	196	209	221	236	250	250
			250	250	250	250	250	250	265	283	300	316
			333	350
		>;

		gen-panel-gamma-curve-table = <
			215	215	215	215	215	215	215	215	215	215
			215	215	215	215	215	215	215	215	215	215
			215	215	215	215	215	215	215	215	215	215
			215	215	215	215	215	215	215	215	215	215
			215	215	215	215	215	215	215	215	215	215
			215	215	215	215	215	215	215	215	215	215
			215	220
		>;
		gen-panel-mdnie-ui-mode-cmds = [
			39 00 00 00 00 6C	EC 00 00 00 00 00 00 00 00 00 00 00 00 00 00 00
						00 00 00 FF FF 14 FF 14 FF 00 00 FF FF 00 FF 00
						FF 00 00 FF FF 00 FF 00 FF 00 00 20 00 20 00 20
						00 20 00 20 00 20 00 20 00 20 00 20 00 20 00 20
						00 20 00 20 00 20 00 20 00 20 00 20 00 20 00 20
						00 20 00 20 00 20 00 20 00 FF 04 00 00 00 00 00
						00 00 04 00 00 00 00 00 00 00 04 00
			39 00 00 00 00 05	EB 01 00 30 00
		];

		gen-panel-gamma-cmds = [
			39 00 00 00 00 22	CA 01 00 01 00 01 00 80 80 80 80 80 80 80 80 80
						80 80 80 80 80 80 80 80 80 80 80 80 80 80 80 00
						00 00
		];
		gen-panel-gamma-update-cmds = [
			15 00 00 00 00 02	F7 03
		];

		gen-panel-read-mtp = [C8 00 21];
		gen-panel-read-id = [
			DA 00 01
			DB 00 01
			DC 00 01
		];
		gen-panel-read-status-reg = [0A];
		gen-panel-read-status-ok = [9A];
		status = "okay";
	};
};
