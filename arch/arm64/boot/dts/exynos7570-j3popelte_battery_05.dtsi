/*
 * SAMSUNG UNIVERSAL7570 board device tree source
 *
 * Copyright (c) 2013 Samsung Electronics Co., Ltd.
 *		http://www.samsung.com
 *
 * This program is free software; you can redistribute it and/or modify
 * it under the terms of the GNU General Public License version 2 as
 * published by the Free Software Foundation.
*/

#include "exynos7570-j3popelte_battery.dtsi"

/ {
	pinctrl@139F0000 {
		/* vf_gnd_short_detection */
		bat_short_det: bat-short-det {
			samsung,pins = "gpa0-3";
			samsung,pin-function = <0xf>;
			samsung,pin-pud = <0>;
		};
	};

	s2mpu06-charger {
		pinctrl-names = "default";
		pinctrl-0 = <&bat_short_det>;

		charger,vf_gnd_short_detection;
		charger,vf_gnd_short_det_gpio = <&gpa0 3 0>;
	};
};
