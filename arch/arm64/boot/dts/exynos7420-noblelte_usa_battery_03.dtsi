/*
 * SAMSUNG UNIVERSAL5433 board device tree source
 *
 * Copyright (c) 2013 Samsung Electronics Co., Ltd.
 *		http://www.samsung.com
 *
 * This program is free software; you can redistribute it and/or modify
 * it under the terms of the GNU General Public License version 2 as
 * published by the Free Software Foundation.
*/

#include "exynos7420-noblelte_common_battery_03.dtsi"
/ {
	hsi2c@13650000 { /* hsi2c5 */
		status = "okay";
		/delete-node/ max77900-charger@61;
		p9220-charger@61 {
			compatible = "idt,p9220-charger";
			reg = <0x61>;
			status = "okay";
		};
	};

	battery {
		battery,wirelss_charger_name = "p9220-charger";
	};
};
