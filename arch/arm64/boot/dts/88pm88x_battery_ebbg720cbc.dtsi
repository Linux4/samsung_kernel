/*
* charger, battery parameters are based on Shenzhen B&k 485760AR battery using 88pm88x
* Part Name: Li-ion Polymer Rechargeable Battery
* Pack Standard: 2400mAh(0.2C)
* Cell Model: 485760AR(4.35V)
*/
&pmic0 {
	charger {
		prechg-current = <450>;
		prechg-voltage = <3000>;
		fastchg-voltage = <4400>;
		fastchg-cur = <2000>;
		fastchg-eoc = <250>;
		fastchg-tout = <8>;
		recharge-thr = <200>;
		dcp-limit = <1420>;
		status = "okay";
	};

	battery {
		bat-ntc-support = <1>;
		bat-capacity = <3000>;		/* mAh */

		low-threshold = <6>;		/* % */
		high-threshold = <60>;		/* % */

		ocv-table = <
			3303 3423 3507 3570 3618 3649 3661 3668 3672 3675
			3678 3680 3683 3686 3693 3703 3712 3721 3728 3735
			3740 3744 3748 3752 3756 3759 3762 3765 3768 3771
			3773 3776 3778 3781 3784 3787 3790 3794 3797 3801
			3804 3808 3812 3816 3821 3825 3830 3834 3839 3844
			3850 3855 3861 3868 3874 3882 3890 3899 3909 3920
			3931 3942 3953 3962 3972 3981 3990 3999 4008 4017
			4027 4036 4046 4056 4066 4076 4086 4097 4107 4118
			4129 4140 4151 4162 4173 4185 4196 4208 4219 4231
			4243 4255 4266 4278 4290 4302 4314 4326 4338 4352 4368
		>;
		power-off-th = <3350>; /* mV */
		safe-power-off-th = <3000>; /* mV */

		/* battery temerature feature parameters */

		abs-lowest-temp = <20>;
		t1-degree = <0>;	/* -20C */
		t2-degree = <20>;	/* 0C */
		t3-degree = <65>;	/* 45C */
		t4-degree = <83>;	/* 63C */

		times-in-minus-ten = <2>;
		offset-in-minus-ten = <100>;
		times-in-zero = <1>;
		offset-in-zero = <0>;

		soc-low-th-cycle = <15>;
		soc-high-th-cycle = <85>;

		zero-degree-ohm = <145493>;

		ntc-table =
			/* -25 ~ -21 */
			<192629 25>,
				<183133 24>,
			<174166 23>,
			<165695 22>,
			<157689 21>,

			/* -20 ~ -11 */
			<150121 20>,
			<142980 19>,
			<136118 18>,
			<129748 17>,
			<123714 16>,
			<118029 15>,
			<112591 14>,
			<107437 13>,
			<102549 12>,
			<97913 11>,

			/* -10 ~ -1 */
			<93514 10>,
			<89319 9>,
			<85339 8>,
			<81560 7>,
			<77972 6>,
			<74563 5>,
			<71323 4>,
			<68244 3>,
			<65316 2>,
			<62531 1>, /* negative temperature */

			/* 0 ~ 9 */
			<59881 0>,

			<57367 1>,
			<54973 2>,
			<52692 3>,
			<50518 4>,
			<48446 5>,
			<46471 6>,
			<44586 7>,
			<42789 8>,
			<41074 9>,

			/* 10 ~ 19 */
			<39436 10>,
			<37871 11>,
			<36376 12>,
			<34948 13>,
			<33585 14>,
			<32282 15>,
			<31037 16>,
			<29846 17>,
			<28708 18>,
			<27619 19>,

			/* 20 ~ 29 */
			<26577 20>,
			<25582 21>,
			<24628 22>,
			<23715 23>,
			<22839 24>,
			<22000 25>,
			<21195 26>,
			<20424 27>,
			<19683 28>,
			<18973 29>,

			/* 30 ~ 39 */
			<18292 30>,
			<17640 31>,
			<17014 32>,
			<16414 33>,
			<15838 34>,
			<15285 35>,
			<14755 36>,
			<14245 37>,
			<13756 38>,
			<13286 39>,

			/* 40 ~ 49 */
			<12843 40>,
			<12400 41>,
			<11980 42>,
			<11577 43>,
			<11190 44>,
			<10817 45>,
			<10459 46>,
			<10114 47>,
			<9782 48>,
			<9462 49>,

			/* 50 ~ 59 */
			<9154 50>,
			<8858 51>,
			<8572 52>,
			<8297 53>,
			<8032 54>,
			<7777 55>,
			<7531 56>,
			<7294 57>,
			<7065 58>,
			<6844 59>,

			/* 60 ~ 65 */
			<6631 60>,
			<6429 61>,
			<6429 62>,
			<6046 63>,
			<5865 64>,
			<5690 65>;
	};
};
