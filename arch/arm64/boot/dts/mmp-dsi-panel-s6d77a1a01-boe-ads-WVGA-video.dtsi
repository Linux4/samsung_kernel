&gen_panel {
	dsi_s6d77a1a01_boe_ads_WVGA: gen-panel-s6d77a1a01-boe-ads-WVGA-video {
		gen-panel-manu = "BOE";		/* condensed manufacturer name */
		gen-panel-name = "s6d77a1a01-boe";
		gen-panel-id = <0x55b910>;
		gen-panel-type = "video_mode";
		gen-panel-refresh = <60>;
		gen-panel-xres = <480>;
		gen-panel-yres = <800>;
		gen-panel-width= <56>;		/* screen width in mm */
		gen-panel-height = <94>;	/* screen height in mm */
		gen-panel-h-front-porch = <84>;	/* right margin */
		gen-panel-h-back-porch = <90>;	/* left margin */
		gen-panel-h-sync-width = <40>;	/* hsync len */
		gen-panel-v-front-porch = <16>;	/* lower margin */
		gen-panel-v-back-porch = <12>;	/* upper margin */
		gen-panel-v-sync-width = <4>;	/* vsync len */
		gen-panel-hsync-invert = <0>;	/* hsync invert */
		gen-panel-vsync-invert = <0>;	/* vsync invert */
		gen-panel-lanes = <2>;
		gen-panel-burst-mode = <2>;
		gen-panel-master-mode;
		/* gen-panel-hfp-en; */
		/* gen-panel-hbp-en; */

		/*
		 * DSI PACKET HEADER INFO
		 * @ data type : 1byte
		 * @ tx mode : 1byte
		 * @ delay(msec) : 2byte
		 * @ size of data : 2byte
		 */
		gen-panel-pkt-dinfo-addr-offset = <0>;
		gen-panel-pkt-dinfo-addr-length = <1>;
		gen-panel-pkt-dinfo-data-offset = <1>;
		gen-panel-pkt-dinfo-data-length = <1>;
		gen-panel-init-cmds = [
			39 00 00 00 00 03	F0 5A 5A
			39 00 00 00 00 03	FC A5 A5
			39 00 00 00 00 02	B3 01
			39 00 00 00 00 02	B5 10
			39 00 00 00 00 04	BC 00 29 51
			39 00 00 00 00 03	E3 24 2C
			39 00 00 00 00 01	21
			39 00 00 00 00 08	F2 11 04 08 10 10 82 54
			39 00 00 00 00 06	F3 91 00 00 00 10
			39 00 00 00 00 2C	F4 01 02 23 24 25 25 26 26 29 29 2C 2B 2C 07 08
						05 04 04 01 01 22 0A 17 0F 11 23 0D 0A 0B 02 19
						13 1E 1F 23 20 05 16 1A 16 1E 24 1E
			39 00 00 00 00 1D	F5 5A 62 B9 21 35 55 06 08 00 39 00 00 0B 4B C4
						CB 4B 12 12 1A 00 10 E0 E2 0E 34 34 03
			39 00 00 14 00 12	FE 00 02 01 39 60 40 21 00 4B 00 80 00 F0 00 00
						00 02
			39 00 00 00 00 0B	EE 86 00 86 00 00 00 00 00 00 00
			39 00 00 00 00 16	EF 34 12 00 00 0A 29 08 27 21 40 10 28 02 21 21
						03 03 40 00 00 00
			39 00 00 00 00 1F	F7 02 1B 1A 00 01 0D 0D 09 09 0C 0C 08 08 04 06
						02 1B 1A 00 01 0F 0F 0B 0B 0E 0E 0A 0A 05 07
			39 00 00 00 00 07	F6 63 25 15 00 00 2E
			39 00 00 00 00 02	36 10
			39 00 00 00 00 12	FA 00 3F 09 10 08 0D 12 12 12 18 1B 1B 1D 1E 21
						25 2D
			39 00 00 00 00 12	FB 00 3F 09 11 08 0E 13 12 13 19 1B 1C 1D 1E 21
						25 2D
			39 00 00 00 00 08	FD 00 10 11 20 21 1F CC
			39 00 00 00 00 03	FC 5A 5A
		];
		gen-panel-enable-cmds = [
			39 00 00 78 00 01	11
			39 00 00 78 00 01	29
		];
		gen-panel-disable-cmds = [
			05 00 00 00 00 01	28
			39 00 00 32 00 1D	F5 5A 62 B9 21 35 55 06 08 00 39 00 00 0B 4B 84
						CB 4B 12 12 1A 00 10 E0 E2 0E 34 34 03
			39 00 00 00 00 1D	F5 5A 62 B9 21 35 55 06 08 00 39 00 00 0B CB C4
						CB 4B 12 12 1A 00 10 E0 E2 0E 34 34 03
			05 00 00 96 00 01	10
		];
		/*
		 * mDNIe
		 */
		gen-panel-mdnie-ui-mode-cmds = [
			39 00 00 00 00 12	C3 00 00 00 00 00 00 00 00 00 00 00 00 00 00 00 00 00
			39 00 00 00 00 07	C4 00 ff ff 00 ff 00
			39 00 00 00 00 07	C5 ff 00 00 ff ff 00
			39 00 00 00 00 07	C6 ff 00 ff 00 00 ff
			39 00 00 00 00 07	C7 ff 00 ff 00 ff 00
			39 00 00 00 00 0D	C8 00 20 00 20 00 20 00 20 00 20 00 20
			39 00 00 00 00 0D	C9 00 20 00 20 00 20 00 20 00 20 00 20
			39 00 00 00 00 0D	CA 00 20 00 20 00 20 00 20 00 20 00 20
			39 00 00 00 00 0D	CB 00 20 00 20 00 20 00 20 00 20 00 FF
			39 00 00 00 00 07	CC 04 8f 1f 88 1f e9
			39 00 00 00 00 07	CE 1f c3 04 54 1f e9
			39 00 00 00 00 07	CF 1f c3 1f 88 04 b5
			39 00 00 00 00 09	C2 05 00 23 00 01 e0 03 20
		];
		gen-panel-mdnie-video-mode-cmds = [
			39 00 00 00 00 12	C3 00 00 00 00 00 00 00 00 00 00 00 00 00 00 00 00 00
			39 00 00 00 00 07	C4 00 ff ff 00 ff 00
			39 00 00 00 00 07	C5 ff 00 00 ff ff 00
			39 00 00 00 00 07	C6 ff 00 ff 00 00 ff
			39 00 00 00 00 07	C7 ff 00 ff 00 ff 00
			39 00 00 00 00 0D	C8 00 14 00 14 00 14 00 14 03 9a 03 9a
			39 00 00 00 00 0D	C9 03 9a 03 9a 07 9e 07 9e 07 9e 07 9e
			39 00 00 00 00 0D	CA 0a a0 0a a0 0a a0 0a a0 16 a6 16 a6
			39 00 00 00 00 0D	CB 16 a6 16 a6 16 a6 0f 20 bf 08 00 FF
			39 00 00 00 00 07	CC 04 8f 1f 88 1f e9
			39 00 00 00 00 07	CE 1f c3 04 54 1f e9
			39 00 00 00 00 07	CF 1f c3 1f 88 04 b5
			39 00 00 00 00 09	C2 07 00 23 00 01 e0 03 20
		];
		gen-panel-mdnie-camera-mode-cmds = [
			39 00 00 00 00 12	C3 00 00 00 00 00 00 00 00 00 00 00 00 00 00 00 00 00
			39 00 00 00 00 07	C4 00 ff ff 00 ff 00
			39 00 00 00 00 07	C5 ff 00 00 ff ff 00
			39 00 00 00 00 07	C6 ff 00 ff 00 00 ff
			39 00 00 00 00 07	C7 ff 00 ff 00 ff 00
			39 00 00 00 00 0D	C8 00 20 00 20 00 20 00 20 00 20 00 20
			39 00 00 00 00 0D	C9 00 20 00 20 00 20 00 20 00 20 00 20
			39 00 00 00 00 0D	CA 00 20 00 20 00 20 00 20 00 20 00 20
			39 00 00 00 00 0D	CB 00 20 00 20 00 20 00 20 00 20 00 FF
			39 00 00 00 00 07	CC 04 8f 1f 88 1f e9
			39 00 00 00 00 07	CE 1f c3 04 54 1f e9
			39 00 00 00 00 07	CF 1f c3 1f 88 04 b5
			39 00 00 00 00 09	C2 05 00 23 00 01 e0 03 20
		];
		gen-panel-mdnie-gallery-mode-cmds = [
			39 00 00 00 00 12	C3 00 00 00 00 00 00 00 00 00 00 00 00 00 00 00 00 00
			39 00 00 00 00 07	C4 00 ff ff 00 ff 00
			39 00 00 00 00 07	C5 ff 00 00 ff ff 00
			39 00 00 00 00 07	C6 ff 00 ff 00 00 ff
			39 00 00 00 00 07	C7 ff 00 ff 00 ff 00
			39 00 00 00 00 0D	C8 00 20 00 20 00 20 00 20 00 20 00 20
			39 00 00 00 00 0D	C9 00 20 00 20 00 20 00 20 00 20 00 20
			39 00 00 00 00 0D	CA 00 20 00 20 00 20 00 20 00 20 00 20
			39 00 00 00 00 0D	CB 00 20 00 20 00 20 00 20 00 20 00 FF
			39 00 00 00 00 07	CC 04 8f 1f 88 1f e9
			39 00 00 00 00 07	CE 1f c3 04 54 1f e9
			39 00 00 00 00 07	CF 1f c3 1f 88 04 b5
			39 00 00 00 00 09	C2 05 00 23 00 01 e0 03 20
		];
		gen-panel-mdnie-negative-mode-cmds = [
			39 00 00 00 00 12	C3 00 00 00 00 00 00 00 00 00 00 00 00 00 00 00 00 00
			39 00 00 00 00 07	C4 ff 00 00 ff 00 ff
			39 00 00 00 00 07	C5 00 ff ff 00 00 ff
			39 00 00 00 00 07	C6 00 ff 00 ff ff 00
			39 00 00 00 00 07	C7 00 ff 00 ff 00 ff
			39 00 00 00 00 0D	C8 00 20 00 20 00 20 00 20 00 20 00 20
			39 00 00 00 00 0D	C9 00 20 00 20 00 20 00 20 00 20 00 20
			39 00 00 00 00 0D	CA 00 20 00 20 00 20 00 20 00 20 00 20
			39 00 00 00 00 0D	CB 00 20 00 20 00 20 00 20 00 20 00 FF
			39 00 00 00 00 07	CC 04 00 00 00 00 00
			39 00 00 00 00 07	CE 00 00 04 00 00 00
			39 00 00 00 00 07	CF 00 00 00 00 04 00
			39 00 00 00 00 09	C2 01 00 32 00 01 e0 03 20
		];
		gen-panel-mdnie-vt-mode-cmds = [
			39 00 00 00 00 12	C3 00 00 00 00 00 00 00 00 00 00 00 00 00 00 00 00 00
			39 00 00 00 00 07	C4 00 ff ff 00 ff 00
			39 00 00 00 00 07	C5 ff 00 00 ff ff 00
			39 00 00 00 00 07	C6 ff 00 ff 00 00 ff
			39 00 00 00 00 07	C7 ff 00 ff 00 ff 00
			39 00 00 00 00 0D	C8 00 20 00 20 00 20 00 20 00 20 00 20
			39 00 00 00 00 0D	C9 00 20 00 20 00 20 00 20 00 20 00 20
			39 00 00 00 00 0D	CA 00 20 00 20 00 20 00 20 00 20 00 20
			39 00 00 00 00 0D	CB 00 20 00 20 00 20 00 20 00 20 00 FF
			39 00 00 00 00 07	CC 04 8f 1f 88 1f e9
			39 00 00 00 00 07	CE 1f c3 04 54 1f e9
			39 00 00 00 00 07	CF 1f c3 1f 88 04 b5
			39 00 00 00 00 09	C2 05 00 23 00 01 e0 03 20
		];
		gen-panel-mdnie-browser-mode-cmds = [
			39 00 00 00 00 12	C3 00 00 00 00 00 00 00 00 00 00 00 00 00 00 00 00 00
			39 00 00 00 00 07	C4 00 ff ff 00 ff 00
			39 00 00 00 00 07	C5 ff 00 00 ff ff 00
			39 00 00 00 00 07	C6 ff 00 ff 00 00 ff
			39 00 00 00 00 07	C7 ff 00 ff 00 ff 00
			39 00 00 00 00 0D	C8 00 20 00 20 00 20 00 20 00 20 00 20
			39 00 00 00 00 0D	C9 00 20 00 20 00 20 00 20 00 20 00 20
			39 00 00 00 00 0D	CA 00 20 00 20 00 20 00 20 00 20 00 20
			39 00 00 00 00 0D	CB 00 20 00 20 00 20 00 20 00 20 00 FF
			39 00 00 00 00 07	CC 04 8f 1f 88 1f e9
			39 00 00 00 00 07	CE 1f c3 04 54 1f e9
			39 00 00 00 00 07	CF 1f c3 1f 88 04 b5
			39 00 00 00 00 09	C2 05 00 23 00 01 e0 03 20
		];
		gen-panel-mdnie-ebook-mode-cmds = [
			39 00 00 00 00 12	C3 00 00 00 00 00 00 00 00 00 00 00 00 00 00 00 00 00
			39 00 00 00 00 07	C4 00 ff ff 00 ff 00
			39 00 00 00 00 07	C5 ff 00 00 ff ff 00
			39 00 00 00 00 07	C6 ff 00 ff 00 00 ff
			39 00 00 00 00 07	C7 d6 00 f5 00 ff 00
			39 00 00 00 00 0D	C8 00 20 00 20 00 20 00 20 00 20 00 20
			39 00 00 00 00 0D	C9 00 20 00 20 00 20 00 20 00 20 00 20
			39 00 00 00 00 0D	CA 00 20 00 20 00 20 00 20 00 20 00 20
			39 00 00 00 00 0D	CB 00 20 00 20 00 20 00 20 00 20 00 FF
			39 00 00 00 00 07	CC 04 8f 1f 88 1f e9
			39 00 00 00 00 07	CE 1f c3 04 54 1f e9
			39 00 00 00 00 07	CF 1f c3 1f 88 04 b5
			39 00 00 00 00 09	C2 05 00 33 00 01 e0 03 20
		];
		gen-panel-mdnie-email-mode-cmds = [
			39 00 00 00 00 12	C3 00 00 00 00 00 00 00 00 00 00 00 00 00 00 00 00 00
			39 00 00 00 00 07	C4 00 ff ff 00 ff 00
			39 00 00 00 00 07	C5 ff 00 00 ff ff 00
			39 00 00 00 00 07	C6 ff 00 ff 00 00 ff
			39 00 00 00 00 07	C7 de 00 f1 00 ff 00
			39 00 00 00 00 0D	C8 00 20 00 20 00 20 00 20 00 20 00 20
			39 00 00 00 00 0D	C9 00 20 00 20 00 20 00 20 00 20 00 20
			39 00 00 00 00 0D	CA 00 20 00 20 00 20 00 20 00 20 00 20
			39 00 00 00 00 0D	CB 00 20 00 20 00 20 00 20 00 20 00 FF
			39 00 00 00 00 07	CC 04 8f 1f 88 1f e9
			39 00 00 00 00 07	CE 1f c3 04 54 1f e9
			39 00 00 00 00 07	CF 1f c3 1f 88 04 b5
			39 00 00 00 00 09	C2 05 00 33 00 01 e0 03 20
		];
		gen-panel-mdnie-outdoor-mode-cmds = [
			39 00 00 00 00 12	C3 00 00 00 00 00 00 00 00 00 00 00 00 00 00 00 00 00
			39 00 00 00 00 07	C4 00 FF FF 00 FF 00
			39 00 00 00 00 07	C5 FF 00 00 FF FF 00
			39 00 00 00 00 07	C6 FF 00 FF 00 00 FF
			39 00 00 14 00 07	C7 FF 00 FF 00 FF 00
			39 00 00 00 00 0D	C8 00 7B 03 48 08 32 08 32 08 32 08 32
			39 00 00 00 00 0D	C9 08 32 10 28 10 28 10 28 10 28 10 28
			39 00 00 00 00 0D	CA 19 22 19 22 19 22 19 22 19 22 19 22
			39 00 00 14 00 0D	CB 23 1E 2E 1B 33 1A 40 18 48 17 00 FF
			39 00 00 00 00 07	CC 04 8F 1F 88 1F E9
			39 00 00 00 00 07	CE 1F C3 04 54 1F E9
			39 00 00 00 00 07	CF 1F C3 1F 88 04 B5
			39 00 00 00 00 09	C2 07 00 33 00 01 E0 03 20
		];
		gen-panel-read-id = [
			DA 00 01
			DB 00 01
			DC 00 01
		];
		gen-panel-read-status-reg = [0A];
		gen-panel-read-status-ok = [9A];
		status = "okay";
	};
};
