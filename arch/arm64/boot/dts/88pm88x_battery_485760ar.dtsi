/*
* charger, battery parameters are based on Shenzhen B&k 485760AR battery using 88pm88x
* Part Name: Li-ion Polymer Rechargeable Battery
* Pack Standard: 2400mAh(0.2C)
* Cell Model: 485760AR(4.35V)
*/
&pmic0 {
	charger {
		prechg-current = <450>;
		prechg-voltage = <3000>;
		fastchg-voltage = <4350>;
		fastchg-cur = <1000>;
		fastchg-eoc = <120>;
		fastchg-tout = <8>;
		recharge-thr = <200>;
		dcp-limit = <2400>;
		status = "okay";
	};

	battery {
		bat-ntc-support = <1>;
		bat-capacity = <2400>;		/* mAh */

		low-threshold = <6>;		/* % */
		high-threshold = <60>;		/* % */

		ocv-table = <
			3428 3519 3585 3632 3657 3666 3671 3675 3677 3679
			3682 3684 3690 3700 3710 3719 3727 3734 3740 3744
			3748 3753 3757 3761 3764 3766 3768 3770 3771 3773
			3774 3775 3777 3779 3781 3784 3786 3789 3792 3795
			3798 3801 3805 3808 3812 3816 3820 3825 3829 3834
			3839 3845 3852 3859 3868 3878 3888 3899 3910 3919
			3928 3936 3944 3952 3959 3967 3974 3982 3989 3997
			4006 4015 4025 4035 4045 4055 4065 4074 4083 4094
			4104 4114 4125 4136 4147 4158 4169 4180 4191 4202
			4214 4225 4237 4249 4261 4273 4285 4297 4311 4324
		>;
		power-off-th = <3350>; /* mV */
		safe-power-off-th = <3000>; /* mV */

		/* battery temerature feature parameters */

		abs-lowest-temp = <20>;
		t1-degree = <0>;	/* -20C */
		t2-degree = <20>;	/* 0C */
		t3-degree = <65>;	/* 45C */
		t4-degree = <83>;	/* 63C */

		times-in-minus-ten = <2>;
		offset-in-minus-ten = <100>;
		times-in-zero = <1>;
		offset-in-zero = <0>;

		soc-low-th-cycle = <15>;
		soc-high-th-cycle = <85>;

		zero-degree-ohm = <145493>;

		/* -24C, -23C, ..., 62C, 63C */
		ntc-table =
		<524484 24>,
		<494913 23>,
		<467213 22>,
		<441252 21>,
		<416912 20>,
		<394080 19>,
		<372653 18>,
		<352535 17>,
		<333639 16>,
		<315882 15>,
		<299189 14>,
		<283489 13>,
		<268717 12>,
		<254812 11>,
		<241718 10>,
		<229383 9>,
		<217757 8>,
		<206797 7>,
		<196459 6>,
		<186705 5>,
		<177497 4>,
		<168803 3>,
		<160590 2>,
		<152829 1>, /* negative temperature */

		<145493 0>,
		<138554 1>,
		<131991 2>,
		<125779 3>,
		<119899 4>,
		<114330 5>,
		<109054 6>,
		<104054 7>,
		<99314  8>,
		<94820  9>,
		<90556  10>,
		<86510  11>,
		<82669  12>,
		<79022  13>,
		<75558  14>,
		<72266  15>,
		<69138  16>,
		<66163  17>,
		<63335  18>,
		<60644  19>,
		<58083  20>,
		<55645  21>,
		<53324  22>,
		<51113  23>,
		<49007  24>,
		<47000  25>,
		<45087  26>,
		<43262  27>,
		<41522  28>,
		<39862  29>,
		<38277  30>,
		<36765  31>,
		<35321  32>,
		<33942  33>,
		<32624  34>,
		<31365  35>,
		<30161  36>,
		<29011  37>,
		<27910  38>,
		<26858  39>,
		<25851  40>,
		<24887  41>,
		<23964  42>,
		<23081  43>,
		<22235  44>,
		<21425  45>,
		<20648  46>,
		<19904  47>,
		<19191  48>,
		<18507  49>,
		<17851  50>,
		<17221  51>,
		<16618  52>,
		<16038  53>,
		<15482  54>,
		<14948  55>,
		<14435  56>,
		<13943  57>,
		<13470  58>,
		<13015  59>,
		<12578  60>,
		<12158  61>,
		<11754  62>,
		<11366  63>;
	};
};
