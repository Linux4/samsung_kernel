/*
 * SAMSUNG UNIVERSAL7570 board device tree source
 *
 * Copyright (c) 2013 Samsung Electronics Co., Ltd.
 *		http://www.samsung.com
 *
 * This program is free software; you can redistribute it and/or modify
 * it under the terms of the GNU General Public License version 2 as
 * published by the Free Software Foundation.
*/

/ {
	s2mpu06-fuelgauge {
		status = "disable";
		compatible = "samsung,s2mpu06-fuelgauge";
		fuelgauge,fuel_alert_soc = <1>;
		fuelgauge,capacity_max = <1000>;
		fuelgauge,capacity_max_margin = <200>;
		fuelgauge,capacity_min = <0>;
		fuelgauge,capacity_calculation_type = <28>;
		fuelgauge,type_str = "SDI";
		fuelgauge,model_type = <1>;

		fuelgauge,cell_character = <
			/* 4.30V Cell character*/
			/* Cell character 0, 0x34 ~ 0xD7 */
			0x77 0x0A 0x2F 0x0A 0xAC 0x09 0x4B 0x09 0x04 0x09
			0x73 0x08 0x21 0x08 0xD6 0x07 0x8D 0x07 0x3E 0x07
			0xE0 0x06 0xAA 0x06 0x82 0x06 0x63 0x06 0x4A 0x06
			0x33 0x06 0x0F 0x06 0xE8 0x05 0xAF 0x05 0x85 0x05
			0x22 0x05 0x35 0x02 0x69 0x08 0x00 0x08 0x97 0x07
			0x2E 0x07 0xC5 0x06 0x5C 0x06 0xF3 0x05 0x8B 0x05
			0x22 0x05 0xB9 0x04 0x50 0x04 0xE7 0x03 0x7E 0x03
			0x15 0x03 0xAC 0x02 0x43 0x02 0xDA 0x01 0x72 0x01
			0x09 0x01 0xA0 0x00 0x37 0x00 0xE0 0x0F 0xFE 0x29
			0xDC 0x29 0x8A 0x29 0x4D 0x29 0x28 0x1F 0x7F 0x1F
			0x21 0x21 0x14 0x21 0xF7 0x0F 0xE6 0xF7 0xC4 0x1D
			0xCA 0xD4 0xD3 0xD4 0x40 0x80 0x26 0x33 0x26 0x40
			0x26 0x5C 0x26 0x5C 0x26 0x5C 0xFF 0xFF 0x02 0x05
			0x14 0x0B 0x03 0x12 0x06 0x1C 0x0C 0x1C 0x10 0x1C
			0x1F 0x1F 0x35 0x35 0x3D 0x3D 0x3D 0x3D 0x3D 0x3D
			0x3D 0x3D 0x3E 0x3F 0x3F 0x3F 0x40 0x40 0x41 0x42
			0x44 0x43 0x66 0x9A
			/* Cell character 1, 0x0F ~ 0x13 */
			0x1F 0x60 0x09 0x00 0x00

			/* 4.28V Cell character*/
			/* Cell character 0, 0x34 ~ 0xD7 */
			0xF5 0x09 0x87 0x09 0x25 0x09 0xC4 0x08 0x83 0x08
			0xF0 0x07 0xC0 0x07 0x81 0x07 0x25 0x07 0xD8 0x06
			0xA8 0x06 0x83 0x06 0x65 0x06 0x4C 0x06 0x37 0x06
			0x18 0x06 0xF4 0x05 0xC5 0x05 0x8D 0x05 0x7E 0x05
			0x09 0x04 0x2B 0x02 0x00 0x08 0x9B 0x07 0x36 0x07
			0xD2 0x06 0x6D 0x06 0x08 0x06 0xA3 0x05 0x3F 0x05
			0xDA 0x04 0x75 0x04 0x10 0x04 0xAB 0x03 0x47 0x03
			0xE2 0x02 0x7D 0x02 0x18 0x02 0xB4 0x01 0x4F 0x01
			0xEA 0x00 0x85 0x00 0x21 0x00 0xF9 0x0F 0xFE 0x29
			0xDC 0x29 0x8A 0x29 0x4D 0x29 0x28 0x1F 0x7F 0x1F
			0x21 0x21 0x14 0x21 0xF7 0x0F 0xE6 0xF7 0xC4 0x1D
			0xCA 0xD4 0xD3 0xD4 0x40 0x80 0x26 0x33 0x26 0x40
			0x26 0x5C 0x26 0x5C 0x26 0x5C 0xFF 0xFF 0x02 0x05
			0x14 0x0B 0x03 0x12 0x06 0x1C 0x0C 0x1C 0x10 0x1C
			0x1F 0x1F 0x35 0x35 0x3D 0x3D 0x3D 0x3D 0x3D 0x3D
			0x3D 0x3D 0x3E 0x3F 0x3F 0x3F 0x40 0x40 0x41 0x42
			0x44 0x43 0x66 0x9A
			/* Cell character 1, 0x0F ~ 0x13 */
			0x1F 0x60 0x09 0x00 0x00

			/* 4.26V Cell character*/
			/* Cell character 0, 0x34 ~ 0xD7 */
			0x14 0x0A 0xCF 0x09 0x64 0x09 0x03 0x09 0xA9 0x08
			0x50 0x08 0xD8 0x07 0xB0 0x07 0x6A 0x07 0x07 0x07
			0xC8 0x06 0x9C 0x06 0x79 0x06 0x5D 0x06 0x46 0x06
			0x31 0x06 0x0D 0x06 0xEB 0x05 0xB8 0x05 0x89 0x05
			0x6B 0x05 0x1B 0x03 0x67 0x08 0x00 0x08 0x99 0x07
			0x32 0x07 0xCB 0x06 0x64 0x06 0xFE 0x05 0x96 0x05
			0x2F 0x05 0xC9 0x04 0x62 0x04 0xFB 0x03 0x94 0x03
			0x2D 0x03 0xC6 0x02 0x5F 0x02 0xF8 0x01 0x91 0x01
			0x2A 0x01 0xC4 0x00 0x5D 0x00 0xF6 0x0F 0xFE 0x29
			0xDC 0x29 0x8A 0x29 0x4D 0x29 0x28 0x1F 0x7F 0x1F
			0x21 0x21 0x14 0x21 0xF7 0x0F 0xE6 0xF7 0xC4 0x1D
			0xCA 0xD4 0xD3 0xD4 0x40 0x80 0x26 0x33 0x26 0x40
			0x26 0x5C 0x26 0x5C 0x26 0x5C 0xFF 0xFF 0x02 0x05
			0x14 0x0B 0x03 0x12 0x06 0x1C 0x0C 0x1C 0x10 0x1C
			0x1F 0x1F 0x35 0x35 0x3D 0x3D 0x3D 0x3D 0x3D 0x3D
			0x3D 0x3D 0x3E 0x3F 0x3F 0x3F 0x40 0x40 0x41 0x42
			0x44 0x43 0x66 0x9A
			/* Cell character 1, 0x0F ~ 0x13 */
			0x1F 0x60 0x09 0x00 0x00

			/* 4.24V Cell character*/
			/* Cell character 0, 0x34 ~ 0xD7 */
			0xA7 0x09 0x41 0x09 0xE3 0x08 0x9A 0x08 0x1F 0x08
			0xCC 0x07 0xA2 0x07 0x5B 0x07 0xFB 0x06 0xC2 0x06
			0x99 0x06 0x78 0x06 0x5D 0x06 0x47 0x06 0x31 0x06
			0x0F 0x06 0xEF 0x05 0xBF 0x05 0x8C 0x05 0x7C 0x05
			0xFE 0x03 0x96 0x02 0x00 0x08 0x9B 0x07 0x35 0x07
			0xD0 0x06 0x6A 0x06 0x05 0x06 0x9F 0x05 0x3A 0x05
			0xD4 0x04 0x6F 0x04 0x0A 0x04 0xA4 0x03 0x3F 0x03
			0xD9 0x02 0x74 0x02 0x0E 0x02 0xA9 0x01 0x44 0x01
			0xDE 0x00 0x79 0x00 0x13 0x00 0xF3 0x0F 0xFE 0x29
			0xDC 0x29 0x8A 0x29 0x4D 0x29 0x28 0x1F 0x7F 0x1F
			0x21 0x21 0x14 0x21 0xF7 0x0F 0xE6 0xF7 0xC4 0x1D
			0xCA 0xD4 0xD3 0xD4 0x40 0x80 0x26 0x33 0x26 0x40
			0x26 0x5C 0x26 0x5C 0x26 0x5C 0xFF 0xFF 0x02 0x05
			0x14 0x0B 0x03 0x12 0x06 0x1C 0x0C 0x1C 0x10 0x1C
			0x1F 0x1F 0x35 0x35 0x3D 0x3D 0x3D 0x3D 0x3D 0x3D
			0x3D 0x3D 0x3E 0x3F 0x3F 0x3F 0x40 0x40 0x41 0x42
			0x44 0x43 0x66 0x9A
			/* Cell character 1, 0x0F ~ 0x13 */
			0x1F 0x60 0x09 0x00 0x00

			/* 4.19V Cell character*/
			/* Cell character 0, 0x34 ~ 0xD7 */
			0x85 0x09 0x45 0x09 0xE1 0x08 0x9C 0x08 0x2A 0x08
			0xD0 0x07 0xAC 0x07 0x6B 0x07 0x0D 0x07 0xCF 0x06
			0xA4 0x06 0x82 0x06 0x66 0x06 0x50 0x06 0x39 0x06
			0x20 0x06 0xFE 0x05 0xDD 0x05 0xA9 0x05 0x87 0x05
			0x59 0x05 0xFA 0x02 0x67 0x08 0x00 0x08 0x99 0x07
			0x32 0x07 0xCA 0x06 0x63 0x06 0xFC 0x05 0x94 0x05
			0x2D 0x05 0xC6 0x04 0x5F 0x04 0xF7 0x03 0x90 0x03
			0x29 0x03 0xC2 0x02 0x5A 0x02 0xF3 0x01 0x8C 0x01
			0x25 0x01 0xBD 0x00 0x56 0x00 0xEF 0x0F 0xFE 0x29
			0xDC 0x29 0x8A 0x29 0x4D 0x29 0x28 0x1F 0x7F 0x1F
			0x21 0x21 0x14 0x21 0xF7 0x0F 0xE6 0xF7 0xC4 0x1D
			0xCA 0xD4 0xD3 0xD4 0x40 0x80 0x26 0x33 0x26 0x40
			0x26 0x5C 0x26 0x5C 0x26 0x5C 0xFF 0xFF 0x02 0x05
			0x14 0x0B 0x03 0x12 0x06 0x1C 0x0C 0x1C 0x10 0x1C
			0x1F 0x1F 0x35 0x35 0x3D 0x3D 0x3D 0x3D 0x3D 0x3D
			0x3D 0x3D 0x3E 0x3F 0x3F 0x3F 0x40 0x40 0x41 0x42
			0x44 0x43 0x66 0x9A
			/* Cell character 1, 0x0F ~ 0x13 */
			0x1F 0x60 0x09 0x00 0xEC
			>;

		//fuelgauge,ocv_table = <0 3650 3760 3890>;
		//fuelgauge,offset_table = <55 50 45 40>;
		fuelgauge,raw_100_vbat = <4273 4245 4226 4207 4159>;
	};

	battery {
		status = "okay";

		pinctrl-names = "default";

		compatible = "samsung,sec-battery";
		battery,vendor = "SDI SDI";
		battery,charger_name = "s2mpu06-charger";
		battery,fuelgauge_name = "s2mpu06-fuelgauge";
		battery,technology = <2>; /* POWER_SUPPLY_TECHNOLOGY_LION */

		battery,chip_vendor = "LSI";

		battery,battery_type = <&gpd1 5 0x1>;

		battery,temp_adc_type = <1>; /* SEC_BATTERY_ADC_TYPE_AP */

		battery,polling_time = <10 30 30 30 3600>;

		battery,temp_table_adc = <300 354 412 490 565 661 795 890 960 1072 1130 1200 1330 1570 1780 2010
								2240 2495 2726 2925 3126 3242 3324 3469 3591 3689>;

		battery,temp_table_data = <900 850 800 750 700 650 600 550 500 470 450 430 400 350 300 250
								200 150 100 50 0 (-30) (-50) (-100) (-150) (-200)>;

		battery,input_current_limit = <1000 460 460 1000 480 900 1000 480 1000 0 820 820 820 1000 1000 0 0 400 700 1000 300 1000 1000 0 1667 1667 1000 1667 80 1800 1667 1400 1000 1000 820 820>;
		battery,fast_charging_current = <1200 0 0 1200 800 1200 1000 800 1200 0 1200 1200 1200 1200 1200 0 0 400 700 1200 300 1000 1200 0 2550 2550 1000 2550 80 1800 1000 1400 0 1000 1200 1200>;
		battery,full_check_current_1st = <240 0 0 240 240 240 240 240 240 0 240 240 240 240 240 0 0 240 240 240 240 240 240 0 240 240 240 240 0 240 240 240 0 240 240 240>;
		battery,full_check_current_2nd = <120 0 0 120 120 120 120 120 120 0 120 120 120 120 120 0 0 120 120 120 120 120 120 0 120 120 120 120 0 120 120 120 0 120 120 120>;

		battery,wireless_cc_cv = <86>;
		battery,inbat_voltage = <1>;

		battery,inbat_voltage_table_adc = <3120 3101 3061 3038 3001 2956 2920 2887 2856 2814
						2793 2754 2720 2677 2641 2613 2572 2531 2502 2467 2436>;
		battery,inbat_voltage_table_data = <438 435 430 425 420 415 410 405 400 395
						390 385 380 375 370 365 360 355 350 345 340>;

		battery,adc_check_count = <5>;

		battery,cable_check_type = <4>; /* SEC_BATTERY_CABLE_CHECK_PSY */
		battery,cable_source_type = <1>; /* SEC_BATTERY_CABLE_SOURCE_EXTERNAL */
		battery,polling_type = <1>; /* SEC_BATTERY_MONITOR_ALARM */
		battery,monitor_initial_count = <0>;

		battery,battery_check_type = <5>; /* SEC_BATTERY_CHECK_CHARGER */
		battery,check_count = <0>;

		battery,ovp_uvlo_check_type = <3>; /* SEC_BATTERY_OVP_UVLO_CHGPOLLING */

		battery,check_adc_max = <1440>;
		battery,check_adc_min = <0>;

		battery,thermal_source = <2>; /* SEC_BATTERY_THERMAL_SOURCE_ADC */

		battery,temp_check_type = <2>; /* SEC_BATTERY_TEMP_CHECK_TEMP */
		battery,temp_check_count = <1>;
		battery,temp_highlimit_threshold_normal = <800>;
		battery,temp_highlimit_recovery_normal = <750>;
		battery,temp_high_threshold_normal = <500>;
		battery,temp_high_recovery_normal = <450>;
		battery,temp_low_threshold_normal = <0>;
		battery,temp_low_recovery_normal = <50>;
		battery,temp_highlimit_threshold_lpm = <800>;
		battery,temp_highlimit_recovery_lpm = <750>;
		battery,temp_high_threshold_lpm = <500>;
		battery,temp_high_recovery_lpm = <450>;
		battery,temp_low_threshold_lpm = <0>;
		battery,temp_low_recovery_lpm = <50>;

		battery,full_check_type = <7>; /* SEC_BATTERY_FULLCHARGED_CHGPSY */
		battery,full_check_type_2nd = <7>; /* SEC_BATTERY_FULLCHARGED_CHGPSY */
		battery,full_check_count = <1>;
		battery,chg_gpio_full_check = <0>;
		battery,chg_polarity_full_check = <1>;

		battery,chg_high_temp_1st = <530>;
		battery,chg_high_temp_2nd = <530>;
		battery,chg_high_temp_recovery = <525>;
		battery,chg_charging_limit_current = <1300>;
		battery,chg_charging_limit_current_2nd = <1300>;
		battery,chg_skip_check_capacity = <10>;
		battery,chg_skip_check_time = <600>;

		battery,wpc_high_temp = <420>;
		battery,wpc_high_temp_recovery = <410>;
		battery,wpc_charging_limit_current = <450>;

		/* SEC_BATTERY_FULL_CONDITION_SOC |
		   SEC_BATTERY_FULL_CONDITION_NOTIMEFULL |
		   SEC_BATTERY_FULL_CONDITION_VCELL */
		battery,full_condition_type = <15>;
		battery,full_condition_soc = <93>;
		battery,full_condition_vcell = <4230>;
		battery,full_condition_vcell2 = <4230>;

		battery,recharge_check_count = <2>;
		battery,recharge_condition_type = <4>; /* SEC_BATTERY_RECHARGE_CONDITION_VCELL */
		battery,recharge_condition_soc = <98>;
		battery,recharge_condition_vcell = <4200>;
		battery,recharge_condition_vcell2 = <4200>;

		battery,standard_curr = <1046>;
		battery,recharging_expired_time = <5400>;
		battery,expired_time = <15000>; /*2nd EOC 120min */
		
		battery,charging_total_time = <21600>;
		battery,recharging_total_time = <5400>;
		battery,charging_reset_time = <0>;

		battery,chg_float_voltage = <4300>;
		battery,chg_float_voltage2 = <4300>;

		battery,self_discharging_temp_block = <600>;
		battery,self_discharging_volt_block = <4250>;
		battery,self_discharging_temp_recov = <550>;
		battery,self_discharging_temp_pollingtime = <400>;

		battery,swelling_high_temp_block = <410>;
		battery,swelling_high_temp_recov = <390>;
		
		battery,swelling_low_temp_2step_mode = <1>;
		battery,swelling_low_temp_block_1st = <150>;
		battery,swelling_low_temp_recov_1st = <200>;
		battery,swelling_low_temp_block_2nd = <50>;
		battery,swelling_low_temp_recov_2nd = <100>;

		battery,swelling_high_temp_current = <1000>;
		battery,swelling_low_temp_current = <720>;
		battery,swelling_low_temp_topoff = <150>;
		battery,swelling_high_temp_topoff = <150>;

		battery,swelling_drop_float_voltage = <4100>;
		battery,swelling_high_rechg_voltage = <3950>;
		battery,swelling_low_rechg_voltage = <3950>;
		battery,swelling_block_time = <600>;

		io-channels = <&exynos_adc 1>;
		io-channel-names = "adc-temp";
		#io-channel-cells = <1>;
		io-channel-ranges;

		/* cycle, chg_float_voltage, recharge_condition_vcell, full_condition_vcell, full_condition_soc */
		battery,age_data = <0 4300 4200 4200 92	/*4.30*/
			200 4280 4180 4180 91	/*4.28*/
			250 4260 4160 4160 89	/*4.26*/
			300 4240 4140 4140 87	/*4.24*/
			1000 4190 4090 4090 83	/*4.19*/
			>;

		battery,data_ver = <0x2>; 
	};

	s2mpu06-charger {
		status = "disable";
		compatible = "samsung,s2mpu06-charger";
		battery,is_1MHz_switching = <1>;
		battery,chg_gpio_en = <0>;
		battery,chg_polarity_en = <0>;
		battery,chg_gpio_status = <0>;
		battery,chg_polarity_status = <0>;
	};
};

