&gen_panel {
	dsi_s6d78a0_boe_qHD_video: gen-panel-s6d78a0-boe-qHD-video {
		gen-panel-manu = "BOE";		/* condensed manufacturer name */
		gen-panel-name = "s6d78a0-boe";
		gen-panel-id = <0x53b810>;
		gen-panel-type = "video_mode";
		gen-panel-refresh = <60>;
		gen-panel-xres = <540>;
		gen-panel-yres = <960>;
		gen-panel-width= <62>;		/* screen width in mm */
		gen-panel-height = <110>;	/* screen height in mm */
		gen-panel-h-front-porch = <60>;/* right margin */
		gen-panel-h-back-porch = <60>;	/* left margin */
		gen-panel-h-sync-width = <14>;	/* hsync len */
		gen-panel-v-front-porch = <8>;	/* lower margin */
		gen-panel-v-back-porch = <6>;	/* upper margin */
		gen-panel-v-sync-width = <2>;	/* vsync len */
		gen-panel-hsync-invert = <0>;	/* hsync invert */
		gen-panel-vsync-invert = <0>;	/* vsync invert */
		gen-panel-lanes = <2>;
		gen-panel-burst-mode = <2>;
		gen-panel-master-mode;
		gen-panel-hfp-en;
		gen-panel-hbp-en;

		/*
		 * DSI PACKET HEADER INFO
		 * @ data type : 1byte
		 * @ tx mode : 1byte
		 * @ delay(msec) : 2byte
		 * @ size of data : 2byte
		 */
		gen-panel-pkt-dinfo-addr-offset = <0>;
		gen-panel-pkt-dinfo-addr-length = <1>;
		gen-panel-pkt-dinfo-data-offset = <1>;
		gen-panel-pkt-dinfo-data-length = <1>;
		gen-panel-init-cmds = [
		/* type | lp | delay | length  */
			39 00 00 00 00 03	F0 5A 5A
			39 00 00 00 00 03	F1 5A 5A
			39 00 00 00 00 03	FC A5 A5
		];
		gen-panel-post-enable-cmds = [
			05 00 00 78 00 01	11	/* sleep out */

			15 00 00 00 00 02	B1 93
			15 00 00 00 00 02	B5 10
			39 00 00 00 00 12	F4 01 10 32 00 24 26 28 27 27 27 B7 2B 2C 65
						6A 34 20
			39 00 00 00 00 15	EF 01 01 81 22 83 04 00 00 00 00 28 81 00 21 21
						03 03 40 00 10
			39 00 00 00 00 09	F2 19 04 08 08 08 14 14 00
			39 00 00 00 00 07	F6 93 23 15 07 07 0C
			39 00 00 00 00 07	E1 01 FF 01 1B 20 17
			39 00 00 00 00 04	E2 ED C7 23 
			39 00 00 00 00 27	F7 01 01 0A 0B 05 1B 1A 01 01 01 01 01 01 01 01
						01 01 01 01 01 01 08 09 04 1B 1A 01 01 01 01 01
						01 01 01 01 01 01 01

			39 00 00 00 00 02	36 10

			39 00 00 00 00 28	FA 00 19 21 1E 14 0B 10 0E 09 0B 00 00 0A 00 1D
								21 1E 14 0B 10 0E 09 0B 00 00 0A 00 1C 21 1E 14
								0B 10 0E 09 0B 00 00 0A
			39 00 00 00 00 28	FB 07 2D 22 24 18 0E 11 0C 05 05 00 00 0A 00 29
								22 24 18 0E 11 0C 05 05 00 00 0A 07 2A 22 24 18
								0E 11 0C 05 05 00 00 0A
			05 00 00 14 00 01	29	/* lcd on */

			39 00 00 00 00 03	F0 A5 A5
			39 00 00 00 00 03	F1 A5 A5
			39 00 00 00 00 03	FC 5A 5A
		];
		gen-panel-disable-cmds = [
			05 00 00 14 00 01	28
			05 00 00 79 00 01	10
		];

		gen-panel-read-id = [
			DA 00 01
			DB 00 01
			DC 00 01
		];
		gen-panel-read-status-reg = [0A];
		gen-panel-read-status-ok = [9A];
		status = "okay";
	};
};
