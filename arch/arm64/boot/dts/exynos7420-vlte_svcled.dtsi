/*
 * SAMSUNG UNIVERSAL7420 board device tree source
 *
 * Copyright (c) 2014 Samsung Electronics Co., Ltd.
 *		http://www.samsung.com
 *
 * This program is free software; you can redistribute it and/or modify
 * it under the terms of the GNU General Public License version 2 as
 * published by the Free Software Foundation.
*/

/ {
	rgb {
		device_type = <4>;
		normal_powermode_current = <10>;
		low_powermode_current = <2>;
		br_ratio_r = <100>;
		br_ratio_g = <100>;
		br_ratio_b = <100>;

		normal_powermode_current_wh = <10>;
		low_powermode_current_wh = <2>;
		br_ratio_r_wh = <100>;
		br_ratio_g_wh = <100>;
		br_ratio_b_wh = <100>;

		normal_powermode_current_bk = <10>;
		low_powermode_current_bk = <2>;
		br_ratio_r_bk = <100>;
		br_ratio_g_bk = <100>;
		br_ratio_b_bk = <100>;

		normal_powermode_current_gd = <10>;
		low_powermode_current_gd = <2>;
		br_ratio_r_gd = <100>;
		br_ratio_g_gd = <100>;
		br_ratio_b_gd = <100>;

		normal_powermode_current_bl = <10>;
		low_powermode_current_bl = <2>;
		br_ratio_r_bl = <100>;
		br_ratio_g_bl = <100>;
		br_ratio_b_bl = <100>;

		normal_powermode_current_rd = <10>;
		low_powermode_current_rd = <2>;
		br_ratio_r_rd = <100>;
		br_ratio_g_rd = <100>;
		br_ratio_b_rd = <100>;

		normal_powermode_current_sv = <10>;
		low_powermode_current_sv = <2>;
		br_ratio_r_sv = <100>;
		br_ratio_g_sv = <100>;
		br_ratio_b_sv = <100>;
	};
};
