/*
 * Copyright (C) 2014 Marvell
 * Yi Zhang <yizhang@marvell.com>
 */

/*
 * 88pm886 parameters for the following battery model
 * Part Name: Li-ion Polymer Rechargeable Battery
 * Pack Parts No.: ALE455557SA
 * Pack Standard: 2000mAh(0.2C)
 * Cell Model: SP455557SA
 * Pack Model: 1S1P-SP455557SA-PCM
 */


&pmic0 {
	charger {
		prechg-current = <450>;
		prechg-voltage = <3000>;
		fastchg-voltage = <4200>;
		fastchg-cur = <1000>;
		fastchg-eoc = <20>;
		fastchg-tout = <8>;
		recharge-thr = <200>;
		dcp-limit = <2400>;
		status = "okay";
	};

	battery {
		bat-capacity = <2000>;	/* mAh */

		low-threshold = <30>;		/* % */
		high-threshold = <50>;		/* % */

		ocv-table = <
			3397 3445 3477 3496 3506 3513 3519 3526 3532 3540
			3551 3563 3576 3587 3600 3612 3625 3637 3649 3662
			3674 3687 3699 3709 3719 3727 3733 3739 3744 3748
			3752 3755 3758 3761 3763 3765 3766 3767 3769 3770
			3771 3772 3773 3774 3776 3777 3778 3780 3781 3784
			3786 3790 3794 3799 3805 3812 3819 3828 3838 3846
			3854 3860 3867 3873 3879 3885 3891 3897 3903 3910
			3916 3923 3930 3937 3944 3951 3959 3966 3973 3981
			3989 3997 4006 4015 4024 4034 4043 4053 4063 4073
			4082 4092 4102 4112 4122 4133 4144 4155 4167 4179
		>;

		abs-lowest-temp = <20>;
		t1-degree = <0>;	/* -20C */
		t2-degree = <20>;	/* 0C */
		t3-degree = <50>;	/* 30C */
		t4-degree = <65>;	/* 45C */

		times-in-minus-ten = <2>;
		offset-in-minus-ten = <100>;
		times-in-zero = <1>;
		offset-in-zero = <0>;

		soc-low-th-cycle = <15>;
		soc-high-th-cycle = <85>;

		zero-degree-ohm = <28704>;

		/* -24C, -23C, ..., 62C, 63C */
		ntc-table =
			        <96391 24>,
				<91222 23>,
				<86369 22>,
				<81809 21>,
				<77523 20>,
				<73492 19>,
				<69701 18>,
				<66132 17>,
				<62772 16>,
				<59606 15>,
				<56623 14>,
				<53810 13>,
				<51157 12>,
				<48654 11>,
				<46290 10>,
				<44058 9>,
				<41950 8>,
				<39957 7>,
				<38072 6>,
				<36290 5>,
				<34603 4>,
				<33006 3>,
				<31494 2>,
				<30062 1>, /* negative temperature */

				<28704 0>,
				<27417 1>,
				<26197 2>,
				<25039 3>,
				<23940 4>,
				<22897 5>,
				<21906 6>,
				<20964 7>,
				<20070 8>,
				<19219 9>,
				<18410 10>,
				<17641 11>,
				<16909 12>,
				<16212 13>,
				<15548 14>,
				<14916 15>,
				<14313 16>,
				<13739 17>,
				<13192 18>,
				<12670 19>,
				<12171 20>,
				<11696 21>,
				<11242 22>,
				<10809 23>,
				<10395 24>,
				<10000 25>,
				<9622 26>,
				<9261 27>,
				<8916 28>,
				<8585 29>,
				<8269 30>,
				<7967 31>,
				<7678 32>,
				<7400 33>,
				<7135 34>,
				<6881 35>,
				<6637 36>,
				<6403 37>,
				<6180 38>,
				<5965 39>,
				<5759 40>,
				<5561 41>,
				<5372 42>,
				<5189 43>,
				<5015 44>,
				<4847 45>,
				<4686 46>,
				<4531 47>,
				<4382 48>,
				<4238 49>,
				<4101 50>,
				<3969 51>,
				<3842 52>,
				<3719 53>,
				<3601 54>,
				<3488 55>,
				<3379 56>,
				<3274 57>,
				<3172 58>,
				<3075 59>,
				<2981 60>,
				<2890 61>,
				<2803 62>,
				<2719 63>;
	};
};
