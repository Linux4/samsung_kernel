/*
 * Copyright (C) 2014 Marvell
 * Yi Zhang <yizhang@marvell.com>
 */

/*
 * 88pm830 parameters for the following battery model
 * Part Name: Li-ion Polymer Rechargeable Battery
 * Pack Parts No.: ALE455557SA
 * Pack Standard: 2000mAh(0.2C)
 * Cell Model: SP455557SA
 * Pack Model: 1S1P-SP455557SA-PCM
 */


&pmic1 {
	charger {
	};

	battery {

		bat-ntc-support = <1>;
		bat-capacity = <2000>;	/* mAh */
		power-off-threshold = <3350>; /* mV */
		safe-power-off-threshold = <3000>; /* mV */

		ocv-table = <
			3397 3445 3477 3496 3506 3513 3519 3526 3532 3540
			3551 3563 3576 3587 3600 3612 3625 3637 3649 3662
			3674 3687 3699 3709 3719 3727 3733 3739 3744 3748
			3752 3755 3758 3761 3763 3765 3766 3767 3769 3770
			3771 3772 3773 3774 3776 3777 3778 3780 3781 3784
			3786 3790 3794 3799 3805 3812 3819 3828 3838 3846
			3854 3860 3867 3873 3879 3885 3891 3897 3903 3910
			3916 3923 3930 3937 3944 3951 3959 3966 3973 3981
			3989 3997 4006 4015 4024 4034 4043 4053 4063 4073
			4082 4092 4102 4112 4122 4133 4144 4155 4167 4179
		>;

		/* battery temerature feature parameters */
		temp-range-num = <2>;
		switch-thr = <15 64>; /* C */
		gp0-bias-curr = <16 56 56>; /* uA */

		/* choose -20C, 0C, 45C, 60C as threshold */
		r-tbat-thr = <77523 28704 4847 2981>; /* ohm */
		ntc-table-size = <88>;

		/* -24C, -23C, ..., 62C, 63C */
		ntc-table = <
			96391 91222 86369 81809 77523 73492 69701 66132
			62772 59606 56623 53810 51157 48654 46290 44058
			41950 39957 38072 36290 34603 33006 31494 30062
			28704 27417 26197 25039 23940 22897 21906 20964
			20070 19219 18410 17641 16909 16212 15548 14916
			14313 13739 13192 12670 12171 11696 11242 10809
			10395 10000 9622  9261  8916  8585  8269  7967
			7678  7400  7135  6881  6637  6403  6180  5965
			5759  5561  5372  5189  5015  4847  4686  4531
			4382  4238  4101  3969  3842  3719  3601  3488
			3379  3274  3172  3075  2981  2890  2803  2719
		>;
	};
};
