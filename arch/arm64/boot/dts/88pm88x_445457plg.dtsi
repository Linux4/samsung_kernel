/*
 * Copyright (C) 2014 Marvell
 * Yi Zhang <yizhang@marvell.com>
 */

/*
 * 88pm886 parameters for the following battery model
 * Part Name: Li-ion Polymer Rechargeable Battery
 * Pack Standard: 1900mAh(0.19C)
 * Cell Model: 445457PLG
 */


&pmic0 {
	charger {
		prechg-current = <450>;
		prechg-voltage = <3000>;
		fastchg-voltage = <4200>;
		fastchg-cur = <1000>;
		fastchg-eoc = <20>;
		fastchg-tout = <8>;
		recharge-thr = <200>;
		dcp-limit = <2400>;
		status = "okay";
	};

	battery {
		bat-capacity = <1900>;	/* mAh */
		ocv-table = <
			3476 3585 3615 3648 3656 3663 3665 3668 3672 3675
			3677 3682 3687 3701 3706 3712 3718 3724 3731 3734
			3738 3742 3745 3748 3752 3757 3760 3762 3764 3765
			3767 3768 3769 3870 3771 3772 3774 3777 3779 3780
			3782 3784 3788 3790 3792 3795 3798 3800 3803 3809
			3812 3815 3819 3823 3834 3842 3849 3858 3867 3874
			3881 3891 3896 3901 3905 3910 3920 3925 3929 3934
			3940 3946 3951 3962 3967 3972 3979 3984 3997 4003
			4010 4017 4025 4032 4040 4056 4062 4070 4078 4085
			4101 4108 4116 4125 4133 4142 4150 4168 4178 4189
		>;

		abs-lowest-temp = <20>;
		t1-degree = <0>;	/* -20C */
		t2-degree = <20>;	/* 0C */
		t3-degree = <50>;	/* 30C */
		t4-degree = <65>;	/* 45C */

		times-in-minus-ten = <2>;
		offset-in-minus-ten = <100>;
		times-in-zero = <1>;
		offset-in-zero = <0>;

		soc-low-th-cycle = <15>;
		soc-high-th-cycle = <85>;

		zero-degree-ohm = <27280>;

		/* -24C, -23C, ..., 62C, 63C */
		ntc-table =
				<82380 24>,
				<78430 23>,
				<74690 22>,
				<71140 21>,
				<67790 20>,
				<64610 19>,
				<61600 18>,
				<58740 17>,
				<56030 16>,
				<53460 15>,
				<51030 14>,
				<48710 13>,
				<46520 12>,
				<44430 11>,
				<42450 10>,
				<40570 9>,
				<38780 8>,
				<37080 7>,
				<35460 6>,
				<33930 5>,
				<32460 4>,
				<31070 3>,
				<29750 2>,
				<28490 1>, /* negative temperature */

				<27280 0>,
				<26140 1>,
				<25050 2>,
				<24010 3>,
				<23020 4>,
				<22070 5>,
				<21170 6>,
				<20310 7>,
				<19490 8>,
				<18710 9>,
				<17960 10>,
				<17250 11>,
				<16570 12>,
				<15910 13>,
				<15290 14>,
				<14700 15>,
				<14130 16>,
				<13590 17>,
				<13070 18>,
				<12570 19>,
				<12090 20>,
				<11640 21>,
				<11200 22>,
				<10780 23>,
				<10380 24>,
				<10000 25>,
				<9633 26>,
				<9282 27>,
				<8945 28>,
				<8622 29>,
				<8312 30>,
				<8015 31>,
				<7730 32>,
				<7456 33>,
				<7194 34>,
				<6942 35>,
				<6700 36>,
				<6468 37>,
				<6245 38>,
				<6031 39>,
				<5826 40>,
				<5628 41>,
				<5438 42>,
				<5255 43>,
				<5080 44>,
				<4911 45>,
				<4749 46>,
				<4592 47>,
				<4442 48>,
				<4297 49>,
				<4158 50>,
				<4024 51>,
				<3895 52>,
				<3771 53>,
				<3651 54>,
				<3536 55>,
				<3425 56>,
				<3318 57>,
				<3215 58>,
				<3115 59>,
				<3019 60>,
				<2927 61>,
				<2837 62>,
				<2751 63>;
	};
};
