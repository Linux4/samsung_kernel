/* Copyright (c) 2019, The Linux Foundation. All rights reserved.
 *
 * This program is free software; you can redistribute it and/or modify
 * it under the terms of the GNU General Public License version 2 and
 * only version 2 as published by the Free Software Foundation.
 *
 * This program is distributed in the hope that it will be useful,
 * but WITHOUT ANY WARRANTY; without even the implied warranty of
 * MERCHANTABILITY or FITNESS FOR A PARTICULAR PURPOSE.  See the
 * GNU General Public License for more details.
 */

#include <dt-bindings/soc/qcom,dcc_v2.h>


/* config_talos_dcc_gladiator() */
#define config_talos_dcc_gladiator	\
	\
		/* Gladiator */	\
		<DCC_READ 0x9680000 1 0>,	\
		<DCC_READ 0x9680004 1 0>,	\
		<DCC_LOOP 8 0 0>,	\
		<DCC_READ 0x9681000 1 0>,	\
		<DCC_LOOP 1 0 0>,	\
		<DCC_READ 0x9681004 1 0>,	\
		<DCC_READ 0x9681008 1 0>,	\
		<DCC_READ 0x968100c 1 0>,	\
		<DCC_READ 0x9681010 1 0>,	\
		<DCC_READ 0x9681014 1 0>,	\
		<DCC_READ 0x968101c 1 0>,	\
		<DCC_READ 0x9681020 1 0>,	\
		<DCC_READ 0x9681024 1 0>,	\
		<DCC_READ 0x9681028 1 0>,	\
		<DCC_READ 0x968102c 1 0>,	\
		<DCC_READ 0x9681030 1 0>,	\
		<DCC_READ 0x9681034 1 0>,	\
		<DCC_READ 0x968103c 1 0>,	\
		<DCC_READ 0x9698100 1 0>,	\
		<DCC_READ 0x9698104 1 0>,	\
		<DCC_READ 0x9698108 1 0>,	\
		<DCC_READ 0x9698110 1 0>,	\
		<DCC_READ 0x9698120 1 0>,	\
		<DCC_READ 0x9698124 1 0>,	\
		<DCC_READ 0x9698128 1 0>,	\
		<DCC_READ 0x969812c 1 0>,	\
		<DCC_READ 0x9698130 1 0>,	\
		<DCC_READ 0x9698134 1 0>,	\
		<DCC_READ 0x9698138 1 0>,	\
		<DCC_READ 0x969813c 1 0>,	\
		<DCC_READ 0x9698500 1 0>,	\
		<DCC_READ 0x9698504 1 0>,	\
		<DCC_READ 0x9698508 1 0>,	\
		<DCC_READ 0x969850c 1 0>,	\
		<DCC_READ 0x9698510 1 0>,	\
		<DCC_READ 0x9698514 1 0>,	\
		<DCC_READ 0x9698518 1 0>,	\
		<DCC_READ 0x969851c 1 0>,	\
		<DCC_READ 0x9698700 1 0>,	\
		<DCC_READ 0x9698704 1 0>,	\
		<DCC_READ 0x9698708 1 0>,	\
		<DCC_READ 0x969870c 1 0>,	\
		<DCC_READ 0x9698714 1 0>,	\
		<DCC_READ 0x9698718 1 0>,	\
		<DCC_READ 0x969871c 1 0>

/* config_talos_dcc_noc_err_regs() */
#define config_talos_dcc_noc_err_regs	\
	\
		/* CNOC */	\
		/* <DCC_READ 0x1500204 1 0>, */	\
		/* <DCC_READ 0x1500240 1 0>, */	\
		/* <DCC_READ 0x1500244 1 0>, */	\
		/* <DCC_READ 0x1500248 1 0>, */	\
		/* <DCC_READ 0x150024C 1 0>, */	\
		/* <DCC_READ 0x1500250 1 0>, */	\
		/* <DCC_READ 0x1500258 1 0>, */	\
		/* <DCC_READ 0x1500288 1 0>, */	\
		/* <DCC_READ 0x150028C 1 0>, */	\
		/* <DCC_READ 0x1500290 1 0>, */	\
		/* <DCC_READ 0x1500294 1 0>, */	\
		/* <DCC_READ 0x15002A8 1 0>, */	\
		/* <DCC_READ 0x15002AC 1 0>, */	\
		/* <DCC_READ 0x15002B0 1 0>, */	\
		/* <DCC_READ 0x15002B4 1 0>, */	\
		/* <DCC_READ 0x1500300 1 0>, */	\
		/* <DCC_READ 0x1500304 1 0>, */	\
		/* <DCC_READ 0x1500010 1 0>, */	\
		/* <DCC_READ 0x1500020 1 0>, */	\
		/* <DCC_READ 0x1500024 1 0>, */	\
		/* <DCC_READ 0x1500028 1 0>, */	\
		/* <DCC_READ 0x150002C 1 0>, */	\
		/* <DCC_READ 0x1500030 1 0>, */	\
		/* <DCC_READ 0x1500034 1 0>, */	\
		/* <DCC_READ 0x1500038 1 0>, */	\
		/* <DCC_READ 0x150003C 1 0>, */	\
	\
		/* SNOC */	\
		<DCC_READ 0x1620204 1 0>,	\
		<DCC_READ 0x1620240 1 0>,	\
		<DCC_READ 0x1620248 1 0>,	\
		<DCC_READ 0x1620288 1 0>,	\
		<DCC_READ 0x162028C 1 0>,	\
		<DCC_READ 0x1620290 1 0>,	\
		<DCC_READ 0x1620294 1 0>,	\
		<DCC_READ 0x16202A8 1 0>,	\
		<DCC_READ 0x16202AC 1 0>,	\
		<DCC_READ 0x16202B0 1 0>,	\
		<DCC_READ 0x16202B4 1 0>,	\
		<DCC_READ 0x1620300 1 0>,	\
	\
		/* AGGNOC */	\
		<DCC_READ 0x1700204 1 0>,	\
		<DCC_READ 0x1700240 1 0>,	\
		<DCC_READ 0x1700248 1 0>,	\
		<DCC_READ 0x1700288 1 0>,	\
		<DCC_READ 0x1700290 1 0>,	\
		<DCC_READ 0x1700300 1 0>,	\
		<DCC_READ 0x1700304 1 0>,	\
		<DCC_READ 0x1700308 1 0>,	\
		<DCC_READ 0x170030C 1 0>,	\
		<DCC_READ 0x1700310 1 0>,	\
		<DCC_READ 0x1700314 1 0>,	\
		<DCC_READ 0x1700C08 1 0>,	\
		<DCC_READ 0x1700C10 1 0>,	\
		<DCC_READ 0x1700C20 1 0>,	\
		<DCC_READ 0x1700C24 1 0>,	\
		<DCC_READ 0x1700C28 1 0>,	\
		<DCC_READ 0x1700C2C 1 0>,	\
		<DCC_READ 0x1700C30 1 0>,	\
		<DCC_READ 0x1700C34 1 0>,	\
		<DCC_READ 0x1700C38 1 0>,	\
		<DCC_READ 0x1700C3C 1 0>,	\
	\
		/* MNOC */	\
		<DCC_READ 0x1740240 1 0>,	\
		<DCC_READ 0x1740248 1 0>,	\
		<DCC_READ 0x1740288 1 0>,	\
		<DCC_READ 0x1740290 1 0>,	\
		<DCC_READ 0x1740300 1 0>,	\
		<DCC_READ 0x1740304 1 0>,	\
		<DCC_READ 0x1740308 1 0>,	\
		<DCC_READ 0x174030C 1 0>,	\
		<DCC_READ 0x1740310 1 0>,	\
		<DCC_READ 0x1740314 1 0>,	\
		<DCC_READ 0x1740004 1 0>,	\
		<DCC_READ 0x1740008 1 0>,	\
		<DCC_READ 0x1740010 1 0>,	\
		<DCC_READ 0x1740020 1 0>,	\
		<DCC_READ 0x1740024 1 0>,	\
		<DCC_READ 0x1740028 1 0>,	\
		<DCC_READ 0x174002C 1 0>,	\
		<DCC_READ 0x1740030 1 0>,	\
		<DCC_READ 0x1740034 1 0>,	\
		<DCC_READ 0x1740038 1 0>,	\
		<DCC_READ 0x174003C 1 0>,	\
	\
		/* GEM_NOC */	\
		<DCC_READ 0x9698204 1 0>,	\
		<DCC_READ 0x9698240 1 0>,	\
		<DCC_READ 0x9698244 1 0>,	\
		<DCC_READ 0x9698248 1 0>,	\
		<DCC_READ 0x969824C 1 0>,	\
		<DCC_READ 0x9681010 1 0>,	\
		<DCC_READ 0x9681014 1 0>,	\
		<DCC_READ 0x9681018 1 0>,	\
		<DCC_READ 0x968101C 1 0>,	\
		<DCC_READ 0x9681020 1 0>,	\
		<DCC_READ 0x9681024 1 0>,	\
		<DCC_READ 0x9681028 1 0>,	\
		<DCC_READ 0x968102C 1 0>,	\
		<DCC_READ 0x9681030 1 0>,	\
		<DCC_READ 0x9681034 1 0>,	\
		<DCC_READ 0x968103C 1 0>,	\
		<DCC_READ 0x9698100 1 0>,	\
		<DCC_READ 0x9698104 1 0>,	\
		<DCC_READ 0x9698108 1 0>,	\
		<DCC_READ 0x9698110 1 0>,	\
		<DCC_READ 0x9698120 1 0>,	\
		<DCC_READ 0x9698124 1 0>,	\
		<DCC_READ 0x9698128 1 0>,	\
		<DCC_READ 0x969812C 1 0>,	\
		<DCC_READ 0x9698130 1 0>,	\
		<DCC_READ 0x9698134 1 0>,	\
		<DCC_READ 0x9698138 1 0>,	\
		<DCC_READ 0x969813C 1 0>,	\
	\
		/* SSC_NOC */	\
		<DCC_READ 0x62BE2004 1 0>,	\
		<DCC_READ 0x62BE2040 1 0>,	\
		<DCC_READ 0x62BE2048 1 0>,	\
		<DCC_READ 0x62BE2088 1 0>,	\
		<DCC_READ 0x62BE2090 1 0>,	\
		<DCC_READ 0x62BE2100 1 0>,	\
		<DCC_READ 0x62BE2104 1 0>,	\
		<DCC_READ 0x62BE2108 1 0>,	\
		<DCC_READ 0x62BE210C 1 0>,	\
		<DCC_READ 0x62BE2110 1 0>,	\
		<DCC_READ 0x62BE2114 1 0>,	\
		<DCC_READ 0x62BE2118 1 0>,	\
		<DCC_READ 0x62BE0010 1 0>,	\
		<DCC_READ 0x62BE0020 1 0>,	\
		<DCC_READ 0x62BE0024 1 0>,	\
		<DCC_READ 0x62BE0028 1 0>,	\
		<DCC_READ 0x62BE002C 1 0>,	\
		<DCC_READ 0x62BE0030 1 0>,	\
		<DCC_READ 0x62BE0034 1 0>,	\
		<DCC_READ 0x62BE0038 1 0>,	\
		<DCC_READ 0x62BE003C 1 0>,	\
	\
		/* DC_NOC */	\
		<DCC_READ 0x9160204 1 0>,	\
		<DCC_READ 0x9160240 1 0>,	\
		<DCC_READ 0x9160248 1 0>,	\
		<DCC_READ 0x9160288 1 0>,	\
		<DCC_READ 0x9160290 1 0>,	\
		<DCC_READ 0x9160300 1 0>,	\
		<DCC_READ 0x9160304 1 0>,	\
		<DCC_READ 0x9160308 1 0>,	\
		<DCC_READ 0x916030C 1 0>,	\
		<DCC_READ 0x9160310 1 0>,	\
		<DCC_READ 0x9160314 1 0>,	\
		<DCC_READ 0x9160318 1 0>,	\
		<DCC_READ 0x9160008 1 0>,	\
		<DCC_READ 0x9160010 1 0>,	\
		<DCC_READ 0x9160020 1 0>,	\
		<DCC_READ 0x9160024 1 0>,	\
		<DCC_READ 0x9160028 1 0>,	\
		<DCC_READ 0x916002C 1 0>,	\
		<DCC_READ 0x9160030 1 0>,	\
		<DCC_READ 0x9160034 1 0>,	\
		<DCC_READ 0x9160038 1 0>,	\
		<DCC_READ 0x916003C 1 0>,	\
	\
		/* SNOC_CENTER_NIU_STATUS_SBM0_SENSEIN */	\
		<DCC_READ 0x1620500 4 0>,	\
	\
		/* SNOC_CENTER_NIU_STATUS_SBM1_SENSEIN */	\
		<DCC_READ 0x1620700 4 0>,	\
	\
		/* SNOC_CENTER_SBM_SENSEIN */	\
		<DCC_READ 0x1620300 1 0>,	\
	\
		/* SNOC_MONAQ_NIU_STATUS_SBM_SENSEIN */	\
		<DCC_READ 0x1620F00 2 0>,	\
	\
		/* SNOC_WEST_NIU_STATUS_SBM_SENSEIN */	\
		<DCC_READ 0x1620B00 2 0>,	\
	\
		/* A1NOC_MONAQ_SBM_SENSEIN */	\
		<DCC_READ 0x1700B00 2 0>,	\
	\
		/* A1NOC_WEST_SBM_SENSEIN */	\
		<DCC_READ 0x1700700 3 0>,	\
	\
		/* CNOC_CENTER_STATUS_SBM_SENSEIN */	\
		/* <DCC_READ 0x1500500 7 0>, */	\
	\
		/* CNOC_MMNOC_STATUS_SBM_SENSEIN */	\
		/* <DCC_READ 0x1500D00 4 0>, */	\
	\
		/* CNOC_WEST_STATUS_SBM_SENSEIN */	\
		/* <DCC_READ 0x1501100 4 0>, */	\
	\
		/* DC_NOC_DISABLE_SBM_SENSEIN */	\
		<DCC_READ 0x9163100 1 0>,	\
	\
		/* GEM_NOC_SBM_MDSP_SAFE_SHAPING_SENSEIN */	\
		<DCC_READ 0x96AA100 1 0>

/* config_talos_dcc_shrm() */
#define config_talos_dcc_shrm	\
	\
		/* SHRM CSR */	\
		<DCC_READ 0x9050008 1 0>,	\
		<DCC_READ 0x9050068 1 0>,	\
		<DCC_READ 0x9050078 1 0>

/* config_talos_dcc_rscc_apps() */
#define config_talos_dcc_rscc_apps	\
	\
		/* RSC */	\
		<DCC_READ 0x18200400 1 0>,	\
		<DCC_READ 0x18200404 1 0>,	\
		<DCC_READ 0x18200408 1 0>,	\
		<DCC_READ 0x18200038 1 0>,	\
		<DCC_READ 0x18200040 1 0>,	\
		<DCC_READ 0x18200048 1 0>,	\
		<DCC_READ 0x18220038 1 0>,	\
		<DCC_READ 0x18220040 1 0>,	\
		<DCC_READ 0x182200D0 1 0>,	\
		<DCC_READ 0x18200030 1 0>,	\
		<DCC_READ 0x18200010 1 0>,	\
	\
		/* RSC-TCS */	\
		<DCC_READ 0x1822000c 1 0>,	\
		<DCC_READ 0x18220d14 1 0>,	\
		<DCC_READ 0x18220fb4 1 0>,	\
		<DCC_READ 0x18221254 1 0>,	\
		<DCC_READ 0x182214f4 1 0>,	\
		<DCC_READ 0x18221794 1 0>,	\
		<DCC_READ 0x18221a34 1 0>,	\
		<DCC_READ 0x18221cd4 1 0>,	\
		<DCC_READ 0x18221f74 1 0>,	\
		<DCC_READ 0x18220d18 1 0>,	\
		<DCC_READ 0x18220fb8 1 0>,	\
		<DCC_READ 0x18221258 1 0>,	\
		<DCC_READ 0x182214f8 1 0>,	\
		<DCC_READ 0x18221798 1 0>,	\
		<DCC_READ 0x18221a38 1 0>,	\
		<DCC_READ 0x18221cd8 1 0>,	\
		<DCC_READ 0x18221f78 1 0>,	\
		<DCC_READ 0x18220d00 1 0>,	\
		<DCC_READ 0x18220d04 1 0>,	\
		<DCC_READ 0x18220d1c 1 0>,	\
		<DCC_READ 0x18220fbc 1 0>,	\
		<DCC_READ 0x1822125c 1 0>,	\
		<DCC_READ 0x182214fc 1 0>,	\
		<DCC_READ 0x1822179c 1 0>,	\
		<DCC_READ 0x18221a3c 1 0>,	\
		<DCC_READ 0x18221cdc 1 0>,	\
		<DCC_READ 0x18221f7c 1 0>,	\
		<DCC_READ 0x18221274 1 0>,	\
		<DCC_READ 0x18221288 1 0>,	\
		<DCC_READ 0x1822129c 1 0>,	\
		<DCC_READ 0x182212b0 1 0>,	\
		<DCC_READ 0x182212c4 1 0>,	\
		<DCC_READ 0x182212d8 1 0>,	\
		<DCC_READ 0x182212ec 1 0>,	\
		<DCC_READ 0x18221300 1 0>,	\
		<DCC_READ 0x18221314 1 0>,	\
		<DCC_READ 0x18221328 1 0>,	\
		<DCC_READ 0x1822133c 1 0>,	\
		<DCC_READ 0x18221350 1 0>,	\
		<DCC_READ 0x18221364 1 0>,	\
		<DCC_READ 0x18221378 1 0>,	\
		<DCC_READ 0x1822138c 1 0>,	\
		<DCC_READ 0x182213a0 1 0>,	\
		<DCC_READ 0x18221514 1 0>,	\
		<DCC_READ 0x18221528 1 0>,	\
		<DCC_READ 0x1822153c 1 0>,	\
		<DCC_READ 0x18221550 1 0>,	\
		<DCC_READ 0x18221564 1 0>,	\
		<DCC_READ 0x18221578 1 0>,	\
		<DCC_READ 0x1822158c 1 0>,	\
		<DCC_READ 0x182215a0 1 0>,	\
		<DCC_READ 0x182215b4 1 0>,	\
		<DCC_READ 0x182215c8 1 0>,	\
		<DCC_READ 0x182215dc 1 0>,	\
		<DCC_READ 0x182215f0 1 0>,	\
		<DCC_READ 0x18221604 1 0>,	\
		<DCC_READ 0x18221618 1 0>,	\
		<DCC_READ 0x1822162c 1 0>,	\
		<DCC_READ 0x18221640 1 0>,	\
		<DCC_READ 0x182217b4 1 0>,	\
		<DCC_READ 0x182217c8 1 0>,	\
		<DCC_READ 0x182217dc 1 0>,	\
		<DCC_READ 0x182217f0 1 0>,	\
		<DCC_READ 0x18221804 1 0>,	\
		<DCC_READ 0x18221818 1 0>,	\
		<DCC_READ 0x1822182c 1 0>,	\
		<DCC_READ 0x18221840 1 0>,	\
		<DCC_READ 0x18221854 1 0>,	\
		<DCC_READ 0x18221868 1 0>,	\
		<DCC_READ 0x1822187c 1 0>,	\
		<DCC_READ 0x18221890 1 0>,	\
		<DCC_READ 0x182218a4 1 0>,	\
		<DCC_READ 0x182218b8 1 0>,	\
		<DCC_READ 0x182218cc 1 0>,	\
		<DCC_READ 0x182218e0 1 0>,	\
		<DCC_READ 0x18221a54 1 0>,	\
		<DCC_READ 0x18221a68 1 0>,	\
		<DCC_READ 0x18221a7c 1 0>,	\
		<DCC_READ 0x18221a90 1 0>,	\
		<DCC_READ 0x18221aa4 1 0>,	\
		<DCC_READ 0x18221ab8 1 0>,	\
		<DCC_READ 0x18221acc 1 0>,	\
		<DCC_READ 0x18221ae0 1 0>,	\
		<DCC_READ 0x18221af4 1 0>,	\
		<DCC_READ 0x18221b08 1 0>,	\
		<DCC_READ 0x18221b1c 1 0>,	\
		<DCC_READ 0x18221b30 1 0>,	\
		<DCC_READ 0x18221b44 1 0>,	\
		<DCC_READ 0x18221b58 1 0>,	\
		<DCC_READ 0x18221b6c 1 0>,	\
		<DCC_READ 0x18221b80 1 0>,	\
		<DCC_READ 0x18221cf4 1 0>,	\
		<DCC_READ 0x18221d08 1 0>,	\
		<DCC_READ 0x18221d1c 1 0>,	\
		<DCC_READ 0x18221d30 1 0>,	\
		<DCC_READ 0x18221d44 1 0>,	\
		<DCC_READ 0x18221d58 1 0>,	\
		<DCC_READ 0x18221d6c 1 0>,	\
		<DCC_READ 0x18221d80 1 0>,	\
		<DCC_READ 0x18221d94 1 0>,	\
		<DCC_READ 0x18221da8 1 0>,	\
		<DCC_READ 0x18221dbc 1 0>,	\
		<DCC_READ 0x18221dd0 1 0>,	\
		<DCC_READ 0x18221de4 1 0>,	\
		<DCC_READ 0x18221df8 1 0>,	\
		<DCC_READ 0x18221e0c 1 0>,	\
		<DCC_READ 0x18221e20 1 0>,	\
		<DCC_READ 0x18221f94 1 0>,	\
		<DCC_READ 0x18221fa8 1 0>,	\
		<DCC_READ 0x18221fbc 1 0>,	\
		<DCC_READ 0x18221fd0 1 0>,	\
		<DCC_READ 0x18221fe4 1 0>,	\
		<DCC_READ 0x18221ff8 1 0>,	\
		<DCC_READ 0x1822200c 1 0>,	\
		<DCC_READ 0x18222020 1 0>,	\
		<DCC_READ 0x18222034 1 0>,	\
		<DCC_READ 0x18222048 1 0>,	\
		<DCC_READ 0x1822205c 1 0>,	\
		<DCC_READ 0x18222070 1 0>,	\
		<DCC_READ 0x18222084 1 0>,	\
		<DCC_READ 0x18222098 1 0>,	\
		<DCC_READ 0x182220ac 1 0>,	\
		<DCC_READ 0x182220c0 1 0>,	\
		<DCC_READ 0x18221278 1 0>,	\
		<DCC_READ 0x1822128c 1 0>,	\
		<DCC_READ 0x182212a0 1 0>,	\
		<DCC_READ 0x182212b4 1 0>,	\
		<DCC_READ 0x182212c8 1 0>,	\
		<DCC_READ 0x182212dc 1 0>,	\
		<DCC_READ 0x182212f0 1 0>,	\
		<DCC_READ 0x18221304 1 0>,	\
		<DCC_READ 0x18221318 1 0>,	\
		<DCC_READ 0x1822132c 1 0>,	\
		<DCC_READ 0x18221340 1 0>,	\
		<DCC_READ 0x18221354 1 0>,	\
		<DCC_READ 0x18221368 1 0>,	\
		<DCC_READ 0x1822137c 1 0>,	\
		<DCC_READ 0x18221390 1 0>,	\
		<DCC_READ 0x182213a4 1 0>,	\
		<DCC_READ 0x18221518 1 0>,	\
		<DCC_READ 0x1822152c 1 0>,	\
		<DCC_READ 0x18221540 1 0>,	\
		<DCC_READ 0x18221554 1 0>,	\
		<DCC_READ 0x18221568 1 0>,	\
		<DCC_READ 0x1822157c 1 0>,	\
		<DCC_READ 0x18221590 1 0>,	\
		<DCC_READ 0x182215a4 1 0>,	\
		<DCC_READ 0x182215b8 1 0>,	\
		<DCC_READ 0x182215cc 1 0>,	\
		<DCC_READ 0x182215e0 1 0>,	\
		<DCC_READ 0x182215f4 1 0>,	\
		<DCC_READ 0x18221608 1 0>,	\
		<DCC_READ 0x1822161c 1 0>,	\
		<DCC_READ 0x18221630 1 0>,	\
		<DCC_READ 0x18221644 1 0>,	\
		<DCC_READ 0x182217b8 1 0>,	\
		<DCC_READ 0x182217cc 1 0>,	\
		<DCC_READ 0x182217e0 1 0>,	\
		<DCC_READ 0x182217f4 1 0>,	\
		<DCC_READ 0x18221808 1 0>,	\
		<DCC_READ 0x1822181c 1 0>,	\
		<DCC_READ 0x18221830 1 0>,	\
		<DCC_READ 0x18221844 1 0>,	\
		<DCC_READ 0x18221858 1 0>,	\
		<DCC_READ 0x1822186c 1 0>,	\
		<DCC_READ 0x18221880 1 0>,	\
		<DCC_READ 0x18221894 1 0>,	\
		<DCC_READ 0x182218a8 1 0>,	\
		<DCC_READ 0x182218bc 1 0>,	\
		<DCC_READ 0x182218d0 1 0>,	\
		<DCC_READ 0x182218e4 1 0>,	\
		<DCC_READ 0x18221a58 1 0>,	\
		<DCC_READ 0x18221a6c 1 0>,	\
		<DCC_READ 0x18221a80 1 0>,	\
		<DCC_READ 0x18221a94 1 0>,	\
		<DCC_READ 0x18221aa8 1 0>,	\
		<DCC_READ 0x18221abc 1 0>,	\
		<DCC_READ 0x18221ad0 1 0>,	\
		<DCC_READ 0x18221ae4 1 0>,	\
		<DCC_READ 0x18221af8 1 0>,	\
		<DCC_READ 0x18221b0c 1 0>,	\
		<DCC_READ 0x18221b20 1 0>,	\
		<DCC_READ 0x18221b34 1 0>,	\
		<DCC_READ 0x18221b48 1 0>,	\
		<DCC_READ 0x18221b5c 1 0>,	\
		<DCC_READ 0x18221b70 1 0>,	\
		<DCC_READ 0x18221b84 1 0>,	\
		<DCC_READ 0x18221cf8 1 0>,	\
		<DCC_READ 0x18221d0c 1 0>,	\
		<DCC_READ 0x18221d20 1 0>,	\
		<DCC_READ 0x18221d34 1 0>,	\
		<DCC_READ 0x18221d48 1 0>,	\
		<DCC_READ 0x18221d5c 1 0>,	\
		<DCC_READ 0x18221d70 1 0>,	\
		<DCC_READ 0x18221d84 1 0>,	\
		<DCC_READ 0x18221d98 1 0>,	\
		<DCC_READ 0x18221dac 1 0>,	\
		<DCC_READ 0x18221dc0 1 0>,	\
		<DCC_READ 0x18221dd4 1 0>,	\
		<DCC_READ 0x18221de8 1 0>,	\
		<DCC_READ 0x18221dfc 1 0>,	\
		<DCC_READ 0x18221e10 1 0>,	\
		<DCC_READ 0x18221e24 1 0>,	\
		<DCC_READ 0x18221f98 1 0>,	\
		<DCC_READ 0x18221fac 1 0>,	\
		<DCC_READ 0x18221fc0 1 0>,	\
		<DCC_READ 0x18221fd4 1 0>,	\
		<DCC_READ 0x18221fe8 1 0>,	\
		<DCC_READ 0x18221ffc 1 0>,	\
		<DCC_READ 0x18222010 1 0>,	\
		<DCC_READ 0x18222024 1 0>,	\
		<DCC_READ 0x18222038 1 0>,	\
		<DCC_READ 0x1822204c 1 0>,	\
		<DCC_READ 0x18222060 1 0>,	\
		<DCC_READ 0x18222074 1 0>,	\
		<DCC_READ 0x18222088 1 0>,	\
		<DCC_READ 0x1822209c 1 0>,	\
		<DCC_READ 0x182220b0 1 0>,	\
		<DCC_READ 0x182220c4 1 0>

/* config_talos_dcc_pdc_apps() */
#define config_talos_dcc_pdc_apps	\
	\
		/* RSC_PCU */	\
		<DCC_READ 0x18000024 1 0>,	\
		<DCC_READ 0x18000040 1 0>,	\
		<DCC_READ 0x18010024 1 0>,	\
		<DCC_READ 0x18010040 1 0>,	\
		<DCC_READ 0x18020024 1 0>,	\
		<DCC_READ 0x18020040 1 0>,	\
		<DCC_READ 0x18030024 1 0>,	\
		<DCC_READ 0x18030040 1 0>,	\
		<DCC_READ 0x18040024 1 0>,	\
		<DCC_READ 0x18040040 1 0>,	\
		<DCC_READ 0x18050024 1 0>,	\
		<DCC_READ 0x18050040 1 0>,	\
		<DCC_READ 0x18060024 1 0>,	\
		<DCC_READ 0x18060040 1 0>,	\
		<DCC_READ 0x18070024 1 0>,	\
		<DCC_READ 0x18070040 1 0>,	\
		<DCC_READ 0x18080024 1 0>,	\
		<DCC_READ 0x18080040 1 0>,	\
		<DCC_READ 0x180800F8 1 0>,	\
		<DCC_READ 0x18080104 1 0>,	\
		<DCC_READ 0x1808011C 1 0>,	\
		<DCC_READ 0x18080128 1 0>

/* config_talos_dcc_rscc_lpass() */
#define config_talos_dcc_rscc_lpass	\
	\
		/* RSCp */	\
		<DCC_READ 0x62B90010 1 0>,	\
		<DCC_READ 0x62B90014 1 0>,	\
		<DCC_READ 0x62B90018 1 0>,	\
		<DCC_READ 0x62B90030 1 0>,	\
		<DCC_READ 0x62B90038 1 0>,	\
		<DCC_READ 0x62B90040 1 0>,	\
		<DCC_READ 0x62B90048 1 0>,	\
		<DCC_READ 0x62B900D0 1 0>,	\
		<DCC_READ 0x62B90210 1 0>,	\
		<DCC_READ 0x62B90230 1 0>,	\
		<DCC_READ 0x62B90250 1 0>,	\
		<DCC_READ 0x62B90270 1 0>,	\
		<DCC_READ 0x62B90290 1 0>,	\
		<DCC_READ 0x62B902B0 1 0>,	\
		<DCC_READ 0x62B90208 1 0>,	\
		<DCC_READ 0x62B90228 1 0>,	\
		<DCC_READ 0x62B90248 1 0>,	\
		<DCC_READ 0x62B90268 1 0>,	\
		<DCC_READ 0x62B90288 1 0>,	\
		<DCC_READ 0x62B902A8 1 0>,	\
		<DCC_READ 0x62B9020C 1 0>,	\
		<DCC_READ 0x62B9022C 1 0>,	\
		<DCC_READ 0x62B9024C 1 0>,	\
		<DCC_READ 0x62B9026C 1 0>,	\
		<DCC_READ 0x62B9028C 1 0>,	\
		<DCC_READ 0x62B902AC 1 0>,	\
		<DCC_READ 0x62B90404 1 0>,	\
		<DCC_READ 0x62B90408 1 0>,	\
		<DCC_READ 0x62B90400 1 0>,	\
		<DCC_READ 0x62B90D04 1 0>,	\
	\
		/* RSCc */	\
		<DCC_READ 0x624B0010 1 0>,	\
		<DCC_READ 0x624B0014 1 0>,	\
		<DCC_READ 0x624B0018 1 0>,	\
		<DCC_READ 0x624B0210 1 0>,	\
		<DCC_READ 0x624B0230 1 0>,	\
		<DCC_READ 0x624B0250 1 0>,	\
		<DCC_READ 0x624B0270 1 0>,	\
		<DCC_READ 0x624B0290 1 0>,	\
		<DCC_READ 0x624B02B0 1 0>,	\
		<DCC_READ 0x624B0208 1 0>,	\
		<DCC_READ 0x624B0228 1 0>,	\
		<DCC_READ 0x624B0248 1 0>,	\
		<DCC_READ 0x624B0268 1 0>,	\
		<DCC_READ 0x624B0288 1 0>,	\
		<DCC_READ 0x624B02A8 1 0>,	\
		<DCC_READ 0x624B020C 1 0>,	\
		<DCC_READ 0x624B022C 1 0>,	\
		<DCC_READ 0x624B024C 1 0>,	\
		<DCC_READ 0x624B026C 1 0>,	\
		<DCC_READ 0x624B028C 1 0>,	\
		<DCC_READ 0x624B02AC 1 0>,	\
		<DCC_READ 0x624B0400 1 0>,	\
		<DCC_READ 0x624B0404 1 0>,	\
		<DCC_READ 0x624B0408 1 0>,	\
	\
		/* Q6_Status */	\
		<DCC_READ 0x62402028 1 0>,	\
	\
		/* RSC-TCS */	\
		<DCC_READ 0x62b9000c 1 0>,	\
		<DCC_READ 0x62b91c14 1 0>,	\
		<DCC_READ 0x62b91eb4 1 0>,	\
		<DCC_READ 0x62b92154 1 0>,	\
		<DCC_READ 0x62b923f4 1 0>,	\
		<DCC_READ 0x62b92694 1 0>,	\
		<DCC_READ 0x62b92934 1 0>,	\
		<DCC_READ 0x62b91c18 1 0>,	\
		<DCC_READ 0x62b91eb8 1 0>,	\
		<DCC_READ 0x62b92158 1 0>,	\
		<DCC_READ 0x62b923f8 1 0>,	\
		<DCC_READ 0x62b92698 1 0>,	\
		<DCC_READ 0x62b92938 1 0>,	\
		<DCC_READ 0x62b91c00 1 0>,	\
		<DCC_READ 0x62b91c04 1 0>,	\
		<DCC_READ 0x62b91c1c 1 0>,	\
		<DCC_READ 0x62b91ebc 1 0>,	\
		<DCC_READ 0x62b9215c 1 0>,	\
		<DCC_READ 0x62b923fc 1 0>,	\
		<DCC_READ 0x62b9269c 1 0>,	\
		<DCC_READ 0x62b9293c 1 0>,	\
		<DCC_READ 0x62b92174 1 0>,	\
		<DCC_READ 0x62b92188 1 0>,	\
		<DCC_READ 0x62b9219c 1 0>,	\
		<DCC_READ 0x62b921b0 1 0>,	\
		<DCC_READ 0x62b921c4 1 0>,	\
		<DCC_READ 0x62b921d8 1 0>,	\
		<DCC_READ 0x62b921ec 1 0>,	\
		<DCC_READ 0x62b92200 1 0>,	\
		<DCC_READ 0x62b92214 1 0>,	\
		<DCC_READ 0x62b92228 1 0>,	\
		<DCC_READ 0x62b9223c 1 0>,	\
		<DCC_READ 0x62b92250 1 0>,	\
		<DCC_READ 0x62b92264 1 0>,	\
		<DCC_READ 0x62b92278 1 0>,	\
		<DCC_READ 0x62b9228c 1 0>,	\
		<DCC_READ 0x62b922a0 1 0>,	\
		<DCC_READ 0x62b92414 1 0>,	\
		<DCC_READ 0x62b92428 1 0>,	\
		<DCC_READ 0x62b9243c 1 0>,	\
		<DCC_READ 0x62b92450 1 0>,	\
		<DCC_READ 0x62b92464 1 0>,	\
		<DCC_READ 0x62b92478 1 0>,	\
		<DCC_READ 0x62b9248c 1 0>,	\
		<DCC_READ 0x62b924a0 1 0>,	\
		<DCC_READ 0x62b924b4 1 0>,	\
		<DCC_READ 0x62b924c8 1 0>,	\
		<DCC_READ 0x62b924dc 1 0>,	\
		<DCC_READ 0x62b924f0 1 0>,	\
		<DCC_READ 0x62b92504 1 0>,	\
		<DCC_READ 0x62b92518 1 0>,	\
		<DCC_READ 0x62b9252c 1 0>,	\
		<DCC_READ 0x62b92540 1 0>,	\
		<DCC_READ 0x62b926b4 1 0>,	\
		<DCC_READ 0x62b926c8 1 0>,	\
		<DCC_READ 0x62b926dc 1 0>,	\
		<DCC_READ 0x62b926f0 1 0>,	\
		<DCC_READ 0x62b92704 1 0>,	\
		<DCC_READ 0x62b92718 1 0>,	\
		<DCC_READ 0x62b9272c 1 0>,	\
		<DCC_READ 0x62b92740 1 0>,	\
		<DCC_READ 0x62b92754 1 0>,	\
		<DCC_READ 0x62b92768 1 0>,	\
		<DCC_READ 0x62b9277c 1 0>,	\
		<DCC_READ 0x62b92790 1 0>,	\
		<DCC_READ 0x62b927a4 1 0>,	\
		<DCC_READ 0x62b927b8 1 0>,	\
		<DCC_READ 0x62b927cc 1 0>,	\
		<DCC_READ 0x62b927e0 1 0>,	\
		<DCC_READ 0x62b92954 1 0>,	\
		<DCC_READ 0x62b92968 1 0>,	\
		<DCC_READ 0x62b9297c 1 0>,	\
		<DCC_READ 0x62b92990 1 0>,	\
		<DCC_READ 0x62b929a4 1 0>,	\
		<DCC_READ 0x62b929b8 1 0>,	\
		<DCC_READ 0x62b929cc 1 0>,	\
		<DCC_READ 0x62b929e0 1 0>,	\
		<DCC_READ 0x62b929f4 1 0>,	\
		<DCC_READ 0x62b92a08 1 0>,	\
		<DCC_READ 0x62b92a1c 1 0>,	\
		<DCC_READ 0x62b92a30 1 0>,	\
		<DCC_READ 0x62b92a44 1 0>,	\
		<DCC_READ 0x62b92a58 1 0>,	\
		<DCC_READ 0x62b92a6c 1 0>,	\
		<DCC_READ 0x62b92a80 1 0>,	\
		<DCC_READ 0x62b92178 1 0>,	\
		<DCC_READ 0x62b9218c 1 0>,	\
		<DCC_READ 0x62b921a0 1 0>,	\
		<DCC_READ 0x62b921b4 1 0>,	\
		<DCC_READ 0x62b921c8 1 0>,	\
		<DCC_READ 0x62b921dc 1 0>,	\
		<DCC_READ 0x62b921f0 1 0>,	\
		<DCC_READ 0x62b92204 1 0>,	\
		<DCC_READ 0x62b92218 1 0>,	\
		<DCC_READ 0x62b9222c 1 0>,	\
		<DCC_READ 0x62b92240 1 0>,	\
		<DCC_READ 0x62b92254 1 0>,	\
		<DCC_READ 0x62b92268 1 0>,	\
		<DCC_READ 0x62b9227c 1 0>,	\
		<DCC_READ 0x62b92290 1 0>,	\
		<DCC_READ 0x62b922a4 1 0>,	\
		<DCC_READ 0x62b92418 1 0>,	\
		<DCC_READ 0x62b9242c 1 0>,	\
		<DCC_READ 0x62b92440 1 0>,	\
		<DCC_READ 0x62b92454 1 0>,	\
		<DCC_READ 0x62b92468 1 0>,	\
		<DCC_READ 0x62b9247c 1 0>,	\
		<DCC_READ 0x62b92490 1 0>,	\
		<DCC_READ 0x62b924a4 1 0>,	\
		<DCC_READ 0x62b924b8 1 0>,	\
		<DCC_READ 0x62b924cc 1 0>,	\
		<DCC_READ 0x62b924e0 1 0>,	\
		<DCC_READ 0x62b924f4 1 0>,	\
		<DCC_READ 0x62b92508 1 0>,	\
		<DCC_READ 0x62b9251c 1 0>,	\
		<DCC_READ 0x62b92530 1 0>,	\
		<DCC_READ 0x62b92544 1 0>,	\
		<DCC_READ 0x62b926b8 1 0>,	\
		<DCC_READ 0x62b926cc 1 0>,	\
		<DCC_READ 0x62b926e0 1 0>,	\
		<DCC_READ 0x62b926f4 1 0>,	\
		<DCC_READ 0x62b92708 1 0>,	\
		<DCC_READ 0x62b9271c 1 0>,	\
		<DCC_READ 0x62b92730 1 0>,	\
		<DCC_READ 0x62b92744 1 0>,	\
		<DCC_READ 0x62b92758 1 0>,	\
		<DCC_READ 0x62b9276c 1 0>,	\
		<DCC_READ 0x62b92780 1 0>,	\
		<DCC_READ 0x62b92794 1 0>,	\
		<DCC_READ 0x62b927a8 1 0>,	\
		<DCC_READ 0x62b927bc 1 0>,	\
		<DCC_READ 0x62b927d0 1 0>,	\
		<DCC_READ 0x62b927e4 1 0>,	\
		<DCC_READ 0x62b92958 1 0>,	\
		<DCC_READ 0x62b9296c 1 0>,	\
		<DCC_READ 0x62b92980 1 0>,	\
		<DCC_READ 0x62b92994 1 0>,	\
		<DCC_READ 0x62b929a8 1 0>,	\
		<DCC_READ 0x62b929bc 1 0>,	\
		<DCC_READ 0x62b929d0 1 0>,	\
		<DCC_READ 0x62b929e4 1 0>,	\
		<DCC_READ 0x62b929f8 1 0>,	\
		<DCC_READ 0x62b92a0c 1 0>,	\
		<DCC_READ 0x62b92a20 1 0>,	\
		<DCC_READ 0x62b92a34 1 0>,	\
		<DCC_READ 0x62b92a48 1 0>,	\
		<DCC_READ 0x62b92a5c 1 0>,	\
		<DCC_READ 0x62b92a70 1 0>,	\
		<DCC_READ 0x62b92a84 1 0>

/* config_talos_dcc_rscc_modem() */
#define config_talos_dcc_rscc_modem	\
	\
		/* RSCp */	\
		<DCC_READ 0x4200010 1 0>,	\
		<DCC_READ 0x4200014 1 0>,	\
		<DCC_READ 0x4200018 1 0>,	\
		<DCC_READ 0x4200030 1 0>,	\
		<DCC_READ 0x4200038 1 0>,	\
		<DCC_READ 0x4200040 1 0>,	\
		<DCC_READ 0x4200048 1 0>,	\
		<DCC_READ 0x42000D0 1 0>,	\
		<DCC_READ 0x4200210 1 0>,	\
		<DCC_READ 0x4200230 1 0>,	\
		<DCC_READ 0x4200250 1 0>,	\
		<DCC_READ 0x4200270 1 0>,	\
		<DCC_READ 0x4200290 1 0>,	\
		<DCC_READ 0x42002B0 1 0>,	\
		<DCC_READ 0x4200208 1 0>,	\
		<DCC_READ 0x4200228 1 0>,	\
		<DCC_READ 0x4200248 1 0>,	\
		<DCC_READ 0x4200268 1 0>,	\
		<DCC_READ 0x4200288 1 0>,	\
		<DCC_READ 0x42002A8 1 0>,	\
		<DCC_READ 0x420020C 1 0>,	\
		<DCC_READ 0x420022C 1 0>,	\
		<DCC_READ 0x420024C 1 0>,	\
		<DCC_READ 0x420026C 1 0>,	\
		<DCC_READ 0x420028C 1 0>,	\
		<DCC_READ 0x42002AC 1 0>,	\
		<DCC_READ 0x4200404 1 0>,	\
		<DCC_READ 0x4200408 1 0>,	\
		<DCC_READ 0x4200400 1 0>,	\
		<DCC_READ 0x4200D04 1 0>,	\
	\
		/* RSCc */	\
		<DCC_READ 0x4130010 1 0>,	\
		<DCC_READ 0x4130014 1 0>,	\
		<DCC_READ 0x4130018 1 0>,	\
		<DCC_READ 0x4130210 1 0>,	\
		<DCC_READ 0x4130230 1 0>,	\
		<DCC_READ 0x4130250 1 0>,	\
		<DCC_READ 0x4130270 1 0>,	\
		<DCC_READ 0x4130290 1 0>,	\
		<DCC_READ 0x41302B0 1 0>,	\
		<DCC_READ 0x4130208 1 0>,	\
		<DCC_READ 0x4130228 1 0>,	\
		<DCC_READ 0x4130248 1 0>,	\
		<DCC_READ 0x4130268 1 0>,	\
		<DCC_READ 0x4130288 1 0>,	\
		<DCC_READ 0x41302A8 1 0>,	\
		<DCC_READ 0x413020C 1 0>,	\
		<DCC_READ 0x413022C 1 0>,	\
		<DCC_READ 0x413024C 1 0>,	\
		<DCC_READ 0x413026C 1 0>,	\
		<DCC_READ 0x413028C 1 0>,	\
		<DCC_READ 0x41302AC 1 0>,	\
		<DCC_READ 0x4130400 1 0>,	\
		<DCC_READ 0x4130404 1 0>,	\
		<DCC_READ 0x4130408 1 0>,	\
	\
		/* Q6 status */	\
		<DCC_READ 0x4082028 1 0>,	\
		<DCC_READ 0x0018A00C 1 0>,	\
	\
		/* RSC-TCS */	\
		<DCC_READ 0x420000c 1 0>,	\
		<DCC_READ 0x4200d14 1 0>,	\
		<DCC_READ 0x4200fb4 1 0>,	\
		<DCC_READ 0x4201254 1 0>,	\
		<DCC_READ 0x42014f4 1 0>,	\
		<DCC_READ 0x4201794 1 0>,	\
		<DCC_READ 0x4201a34 1 0>,	\
		<DCC_READ 0x4201cd4 1 0>,	\
		<DCC_READ 0x4201f74 1 0>,	\
		<DCC_READ 0x4200d18 1 0>,	\
		<DCC_READ 0x4200fb8 1 0>,	\
		<DCC_READ 0x4201258 1 0>,	\
		<DCC_READ 0x42014f8 1 0>,	\
		<DCC_READ 0x4201798 1 0>,	\
		<DCC_READ 0x4201a38 1 0>,	\
		<DCC_READ 0x4201cd8 1 0>,	\
		<DCC_READ 0x4201f78 1 0>,	\
		<DCC_READ 0x4200d00 1 0>,	\
		<DCC_READ 0x4200d04 1 0>,	\
		<DCC_READ 0x4200d1c 1 0>,	\
		<DCC_READ 0x4200fbc 1 0>,	\
		<DCC_READ 0x420125c 1 0>,	\
		<DCC_READ 0x42014fc 1 0>,	\
		<DCC_READ 0x420179c 1 0>,	\
		<DCC_READ 0x4201a3c 1 0>,	\
		<DCC_READ 0x4201cdc 1 0>,	\
		<DCC_READ 0x4201f7c 1 0>,	\
		<DCC_READ 0x4201274 1 0>,	\
		<DCC_READ 0x4201288 1 0>,	\
		<DCC_READ 0x420129c 1 0>,	\
		<DCC_READ 0x42012b0 1 0>,	\
		<DCC_READ 0x42012c4 1 0>,	\
		<DCC_READ 0x42012d8 1 0>,	\
		<DCC_READ 0x42012ec 1 0>,	\
		<DCC_READ 0x4201300 1 0>,	\
		<DCC_READ 0x4201314 1 0>,	\
		<DCC_READ 0x4201328 1 0>,	\
		<DCC_READ 0x420133c 1 0>,	\
		<DCC_READ 0x4201350 1 0>,	\
		<DCC_READ 0x4201364 1 0>,	\
		<DCC_READ 0x4201378 1 0>,	\
		<DCC_READ 0x420138c 1 0>,	\
		<DCC_READ 0x42013a0 1 0>,	\
		<DCC_READ 0x4201514 1 0>,	\
		<DCC_READ 0x4201528 1 0>,	\
		<DCC_READ 0x420153c 1 0>,	\
		<DCC_READ 0x4201550 1 0>,	\
		<DCC_READ 0x4201564 1 0>,	\
		<DCC_READ 0x4201578 1 0>,	\
		<DCC_READ 0x420158c 1 0>,	\
		<DCC_READ 0x42015a0 1 0>,	\
		<DCC_READ 0x42015b4 1 0>,	\
		<DCC_READ 0x42015c8 1 0>,	\
		<DCC_READ 0x42015dc 1 0>,	\
		<DCC_READ 0x42015f0 1 0>,	\
		<DCC_READ 0x4201604 1 0>,	\
		<DCC_READ 0x4201618 1 0>,	\
		<DCC_READ 0x420162c 1 0>,	\
		<DCC_READ 0x4201640 1 0>,	\
		<DCC_READ 0x42017b4 1 0>,	\
		<DCC_READ 0x42017c8 1 0>,	\
		<DCC_READ 0x42017dc 1 0>,	\
		<DCC_READ 0x42017f0 1 0>,	\
		<DCC_READ 0x4201804 1 0>,	\
		<DCC_READ 0x4201818 1 0>,	\
		<DCC_READ 0x420182c 1 0>,	\
		<DCC_READ 0x4201840 1 0>,	\
		<DCC_READ 0x4201854 1 0>,	\
		<DCC_READ 0x4201868 1 0>,	\
		<DCC_READ 0x420187c 1 0>,	\
		<DCC_READ 0x4201890 1 0>,	\
		<DCC_READ 0x42018a4 1 0>,	\
		<DCC_READ 0x42018b8 1 0>,	\
		<DCC_READ 0x42018cc 1 0>,	\
		<DCC_READ 0x42018e0 1 0>,	\
		<DCC_READ 0x4201a54 1 0>,	\
		<DCC_READ 0x4201a68 1 0>,	\
		<DCC_READ 0x4201a7c 1 0>,	\
		<DCC_READ 0x4201a90 1 0>,	\
		<DCC_READ 0x4201aa4 1 0>,	\
		<DCC_READ 0x4201ab8 1 0>,	\
		<DCC_READ 0x4201acc 1 0>,	\
		<DCC_READ 0x4201ae0 1 0>,	\
		<DCC_READ 0x4201af4 1 0>,	\
		<DCC_READ 0x4201b08 1 0>,	\
		<DCC_READ 0x4201b1c 1 0>,	\
		<DCC_READ 0x4201b30 1 0>,	\
		<DCC_READ 0x4201b44 1 0>,	\
		<DCC_READ 0x4201b58 1 0>,	\
		<DCC_READ 0x4201b6c 1 0>,	\
		<DCC_READ 0x4201b80 1 0>,	\
		<DCC_READ 0x4201cf4 1 0>,	\
		<DCC_READ 0x4201d08 1 0>,	\
		<DCC_READ 0x4201d1c 1 0>,	\
		<DCC_READ 0x4201d30 1 0>,	\
		<DCC_READ 0x4201d44 1 0>,	\
		<DCC_READ 0x4201d58 1 0>,	\
		<DCC_READ 0x4201d6c 1 0>,	\
		<DCC_READ 0x4201d80 1 0>,	\
		<DCC_READ 0x4201d94 1 0>,	\
		<DCC_READ 0x4201da8 1 0>,	\
		<DCC_READ 0x4201dbc 1 0>,	\
		<DCC_READ 0x4201dd0 1 0>,	\
		<DCC_READ 0x4201de4 1 0>,	\
		<DCC_READ 0x4201df8 1 0>,	\
		<DCC_READ 0x4201e0c 1 0>,	\
		<DCC_READ 0x4201e20 1 0>,	\
		<DCC_READ 0x4201f94 1 0>,	\
		<DCC_READ 0x4201fa8 1 0>,	\
		<DCC_READ 0x4201fbc 1 0>,	\
		<DCC_READ 0x4201fd0 1 0>,	\
		<DCC_READ 0x4201fe4 1 0>,	\
		<DCC_READ 0x4201ff8 1 0>,	\
		<DCC_READ 0x420200c 1 0>,	\
		<DCC_READ 0x4202020 1 0>,	\
		<DCC_READ 0x4202034 1 0>,	\
		<DCC_READ 0x4202048 1 0>,	\
		<DCC_READ 0x420205c 1 0>,	\
		<DCC_READ 0x4202070 1 0>,	\
		<DCC_READ 0x4202084 1 0>,	\
		<DCC_READ 0x4202098 1 0>,	\
		<DCC_READ 0x42020ac 1 0>,	\
		<DCC_READ 0x42020c0 1 0>,	\
		<DCC_READ 0x4201278 1 0>,	\
		<DCC_READ 0x420128c 1 0>,	\
		<DCC_READ 0x42012a0 1 0>,	\
		<DCC_READ 0x42012b4 1 0>,	\
		<DCC_READ 0x42012c8 1 0>,	\
		<DCC_READ 0x42012dc 1 0>,	\
		<DCC_READ 0x42012f0 1 0>,	\
		<DCC_READ 0x4201304 1 0>,	\
		<DCC_READ 0x4201318 1 0>,	\
		<DCC_READ 0x420132c 1 0>,	\
		<DCC_READ 0x4201340 1 0>,	\
		<DCC_READ 0x4201354 1 0>,	\
		<DCC_READ 0x4201368 1 0>,	\
		<DCC_READ 0x420137c 1 0>,	\
		<DCC_READ 0x4201390 1 0>,	\
		<DCC_READ 0x42013a4 1 0>,	\
		<DCC_READ 0x4201518 1 0>,	\
		<DCC_READ 0x420152c 1 0>,	\
		<DCC_READ 0x4201540 1 0>,	\
		<DCC_READ 0x4201554 1 0>,	\
		<DCC_READ 0x4201568 1 0>,	\
		<DCC_READ 0x420157c 1 0>,	\
		<DCC_READ 0x4201590 1 0>,	\
		<DCC_READ 0x42015a4 1 0>,	\
		<DCC_READ 0x42015b8 1 0>,	\
		<DCC_READ 0x42015cc 1 0>,	\
		<DCC_READ 0x42015e0 1 0>,	\
		<DCC_READ 0x42015f4 1 0>,	\
		<DCC_READ 0x4201608 1 0>,	\
		<DCC_READ 0x420161c 1 0>,	\
		<DCC_READ 0x4201630 1 0>,	\
		<DCC_READ 0x4201644 1 0>,	\
		<DCC_READ 0x42017b8 1 0>,	\
		<DCC_READ 0x42017cc 1 0>,	\
		<DCC_READ 0x42017e0 1 0>,	\
		<DCC_READ 0x42017f4 1 0>,	\
		<DCC_READ 0x4201808 1 0>,	\
		<DCC_READ 0x420181c 1 0>,	\
		<DCC_READ 0x4201830 1 0>,	\
		<DCC_READ 0x4201844 1 0>,	\
		<DCC_READ 0x4201858 1 0>,	\
		<DCC_READ 0x420186c 1 0>,	\
		<DCC_READ 0x4201880 1 0>,	\
		<DCC_READ 0x4201894 1 0>,	\
		<DCC_READ 0x42018a8 1 0>,	\
		<DCC_READ 0x42018bc 1 0>,	\
		<DCC_READ 0x42018d0 1 0>,	\
		<DCC_READ 0x42018e4 1 0>,	\
		<DCC_READ 0x4201a58 1 0>,	\
		<DCC_READ 0x4201a6c 1 0>,	\
		<DCC_READ 0x4201a80 1 0>,	\
		<DCC_READ 0x4201a94 1 0>,	\
		<DCC_READ 0x4201aa8 1 0>,	\
		<DCC_READ 0x4201abc 1 0>,	\
		<DCC_READ 0x4201ad0 1 0>,	\
		<DCC_READ 0x4201ae4 1 0>,	\
		<DCC_READ 0x4201af8 1 0>,	\
		<DCC_READ 0x4201b0c 1 0>,	\
		<DCC_READ 0x4201b20 1 0>,	\
		<DCC_READ 0x4201b34 1 0>,	\
		<DCC_READ 0x4201b48 1 0>,	\
		<DCC_READ 0x4201b5c 1 0>,	\
		<DCC_READ 0x4201b70 1 0>,	\
		<DCC_READ 0x4201b84 1 0>,	\
		<DCC_READ 0x4201cf8 1 0>,	\
		<DCC_READ 0x4201d0c 1 0>,	\
		<DCC_READ 0x4201d20 1 0>,	\
		<DCC_READ 0x4201d34 1 0>,	\
		<DCC_READ 0x4201d48 1 0>,	\
		<DCC_READ 0x4201d5c 1 0>,	\
		<DCC_READ 0x4201d70 1 0>,	\
		<DCC_READ 0x4201d84 1 0>,	\
		<DCC_READ 0x4201d98 1 0>,	\
		<DCC_READ 0x4201dac 1 0>,	\
		<DCC_READ 0x4201dc0 1 0>,	\
		<DCC_READ 0x4201dd4 1 0>,	\
		<DCC_READ 0x4201de8 1 0>,	\
		<DCC_READ 0x4201dfc 1 0>,	\
		<DCC_READ 0x4201e10 1 0>,	\
		<DCC_READ 0x4201e24 1 0>,	\
		<DCC_READ 0x4201f98 1 0>,	\
		<DCC_READ 0x4201fac 1 0>,	\
		<DCC_READ 0x4201fc0 1 0>,	\
		<DCC_READ 0x4201fd4 1 0>,	\
		<DCC_READ 0x4201fe8 1 0>,	\
		<DCC_READ 0x4201ffc 1 0>,	\
		<DCC_READ 0x4202010 1 0>,	\
		<DCC_READ 0x4202024 1 0>,	\
		<DCC_READ 0x4202038 1 0>,	\
		<DCC_READ 0x420204c 1 0>,	\
		<DCC_READ 0x4202060 1 0>,	\
		<DCC_READ 0x4202074 1 0>,	\
		<DCC_READ 0x4202088 1 0>,	\
		<DCC_READ 0x420209c 1 0>,	\
		<DCC_READ 0x42020b0 1 0>,	\
		<DCC_READ 0x42020c4 1 0>

/* config_talos_dcc_rscc_cdsp() */
#define config_talos_dcc_rscc_cdsp	\
	\
		/* RSCp */	\
		<DCC_READ 0x80A4010 1 0>,	\
		<DCC_READ 0x80A4014 1 0>,	\
		<DCC_READ 0x80A4018 1 0>,	\
		<DCC_READ 0x80A4030 1 0>,	\
		<DCC_READ 0x80A4038 1 0>,	\
		<DCC_READ 0x80A4040 1 0>,	\
		<DCC_READ 0x80A4048 1 0>,	\
		<DCC_READ 0x80A40D0 1 0>,	\
		<DCC_READ 0x80A4210 1 0>,	\
		<DCC_READ 0x80A4230 1 0>,	\
		<DCC_READ 0x80A4250 1 0>,	\
		<DCC_READ 0x80A4270 1 0>,	\
		<DCC_READ 0x80A4290 1 0>,	\
		<DCC_READ 0x80A42B0 1 0>,	\
		<DCC_READ 0x80A4208 1 0>,	\
		<DCC_READ 0x80A4228 1 0>,	\
		<DCC_READ 0x80A4248 1 0>,	\
		<DCC_READ 0x80A4268 1 0>,	\
		<DCC_READ 0x80A4288 1 0>,	\
		<DCC_READ 0x80A42A8 1 0>,	\
		<DCC_READ 0x80A420C 1 0>,	\
		<DCC_READ 0x80A422C 1 0>,	\
		<DCC_READ 0x80A424C 1 0>,	\
		<DCC_READ 0x80A426C 1 0>,	\
		<DCC_READ 0x80A428C 1 0>,	\
		<DCC_READ 0x80A42AC 1 0>,	\
		<DCC_READ 0x80A4404 1 0>,	\
		<DCC_READ 0x80A4408 1 0>,	\
		<DCC_READ 0x80A4400 1 0>,	\
		<DCC_READ 0x80A4D04 1 0>,	\
	\
		/* RSCc_CDSP */	\
		<DCC_READ 0x83B0010 1 0>,	\
		<DCC_READ 0x83B0014 1 0>,	\
		<DCC_READ 0x83B0018 1 0>,	\
		<DCC_READ 0x83B0210 1 0>,	\
		<DCC_READ 0x83B0230 1 0>,	\
		<DCC_READ 0x83B0250 1 0>,	\
		<DCC_READ 0x83B0270 1 0>,	\
		<DCC_READ 0x83B0290 1 0>,	\
		<DCC_READ 0x83B02B0 1 0>,	\
		<DCC_READ 0x83B0208 1 0>,	\
		<DCC_READ 0x83B0228 1 0>,	\
		<DCC_READ 0x83B0248 1 0>,	\
		<DCC_READ 0x83B0268 1 0>,	\
		<DCC_READ 0x83B0288 1 0>,	\
		<DCC_READ 0x83B02A8 1 0>,	\
		<DCC_READ 0x83B020C 1 0>,	\
		<DCC_READ 0x83B022C 1 0>,	\
		<DCC_READ 0x83B024C 1 0>,	\
		<DCC_READ 0x83B026C 1 0>,	\
		<DCC_READ 0x83B028C 1 0>,	\
		<DCC_READ 0x83B02AC 1 0>,	\
		<DCC_READ 0x83B0400 1 0>,	\
		<DCC_READ 0x83B0404 1 0>,	\
		<DCC_READ 0x83B0408 1 0>,	\
	\
		/* Q6 Status */	\
		<DCC_READ 0x8302028 1 0>,	\
	\
		/* RSC_TCS */	\
		<DCC_READ 0x80a400c 1 0>,	\
		<DCC_READ 0x80a4d14 1 0>,	\
		<DCC_READ 0x80a4fb4 1 0>,	\
		<DCC_READ 0x80a5254 1 0>,	\
		<DCC_READ 0x80a54f4 1 0>,	\
		<DCC_READ 0x80a4d18 1 0>,	\
		<DCC_READ 0x80a4fb8 1 0>,	\
		<DCC_READ 0x80a5258 1 0>,	\
		<DCC_READ 0x80a54f8 1 0>,	\
		<DCC_READ 0x80a4d00 1 0>,	\
		<DCC_READ 0x80a4d04 1 0>,	\
		<DCC_READ 0x80a4d1c 1 0>,	\
		<DCC_READ 0x80a4fbc 1 0>,	\
		<DCC_READ 0x80a525c 1 0>,	\
		<DCC_READ 0x80a54fc 1 0>,	\
		<DCC_READ 0x80a5274 1 0>,	\
		<DCC_READ 0x80a5288 1 0>,	\
		<DCC_READ 0x80a529c 1 0>,	\
		<DCC_READ 0x80a52b0 1 0>,	\
		<DCC_READ 0x80a52c4 1 0>,	\
		<DCC_READ 0x80a52d8 1 0>,	\
		<DCC_READ 0x80a52ec 1 0>,	\
		<DCC_READ 0x80a5300 1 0>,	\
		<DCC_READ 0x80a5314 1 0>,	\
		<DCC_READ 0x80a5328 1 0>,	\
		<DCC_READ 0x80a533c 1 0>,	\
		<DCC_READ 0x80a5350 1 0>,	\
		<DCC_READ 0x80a5514 1 0>,	\
		<DCC_READ 0x80a5528 1 0>,	\
		<DCC_READ 0x80a553c 1 0>,	\
		<DCC_READ 0x80a5550 1 0>,	\
		<DCC_READ 0x80a5564 1 0>,	\
		<DCC_READ 0x80a5578 1 0>,	\
		<DCC_READ 0x80a558c 1 0>,	\
		<DCC_READ 0x80a55a0 1 0>,	\
		<DCC_READ 0x80a55b4 1 0>,	\
		<DCC_READ 0x80a55c8 1 0>,	\
		<DCC_READ 0x80a55dc 1 0>,	\
		<DCC_READ 0x80a55f0 1 0>,	\
		<DCC_READ 0x80a5278 1 0>,	\
		<DCC_READ 0x80a528c 1 0>,	\
		<DCC_READ 0x80a52a0 1 0>,	\
		<DCC_READ 0x80a52b4 1 0>,	\
		<DCC_READ 0x80a52c8 1 0>,	\
		<DCC_READ 0x80a52dc 1 0>,	\
		<DCC_READ 0x80a52f0 1 0>,	\
		<DCC_READ 0x80a5304 1 0>,	\
		<DCC_READ 0x80a5318 1 0>,	\
		<DCC_READ 0x80a532c 1 0>,	\
		<DCC_READ 0x80a5340 1 0>,	\
		<DCC_READ 0x80a5354 1 0>,	\
		<DCC_READ 0x80a5518 1 0>,	\
		<DCC_READ 0x80a552c 1 0>,	\
		<DCC_READ 0x80a5540 1 0>,	\
		<DCC_READ 0x80a5554 1 0>,	\
		<DCC_READ 0x80a5568 1 0>,	\
		<DCC_READ 0x80a557c 1 0>,	\
		<DCC_READ 0x80a5590 1 0>,	\
		<DCC_READ 0x80a55a4 1 0>,	\
		<DCC_READ 0x80a55b8 1 0>,	\
		<DCC_READ 0x80a55cc 1 0>,	\
		<DCC_READ 0x80a55e0 1 0>,	\
		<DCC_READ 0x80a55f4 1 0>

/* config_talos_dcc_memnoc_mccc() */
#define config_talos_dcc_memnoc_mccc	\
	\
		/* MCCC */	\
		<DCC_READ 0x90b0280 1 0>,	\
		<DCC_READ 0x90b0288 1 0>,	\
		<DCC_READ 0x90b028c 1 0>,	\
		<DCC_READ 0x90b0290 1 0>,	\
		<DCC_READ 0x90b0294 1 0>,	\
		<DCC_READ 0x90b0298 1 0>,	\
		<DCC_READ 0x90b029c 1 0>,	\
		<DCC_READ 0x90b02a0 1 0>

/* config_talos_dcc_gpu() */
#define config_talos_dcc_gpu	\
	\
		/* GCC */	\
		<DCC_READ 0x105050 1 0>,	\
		<DCC_READ 0x171004 1 0>,	\
		<DCC_READ 0x171154 1 0>,	\
		<DCC_READ 0x17100C 1 0>,	\
		<DCC_READ 0x171018 1 0>,	\
		<DCC_READ 0x17B000 1 0>,	\
		<DCC_READ 0x17C000 1 0>,	\
		<DCC_READ 0x17D000 1 0>,	\
		<DCC_READ 0x17E000 1 0>,	\
		<DCC_READ 0x187000 1 0>,	\
		<DCC_READ 0x119000 1 0>,	\
	\
		/* GPUCC */	\
		<DCC_READ 0x5091004 1 0>,	\
		<DCC_READ 0x509100c 1 0>,	\
		<DCC_READ 0x5091010 1 0>,	\
		<DCC_READ 0x5091014 1 0>,	\
		<DCC_READ 0x5091054 1 0>,	\
		<DCC_READ 0x5091060 1 0>,	\
		<DCC_READ 0x509106c 1 0>,	\
		<DCC_READ 0x5091070 1 0>,	\
		<DCC_READ 0x5091074 1 0>,	\
		<DCC_READ 0x5091078 1 0>,	\
		<DCC_READ 0x509107c 1 0>,	\
		<DCC_READ 0x509108c 1 0>,	\
		<DCC_READ 0x5091098 1 0>,	\
		<DCC_READ 0x509109c 1 0>,	\
		<DCC_READ 0x5091540 1 0>,	\
		<DCC_READ 0x5095000 1 0>,	\
		<DCC_READ 0x5095004 1 0>,	\
	\
		/* GFX smmu */	\
		<DCC_READ 0x50a9610 1 0>,	\
		<DCC_READ 0x50a9620 1 0>,	\
	\
		/* GPU GX */	\
		<DCC_READ 0x5000840 1 0>,	\
		<DCC_READ 0x5002018 1 0>,	\
		<DCC_READ 0x500201C 1 0>

/* config_talos_dcc_osm() */
#define config_talos_dcc_osm	\
	\
		/* APSS_OSM */	\
		<DCC_READ 0x18321700 1 0>,	\
		<DCC_READ 0x18322C18 1 0>,	\
		<DCC_READ 0x18323700 1 0>,	\
		<DCC_READ 0x18324C18 1 0>,	\
		<DCC_READ 0x18325F00 1 0>,	\
		<DCC_READ 0x18327418 1 0>

/* config_talos_dcc_cabo_llcc_shrm() */
#define config_talos_dcc_cabo_llcc_shrm	\
	\
		/* LLCC/CABO */	\
		<DCC_READ 0x9236028 1 0>,	\
		<DCC_READ 0x923602C 1 0>,	\
		<DCC_READ 0x9236030 1 0>,	\
		<DCC_READ 0x9236034 1 0>,	\
		<DCC_READ 0x9236038 1 0>,	\
		<DCC_READ 0x9232100 1 0>,	\
		<DCC_READ 0x92360b0 1 0>,	\
		<DCC_READ 0x9236044 1 0>,	\
		<DCC_READ 0x9236048 1 0>,	\
		<DCC_READ 0x923604c 1 0>,	\
		<DCC_READ 0x9236050 1 0>,	\
		<DCC_READ 0x923e030 1 0>,	\
		<DCC_READ 0x923e034 1 0>,	\
		<DCC_READ 0x9241000 1 0>,	\
		<DCC_READ 0x9248058 1 0>,	\
		<DCC_READ 0x924805c 1 0>,	\
		<DCC_READ 0x9248060 1 0>,	\
		<DCC_READ 0x9248064 1 0>,	\
		<DCC_READ 0x9260410 1 0>,	\
		<DCC_READ 0x92e0410 1 0>,	\
		<DCC_READ 0x9260414 1 0>,	\
		<DCC_READ 0x92e0414 1 0>,	\
		<DCC_READ 0x9260418 1 0>,	\
		<DCC_READ 0x92e0418 1 0>,	\
		<DCC_READ 0x9260420 1 0>,	\
		<DCC_READ 0x9260424 1 0>,	\
		<DCC_READ 0x9260430 1 0>,	\
		<DCC_READ 0x9260440 1 0>,	\
		<DCC_READ 0x9260448 1 0>,	\
		<DCC_READ 0x92604a0 1 0>,	\
		<DCC_READ 0x92e0420 1 0>,	\
		<DCC_READ 0x92e0424 1 0>,	\
		<DCC_READ 0x92e0430 1 0>,	\
		<DCC_READ 0x92e0440 1 0>,	\
		<DCC_READ 0x92e0448 1 0>,	\
		<DCC_READ 0x92e04a0 1 0>,	\
		<DCC_READ 0x9600000 1 0>,	\
		<DCC_READ 0x9601000 1 0>,	\
		<DCC_READ 0x9602000 1 0>,	\
		<DCC_READ 0x9603000 1 0>,	\
		<DCC_READ 0x9604000 1 0>,	\
		<DCC_READ 0x9605000 1 0>,	\
		<DCC_READ 0x9606000 1 0>,	\
		<DCC_READ 0x9607000 1 0>,	\
		<DCC_READ 0x9608000 1 0>,	\
		<DCC_READ 0x9609000 1 0>,	\
		<DCC_READ 0x960a000 1 0>,	\
		<DCC_READ 0x960b000 1 0>,	\
		<DCC_READ 0x960c000 1 0>,	\
		<DCC_READ 0x960d000 1 0>,	\
		<DCC_READ 0x960e000 1 0>,	\
		<DCC_READ 0x960f000 1 0>,	\
		<DCC_READ 0x9610000 1 0>,	\
		<DCC_READ 0x9611000 1 0>,	\
		<DCC_READ 0x9612000 1 0>,	\
		<DCC_READ 0x9613000 1 0>,	\
		<DCC_READ 0x9614000 1 0>,	\
		<DCC_READ 0x9615000 1 0>,	\
		<DCC_READ 0x9616000 1 0>,	\
		<DCC_READ 0x9617000 1 0>,	\
		<DCC_READ 0x9618000 1 0>,	\
		<DCC_READ 0x9619000 1 0>,	\
		<DCC_READ 0x961a000 1 0>,	\
		<DCC_READ 0x961b000 1 0>,	\
		<DCC_READ 0x961c000 1 0>,	\
		<DCC_READ 0x961d000 1 0>,	\
		<DCC_READ 0x961e000 1 0>,	\
		<DCC_READ 0x961f000 1 0>,	\
		<DCC_READ 0x9600004 1 0>,	\
		<DCC_READ 0x9601004 1 0>,	\
		<DCC_READ 0x9602004 1 0>,	\
		<DCC_READ 0x9603004 1 0>,	\
		<DCC_READ 0x9604004 1 0>,	\
		<DCC_READ 0x9605004 1 0>,	\
		<DCC_READ 0x9606004 1 0>,	\
		<DCC_READ 0x9607004 1 0>,	\
		<DCC_READ 0x9608004 1 0>,	\
		<DCC_READ 0x9609004 1 0>,	\
		<DCC_READ 0x960a004 1 0>,	\
		<DCC_READ 0x960b004 1 0>,	\
		<DCC_READ 0x960c004 1 0>,	\
		<DCC_READ 0x960d004 1 0>,	\
		<DCC_READ 0x960e004 1 0>,	\
		<DCC_READ 0x960f004 1 0>,	\
		<DCC_READ 0x9610004 1 0>,	\
		<DCC_READ 0x9611004 1 0>,	\
		<DCC_READ 0x9612004 1 0>,	\
		<DCC_READ 0x9613004 1 0>,	\
		<DCC_READ 0x9614004 1 0>,	\
		<DCC_READ 0x9615004 1 0>,	\
		<DCC_READ 0x9616004 1 0>,	\
		<DCC_READ 0x9617004 1 0>,	\
		<DCC_READ 0x9618004 1 0>,	\
		<DCC_READ 0x9619004 1 0>,	\
		<DCC_READ 0x961a004 1 0>,	\
		<DCC_READ 0x961b004 1 0>,	\
		<DCC_READ 0x961c004 1 0>,	\
		<DCC_READ 0x961d004 1 0>,	\
		<DCC_READ 0x961e004 1 0>,	\
		<DCC_READ 0x961f004 1 0>,	\
		<DCC_READ 0x9266418 1 0>,	\
		<DCC_READ 0x92e6418 1 0>,	\
		<DCC_READ 0x9265804 1 0>,	\
		<DCC_READ 0x92e5804 1 0>,	\
		<DCC_READ 0x92604b8 1 0>,	\
		<DCC_READ 0x92e04b8 1 0>

/* config_talos_dcc_cx_mx() */
#define config_talos_dcc_cx_mx	\
	\
		/* CX_MX */	\
		<DCC_READ 0x0C201244 1 0>,	\
		<DCC_READ 0x0C202244 1 0>,	\
	\
		/* APC Voltage */	\
		<DCC_READ 0x18100C18 1 0>,	\
		<DCC_READ 0x18101C18 1 0>,	\
	\
		/* APC / MX CORNER */	\
		<DCC_READ 0x18300000 1 0>,	\
	\
		/* CPRH */	\
		<DCC_READ 0x183A3A84 2 0>,	\
		<DCC_READ 0x18393A84 1 0>

/* config_talos_dcc_gcc_regs() */
#define config_talos_dcc_gcc_regs	\
	\
		/* GCC */	\
		<DCC_READ 0x00100000 1 0>,	\
		<DCC_READ 0x00100004 1 0>,	\
		<DCC_READ 0x00100008 1 0>,	\
		<DCC_READ 0x0010000C 1 0>,	\
		<DCC_READ 0x00100010 1 0>,	\
		<DCC_READ 0x00100014 1 0>,	\
		<DCC_READ 0x00100018 1 0>,	\
		<DCC_READ 0x0010001C 1 0>,	\
		<DCC_READ 0x00100020 1 0>,	\
		<DCC_READ 0x00100024 1 0>,	\
		<DCC_READ 0x00100028 1 0>,	\
		<DCC_READ 0x0010002C 1 0>,	\
		<DCC_READ 0x00100030 1 0>,	\
		<DCC_READ 0x00100034 1 0>,	\
		<DCC_READ 0x00100100 1 0>,	\
		<DCC_READ 0x00100104 1 0>,	\
		<DCC_READ 0x00100108 1 0>,	\
		<DCC_READ 0x0010010C 1 0>,	\
		<DCC_READ 0x00101000 1 0>,	\
		<DCC_READ 0x00101004 1 0>,	\
		<DCC_READ 0x00101008 1 0>,	\
		<DCC_READ 0x0010100C 1 0>,	\
		<DCC_READ 0x00101010 1 0>,	\
		<DCC_READ 0x00101014 1 0>,	\
		<DCC_READ 0x00101018 1 0>,	\
		<DCC_READ 0x0010101C 1 0>,	\
		<DCC_READ 0x00101020 1 0>,	\
		<DCC_READ 0x00101024 1 0>,	\
		<DCC_READ 0x00101028 1 0>,	\
		<DCC_READ 0x0010102C 1 0>,	\
		<DCC_READ 0x00101030 1 0>,	\
		<DCC_READ 0x00101034 1 0>,	\
		<DCC_READ 0x00102000 1 0>,	\
		<DCC_READ 0x00102004 1 0>,	\
		<DCC_READ 0x00102008 1 0>,	\
		<DCC_READ 0x0010200C 1 0>,	\
		<DCC_READ 0x00102010 1 0>,	\
		<DCC_READ 0x00102014 1 0>,	\
		<DCC_READ 0x00102018 1 0>,	\
		<DCC_READ 0x0010201C 1 0>,	\
		<DCC_READ 0x00102020 1 0>,	\
		<DCC_READ 0x00102024 1 0>,	\
		<DCC_READ 0x00102028 1 0>,	\
		<DCC_READ 0x0010202C 1 0>,	\
		<DCC_READ 0x00102030 1 0>,	\
		<DCC_READ 0x00102034 1 0>,	\
		<DCC_READ 0x00103000 1 0>,	\
		<DCC_READ 0x00103004 1 0>,	\
		<DCC_READ 0x00103008 1 0>,	\
		<DCC_READ 0x0010300C 1 0>,	\
		<DCC_READ 0x00103010 1 0>,	\
		<DCC_READ 0x00103014 1 0>,	\
		<DCC_READ 0x00103018 1 0>,	\
		<DCC_READ 0x0010301C 1 0>,	\
		<DCC_READ 0x00103020 1 0>,	\
		<DCC_READ 0x00103024 1 0>,	\
		<DCC_READ 0x00103028 1 0>,	\
		<DCC_READ 0x0010302C 1 0>,	\
		<DCC_READ 0x00103030 1 0>,	\
		<DCC_READ 0x00103034 1 0>,	\
		<DCC_READ 0x00113000 1 0>,	\
		<DCC_READ 0x00113004 1 0>,	\
		<DCC_READ 0x00113008 1 0>,	\
		<DCC_READ 0x0011300C 1 0>,	\
		<DCC_READ 0x00113010 1 0>,	\
		<DCC_READ 0x00113014 1 0>,	\
		<DCC_READ 0x00113018 1 0>,	\
		<DCC_READ 0x0011301C 1 0>,	\
		<DCC_READ 0x00113020 1 0>,	\
		<DCC_READ 0x00113024 1 0>,	\
		<DCC_READ 0x00113028 1 0>,	\
		<DCC_READ 0x0011302C 1 0>,	\
		<DCC_READ 0x00113030 1 0>,	\
		<DCC_READ 0x00113034 1 0>,	\
		<DCC_READ 0x0011A000 1 0>,	\
		<DCC_READ 0x0011A004 1 0>,	\
		<DCC_READ 0x0011A008 1 0>,	\
		<DCC_READ 0x0011A00C 1 0>,	\
		<DCC_READ 0x0011A010 1 0>,	\
		<DCC_READ 0x0011A014 1 0>,	\
		<DCC_READ 0x0011A018 1 0>,	\
		<DCC_READ 0x0011A01C 1 0>,	\
		<DCC_READ 0x0011A020 1 0>,	\
		<DCC_READ 0x0011A024 1 0>,	\
		<DCC_READ 0x0011A028 1 0>,	\
		<DCC_READ 0x0011A02C 1 0>,	\
		<DCC_READ 0x0011A030 1 0>,	\
		<DCC_READ 0x0011A034 1 0>,	\
		<DCC_READ 0x0011B000 1 0>,	\
		<DCC_READ 0x0011B004 1 0>,	\
		<DCC_READ 0x0011B008 1 0>,	\
		<DCC_READ 0x0011B00C 1 0>,	\
		<DCC_READ 0x0011B010 1 0>,	\
		<DCC_READ 0x0011B014 1 0>,	\
		<DCC_READ 0x0011B018 1 0>,	\
		<DCC_READ 0x0011B01C 1 0>,	\
		<DCC_READ 0x0011B020 1 0>,	\
		<DCC_READ 0x0011B024 1 0>,	\
		<DCC_READ 0x0011B028 1 0>,	\
		<DCC_READ 0x0011B02C 1 0>,	\
		<DCC_READ 0x0011B030 1 0>,	\
		<DCC_READ 0x0011B034 1 0>,	\
		<DCC_READ 0x00174000 1 0>,	\
		<DCC_READ 0x00174004 1 0>,	\
		<DCC_READ 0x00174008 1 0>,	\
		<DCC_READ 0x0017400C 1 0>,	\
		<DCC_READ 0x00174010 1 0>,	\
		<DCC_READ 0x00174014 1 0>,	\
		<DCC_READ 0x00174018 1 0>,	\
		<DCC_READ 0x0017401C 1 0>,	\
		<DCC_READ 0x00174020 1 0>,	\
		<DCC_READ 0x00174024 1 0>,	\
		<DCC_READ 0x00174028 1 0>,	\
		<DCC_READ 0x0017402C 1 0>,	\
		<DCC_READ 0x00174030 1 0>,	\
		<DCC_READ 0x00174034 1 0>,	\
		<DCC_READ 0x00176000 1 0>,	\
		<DCC_READ 0x00176004 1 0>,	\
		<DCC_READ 0x00176008 1 0>,	\
		<DCC_READ 0x0017600C 1 0>,	\
		<DCC_READ 0x00176010 1 0>,	\
		<DCC_READ 0x00176014 1 0>,	\
		<DCC_READ 0x00176018 1 0>,	\
		<DCC_READ 0x0017601C 1 0>,	\
		<DCC_READ 0x00176020 1 0>,	\
		<DCC_READ 0x00176024 1 0>,	\
		<DCC_READ 0x00176028 1 0>,	\
		<DCC_READ 0x0017602C 1 0>,	\
		<DCC_READ 0x00176030 1 0>,	\
		<DCC_READ 0x00176034 1 0>,	\
		<DCC_READ 0x0010401C 1 0>,	\
		<DCC_READ 0x00183024 1 0>,	\
		<DCC_READ 0x00144168 1 0>,	\
		<DCC_READ 0x0011702C 1 0>,	\
		<DCC_READ 0x0010904C 1 0>,	\
		<DCC_READ 0x00189038 1 0>,	\
		<DCC_READ 0x001443E8 1 0>,	\
		<DCC_READ 0x001442B8 1 0>,	\
		<DCC_READ 0x00105060 1 0>,	\
		<DCC_READ 0x00141024 1 0>,	\
		<DCC_READ 0x00145038 1 0>,	\
		<DCC_READ 0x00109004 1 0>,	\
		<DCC_READ 0x00189004 1 0>,	\
		<DCC_READ 0x00190004 1 0>,	\
	\
		/* AOSS_CC */	\
		<DCC_READ 0x0C2A0000 1 0>,	\
		<DCC_READ 0x0C2A0004 1 0>,	\
		<DCC_READ 0x0C2A0008 1 0>,	\
		<DCC_READ 0x0C2A000C 1 0>,	\
		<DCC_READ 0x0C2A0010 1 0>,	\
		<DCC_READ 0x0C2A0014 1 0>,	\
		<DCC_READ 0x0C2A0018 1 0>,	\
		<DCC_READ 0x0C2A001C 1 0>,	\
		<DCC_READ 0x0C2A0020 1 0>,	\
		<DCC_READ 0x0C2A0024 1 0>,	\
		<DCC_READ 0x0C2A0028 1 0>,	\
		<DCC_READ 0x0C2A002C 1 0>,	\
		<DCC_READ 0x0C2A0030 1 0>,	\
		<DCC_READ 0x0C2A0034 1 0>,	\
		<DCC_READ 0x0C2A1000 1 0>,	\
		<DCC_READ 0x0C2A1004 1 0>,	\
		<DCC_READ 0x0C2A1008 1 0>,	\
		<DCC_READ 0x0C2A100C 1 0>,	\
		<DCC_READ 0x0C2A1010 1 0>,	\
		<DCC_READ 0x0C2A1014 1 0>,	\
		<DCC_READ 0x0C2A1018 1 0>,	\
		<DCC_READ 0x0C2A101C 1 0>,	\
		<DCC_READ 0x0C2A1020 1 0>,	\
		<DCC_READ 0x0C2A1024 1 0>,	\
		<DCC_READ 0x0C2A1028 1 0>,	\
		<DCC_READ 0x0C2A102C 1 0>,	\
		<DCC_READ 0x0C2A1030 1 0>,	\
		<DCC_READ 0x0C2A2260 1 0>,	\
		<DCC_READ 0x0C2A2264 1 0>,	\
		<DCC_READ 0x0C2A3008 1 0>,	\
		<DCC_READ 0x0C2A300C 1 0>,	\
		<DCC_READ 0x0C2A3010 1 0>,	\
		<DCC_READ 0x0C2A3014 1 0>,	\
		<DCC_READ 0x0C2A3024 1 0>,	\
		<DCC_READ 0x0C2A2034 1 0>,	\
		<DCC_READ 0x0C2A214C 1 0>,	\
		<DCC_READ 0x0C2A2150 1 0>,	\
		<DCC_READ 0x0C2A2154 1 0>

/* config_talos_dcc_tsens_regs() */
#define config_talos_dcc_tsens_regs	\
	\
		/* GOLD */	\
		<DCC_READ 0x0C2630A0 4 0>,	\
		<DCC_READ 0x0C2630B0 4 0>,	\
		<DCC_READ 0x0C2630C0 4 0>,	\
		<DCC_READ 0x0C2630D0 4 0>

/* config_talos_dcc_core_hang() */
#define config_talos_dcc_core_hang	\
		<DCC_READ 0x1800005C 1 0>,	\
		<DCC_READ 0x1801005C 1 0>,	\
		<DCC_READ 0x1802005C 1 0>,	\
		<DCC_READ 0x1803005C 1 0>,	\
		<DCC_READ 0x1804005C 1 0>,	\
		<DCC_READ 0x1805005C 1 0>,	\
		<DCC_READ 0x1806005C 1 0>,	\
		<DCC_READ 0x1807005C 1 0>

/* config_talos_dcc_bcm_seq_hang() */
#define config_talos_dcc_bcm_seq_hang	\
		<DCC_READ 0x00109468 1 0>

/* config_talos_dcc_pll() */
#define config_talos_dcc_pll	\
		<DCC_READ 0x18282004 1 0>,	\
		<DCC_READ 0x18325F6C 1 0>,	\
		<DCC_READ 0x1808012C 1 0>,	\
		<DCC_READ 0x1832582C 1 0>,	\
		<DCC_READ 0x18280004 1 0>,	\
		<DCC_READ 0x18284038 1 0>,	\
		<DCC_READ 0x18284000 2 0>

&dcc {
	qcom,curr-link-list = <3>;
	qcom,link-list =
		config_talos_dcc_gladiator,
		config_talos_dcc_noc_err_regs,
		config_talos_dcc_shrm,
		config_talos_dcc_rscc_apps,
		config_talos_dcc_pdc_apps,
		/* config_talos_dcc_rscc_lpass, */
		config_talos_dcc_rscc_modem,
		/* config_talos_dcc_rscc_cdsp, */
		config_talos_dcc_memnoc_mccc,
		config_talos_dcc_gpu,
		config_talos_dcc_osm,
		config_talos_dcc_cabo_llcc_shrm,
		config_talos_dcc_cx_mx,
		config_talos_dcc_gcc_regs,
		config_talos_dcc_tsens_regs,
		config_talos_dcc_core_hang,
		config_talos_dcc_bcm_seq_hang,
		config_talos_dcc_pll;

};
