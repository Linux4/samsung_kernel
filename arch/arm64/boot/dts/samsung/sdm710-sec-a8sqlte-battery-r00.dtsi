/* Copyright (c) 2014, The Linux Foundation. All rights reserved.
 *
 * This program is free software; you can redistribute it and/or modify
 * it under the terms of the GNU General Public License version 2 and
 * only version 2 as published by the Free Software Foundation.
 *
 * This program is distributed in the hope that it will be useful,
 * but WITHOUT ANY WARRANTY; without even the implied warranty of
 * MERCHANTABILITY or FITNESS FOR A PARTICULAR PURPOSE.  See the
 * GNU General Public License for more details.
 */

#include "sdm710-sec-a8sqlte-battery-common.dtsi"

&soc {
	i2c_24: i2c@24 {
		compatible = "i2c-gpio";
		gpios = <&tlmm 4 0 /* sda */
			&tlmm 5 0 /* scl */
			>;
		#address-cells = <1>;
		#size-cells = <0>;

		sm5705-fuelgauge@71 {
			compatible = "sm5705-fuelgauge,i2c";
			reg = <0x71>;
			pinctrl-names = "default";
			pinctrl-0 = <&fuel_irq &sm5705_fg_i2c_active>;
			fuelgauge,fuel_int = <&tlmm 77 0>;
			fuelgauge,fuel_alert_soc = <1>;
			fuelgauge,capacity_max = <1000>;
			fuelgauge,capacity_max_margin = <70>;
			fuelgauge,capacity_min = <0>;
			fuelgauge,capacity_calculation_type = <0x1F>;
			fuelgauge,type_str = "BATTERY";
			fuelgauge,model_type = <1>;
			fuelgauge,fg_log_enable = <1>;
		};
	};

};
