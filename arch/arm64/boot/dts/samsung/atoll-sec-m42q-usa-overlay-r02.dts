/* Copyright (c) 2020, The Linux Foundation. All rights reserved.
 *
 * This program is free software; you can redistribute it and/or modify
 * it under the terms of the GNU General Public License version 2 and
 * only version 2 as published by the Free Software Foundation.
 *
 * This program is distributed in the hope that it will be useful,
 * but WITHOUT ANY WARRANTY; without even the implied warranty of
 * MERCHANTABILITY or FITNESS FOR A PARTICULAR PURPOSE.  See the
 * GNU General Public License for more details.
 */

/dts-v1/;
/plugin/;

#include "atoll-sec-common.dtsi"
#include "atoll-sec-m42q-r02.dtsi"
#include "drivers/atoll-sec-m42q-battery-r02.dtsi"
#include "drivers/atoll-sec-m42q-fingerprint-r00.dtsi"

/ {
	model = "Samsung M42Q PROJECT - SM-M425U1_REV00  (board-id,02)";
	compatible = "qcom,atoll-ab-idp", "qcom,atoll-ab", "qcom,idp";
	qcom,board-id = <34 2>;
	dtbo-version = <0>;
};
