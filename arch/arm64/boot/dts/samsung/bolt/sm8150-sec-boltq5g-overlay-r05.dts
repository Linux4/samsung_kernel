/* Copyright (c) 2016-2017, The Linux Foundation. All rights reserved.
 *
 * This program is free software; you can redistribute it and/or modify
 * it under the terms of the GNU General Public License version 2 and
 * only version 2 as published by the Free Software Foundation.
 *
 * This program is distributed in the hope that it will be useful,
 * but WITHOUT ANY WARRANTY; without even the implied warranty of
 * MERCHANTABILITY or FITNESS FOR A PARTICULAR PURPOSE.  See the
 * GNU General Public License for more details.
 */

/dts-v1/;
/plugin/;

#include <dt-bindings/clock/qcom,gcc-sm8150.h>
#include <dt-bindings/clock/qcom,camcc-sm8150.h>
#include <dt-bindings/clock/qcom,rpmh.h>
#include <dt-bindings/interrupt-controller/arm-gic.h>

#include "../qcom/sm8150-mtp.dtsi"
#include "../qcom/sdx5xm-external-soc.dtsi"
#include "../qcom/sm8150-sdx50m.dtsi"
#include "sm8150-sec-common.dtsi"
#include "sm8150-sec-boltq5g-pm-common.dtsi"
#include "sm8150-sec-boltq5g-input-common.dtsi"
#include "sm8150-sec-boltq5g-r05.dtsi"
#include "sm8150-sec-boltq5g-pinctrl-r05.dtsi"
#include "sm8150-sec-boltq5g-display-r05.dtsi"
#include "sm8150-sec-boltq5g-displayport-r00.dtsi"
#include "battery-data-boltq5g-common.dtsi"
#include "sm8150-max77705.dtsi"

/ {
	model = "Samsung BOLTQ5G PROJECT Rev05";
	compatible = "qcom,sm8150-mtp", "qcom,sm8150", "qcom,mtp";
	qcom,board-id = <0x01010008 0x5>;
};
