/* Copyright (c) 2018, The Linux Foundation. All rights reserved.
 *
 * This program is free software; you can redistribute it and/or modify
 * it under the terms of the GNU General Public License version 2 and
 * only version 2 as published by the Free Software Foundation.
 *
 * This program is distributed in the hope that it will be useful,
 * but WITHOUT ANY WARRANTY; without even the implied warranty of
 * MERCHANTABILITY or FITNESS FOR A PARTICULAR PURPOSE.  See the
 * GNU General Public License for more details.
 */

/dts-v1/;
/plugin/;

#include <dt-bindings/interrupt-controller/arm-gic.h>
#include <dt-bindings/clock/qcom,camcc-sm6150.h>

#include "../qcom/sm6150-idp.dtsi"
#include "sm6150-sec-common.dtsi"

#include "sm6150-sec-a60q-pm-common.dtsi"

#include "sm6150-sec-a60q-chn-r02.dtsi"
#include "sm6150-sec-a60q-chn-pinctrl-r02.dtsi"
#include "sm6150-sec-a60q-battery-common.dtsi"
#include "sm6150-sec-a60q-nfc-r00.dtsi"
#include "sm6150-sec-a60q-eif-r00.dtsi"
#include "sm6150-sec-a60q-display-r01.dtsi"
#include "sm6150-sec-a60q-fingerprint_00.dtsi"
#include "sm6150-sec-a60q-camera-r01.dtsi"

/ {
	model = "Samsung A60Q PROJECT (board-id,02)";
	compatible = "qcom,sm6150p-idp", "qcom,sm6150p", "qcom,idp";
	qcom,msm-id = <355 0x0>;
	qcom,board-id = <34 2>;
};
