/* 
 * Generated by Samsung 
 * If these files should be changed, then please make a sync with MTK
*/

/dts-v1/;
/plugin/;

#include "../mediatek/S96806AA2.dts"
#include "mt6833-f42x_common.dtsi"
#include "mt6833_a22x_fingerprint_sensor_00.dtsi"

/* Add Samsung configuration over here */
/ {
	compatible = "Samsung,F42 5G KOR SKT 00", "Mediatek,MT6833";
	dtbo-hw_rev = <0x0>;
	dtbo-hw_rev_end = <0x20>;	
};

/*End of this file, DO NOT ADD ANYTHING HERE*/

