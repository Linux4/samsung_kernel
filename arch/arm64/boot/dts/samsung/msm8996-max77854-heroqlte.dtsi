/* Copyright (c) 2012, The Linux Foundation. All rights reserved.
 *
 * This program is free software; you can redistribute it and/or modify
 * it under the terms of the GNU General Public License version 2 and
 * only version 2 as published by the Free Software Foundation.
 *
 * This program is distributed in the hope that it will be useful,
 * but WITHOUT ANY WARRANTY; without even the implied warranty of
 * MERCHANTABILITY or FITNESS FOR A PARTICULAR PURPOSE.  See the
 * GNU General Public License for more details.
 */

#include "msm8996-max77854.dtsi"

&soc {
	rgb {
		device_type = "hero";
		rgb-name = "led_w", "led_r", "led_g", "led_b";

		normal_powermode_current = <10>;
		low_powermode_current = <2>;
		br_ratio_r = <450>;
		br_ratio_g = <70>;
		br_ratio_b = <200>;

		normal_powermode_current_bk = <10>;
		low_powermode_current_bk = <2>;
		br_ratio_r_bk = <320>;
		br_ratio_g_bk = <50>;
		br_ratio_b_bk = <170>;

		normal_powermode_current_wh = <10>;
		low_powermode_current_wh = <2>;
		br_ratio_r_wh = <150>;
		br_ratio_g_wh = <40>;
		br_ratio_b_wh = <250>;

		normal_powermode_current_gd = <10>;
		low_powermode_current_gd = <2>;
		br_ratio_r_gd = <150>;
		br_ratio_g_gd = <40>;
		br_ratio_b_gd = <250>;

		normal_powermode_current_sv = <10>;
		low_powermode_current_sv = <2>;
		br_ratio_r_sv = <170>;
		br_ratio_g_sv = <60>;
		br_ratio_b_sv = <360>;

		normal_powermode_current_pg = <10>;
		low_powermode_current_pg = <2>;
		br_ratio_r_pg = <100>;
		br_ratio_g_pg = <50>;
		br_ratio_b_pg = <290>;
	};
};

