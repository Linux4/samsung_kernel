/* Copyright (c) 2014, The Linux Foundation. All rights reserved.
 *
 * This program is free software; you can redistribute it and/or modify
 * it under the terms of the GNU General Public License version 2 and
 * only version 2 as published by the Free Software Foundation.
 *
 * This program is distributed in the hope that it will be useful,
 * but WITHOUT ANY WARRANTY; without even the implied warranty of
 * MERCHANTABILITY or FITNESS FOR A PARTICULAR PURPOSE.  See the
 * GNU General Public License for more details.
 */

/* hw id 10, 13 and so on */
&soc {
	i2c@22 {
		status = "ok";
		cell-index = <22>;
		compatible = "i2c-gpio";
		gpios = <&tlmm 6 0 /* sda */
				&tlmm 7 0 /* scl */
		>;
		#i2c-gpio,delay-us = <2>;
		#address-cells = <1>;
		#size-cells = <0>;

		pinctrl-names = "default", "sleep";
		pinctrl-0 = <&mfc_i2c_active>;
		pinctrl-1 = <&mfc_i2c_suspend>;

		mfc-charger@3b {
			compatible = "idt,mfc-charger";
			reg = <0x3b>;
			status = "okay";

			pinctrl-names = "default";
			pinctrl-0 = <&mfc_irq_default &mfc_pdet_default &mfc_ping_nen_default>;

			battery,wpc_int = <&tlmm 50 GPIO_ACTIVE_LOW>; /* MFC_AP_INT */
			battery,wpc_det = <&pm8150l_gpios 1 GPIO_ACTIVE_HIGH>; /* WPC_DET */
			battery,wpc_en = <&expander_gpios 3 0>; /* WPC_EN */
			battery,mst_pwr_en = <&expander_gpios 21 0>; /* MST_PWR_EN */

			battery,charger_name = "max77705-charger";
			battery,fuelgauge_name = "max77705-fuelgauge";
			battery,wireless_charger_name = "mfc-charger";
			battery,fod_data = <150 64 142 53 150 37 150 35 155 21 156 21>;
			battery,fod_data_cv = <150 94 142 83 150 67 150 65 155 51 156 51>;
			battery,fod_hero_5v_data = <150 (-27) 142 (-37) 150 (-53) 150 (-53) 165 160 156 (-61)>;
			battery,wc_cover_rpp = <0x44>;
			battery,oc_fod1 = <1100>;
			battery,tx_gear_min_op_freq_delay = <4000>;
			battery,wireless20_vout_list = <9 9 9>; /* WIRELESS_VOUT_11V, 11V, 11V */
			battery,wireless20_vrect_list = <10 11 11>; /* MFC_AFC_CONF_12V_TX, 12.5V, 12.5V */
			battery,wireless20_max_power_list = <2 3 3>; /* SEC_WIRELESS_RX_POWER_12W, 15W, 15W */
		};
	};
};