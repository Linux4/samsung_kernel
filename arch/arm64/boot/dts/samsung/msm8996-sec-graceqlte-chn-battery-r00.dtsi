/* Copyright (c) 2014, The Linux Foundation. All rights reserved.
 *
 * This program is free software; you can redistribute it and/or modify
 * it under the terms of the GNU General Public License version 2 and
 * only version 2 as published by the Free Software Foundation.
 *
 * This program is distributed in the hope that it will be useful,
 * but WITHOUT ANY WARRANTY; without even the implied warranty of
 * MERCHANTABILITY or FITNESS FOR A PARTICULAR PURPOSE.  See the
 * GNU General Public License for more details.
 */
#include "msm8996-sec-graceqlte-common-battery.dtsi"
&soc {
	battery {
		battery,chg_12v_high_temp = <560>;
		battery,chg_high_temp = <440>;
		battery,chg_high_temp_recovery = <410>;
		/* battery,chg_charging_limit_current = <1100>; */
	};
};
