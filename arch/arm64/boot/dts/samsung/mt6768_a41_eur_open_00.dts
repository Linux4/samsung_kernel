/* Generated by MediaTek 
 * If these files should be chaned, then please make a sync with MTK
*/
#include "../mediatek/k68v1_64_titan.dts"

/* Add Samsung configuration over here */
/ {
	fragment@model {
		target-path = "/";
		__overlay__ {
			usb_notifier {
				compatible = "samsung,usb-notifier";
			};
			muic {
				new_factory;
				dcd_timeout;
			};
		};
	};
};
/*End of this file, DO NOT ADD ANYTHING HERE*/
