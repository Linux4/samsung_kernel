/* Copyright (c) 2016-2017, The Linux Foundation. All rights reserved.
 *
 * This program is free software; you can redistribute it and/or modify
 * it under the terms of the GNU General Public License version 2 and
 * only version 2 as published by the Free Software Foundation.
 *
 * This program is distributed in the hope that it will be useful,
 * but WITHOUT ANY WARRANTY; without even the implied warranty of
 * MERCHANTABILITY or FITNESS FOR A PARTICULAR PURPOSE.  See the
 * GNU General Public License for more details.
 */

/dts-v1/;
/plugin/;

#include <dt-bindings/clock/qcom,gcc-sm8150.h>
#include <dt-bindings/clock/qcom,camcc-sm8150.h>
#include <dt-bindings/clock/qcom,rpmh.h>
#include <dt-bindings/interrupt-controller/arm-gic.h>

#include "../qcom/sm8150-mtp.dtsi"
#include "sm8150-sec-common.dtsi"
#include "sm8150-sec-winnerlte-pm-common.dtsi"
#include "sm8150-sec-winnerlte-input-common.dtsi"
#include "sm8150-sec-winnerlte-r06.dtsi"
#include "sm8150-sec-winnerlte-pinctrl-r06.dtsi"
#include "sm8150-sec-winnerlte-display-r04.dtsi"
#include "sm8150-sec-winnerlte-displayport-r06.dtsi"
#include "sm8150-sec-winnerlte-fingerprint-sensor-r00.dtsi"
#include "battery-data-winnerlte-r06.dtsi"
#include "sm8150-max77705.dtsi"
#include "sm8150-sec-winnerlte-sensor-common.dtsi"
#include "sm8150-camera-sensor-winnerlte-r06.dtsi"
#include "sm8150-sec-beyond2qlte-nfc-r00.dtsi"
#include "sm8150-cs40l2x-winnerlte-r04.dtsi"

/ {
	model = "Samsung WINNERLTE PROJECT Rev06";
	compatible = "qcom,sm8150-mtp", "qcom,sm8150", "qcom,mtp";
	qcom,board-id = <8 6>;
};
