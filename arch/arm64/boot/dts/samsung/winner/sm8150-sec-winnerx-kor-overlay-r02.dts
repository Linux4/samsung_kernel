/* Copyright (c) 2016-2017, The Linux Foundation. All rights reserved.
 *
 * This program is free software; you can redistribute it and/or modify
 * it under the terms of the GNU General Public License version 2 and
 * only version 2 as published by the Free Software Foundation.
 *
 * This program is distributed in the hope that it will be useful,
 * but WITHOUT ANY WARRANTY; without even the implied warranty of
 * MERCHANTABILITY or FITNESS FOR A PARTICULAR PURPOSE.  See the
 * GNU General Public License for more details.
 */

/dts-v1/;
/plugin/;

#include <dt-bindings/clock/qcom,gcc-sm8150.h>
#include <dt-bindings/clock/qcom,camcc-sm8150.h>
#include <dt-bindings/clock/qcom,rpmh.h>
#include <dt-bindings/interrupt-controller/arm-gic.h>

#include "../qcom/sm8150-mtp.dtsi"
#include "../qcom/sdx5xm-external-soc.dtsi"
#include "../qcom/sm8150-sdx50m.dtsi"
#include "sm8150-sec-common.dtsi"
#include "sm8150-sec-winnerxlte-pm-common.dtsi"
#include "sm8150-sec-winnerx-input-common.dtsi"
#include "sm8150-sec-winnerx-r02.dtsi"
#include "sm8150-sec-winnerx-pinctrl-r02.dtsi"
#include "sm8150-sec-winnerx-display-r01.dtsi"
#include "sm8150-sec-winnerx-displayport-r00.dtsi"
#include "sm8150-sec-winnerlte-fingerprint-sensor-r00.dtsi"
#include "battery-data-winnerx-common.dtsi"
#include "sm8150-max77705.dtsi"
#include "sm8150-sec-winnerx-sensor-r01.dtsi"
#include "sm8150-camera-sensor-winnerx-r00.dtsi"
#include "sm8150-sec-beyondxq-nfc-r04.dtsi"
#include "sm8150-cs40l2x-winnerx-r00.dtsi"

/ {
	model = "Samsung WINNERX KOR PROJECT Rev02";
	compatible = "qcom,sm8150-mtp", "qcom,sm8150", "qcom,mtp";
	qcom,board-id = <0x00010008 0x2>;
};
