/*
 * Copyright (c) 2017, The Linux Foundation. All rights reserved.
 *
 * This program is free software; you can redistribute it and/or modify
 * it under the terms of the GNU General Public License version 2 and
 * only version 2 as published by the Free Software Foundation.
 *
 * This program is distributed in the hope that it will be useful,
 * but WITHOUT ANY WARRANTY; without even the implied warranty of
 * MERCHANTABILITY or FITNESS FOR A PARTICULAR PURPOSE.  See the
 * GNU General Public License for more details.
 */




#include "sdm660-sec-a9y18qlte-common.dtsi"
#include "sdm660-sec-a9y18qlte-sensor-r00.dtsi"

&soc {
	/* not use S2DOS03 */
	/delete-node/ i2c@22;
};
