#include "lito-sec.a51xq_usa.00.lego-behind.dtsi"
#include "lito-sec-a51xq-pinctrl-r01.dtsi"

/* Please remove this code when you use it
&soc {

};
*/

&wsa_spkr_en1 {
	/delete-property/ qcom,lpi-gpios; 
};

/ {
	model = "Samsung A51XQ PROJECT REV01";
	qcom,board-id = <8 1>;
	dtbo-version = <0>;
};

