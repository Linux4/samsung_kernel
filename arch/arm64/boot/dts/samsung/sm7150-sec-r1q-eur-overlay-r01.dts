/* Copyright (c) 2018, The Linux Foundation. All rights reserved.
 *
 * This program is free software; you can redistribute it and/or modify
 * it under the terms of the GNU General Public License version 2 and
 * only version 2 as published by the Free Software Foundation.
 *
 * This program is distributed in the hope that it will be useful,
 * but WITHOUT ANY WARRANTY; without even the implied warranty of
 * MERCHANTABILITY or FITNESS FOR A PARTICULAR PURPOSE.  See the
 * GNU General Public License for more details.
 */

/dts-v1/;
/plugin/;

#include <dt-bindings/interrupt-controller/arm-gic.h>
#include <dt-bindings/clock/qcom,camcc-sdmmagpie.h>

#include "common/sm7150-sec-common.dtsi"

#include "sm7150-sec-r1q-pm-common.dtsi"

#include "sm7150-sec-r1q-eur-r01.dtsi"
#include "sm7150-sec-r1q-eur-pinctrl-r01.dtsi"
#include "sm7150-sec-r1q-display-r01.dtsi"
#include "sm7150-sec-r1q-eif-r00.dtsi"
#include "sm7150-sec-r1q-battery-r02.dtsi"
#include "sm7150-sec-r1q-fingerprint_00.dtsi"
#include "sm7150-sec-r1q-nfc-r00.dtsi"
#include "sm7150-camera-sensor-r1q-r00.dtsi"

/ {
	model = "Samsung R1Q PROJECT Rev0.0A / BringUp_1 (board-id,01)";
	compatible = "qcom,sdmmagpie-idp", "qcom,sdmmagpie", "qcom,idp";
	qcom,msm-id = <365 0x0>;
	qcom,board-id = <34 1>;
};

&qupv3_se7_i2c {
	touchscreen@50 {
		imagis,bringup = <1>;
	};
};