/* 
 * Generated by Samsung 
 * If these files should be changed, then please make a sync with MTK
*/

#include "mt6769t-f22_common.dtsi"
#include "mt6769t-f22_camera_00.dtsi"

&melfas_mip4_ts {
	status = "disabled";
};

/*End of this file, DO NOT ADD ANYTHING HERE*/
