/* Copyright (c) 2019, The Linux Foundation. All rights reserved. 
* 
* This program is free software; you can redistribute it and/or modify 
* it under the terms of the GNU General Public License version 2 and 
* only version 2 as published by the Free Software Foundation. 
* 
* This program is distributed in the hope that it will be useful, 
* but WITHOUT ANY WARRANTY; without even the implied warranty of 
* MERCHANTABILITY or FITNESS FOR A PARTICULAR PURPOSE.  See the 
* GNU General Public License for more details. 
*/ 
 
/dts-v1/; 
/plugin/; 
 
#include "common/sm7150-sec-common.dtsi" 
#include "m51/sm7150-sec-m51-eur-r00.dtsi"
#include "m51/sm7150-sec-m51-eur-pinctrl-r00.dtsi" 
/* FIXME : strongly recommend to move it to sm7150-sec-a71-eur-r0n.dtsi */
#include "drivers/sm7150-sec-m51-display-r00.dtsi"
#include "drivers/sm7150-sec-m51-battery-r00.dtsi"
#include "drivers/sm7150-sec-m51-eif-r00.dtsi"

 
/ { 
	model = "Samsung M51 PROJECT Rev0.0 (board-id,00)"; 
	compatible = "qcom,sdmmagpie-idp", "qcom,sdmmagpie", "qcom,idp"; 
	qcom,msm-id = <365 0x0>; 
	qcom,board-id = <34 0>; 
}; 
