/* Copyright (c) 2013, Samsung Electronics Corporation. All rights reserved.
 *
 * This program is free software; you can redistribute it and/or modify
 * it under the terms of the GNU General Public License version 2 and
 * only version 2 as published by the Free Software Foundation.
 *
 * This program is distributed in the hope that it will be useful,
 * but WITHOUT ANY WARRANTY; without even the implied warranty of
 * MERCHANTABILITY or FITNESS FOR A PARTICULAR PURPOSE.  See the
 * GNU General Public License for more details.
 */

&soc {
	sec-mst {
		compatible = "sec-mst";
		sec-mst,mst-pwr-gpio = <&tlmm 36 0>;
		sec-mst,mst-data-gpio = <&tlmm 37 0>;
		sec-mst,mst-en-gpio = <&tlmm 38 0>;
		sec-mst,mst-support-gpio = <&pm6150l_gpios 2 0>;

		//pinctrl-names = "mst_active";
		//pinctrl-0 = <&mst_data_init &mst_en_init>;
	};
/*
	tlmm: pinctrl@03000000 {
		mst_data_init: mst_data_init {
			mux {
				pins = "gpio84";
				function = "gpio";
			};
			config {
				pins = "gpio84";
				drive-strength = <16>;
				bias-pull-down;
				output_low;
			};
		};
		mst_en_init: mst_en_init {
			mux {
				pins = "gpio83";
				function = "gpio";
			};
			config {
				pins = "gpio83";
				drive-strength = <16>;
				bias-pull-down;
				output_low;
			};
		};
	};
*/
};
