/*
 * SAMSUNG S5E9925 board device tree source
 *
 * Copyright (c) 2021 Samsung Electronics Co., Ltd.
 *		http://www.samsung.com
 *
 * This program is free software; you can redistribute it and/or modify
 * it under the terms of the GNU General Public License version 2 as
 * published by the Free Software Foundation.
*/

/dts-v1/;
/plugin/;

/ {
	compatible = "samsung,s5e9925";
	dtbo-hw_rev = <0>;
	dtbo-hw_rev_end = <255>;
	edtbo-rev = <0>;

	fragment@model {
		target-path = "/";
		__overlay__ {
			#address-cells = <2>;
			#size-cells = <1>;

			model = "Samsung G0S board EDTBO based on S5E9925";
		}; /* end of __overlay__ */
	}; /* end of fragment */
}; /* end of root */
