/* 
 * This pinctrl code is only for PULL state change.
 * IN-OUT setting is set to OUTPUT at fixed-regulator probe.
 */

&tlmm {
        ldo_gpio3: ldo_gpio3 {
                GPIO_CONFIG_PUD(AP,tlmm,58, FUNC_OUTPUT, PULL_NONE);
#if 0
		samsung,pin-con-pdn = <3>;
		samsung,pin-pud-pdn = <0>;
#endif
        };
};

&smd {
	fixed_regulator3: fixed_regulator@3 {
		compatible = "regulator-fixed";
		regulator-name = "fixed_regulator3";
		gpio = <SEC_GPIO_REF(AP,tlmm,58) 0>;
		pinctrl-names = "default";
		pinctrl-0 = <&ldo_gpio3>;
		enable-active-high;
	};
};

