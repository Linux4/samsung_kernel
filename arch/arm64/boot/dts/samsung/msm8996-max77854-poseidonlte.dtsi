/* Copyright (c) 2012, The Linux Foundation. All rights reserved.
 *
 * This program is free software; you can redistribute it and/or modify
 * it under the terms of the GNU General Public License version 2 and
 * only version 2 as published by the Free Software Foundation.
 *
 * This program is distributed in the hope that it will be useful,
 * but WITHOUT ANY WARRANTY; without even the implied warranty of
 * MERCHANTABILITY or FITNESS FOR A PARTICULAR PURPOSE.  See the
 * GNU General Public License for more details.
 */

#include "msm8996-max77854.dtsi"

&soc {
	rgb {
		device_type = "poseidon";
		rgb-name = "led_w", "led_r", "led_g", "led_b";

		normal_powermode_current = <10>;
		low_powermode_current = <2>;
		br_ratio_r = <1000>;
		br_ratio_g = <250>;
		br_ratio_b = <1600>;
		/*Green*/
		normal_powermode_current_gr = <10>;
		low_powermode_current_gr = <2>;
		br_ratio_r_gr = <1000>;
		br_ratio_g_gr = <250>;
		br_ratio_b_gr = <1600>;
		/*Gold*/
		normal_powermode_current_gd = <10>;
		low_powermode_current_gd = <2>;
		br_ratio_r_gd = <1000>;
		br_ratio_g_gd = <250>;
		br_ratio_b_gd = <1600>;
		/*Titan*/
		normal_powermode_current_tt = <10>;
		low_powermode_current_tt = <2>;
		br_ratio_r_tt = <1000>;
		br_ratio_g_tt = <250>;
		br_ratio_b_tt = <1600>;
	};
};

