/* Copyright (c) 2019, The Linux Foundation. All rights reserved. 

* 

* This program is free software; you can redistribute it and/or modify 

* it under the terms of the GNU General Public License version 2 and 

* only version 2 as published by the Free Software Foundation. 

* 

* This program is distributed in the hope that it will be useful, 

* but WITHOUT ANY WARRANTY; without even the implied warranty of 

* MERCHANTABILITY or FITNESS FOR A PARTICULAR PURPOSE.  See the 

* GNU General Public License for more details. 

*/ 

#include "sm7150-sec-a71-eur-ldu-r05.dtsi"
#include "sm7150-sec-a71-eur-ldu-pinctrl-r06.dtsi"
//#include "../drivers/sm7150-camera-sensor-a71-r01.dtsi"

//#include "../drivers/sm7150-sec-a71-display-r00.dtsi"


&soc {
	i2c_14: 12c@14 {
		status  = "ok";

		cell-index = <14>;
		compatible = "i2c-gpio";
		gpios = <&tlmm 101 0 /*sda*/
			&tlmm 102 0 /*scl*/
			>;

		#address-cells = <1>;
		#size-cells = <0>;
		pinctrl-names = "default";
		pinctrl-0 = <&s2mu106_fg_active>;
	};
};

