#include "lito-sec.a71xq.06.lego-behind.dtsi"
#include "lito-sec-a71xq-pinctrl-r09.dtsi"

/* Please remove this code when you use it
&soc {

};
*/

/ {
	model = "Samsung A71XQ PROJECT REV09";
	qcom,board-id = <8 9>;
	dtbo-version = <0>;
};
