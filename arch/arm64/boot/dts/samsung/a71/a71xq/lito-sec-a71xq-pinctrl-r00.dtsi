/* Copyright (c) 2019, The Linux Foundation. All rights reserved.
 *
 * This program is free software; you can redistribute it and/or modify
 * it under the terms of the GNU General Public License version 2 and
 * only version 2 as published by the Free Software Foundation.
 *
 * This program is distributed in the hope that it will be useful,
 * but WITHOUT ANY WARRANTY; without even the implied warranty of
 * MERCHANTABILITY or FITNESS FOR A PARTICULAR PURPOSE.  See the
 * GNU General Public License for more details.
 */

&soc {

};
&tas2562_i2c_default {
	mux {
		pins = "gpio108", "gpio109";
		function = "gpio";
	};
	config {
		pins = "gpio108", "gpio109";
		drive-strength = <2>;	/* 2 mA */
		/delete-property/ bias-disable;
		bias-pull-up;			/* NO PULL */
	};
};

