#include "lito-sec.a71xq.02.lego-behind.dtsi"
#include "lito-sec-a71xq-pinctrl-r04.dtsi"

/* Please remove this code when you use it
&soc {

};
*/

/ {
	model = "Samsung A71XQ PROJECT REV04";
	qcom,board-id = <8 4>;
	dtbo-version = <0>;
};
