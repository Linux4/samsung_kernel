/* Copyright (c) 2019, The Linux Foundation. All rights reserved.
 *
 * This program is free software; you can redistribute it and/or modify
 * it under the terms of the GNU General Public License version 2 and
 * only version 2 as published by the Free Software Foundation.
 *
 * This program is distributed in the hope that it will be useful,
 * but WITHOUT ANY WARRANTY; without even the implied warranty of
 * MERCHANTABILITY or FITNESS FOR A PARTICULAR PURPOSE.  See the
 * GNU General Public License for more details.
 */

&tas2562_i2c_default {
	mux {
		pins = "gpio132", "gpio133";
		function = "gpio";
	};
	config {
		pins = "gpio132", "gpio133";
		drive-strength = <2>;	/* 2 mA */
		/delete-property/ bias-pull-up;
		bias-disable;			/* NO PULL */
	};
};
