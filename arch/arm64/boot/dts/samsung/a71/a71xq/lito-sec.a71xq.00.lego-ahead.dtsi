/* Copyright (c) 2019, The Linux Foundation. All rights reserved.
 *
 * This program is free software; you can redistribute it and/or modify
 * it under the terms of the GNU General Public License version 2 and
 * only version 2 as published by the Free Software Foundation.
 *
 * This program is distributed in the hope that it will be useful,
 * but WITHOUT ANY WARRANTY; without even the implied warranty of
 * MERCHANTABILITY or FITNESS FOR A PARTICULAR PURPOSE.  See the
 * GNU General Public License for more details.
 */

#include <dt-bindings/interrupt-controller/arm-gic.h>
#include "../../../vendor/qcom/lito-mtp.dtsi"

#include "../../lito-sec-common.dtsi"
#include "../../lito-sec-pm7250b-common.dtsi"
#include "../../lito-sec-dcc-common.dtsi"

#include "../lito-sec-a71-common.dtsi"
#include "../lito-sec-a71-pm-common.dtsi"
#include "../lito-sec-a71-pinctrl-common.dtsi"

#include "../lito-sec-a71-audio-common.dtsi"
#include "../lito-sec-a71-audio-pinctrl-common.dtsi"
#include "../lito-sec-a71-input-common.dtsi"
#include "../lito-sec-a71-s2mu107-common.dtsi"
#include "../lito-sec-a71xq-camera-sensor-r00.dtsi"
