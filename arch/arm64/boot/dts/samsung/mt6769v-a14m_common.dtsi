/* Generated by Samsung for MTK vendor board 

 * If these files should be changed, then please make a sync with MTK
*/

/* Add Samsung configuration over here */
/ {
	fragment@model {
		target-path = "/";
		__overlay__ {
			usb_notifier {
				compatible = "samsung,usb-notifier";
				disable_host_wakelock;
			};
		};
	};
};
