/* Copyright (c) 2014, The Linux Foundation. All rights reserved.
 *
 * This program is free software; you can redistribute it and/or modify
 * it under the terms of the GNU General Public License version 2 and
 * only version 2 as published by the Free Software Foundation.
 *
 * This program is distributed in the hope that it will be useful,
 * but WITHOUT ANY WARRANTY; without even the implied warranty of
 * MERCHANTABILITY or FITNESS FOR A PARTICULAR PURPOSE.  See the
 * GNU General Public License for more details.
 */

&bluetooth {
        compatible = "qcom,qca6490";
        qcom,bt-vdd-asd-supply = <>;
        qcom,bt-vdd-ipa-2p2-supply = <>;
        qcom,bt-vdd-aon-config = <1012000 1012000 0 1>;
        qcom,bt-vdd-dig-config = <1012000 1012000 0 1>;
        qcom,bt-vdd-rfacmn-config  = <1012000 1012000 0 1>;
        qcom,bt-vdd-rfa-0p8-config  = <1012000 1012000 0 1>;
        qcom,bt-vdd-rfa1-config = <1900000 2100000 0 1>;
};
