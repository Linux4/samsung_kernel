/* Copyright (c) 2021, The Linux Foundation. All rights reserved.
 *
 * This program is free software; you can redistribute it and/or modify
 * it under the terms of the GNU General Public License version 2 and
 * only version 2 as published by the Free Software Foundation.
 *
 * This program is distributed in the hope that it will be useful,
 * but WITHOUT ANY WARRANTY; without even the implied warranty of
 * MERCHANTABILITY or FITNESS FOR A PARTICULAR PURPOSE.  See the
 * GNU General Public License for more details.
 */

#include "../../yupik-sec-common.dtsi"

#include "../yupik-sec-gtactpro-common.dtsi"
#include "../yupik-sec-gtactpro-pinctrl-common.dtsi"
#include "../yupik-sec-gtactprowifi-sensor-r01.dtsi"
#include "../yupik-sec-gtactprowifi-sensor-pinctrl-r01.dtsi"
#include "./yupik-sec-gtact4prowifi-pm-common.dtsi"
#include "../yupik-sec-gtact4pro-input-common.dtsi"
#include "./yupik-sec-gtact4prowifi-wlan-common.dtsi"
#include "./yupik-sec-gtact4prowifi-pinctrl-r04.dtsi"
#include "../yupik-sec-gtact4pro-audio-common.dtsi"
#include "../yupik-sec-gtact4pro-audio-pinctrl-common.dtsi"
#include "./yupik-sec-gtact4pro-camera-sensor-common.dtsi"
#include "./yupik-sec-gtact4prowifi-bluetooth-common.dtsi"

/ {
	model = "Samsung GTACT4PROWIFI PROJECT (board-id,04)";
	qcom,msm-id = <475 0x10000>, <515 0x10000>;
	qcom,board-id = <34 4>;
	dtbo-version = <0>;
};

&pm8350c_l8{
	regulator-min-microvolt = <1800000>;
	regulator-max-microvolt = <1800000>;
	qcom,init-voltage = <1800000>;
	regulator-always-on;
};