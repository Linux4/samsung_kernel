/* Copyright (c) 2021, The Linux Foundation. All rights reserved.
 *
 * This program is free software; you can redistribute it and/or modify
 * it under the terms of the GNU General Public License version 2 and
 * only version 2 as published by the Free Software Foundation.
 *
 * This program is distributed in the hope that it will be useful,
 * but WITHOUT ANY WARRANTY; without even the implied warranty of
 * MERCHANTABILITY or FITNESS FOR A PARTICULAR PURPOSE.  See the
 * GNU General Public License for more details.
 */

#include "../../yupik-sec-common.dtsi"

#include "../yupik-sec-gtactpro-common.dtsi"
#include "../yupik-sec-gtactpro-pinctrl-common.dtsi"
#include "../yupik-sec-gtactprowifi-sensor-r01.dtsi"
#include "../yupik-sec-gtactprowifi-sensor-pinctrl-r01.dtsi"
#include "./yupik-sec-gtact4prowifi-pm-common.dtsi"
#include "../yupik-sec-gtact4pro-input-common.dtsi"
#include "./yupik-sec-gtact4prowifi-wlan-common.dtsi"
#include "./yupik-sec-gtact4prowifi-pinctrl-r02.dtsi"
#include "../yupik-sec-gtact4pro-audio-common.dtsi"
#include "../yupik-sec-gtact4pro-audio-pinctrl-common.dtsi"
#include "./yupik-sec-gtact4pro-camera-sensor-common.dtsi"
#include "./yupik-sec-gtact4prowifi-bluetooth-common.dtsi"

/ {
	model = "Samsung GTACT4PROWIFI PROJECT (board-id,02)";
	qcom,msm-id = <475 0x10000>, <515 0x10000>;
	qcom,board-id = <34 2>;
	dtbo-version = <0>;
};

&pm8350c_l8{
	regulator-min-microvolt = <1800000>;
	regulator-max-microvolt = <1800000>;
	qcom,init-voltage = <1800000>;
	regulator-always-on;
};

&qupv3_se6_i2c {
	status = "ok";

	pinctrl-names = "default", "sleep";
	pinctrl-0 = <&qupv3_se6_i2c_active &qupv3_se6_redriver_i2c_active>;
	pinctrl-1 = <&qupv3_se6_i2c_sleep>;

	ps5169@28 {
		compatible = "ps5169_driver";
		reg = <0x28>;
		combo,con_sel = <&tlmm 140 0>;
		combo,enable_control = <0>;
	};
};
