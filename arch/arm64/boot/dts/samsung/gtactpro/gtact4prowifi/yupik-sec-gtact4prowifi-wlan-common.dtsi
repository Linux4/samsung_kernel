/* Copyright (c) 2014, The Linux Foundation. All rights reserved.
 *
 * This program is free software; you can redistribute it and/or modify
 * it under the terms of the GNU General Public License version 2 and
 * only version 2 as published by the Free Software Foundation.
 *
 * This program is distributed in the hope that it will be useful,
 * but WITHOUT ANY WARRANTY; without even the implied warranty of
 * MERCHANTABILITY or FITNESS FOR A PARTICULAR PURPOSE.  See the
 * GNU General Public License for more details.
 */

#include "../../../vendor/qcom/yupik-idp-hsp.dtsi"
#include "../../../vendor/qcom/yupik-hsp.dtsi"

&wlan {
	qcom,vdd-wlan-aon-config = <1012000 1012000 0 0 1>;
	qcom,vdd-wlan-dig-config = <1012000 1012000 0 0 1>;
	qcom,vdd-wlan-rfa1-config = <1900000 2100000 0 0 1>;
	wlan-ant-switch-supply = <>;
	qcom,wlan-ant-switch-config = <>;
};

&pcie0 {
        esoc-name = "wlan";
	qcom,target-link-speed = <0x2>;
	status = "ok";
};

&pcie0_msi {
        status = "disabled";
};

&pil_wpss_mem {
        status = "disabled";
};

