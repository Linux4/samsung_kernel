/* Copyright (c) 2013-2014, The Linux Foundation. All rights reserved.
 *
 * This program is free software; you can redistribute it and/or modify
 * it under the terms of the GNU General Public License version 2 and
 * only version 2 as published by the Free Software Foundation.
 *
 * This program is distributed in the hope that it will be useful,
 * but WITHOUT ANY WARRANTY; without even the implied warranty of
 * MERCHANTABILITY or FITNESS FOR A PARTICULAR PURPOSE.  See the
 * GNU General Public License for more details.
 */

&pm6150l_l6 {
	regulator-min-microvolt = <3300000>;
	regulator-max-microvolt = <3300000>;
	qcom,init-voltage = <3300000>;
};

&soc {
	qupv3_se6_spi: spi@0xa80000 {
		status = "okay";

		etspi-spi@0 {
			compatible = "etspi,et7xx";
			reg = <0>;
			spi-max-frequency = <50000000>;
			etspi-min_cpufreq_limit = <2169600>;
			gpio-controller;
			#gpio-cells = <2>;

			etspi-sleepPin = <&expander_gpios 15 0>;
			etspi-chipid = "ET713";
			etspi-modelinfo = "A805";
			etspi-regulator = "pm6150l_l6";
			etspi-position = "14.46,0.00,7.30,7.30,14.80,14.80,12.00,12.00,5.00";
		};
	};
};