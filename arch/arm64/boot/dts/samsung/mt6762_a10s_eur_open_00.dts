/* 
 * Generated by Samsung 
 * If these files should be changed, then please make a sync with WINGTECH
*/

/dts-v1/;
/plugin/;

#include "../mediatek/S96116RA1.dts"
#include "mt6762-a10s_common.dtsi"

/* Add Samsung configuration over here */
/ {
	compatible = "Samsung,A10S EUR OPEN 00", "Mediatek,MT6762";
	dtbo-hw_rev = <0x0>;
	dtbo-hw_rev_end = <0x20>;	
};

/*End of this file, DO NOT ADD ANYTHING HERE*/
