/*
 * SAMSUNG S5E8825 board device tree source
 *
 * Copyright (c) 2020 Samsung Electronics Co., Ltd.
 *		http://www.samsung.com
 *
 * This program is free software; you can redistribute it and/or modify
 * it under the terms of the GNU General Public License version 2 as
 * published by the Free Software Foundation.
*/

#include "s5e8825-m33x_common.dtsi"
#include "s5e8825-m33x_pm_00.dtsi"
#include "camera/s5e8825-m33x-camera_00.dtsi"

/ {
	compatible = "samsung,M33X SWA INS 01", "samsung,S5E8825";

	fragment@model {
		target-path = "/";
		__overlay__ {
			#address-cells = <2>;
			#size-cells = <1>;

			model = "Samsung M33X SWA INS 01 based on S5E8825";

		}; /* end of __overlay__ */
	}; /* end of fragment */
}; /* end of root */

&serial_0 {
	status = "okay";
};

/* ----------------------------------------------------------------------------
 * Configurations for GPIOs without Device Driver
 * Note: Do NOT add pins using by device drivers to the configuration below
 * ----------------------------------------------------------------------------
 */
/*
 * pin banks of s5e8825 pin-controller 0 (ALIVE) : pinctrl@11850000
 * GPA0, GPA1
 * GPQ0, GPQ1
 * GPC0 ~ GPC7
 * GPX0
 * NOTE: These pin's are ALIVE region. DO NOT add SLEEP gpio config.
 */
/*
&pinctrl_0 {
	pinctrl-names = "default";
	pinctrl-0 = <&initial0>;
	initial0: initial-state {
	};
};
*/

/*
 * pin banks of s5e8825 pin-controller 1 (CMGP) : pinctrl@11430000
 * GPM0 ~ GPM20
 */
/*
&pinctrl_1 {
	pinctrl-names = "default";
	pinctrl-0 = <&initial1>;
	initial1: initial-state {
	};
};
*/

/*
 * pin banks of s5e8825 pin-controller 2 (CHUB) : pinctrl@111d0000
 * GPH0, GPH1
 * NOTE: These pin's are ALIVE region. DO NOT add SLEEP gpio config.
 */
/*
&pinctrl_2 {
	pinctrl-names = "default";
	pinctrl-0 = <&initial2>;
	initial2: initial-state {
	};
};
*/

/*
 * pin banks of s5e8825 pin-controller 3 (CHUBINT) : pinctrl@111e0000
 * GPE0, GPE1
 * NOTE: These pin's are ALIVE region. DO NOT add SLEEP gpio config.
 */
/*
&pinctrl_3 {
	pinctrl-names = "default";
	pinctrl-0 = <&initial3>;
	initial3: initial-state {
	};
};
*/

/*
 * pin banks of s5e8825 pin-controller 4 (HSI) : pinctrl@13450000
 * GPF0, GPF1
 */
/*
&pinctrl_4 {
	pinctrl-names = "default";
	pinctrl-0 = <&initial4>;
	initial4: initial-state {
	};
};
*/

/*
 * pin banks of s5e8825 pin-controller 5 (HSIUFS) : pinctrl@13440000
 * GPF3
 */
/*
&pinctrl_5 {
	pinctrl-names = "default";
	pinctrl-0 = <&initial5>;
	initial5: initial-state {
	};
};
*/

/*
 * pin banks of s5e8825 pin-controller 6 (PERI) : pinctrl@10040000
 * GPP0 ~ GPP3
 * GPG0 ~ GPG2
 * GPB0, GPB1
 */

&pinctrl_6 {
	pinctrl-names = "default";
	pinctrl-0 = <&initial6>;
	initial6: initial-state {
		PIN_IN(gpg0-1, DOWN);	/* BAT_CHECK : NC*/
	};
};


/*
 * pin banks of s5e8825 pin-controller 7 (PERIMMC) : pinctrl@100f0000
 * GPF2
 */
/*
&pinctrl_7 {
	pinctrl-names = "default";
	pinctrl-0 = <&initial7>;
	initial5: initial-state {
	};
};
*/

/*
 * pin banks of s5e8825 pin-controller 8 (VTS) : pinctrl@11780000
 * GPV0
 */
/*
&pinctrl_8 {
	pinctrl-names = "default";
	pinctrl-0 = <&initial7>;
	initial5: initial-state {
	};
};
*/

