/* Copyright (c) 2014, The Linux Foundation. All rights reserved.
 *
 * This program is free software; you can redistribute it and/or modify
 * it under the terms of the GNU General Public License version 2 and
 * only version 2 as published by the Free Software Foundation.
 *
 * This program is distributed in the hope that it will be useful,
 * but WITHOUT ANY WARRANTY; without even the implied warranty of
 * MERCHANTABILITY or FITNESS FOR A PARTICULAR PURPOSE.  See the
 * GNU General Public License for more details.
 */

#include "battery-data-r3q-common.dtsi"

&soc {
	battery {
		battery,temp_table_adc = <340000 351000 365000 389000 406000
						421000 479000 550000 648000 748000
						845000 929000 1022000 1122000 1227000
						1305000 1400000 1550000 1604000 1640000
						1680000 1720000 1757000>;
		battery,temp_table_data = <900 850 800 750 700
						650 600 550 500 450
						400 350 300 250 200
						150 100 50 0 (-50)
						(-100) (-150) (-200)>;
	};
};
