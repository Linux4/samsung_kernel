/* 
 * Generated by Samsung 
 * If these files should be changed, then please make a sync with MTK
*/

/dts-v1/;
/plugin/;

#include "../mediatek/ot8_fem.dts"
#include "mt8768t-gta7lite_common.dtsi"

/* Add Samsung configuration over here */
/ {
	compatible = "Samsung,Tab-A7-Lite USA SINGLE 00", "Mediatek,MT8768T";
	dtbo-hw_rev = <0x0>;
	dtbo-hw_rev_end = <0x20>;	
};

/*End of this file, DO NOT ADD ANYTHING HERE*/

