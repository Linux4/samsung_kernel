/*
 * SAMSUNG EXYNOS9611 board device tree source
 *
 * Copyright (c) 2019 Samsung Electronics Co., Ltd.
 *		http://www.samsung.com
 *
 * This program is free software; you can redistribute it and/or modify
 * it under the terms of the GNU General Public License version 2 as
 * published by the Free Software Foundation.
 */

#include <dt-bindings/clock/exynos9610.h>

&contexthub_0 {
	os-type = "sensorhub/shub_exynos9611_g715.fw";
	/* chub irq pin lists */
	chub-irq-pin-len = <0>;
	chub-irq-pin = <>;
	clocks =
		/* SHUB */
		<&clock UMUX_CLKCMU_SHUB_BUS>,
		/* MAG, PROXI, BARO are all I2C */
		<&clock CMGP_I2C>;
	clock-names =
		"chub_bus",
		"cmgp_i2c";

	sensor-ldo-en = <&gpm21 0 1>;

	/* SSP */
	ssp-acc-position = <1>;
	ssp-mag-position = <2>;
	ssp-prox-thresh = /bits/ 16 <350 250>;
	ssp-prox-mode-thresh = /bits/ 16 <350 251>;
	ssp-prox-setting-thresh = /bits/ 16 <350 130>;
	ssp-mag-array = /bits/ 8 <3 232 255 226 255 249 255 243 3 
	223 0 17 255 250 0 0 4 37
	0 0 0 0 0 0 0 0 0>;
};
