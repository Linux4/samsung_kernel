/* Copyright (c) 2018, The Linux Foundation. All rights reserved.
 *
 * This program is free software; you can redistribute it and/or modify
 * it under the terms of the GNU General Public License version 2 and
 * only version 2 as published by the Free Software Foundation.
 *
 * This program is distributed in the hope that it will be useful,
 * but WITHOUT ANY WARRANTY; without even the implied warranty of
 * MERCHANTABILITY or FITNESS FOR A PARTICULAR PURPOSE.  See the
 * GNU General Public License for more details.
 */

/dts-v1/;
/plugin/;

#include <dt-bindings/interrupt-controller/arm-gic.h>
#include <dt-bindings/clock/qcom,camcc-sm6150.h>

#include "../qcom/sm6150-idp.dtsi"
#include "sm6150-sec-common.dtsi"

#include "sm6150-sec-a70q-pm-common.dtsi"

#include "sm6150-sec-a70q-can-r02.dtsi"
#include "sm6150-sec-a70q-can-pinctrl-r02.dtsi"
#include "sm6150-sec-a70q-battery-common.dtsi"
#include "sm6150-sec-a70q-nfc-r00.dtsi"
#include "sm6150-sec-a70q-eif-r00.dtsi"
#include "sm6150-sec-a70q-display-r01.dtsi"
#include "sm6150-sec-a70q-fingerprint_02.dtsi"
#include "sm6150-camera-sensor-a70q-eur-r02.dtsi"
/ {
	model = "Samsung A70Q PROJECT Rev0.1 (board-id,02)";
	compatible = "qcom,sm6150p-idp", "qcom,sm6150p", "qcom,idp";
	qcom,msm-id = <355 0x0>;
	qcom,board-id = <34 2>;
};

&qupv3_se1_i2c {
	touchscreen@50 {
		imagis,bringup = <1>;
	};
};