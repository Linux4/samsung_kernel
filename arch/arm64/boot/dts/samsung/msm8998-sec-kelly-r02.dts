/* Copyright (c) 2016, The Linux Foundation. All rights reserved.
 *
 * This program is free software; you can redistribute it and/or modify
 * it under the terms of the GNU General Public License version 2 and
 * only version 2 as published by the Free Software Foundation.
 *
 * This program is distributed in the hope that it will be useful,
 * but WITHOUT ANY WARRANTY; without even the implied warranty of
 * MERCHANTABILITY or FITNESS FOR A PARTICULAR PURPOSE.  See the
 * GNU General Public License for more details.
 */


/dts-v1/;

#include "../qcom/msm8998-v2.1.dtsi"
#include "../qcom/msm8998-mtp.dtsi"
#include "msm8998-sec-common.dtsi"
#include "msm8998-sec-kelly-common.dtsi"
#include "msm8998-sec-kelly-common-pm-r02.dtsi"
#include "battery-data-kelly-r01.dtsi"
#include "msm8998-sec-kelly-r02.dtsi"
#include "msm8998-sec-kelly-pm-r01.dtsi"
/ {
	model = "Samsung KELLY CHN PROJECT Rev02";
	compatible = "qcom,msm8998-mtp", "qcom,msm8998", "qcom,mtp";
	qcom,board-id = <8 2>;

};

&soc {
	i2c_17: i2c@17 { /* SW I2C */
		sx9320-i2c@28 {
			sx9320,normal_thd = <0x2D>;
		};
	};
};
