/* Copyright (c) 2016-2017, The Linux Foundation. All rights reserved.
 *
 * This program is free software; you can redistribute it and/or modify
 * it under the terms of the GNU General Public License version 2 and
 * only version 2 as published by the Free Software Foundation.
 *
 * This program is distributed in the hope that it will be useful,
 * but WITHOUT ANY WARRANTY; without even the implied warranty of
 * MERCHANTABILITY or FITNESS FOR A PARTICULAR PURPOSE.  See the
 * GNU General Public License for more details.
 */

/dts-v1/;
/plugin/;

#include <dt-bindings/clock/qcom,gcc-sm8150.h>
#include <dt-bindings/clock/qcom,camcc-sm8150.h>
#include <dt-bindings/clock/qcom,rpmh.h>
#include <dt-bindings/interrupt-controller/arm-gic.h>

#include "../qcom/sm8150-mtp.dtsi"
#include "../qcom/sdx5xm-external-soc.dtsi"
#include "../qcom/sm8150-sdx50m.dtsi"
#include "sm8150-sec-common.dtsi"
#include "sm8150-sec-gts6x-pm-common.dtsi"
#include "sm8150-sec-gts6x-r04.dtsi"
#include "sm8150-sec-gts6x-pinctrl-r04.dtsi"
#include "sm8150-sec-gts5l-display-r01.dtsi"
#include "sm8150-sec-gts5l-displayport-r00.dtsi"
#include "battery-data-gts6l-common.dtsi"
#include "sm8150-s2mm005.dtsi"
#include "sm8150-max77705-motor.dtsi"
#include "sm8150-sm5705q-gts6lx-r04.dtsi"
#include "sm8150-sec-beyond2qlte-sensor-common.dtsi"
#include "sm8150-sec-gts5l-fingerprint-sensor-r00.dtsi"
#include "sm8150-camera-sensor-gts5lqlte-r00.dtsi"
#include "sm8150-sec-beyondq-mst-r04.dtsi"

/ {
	model = "Samsung GTS6X PROJECT Rev04";
	compatible = "qcom,sm8150-mtp", "qcom,sm8150", "qcom,mtp";
	qcom,board-id = <0x00010008 0x4>;
	dtbo-version = <0>;
};
