/* Copyright (c) 2016-2017, The Linux Foundation. All rights reserved.
 *
 * This program is free software; you can redistribute it and/or modify
 * it under the terms of the GNU General Public License version 2 and
 * only version 2 as published by the Free Software Foundation.
 *
 * This program is distributed in the hope that it will be useful,
 * but WITHOUT ANY WARRANTY; without even the implied warranty of
 * MERCHANTABILITY or FITNESS FOR A PARTICULAR PURPOSE.  See the
 * GNU General Public License for more details.
 */

#include "sm8150-sec-gts6l-r01.dtsi"

&soc {

};

&usb2_phy0 {
	qcom,param-override-seq =
		<0xc7 0x6c
		 0x8b 0x70
		 0x2e 0x74
		 0x03 0x78>;
	qcom,param-host-override-seq =
		<0x67 0x6c
		 0x43 0x70
		 0x2e 0x74
		 0x03 0x78>;
};
