#include <dt-bindings/clock/mt6768-clk.h>

#define topckgen_clk topckgen
#define infracfg_ao_clk infracfg_ao
/* /home/dpi/qb5_8814/workspace/P4_1716/android/kernel/kmodule/ap/mtk/mt6769t/ap_mtk_mt6769t_T.a13ve_eur.00.dtsi */
#include "../../mediatek/k69v1_64_titan_bengal_tiger_k419/Board_00.dts"
#include "../../mediatek/k69v1_64_titan_bengal_tiger_k419/gpio00.dtsi"
