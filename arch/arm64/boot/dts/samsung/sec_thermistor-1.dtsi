&smd {
	sec_pa_thermistor: sec_thermistor@1 {
		compatible = "samsung,sec-thermistor";
		status = "okay";
		thermistor_name = "sec-pa-thermistor";
		id = <1>;

		io-channels = SEC_ADC(pm8150_vadc,77);
		io-channel-names = "pa_therm";
		io-channel-ranges;
	};
};

&pm8150_vadc {
	pa_therm {
		reg = SEC_ADC_NUM(pm8150_vadc,77);
		label = "pa_therm";
		qcom,ratiometric;
		qcom,hw-settle-time = <200>;
		qcom,pre-scaling = <1 1>;
		qcom,decimation = <840>;
		qcom,avg-samples = <8>;
	};
};

#if 0
&pm8150_vadc {
	pa_therm {
		/delete-property/ qcom,decimation;
		/delete-property/ qcom,avg-samples;

		/* Set calib type to ADC_SCALE_HW_CALIB_DEFAULT */
		qcom,scale-fn-type = <5>;
	};
};
#endif
