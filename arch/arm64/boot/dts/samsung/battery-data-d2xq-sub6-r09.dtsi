/* Copyright (c) 2014, The Linux Foundation. All rights reserved.
 *
 * This program is free software; you can redistribute it and/or modify
 * it under the terms of the GNU General Public License version 2 and
 * only version 2 as published by the Free Software Foundation.
 *
 * This program is distributed in the hope that it will be useful,
 * but WITHOUT ANY WARRANTY; without even the implied warranty of
 * MERCHANTABILITY or FITNESS FOR A PARTICULAR PURPOSE.  See the
 * GNU General Public License for more details.
 */

/* This dtsi is for hw rev 09 */
#include "battery-data-d2xq-sub6-common.dtsi"

&qupv3_se8_i2c {
	status = "okay";

	mfc-charger@3b {
		status = "disabled";
	};

	mfc-s2miw04-charger@3b {
			compatible = "lsi,mfc-s2miw04-charger";
			reg = <0x3b>;
			status = "okay";

			pinctrl-names = "default";
			pinctrl-0 = <&mfc_irq_default>;

			battery,wpc_int = <&tlmm 50 GPIO_ACTIVE_LOW>; /* MFC_AP_INT */
			battery,wpc_det = <&pm8150l_gpios 1 GPIO_ACTIVE_HIGH>; /* WPC_DET */
			battery,wpc_en = <&expander_gpios 3 0>; /* WPC_EN */
			battery,mst_pwr_en = <&expander_gpios 21 0>; /* MST_PWR_EN */
			battery,ping_nen = <&tlmm 174 GPIO_ACTIVE_LOW>; /* PING_nEN */
			battery,pdet_n = <&tlmm 124 GPIO_ACTIVE_LOW>; /* PDET_N */
			battery,vrect_int = <&pm8150_gpios 6 GPIO_ACTIVE_LOW>; /* VRECT_INT */

			battery,charger_name = "max77705-charger";
			battery,fuelgauge_name = "max77705-fuelgauge";
			battery,wireless_charger_name = "mfc-charger";
			battery,fod_data = <0x0C 0xA6 0x0C 0xA0 0x0C 0x8C 0x0C 0x8E 0x0C 0x91 0x0C 0x91 0x0C 0x91 0x0C 0x91 0x0C 0x91 0x0C 0x91>;
			battery,fod_data_cv = <0x0C 0xC4 0x0C 0xBE 0x0C 0xAA 0x0C 0xAC 0x0C 0xAF 0x0C 0xAF 0x0C 0xAF 0x0C 0xAF 0x0C 0xAF 0x0C 0xAF>;
			battery,fod_hero_5v_data = <0x0C 0xA6 0x0C 0xA0 0x0C 0x8C 0x0C 0x8E 0x0C 0x91 0x0C 0x91 0x0C 0x91 0x0C 0x91 0x0C 0x91 0x0C 0x91>;
			battery,fod_dream_data = <0x0C 0xA6 0x0C 0xA0 0x0C 0x8C 0x0C 0x8E 0x0C 0x91 0x0C 0x91 0x0C 0x91 0x0C 0x91 0x0C 0x91 0x0C 0x91>;
			battery,fod_dream_cv_data = <0x0C 0xA6 0x0C 0xA0 0x0C 0x8C 0x0C 0x8E 0x0C 0x91 0x0C 0x91 0x0C 0x91 0x0C 0x91 0x0C 0x91 0x0C 0x91>;
			battery,wc_cover_rpp = <0x44>;
			battery,wireless20_vout_list = <9 9 9>; /* WIRELESS_VOUT_11V, 11V, 11V */
			battery,wireless20_vrect_list = <10 11 11>; /* MFC_AFC_CONF_12V_TX, 12.5V, 12.5V */
			battery,wireless20_max_power_list = <2 3 3>; /* SEC_WIRELESS_RX_POWER_12W, 15W, 15W */
		};
};
