/* 
 * Generated by Samsung 
 * If these files should be changed, then please make a sync with MTK
*/

#include "mt6769t-a22_common.dtsi"
#include "display_lcd_a22_00.dtsi"
#include "mt6769t-a22_camera_00.dtsi"

&melfas_mip4_ts {
	status = "disabled";
};

/*End of this file, DO NOT ADD ANYTHING HERE*/
