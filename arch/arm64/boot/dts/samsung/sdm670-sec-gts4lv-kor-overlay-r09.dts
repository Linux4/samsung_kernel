/* Copyright (c) 2018, The Linux Foundation. All rights reserved.
 *
 * This program is free software; you can redistribute it and/or modify
 * it under the terms of the GNU General Public License version 2 and
 * only version 2 as published by the Free Software Foundation.
 *
 * This program is distributed in the hope that it will be useful,
 * but WITHOUT ANY WARRANTY; without even the implied warranty of
 * MERCHANTABILITY or FITNESS FOR A PARTICULAR PURPOSE.  See the
 * GNU General Public License for more details.
 */

/dts-v1/;
/plugin/;

#include <dt-bindings/clock/qcom,gcc-sdm845.h>
#include <dt-bindings/clock/qcom,camcc-sdm845.h>
#include <dt-bindings/clock/qcom,dispcc-sdm845.h>
#include <dt-bindings/clock/qcom,rpmh.h>
#include <dt-bindings/interrupt-controller/arm-gic.h>

#include "../qcom/sdm670-mtp.dtsi"
#include "sdm670-sec-common.dtsi"
#include "sdm670-sec-gts4lv-pm-common.dtsi"
#include "sdm670-sec-gts4lv-battery-common.dtsi"

#include "sdm670-sec-gts4lv-r09.dtsi"
#include "sdm670-sec-gts4lv-pinctrl-r09.dtsi"

#include "sdm670-sec-gts4lv-display-r09.dtsi"
#include "sdm670-sec-gts4lv-eif-r00.dtsi"
#include "sdm670-sec-gts4lv-displayport-r05.dtsi"
#include "sdm670-sec-gts4lv-camera-sensor-r00.dtsi"
#include "sdm670-sec-gts4lv-sensor-r00.dtsi"

/ {
	model = "Samsung GTS4LV KOR PROJECT (board-id,09)";
	compatible = "qcom,sdm670-mtp", "qcom,sdm670", "qcom,mtp";
	qcom,board-id = <8 9>;
	qcom,pmic-id = <0x0001001b 0x0101011a 0x0 0x0>,
		       <0x0001001b 0x0102001a 0x0 0x0>,
		       <0x0001001b 0x0201011a 0x0 0x0>;
};

