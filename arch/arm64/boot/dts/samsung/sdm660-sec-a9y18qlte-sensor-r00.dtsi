/*
 * Copyright (c) 2017, The Linux Foundation. All rights reserved.
 *
 * This program is free software; you can redistribute it and/or modify
 * it under the terms of the GNU General Public License version 2 and
 * only version 2 as published by the Free Software Foundation.
 *
 * This program is distributed in the hope that it will be useful,
 * but WITHOUT ANY WARRANTY; without even the implied warranty of
 * MERCHANTABILITY or FITNESS FOR A PARTICULAR PURPOSE.  See the
 * GNU General Public License for more details.
 */
 
&soc {
	qcom,lpass@15700000 {
		qcom,gpio-sensor-ldo = <&tlmm 113 0>;
		pinctrl-names = "default", "sleep", "idle";
		pinctrl-0 = <&sensor_ldo_default>;
		pinctrl-1 = <&sensor_ldo_active>;
		pinctrl-2 = <&sensor_ldo_active>;
	};
};
