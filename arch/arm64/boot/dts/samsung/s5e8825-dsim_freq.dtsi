/*
 * SAMSUNG Panel Device Tree Source
 *
 * Copyright (c) 2017 Samsung Electronics Co., Ltd.
 *		http://www.samsung.com
 *
 * This program is free software; you can redistribute it and/or modify
 * it under the terms of the GNU General Public License version 2 as
 * published by the Free Software Foundation.
 */

/ {
	fragment@dsim_freq {
		target-path = "/";
		__overlay__ {
			dsim_freq_1108: dsim_freq_1108 {
				hs-clk = <1108>;
				pmsk = <
					0x02 0xAA 0x02 0x7627
					0x0D 0x04 0x00 0x00
					0x00 0x00 0x00 0x00
					0x00 0x00>;
				cmd_underrun_lp_ref = <2107>;
			};

			dsim_freq_1124: dsim_freq_1124 {
				hs-clk = <1124>;
				pmsk = <
					0x02 0xAD 0x02 0x2C4F
					0x0D 0x04 0x00 0x00
					0x00 0x00 0x00 0x00
					0x00 0x00>;
				cmd_underrun_lp_ref = <2184>;
			};

			dsim_freq_1125: dsim_freq_1125 {
				hs-clk = <1125>;
				pmsk = <
					0x02 0xAD 0x02 0x13B1
					0x0D 0x04 0x00 0x00
					0x00 0x00 0x00 0x00
					0x00 0x00>;
				cmd_underrun_lp_ref = <2189>;
			};
		};
	};
};
