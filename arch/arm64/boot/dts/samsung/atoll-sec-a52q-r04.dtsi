/* Copyright (c) 2020, The Linux Foundation. All rights reserved.
 *
 * This program is free software; you can redistribute it and/or modify
 * it under the terms of the GNU General Public License version 2 and
 * only version 2 as published by the Free Software Foundation.
 *
 * This program is distributed in the hope that it will be useful,
 * but WITHOUT ANY WARRANTY; without even the implied warranty of
 * MERCHANTABILITY or FITNESS FOR A PARTICULAR PURPOSE.  See the
 * GNU General Public License for more details.
 */

#include "atoll-sec-a52q-r02.dtsi"
#include "atoll-sec-a52q-pinctrl-r04.dtsi"

&vibrator {
	/delete-property/ samsung,vib_en;
};

&tsp_zt {
	status = "disabled";
};

&tsp_stm {
	status = "okay";
};
