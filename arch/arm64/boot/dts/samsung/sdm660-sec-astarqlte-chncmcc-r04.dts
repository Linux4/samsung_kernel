/*
 * Copyright (c) 2017, The Linux Foundation. All rights reserved.
 *
 * This program is free software; you can redistribute it and/or modify
 * it under the terms of the GNU General Public License version 2 and
 * only version 2 as published by the Free Software Foundation.
 *
 * This program is distributed in the hope that it will be useful,
 * but WITHOUT ANY WARRANTY; without even the implied warranty of
 * MERCHANTABILITY or FITNESS FOR A PARTICULAR PURPOSE.  See the
 * GNU General Public License for more details.
 */


/dts-v1/;

#define SDM660_A_STARQLTE_REV04

#include "../qcom/sdm660.dtsi"
#include "../qcom/sdm660-mtp.dtsi"
#include "../qcom/msm-pm660a.dtsi"

#include "sdm660-sec-common.dtsi"
#include "sdm660-sec-astarqlte-audio.dtsi"
#include "sdm660-sec-astarqlte-chn-r04.dtsi"
#include "sdm660-sec-astarqlte-chn-pinctrl-r04.dtsi"
#include "sdm660-sec-astarqlte-display-r00.dtsi"
#include "sdm660-sec-astarqlte-battery-common.dtsi"
#include "sdm660-sec-astarqlte-muic-common.dtsi"
#include "sdm660-sec-astarqlte-chn-fingerprint-sensor_00.dtsi"
#include "sdm660-camera-sensor-astarqlte_chn-r04.dtsi"
#include "../../../../drivers/leds/tuning/astarqlte_led_tuning.dtsi"

/ {
	model = "Samsung A-STARQLTE CHNCMCC PROJECT Rev03 (board-id,04)";
	compatible = "qcom,sdm660-mtp", "qcom,sdm660", "qcom,mtp";
	qcom,board-id = <8 4>;
};

&soc {
	i2c_26: i2c@26 {
		sm5705_fled {
			compatible = "siliconmitus,sm5705-fled";
			enable = <1 1>;
			id= <0>;
			status = "okay";
			flash-mode-current-mA = <1000>;
			torch-mode-current-mA = <150>;
			preflash-mode-current-mA = <150>;
			used-gpio-control = <1>;
			flash-en-gpio = <&tlmm 60 0x00>;
			torch-en-gpio = <&tlmm 41 0x00>;
		};
	};
};
