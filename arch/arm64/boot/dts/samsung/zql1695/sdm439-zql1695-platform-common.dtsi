/* Overlay DT source file for QRD board. All DTSI files included by this file must not contain any SOC-specific bindings.
 */
/*HS60 code for HS60-19 by wangqilin at 2019/07/12 start*/
#include "drivers/display/sdm439-zql1695-display.dtsi"
/*HS60 code for HS60-19 by wangqilin at 2019/07/12 end*/
/*HS60 code for SR-ZQL1695-01000000493 by zhanghao6 at 20190715 start*/
#include "sdm439-zql169x-swtp.dtsi"
/*HS60 code for SR-ZQL1695-01000000493 by zhanghao6 at 20190715 end*/
/* huaqin add for HS60-21 bringup TP function by liufurong at 2019/07/12 start */
#include "zql1695-tp.dtsi"
/* huaqin add for HS60-21 bringup TP function by liufurong at 2019/07/12 end */
/* huaqin add for HS60-68 by liufurong at 2019/07/16 start */
#include "zql1695-key.dtsi"
/* huaqin add for HS60-68 by liufurong at 2019/07/16 end */
/* Huaqin add for HS60-37 Configure battery NTC for charging by gaochao at 2019/07/11 start */
#include "battery-common.dtsi"
/* Huaqin add for HS60-37 Configure battery NTC for charging by gaochao at 2019/07/11 end */
/* Huaqin modify for ZQL1695/HS60-138 modify usb eye diagram by wenyaqi at 2019/7/19 start */
#include "zql169x-usb-eye-diagram.dtsi"
/* Huaqin modify for ZQL1695/HS60-138 modify usb eye diagram by wenyaqi at 2019/7/19 end */

/* HS60 add for HS60-163 Set usb thermal by gaochao at 2019/07/30 start */
#include "usb-thermal-common.dtsi"
/* HS60 add for HS60-163 Set usb thermal by gaochao at 2019/07/30 end */
/* HS60 add for HS60-341 Configure charge-thermal and MSM-thermal NTC by gaochao at 2019/08/05 start */
#include "thermal_zones-common.dtsi"
/* HS60 add for HS60-341 Configure charge-thermal and MSM-thermal NTC by gaochao at 2019/08/05 end */

/* huaqin add for HS60-25 bringup headphone function by xudayi at 2019/07/11 start */
#include "audio-common.dtsi"
/* huaqin add for HS60-25 bringup headphone function by xudayi at 2019/07/11 end */

/* huaqin rm for AR-ZQL1695-01-505 remove tps61280 by limengxia at 2019/11/12 start */
/* #include "zql1695-tps61280.dtsi" */
/* huaqin rm for AR-ZQL1695-01-505 remove tps61280 by limengxia at 2019/11/12 end */

/*HS60 code for HS60-32/HS60-93 by zhuqiang at 2019/7/15 start*/
#include "sdm439-sar-sensors.dtsi"
/*HS60 code for HS60-32/HS60-93 by zhuqiang at 2019/7/15 end*/

/* samsung qc-bsp start */
#include "sdm439-zql1695-sec-bsp.dtsi"
/* samsung qc-bsp end */

/* samsung abc start */
#include "abc_common.dtsi"
/* samsung abc end */

/* samsung qc-pm start */
#include "sdm439-sec-pm.dtsi"
/* samsung qc-pm end */