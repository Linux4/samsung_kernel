&usb_otg {
	/* HS60 modify for ZQL1695/HS60-138 modify usb eye diagram by wenyaqi at 2019/7/19 start */
	/* HS60 modify for ZQL1695/HS60-138 optimize usb eye diagram by wenyaqi at 2019/7/25 start */
	/* HS60 modify for HS60-3738 optimize usb eye diagram by wangzikang at 2019/11/07 start */
	//Only work at ZQL1695
	qcom,hsusb-otg-phy-init-seq = <0x7d 0x80 0x26 0x81 0x37 0x82 0x33 0x83 0xffffffff>;
	/* HS60 modify for HS60-3738 optimize usb eye diagram by wangzikang at 2019/11/07 end */
	/* HS60 modify for ZQL1695/HS60-138 optimize usb eye diagram by wenyaqi at 2019/7/25 end */
	/* HS60 modify for ZQL1695/HS60-138 modify usb eye diagram by wenyaqi at 2019/7/19 end */
};
