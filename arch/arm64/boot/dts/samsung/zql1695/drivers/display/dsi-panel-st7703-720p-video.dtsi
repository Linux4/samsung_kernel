/* Copyright (c) 2013, The Linux Foundation. All rights reserved.
 *
 * This program is free software; you can redistribute it and/or modify
 * it under the terms of the GNU General Public License version 2 and
 * only version 2 as published by the Free Software Foundation.
 *
 * This program is distributed in the hope that it will be useful,
 * but WITHOUT ANY WARRANTY; without even the implied warranty of
 * MERCHANTABILITY or FITNESS FOR A PARTICULAR PURPOSE.  See the
 * GNU General Public License for more details.
 */

/*---------------------------------------------------------------------------
 * This file is autogenerated file using gcdb parser. Please do not edit it.
 * Update input XML file to add a new entry or update variable in this file
 * VERSION = "1.0"
 *---------------------------------------------------------------------------*/
&mdss_mdp {
	dsi_st7703_720p_video: qcom,mdss_dsi_st7703_720p_video {
		qcom,mdss-dsi-panel-name = "st7703 720p video mode dsi panel";
		qcom,mdss-dsi-panel-controller = <&mdss_dsi0>;
		qcom,mdss-dsi-panel-type = "dsi_video_mode";
		qcom,mdss-dsi-panel-destination = "display_1";
		qcom,mdss-dsi-panel-framerate = <60>;
		qcom,mdss-dsi-virtual-channel-id = <0>;
		qcom,mdss-dsi-stream = <0>;
		qcom,mdss-dsi-panel-width = <720>;
		qcom,mdss-dsi-panel-height = <1520>;
		qcom,mdss-dsi-h-front-porch = <78>;
		qcom,mdss-dsi-h-back-porch = <70>;
		qcom,mdss-dsi-h-pulse-width = <30>;
		qcom,mdss-dsi-h-sync-skew = <0>;
		qcom,mdss-dsi-v-back-porch = <11>;
		qcom,mdss-dsi-v-front-porch = <17>;
		qcom,mdss-dsi-v-pulse-width = <4>;
		qcom,mdss-dsi-h-left-border = <0>;
		qcom,mdss-dsi-h-right-border = <0>;
		qcom,mdss-dsi-v-top-border = <0>;
		qcom,mdss-dsi-v-bottom-border = <0>;
		qcom,mdss-dsi-bpp = <24>;
		qcom,mdss-dsi-color-order = "rgb_swap_rgb";
		qcom,mdss-dsi-underflow-color = <0xff>;
		qcom,mdss-dsi-border-color = <0>;
		qcom,mdss-dsi-on-command = [29 01 00 00 00 00 04 B9 F1 12 83
				29 01 00 00 00 00 02 B8 75
				29 01 00 00 00 00 1C BA 32 81 05 F9 0E 0E 20 00 00 00 00 00 00 00 44 25 00 90 0A 00 00 00 4F D1 03 02 37
				29 01 00 00 00 00 04 BF 02 10 00
				29 01 00 00 00 00 0B B3 07 0B 28 28 03 FF 00 00 00 00
				29 01 00 00 00 00 0A C0 73 73 50 50 A0 00 08 70 00
				29 01 00 00 00 00 02 BC 46
				29 01 00 00 00 00 02 CC 0B
				29 01 00 00 00 00 02 B4 80
				29 01 00 00 00 00 02 B1 85
				29 01 00 00 00 00 04 B2 04 12 F0
				29 01 00 00 00 00 0F E3 07 07 0B 0B 07 0B 00 00 00 00 28 80 C0 17
				29 01 00 00 00 00 0D C1 53 80 32 32 99 F1 FF FF EC EC 7F 7F
				29 01 00 00 00 00 07 C6 01 40 FF DF 00 20
				29 01 00 00 00 00 03 B5 09 09
				29 01 00 00 00 00 03 B6 5B 5B
				29 01 00 00 00 00 40 E9 C2 10 05 05 FD 80 32 12 31 23 47 82 80 32 47 00 00 81 00 00 00 00 00 81 00 00 00 00 F8 AB 02 46 08 88 88 84 88 88 88 F8 AB 13 57 18 88 88 85 88 88 88 00 00 00 00 00 00 00 00 00 00 00 00 00
				29 01 00 00 00 00 3E EA 96 12 01 01 00 3D 00 00 00 00 00 00 8F AB 75 31 58 88 88 81 88 88 88 8F AB 64 20 48 88 88 80 88 88 88 23 14 00 01 08 00 00 00 00 00 00 00 00 00 00 00 00 00 00 00 40 80 32 00 00 00 00
				29 01 00 00 00 00 23 E0 00 10 1C 29 3B 3F 4D 3F 06 0C 0E 12 13 11 13 12 18 00 10 1C 29 3B 3F 4D 3F 06 0C 0E 12 13 11 13 12 18
				05 01 00 00 78 00 02 11 00
				05 01 00 00 14 00 02 29 00];
		qcom,mdss-dsi-off-command = [05 01 00 00 32 00 02 28 00
					05 01 00 00 78 00 02 10 00];
		qcom,mdss-dsi-on-command-state = "dsi_lp_mode";
		qcom,mdss-dsi-off-command-state = "dsi_hs_mode";
		qcom,mdss-dsi-h-sync-pulse = <1>;
		qcom,mdss-dsi-traffic-mode = "burst_mode";
		qcom,mdss-dsi-lane-map = "lane_map_0123";
		qcom,mdss-dsi-bllp-eof-power-mode;
		qcom,mdss-dsi-bllp-power-mode;
		qcom,mdss-dsi-lane-0-state;
		qcom,mdss-dsi-lane-1-state;
		qcom,mdss-dsi-lane-2-state;
		/delete-property/ qcom,mdss-dsi-panel-timings;
		qcom,mdss-dsi-panel-timings-phy-12nm = [
					0F 08 0C 04 00 06 04 0B];
		qcom,mdss-dsi-t-clk-post = <0x0c>;
		//qcom,mdss-dsi-t-clk-pre = <0x27>;
		qcom,mdss-dsi-bl-min-level = <1>;
		qcom,mdss-dsi-bl-max-level = <4095>;
		qcom,mdss-dsi-dma-trigger = "trigger_sw";
		qcom,mdss-dsi-mdp-trigger = "none";
		qcom,mdss-dsi-bl-pmic-control-type = "bl_ctrl_pwm";
		qcom,mdss-dsi-bl-pmic-pwm-frequency = <100>;
		qcom,mdss-dsi-bl-pmic-bank-select = <0>;
		qcom,mdss-dsi-pwm-gpio = <&pm8953_gpios 8 0>;
		qcom,panel-supply-entries = <&dsi_panel_pwr_supply>;
		qcom,mdss-dsi-reset-sequence = <1 20>, <0 2>, <1 20>;
		/*HS60 code for HS60-248 by sunguoqing at 2019/07/29 start*/
		qcom,mdss-dsi-lp11-init;
		/*HS60 code for HS60-248 by sunguoqing at 2019/07/29 end*/
	};
};
