/* Copyright (c) 2013, The Linux Foundation. All rights reserved.
 *
 * This program is free software; you can redistribute it and/or modify
 * it under the terms of the GNU General Public License version 2 and
 * only version 2 as published by the Free Software Foundation.
 *
 * This program is distributed in the hope that it will be useful,
 * but WITHOUT ANY WARRANTY; without even the implied warranty of
 * MERCHANTABILITY or FITNESS FOR A PARTICULAR PURPOSE.  See the
 * GNU General Public License for more details.
 */

/*---------------------------------------------------------------------------
 * This file is autogenerated file using gcdb parser. Please do not edit it.
 * Update input XML file to add a new entry or update variable in this file
 * VERSION = "1.0"
 *---------------------------------------------------------------------------*/
&mdss_mdp {
	dsi_jdd_hsd_ili9881c_70h_720p_video: qcom,mdss_dsi_jdd_hsd_ili9881c_70h_720p_video {
		qcom,mdss-dsi-panel-name = "jdd hsd ili9881c 70h 720p video mode dsi panel";
		qcom,mdss-dsi-panel-controller = <&mdss_dsi0>;
		qcom,mdss-dsi-panel-type = "dsi_video_mode";
		qcom,mdss-dsi-panel-destination = "display_1";
		qcom,mdss-dsi-panel-framerate = <60>;
		qcom,mdss-dsi-virtual-channel-id = <0>;
		qcom,mdss-dsi-stream = <0>;
		qcom,mdss-dsi-panel-width = <720>;
		qcom,mdss-dsi-panel-height = <1520>;
		qcom,mdss-dsi-h-front-porch = <80>;
		qcom,mdss-dsi-h-back-porch = <80>;
		qcom,mdss-dsi-h-pulse-width = <60>;
		qcom,mdss-dsi-h-sync-skew = <0>;
		qcom,mdss-dsi-v-back-porch = <24>;
		qcom,mdss-dsi-v-front-porch = <24>;
		qcom,mdss-dsi-v-pulse-width = <2>;
		qcom,mdss-dsi-h-left-border = <0>;
		qcom,mdss-dsi-h-right-border = <0>;
		qcom,mdss-dsi-v-top-border = <0>;
		qcom,mdss-dsi-v-bottom-border = <0>;
		qcom,mdss-dsi-bpp = <24>;
		qcom,mdss-dsi-color-order = "rgb_swap_rgb";
		qcom,mdss-dsi-underflow-color = <0xff>;
		qcom,mdss-dsi-border-color = <0>;
		qcom,mdss-dsi-on-command = [39 01 00 00 00 00 04 FF 98 81 03
			15 01 00 00 00 00 02 01 00
			15 01 00 00 00 00 02 02 00
			15 01 00 00 00 00 02 03 53
			15 01 00 00 00 00 02 04 13
			15 01 00 00 00 00 02 05 00
			15 01 00 00 00 00 02 06 04
			15 01 00 00 00 00 02 07 00
			15 01 00 00 00 00 02 08 00
			15 01 00 00 00 00 02 09 23
			15 01 00 00 00 00 02 0A 23
			15 01 00 00 00 00 02 0B 00
			15 01 00 00 00 00 02 0C 00
			15 01 00 00 00 00 02 0D 00
			15 01 00 00 00 00 02 0E 00
			15 01 00 00 00 00 02 0F 23
			15 01 00 00 00 00 02 10 23
			15 01 00 00 00 00 02 11 00
			15 01 00 00 00 00 02 12 00
			15 01 00 00 00 00 02 13 00
			15 01 00 00 00 00 02 14 00
			15 01 00 00 00 00 02 15 04
			15 01 00 00 00 00 02 16 04
			15 01 00 00 00 00 02 17 00
			15 01 00 00 00 00 02 18 00
			15 01 00 00 00 00 02 19 00
			15 01 00 00 00 00 02 1A 00
			15 01 00 00 00 00 02 1B 00
			15 01 00 00 00 00 02 1C 00
			15 01 00 00 00 00 02 1D 00
			15 01 00 00 00 00 02 1E 44
			15 01 00 00 00 00 02 1F 80
			15 01 00 00 00 00 02 20 02
			15 01 00 00 00 00 02 21 03
			15 01 00 00 00 00 02 22 00
			15 01 00 00 00 00 02 23 00
			15 01 00 00 00 00 02 24 00
			15 01 00 00 00 00 02 25 00
			15 01 00 00 00 00 02 26 00
			15 01 00 00 00 00 02 27 00
			15 01 00 00 00 00 02 28 33
			15 01 00 00 00 00 02 29 33
			15 01 00 00 00 00 02 2A 00
			15 01 00 00 00 00 02 2B 00
			15 01 00 00 00 00 02 2C 00
			15 01 00 00 00 00 02 2D 00
			15 01 00 00 00 00 02 2E 00
			15 01 00 00 00 00 02 2F 00
			15 01 00 00 00 00 02 30 00
			15 01 00 00 00 00 02 31 00
			15 01 00 00 00 00 02 32 00
			15 01 00 00 00 00 02 33 00
			15 01 00 00 00 00 02 34 04
			15 01 00 00 00 00 02 35 00
			15 01 00 00 00 00 02 36 00
			15 01 00 00 00 00 02 37 00
			15 01 00 00 00 00 02 38 3C
			15 01 00 00 00 00 02 39 00
			15 01 00 00 00 00 02 3A 00
			15 01 00 00 00 00 02 3B 00
			15 01 00 00 00 00 02 3C 00
			15 01 00 00 00 00 02 3D 00
			15 01 00 00 00 00 02 3E 00
			15 01 00 00 00 00 02 3F 00
			15 01 00 00 00 00 02 40 00
			15 01 00 00 00 00 02 41 00
			15 01 00 00 00 00 02 42 00
			15 01 00 00 00 00 02 43 00
			15 01 00 00 00 00 02 44 00
			15 01 00 00 00 00 02 50 01
			15 01 00 00 00 00 02 51 23
			15 01 00 00 00 00 02 52 45
			15 01 00 00 00 00 02 53 67
			15 01 00 00 00 00 02 54 89
			15 01 00 00 00 00 02 55 AB
			15 01 00 00 00 00 02 56 01
			15 01 00 00 00 00 02 57 23
			15 01 00 00 00 00 02 58 45
			15 01 00 00 00 00 02 59 67
			15 01 00 00 00 00 02 5A 89
			15 01 00 00 00 00 02 5B AB
			15 01 00 00 00 00 02 5C CD
			15 01 00 00 00 00 02 5D EF
			15 01 00 00 00 00 02 5E 11
			15 01 00 00 00 00 02 5F 01
			15 01 00 00 00 00 02 60 00
			15 01 00 00 00 00 02 61 14
			15 01 00 00 00 00 02 62 15
			15 01 00 00 00 00 02 63 0C
			15 01 00 00 00 00 02 64 0D
			15 01 00 00 00 00 02 65 0E
			15 01 00 00 00 00 02 66 0F
			15 01 00 00 00 00 02 67 06
			15 01 00 00 00 00 02 68 02
			15 01 00 00 00 00 02 69 02
			15 01 00 00 00 00 02 6A 02
			15 01 00 00 00 00 02 6B 02
			15 01 00 00 00 00 02 6C 02
			15 01 00 00 00 00 02 6D 02
			15 01 00 00 00 00 02 6E 08
			15 01 00 00 00 00 02 6F 02
			15 01 00 00 00 00 02 70 02
			15 01 00 00 00 00 02 71 02
			15 01 00 00 00 00 02 72 02
			15 01 00 00 00 00 02 73 02
			15 01 00 00 00 00 02 74 02
			15 01 00 00 00 00 02 75 01
			15 01 00 00 00 00 02 76 00
			15 01 00 00 00 00 02 77 14
			15 01 00 00 00 00 02 78 15
			15 01 00 00 00 00 02 79 0C
			15 01 00 00 00 00 02 7A 0D
			15 01 00 00 00 00 02 7B 0E
			15 01 00 00 00 00 02 7C 0F
			15 01 00 00 00 00 02 7D 08
			15 01 00 00 00 00 02 7E 02
			15 01 00 00 00 00 02 7F 02
			15 01 00 00 00 00 02 80 02
			15 01 00 00 00 00 02 81 02
			15 01 00 00 00 00 02 82 02
			15 01 00 00 00 00 02 83 02
			15 01 00 00 00 00 02 84 06
			15 01 00 00 00 00 02 85 02
			15 01 00 00 00 00 02 86 02
			15 01 00 00 00 00 02 87 02
			15 01 00 00 00 00 02 88 02
			15 01 00 00 00 00 02 89 02
			15 01 00 00 00 00 02 8A 02
			39 01 00 00 00 00 04 FF 98 81 04
			15 01 00 00 00 00 02 00 00
			15 01 00 00 00 00 02 6C 15
			15 01 00 00 00 00 02 6E 2A
			15 01 00 00 00 00 02 6F 33
			15 01 00 00 00 00 02 3A A4
			15 01 00 00 00 00 02 8D 14
			15 01 00 00 00 00 02 87 BA
			15 01 00 00 00 00 02 3B 98
			15 01 00 00 00 00 02 35 17
			15 01 00 00 00 00 02 38 01
			15 01 00 00 00 00 02 39 00
			39 01 00 00 00 00 04 FF 98 81 01
			15 01 00 00 00 00 02 22 0A
			15 01 00 00 00 00 02 31 00
			15 01 00 00 00 00 02 53 5B
			15 01 00 00 00 00 02 50 E9
			15 01 00 00 00 00 02 51 E5
			15 01 00 00 00 00 02 60 26
			15 01 00 00 00 00 02 63 00
			15 01 00 00 00 00 02 2E 04
			15 01 00 00 00 00 02 2F 80
			15 01 00 00 00 00 02 A0 08
			15 01 00 00 00 00 02 A1 2D
			15 01 00 00 00 00 02 A2 40
			15 01 00 00 00 00 02 A3 17
			15 01 00 00 00 00 02 A4 1E
			15 01 00 00 00 00 02 A5 33
			15 01 00 00 00 00 02 A6 28
			15 01 00 00 00 00 02 A7 27
			15 01 00 00 00 00 02 A8 B6
			15 01 00 00 00 00 02 A9 1D
			15 01 00 00 00 00 02 AA 29
			15 01 00 00 00 00 02 AB 8D
			15 01 00 00 00 00 02 AC 23
			15 01 00 00 00 00 02 AD 20
			15 01 00 00 00 00 02 AE 52
			15 01 00 00 00 00 02 AF 26
			15 01 00 00 00 00 02 B0 2B
			15 01 00 00 00 00 02 B1 52
			15 01 00 00 00 00 02 B2 60
			15 01 00 00 00 00 02 B3 39
			15 01 00 00 00 00 02 C0 08
			15 01 00 00 00 00 02 C1 2D
			15 01 00 00 00 00 02 C2 40
			15 01 00 00 00 00 02 C3 17
			15 01 00 00 00 00 02 C4 1E
			15 01 00 00 00 00 02 C5 33
			15 01 00 00 00 00 02 C6 28
			15 01 00 00 00 00 02 C7 27
			15 01 00 00 00 00 02 C8 B6
			15 01 00 00 00 00 02 C9 1D
			15 01 00 00 00 00 02 CA 29
			15 01 00 00 00 00 02 CB 8D
			15 01 00 00 00 00 02 CC 23
			15 01 00 00 00 00 02 CD 20
			15 01 00 00 00 00 02 CE 52
			15 01 00 00 00 00 02 CF 26
			15 01 00 00 00 00 02 D0 2B
			15 01 00 00 00 00 02 D1 52
			15 01 00 00 00 00 02 D2 60
			15 01 00 00 00 00 02 D3 39
			39 01 00 00 00 00 04 FF 98 81 00
			39 01 00 00 78 00 02 11 00
			39 01 00 00 14 00 02 29 00
			15 01 00 00 00 00 02 35 00];
		qcom,mdss-dsi-off-command = [
		39 01 00 00 00 00 04 FF 98 81 00
		05 01 00 00 14 00 02 28 00
		05 01 00 00 78 00 02 10 00];
		qcom,mdss-dsi-on-command-state = "dsi_lp_mode";
		qcom,mdss-dsi-off-command-state = "dsi_lp_mode";
		qcom,mdss-dsi-h-sync-pulse = <1>;
		qcom,mdss-dsi-traffic-mode = "burst_mode";
		qcom,mdss-dsi-lane-map = "lane_map_0123";
		qcom,mdss-dsi-bllp-eof-power-mode;
		qcom,mdss-dsi-bllp-power-mode;
		qcom,mdss-dsi-lane-0-state;
		qcom,mdss-dsi-lane-1-state;
		qcom,mdss-dsi-lane-2-state;
		/delete-property/ qcom,mdss-dsi-panel-timings;
		qcom,mdss-dsi-panel-timings-phy-12nm = [
					10 08 0D 04 00 07 04 0B];
		qcom,mdss-dsi-t-clk-post = <0x0d>;
		//qcom,mdss-dsi-t-clk-pre = <0x27>;
		qcom,mdss-dsi-bl-min-level = <1>;
		qcom,mdss-dsi-bl-max-level = <4095>;
		qcom,esd-check-enabled;
		qcom,mdss-dsi-panel-status-command      = [06 01 00 01 05 00 01 09];
		qcom,mdss-dsi-panel-status-command-mode = "dsi_lp_mode";
		qcom,mdss-dsi-panel-status-check-mode   = "reg_read";
		qcom,mdss-dsi-panel-status-read-length  = <3>;
		qcom,mdss-dsi-panel-status-valid-params = <3>;
		qcom,mdss-dsi-panel-status-value        = <0x80 0x03 0x06>;
		qcom,mdss-dsi-panel-max-error-count     = <3>;
		qcom,mdss-dsi-dma-trigger = "trigger_sw";
		qcom,mdss-dsi-mdp-trigger = "none";
		qcom,mdss-dsi-bl-pmic-control-type = "bl_ctrl_pwm";
		qcom,mdss-dsi-bl-pmic-pwm-frequency = <100>;
		qcom,mdss-dsi-bl-pmic-bank-select = <0>;
		qcom,mdss-dsi-pwm-gpio = <&pm8953_gpios 8 0>;
		qcom,panel-supply-entries = <&dsi_panel_pwr_supply>;
		qcom,mdss-dsi-reset-sequence = <1 5>, <0 1>, <1 12>;
		/*HS60 code for HS60-248 by sunguoqing at 2019/07/29 start*/
		qcom,mdss-dsi-lp11-init;
		/*HS60 code for HS60-248 by sunguoqing at 2019/07/29 end*/
	};
};
