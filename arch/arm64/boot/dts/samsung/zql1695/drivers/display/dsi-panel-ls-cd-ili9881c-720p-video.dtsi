/* Copyright (c) 2013, The Linux Foundation. All rights reserved.
 *
 * This program is free software; you can redistribute it and/or modify
 * it under the terms of the GNU General Public License version 2 and
 * only version 2 as published by the Free Software Foundation.
 *
 * This program is distributed in the hope that it will be useful,
 * but WITHOUT ANY WARRANTY; without even the implied warranty of
 * MERCHANTABILITY or FITNESS FOR A PARTICULAR PURPOSE.  See the
 * GNU General Public License for more details.
 */

/*---------------------------------------------------------------------------
 * This file is autogenerated file using gcdb parser. Please do not edit it.
 * Update input XML file to add a new entry or update variable in this file
 * VERSION = "1.0"
 *---------------------------------------------------------------------------*/
&mdss_mdp {
	dsi_ls_cd_ili9881c_720p_video: qcom,mdss_dsi_ls_cd_ili9881c_720p_video {
		qcom,mdss-dsi-panel-name = "ls cd ili9881c 720p video mode dsi panel";
		qcom,mdss-dsi-panel-controller = <&mdss_dsi0>;
		qcom,mdss-dsi-panel-type = "dsi_video_mode";
		qcom,mdss-dsi-panel-destination = "display_1";
		qcom,mdss-dsi-panel-framerate = <60>;
		qcom,mdss-dsi-virtual-channel-id = <0>;
		qcom,mdss-dsi-stream = <0>;
		qcom,mdss-dsi-panel-width = <720>;
		qcom,mdss-dsi-panel-height = <1520>;
		qcom,mdss-dsi-h-front-porch = <84>;
		qcom,mdss-dsi-h-back-porch = <80>;
		qcom,mdss-dsi-h-pulse-width = <8>;
		qcom,mdss-dsi-h-sync-skew = <0>;
		qcom,mdss-dsi-v-back-porch = <16>;
		qcom,mdss-dsi-v-front-porch = <20>;
		qcom,mdss-dsi-v-pulse-width = <8>;
		qcom,mdss-dsi-h-left-border = <0>;
		qcom,mdss-dsi-h-right-border = <0>;
		qcom,mdss-dsi-v-top-border = <0>;
		qcom,mdss-dsi-v-bottom-border = <0>;
		qcom,mdss-dsi-bpp = <24>;
		qcom,mdss-dsi-color-order = "rgb_swap_rgb";
		qcom,mdss-dsi-underflow-color = <0xff>;
		qcom,mdss-dsi-border-color = <0>;
		qcom,mdss-dsi-on-command = [39 01 00 00 00 00 04 FF 98 81 03
			15 01 00 00 00 00 02 01 00
			15 01 00 00 00 00 02 02 00
			15 01 00 00 00 00 02 03 53
			15 01 00 00 00 00 02 04 53
			15 01 00 00 00 00 02 05 13
			15 01 00 00 00 00 02 06 04
			15 01 00 00 00 00 02 07 02
			15 01 00 00 00 00 02 08 02
			15 01 00 00 00 00 02 09 00
			15 01 00 00 00 00 02 0a 00
			15 01 00 00 00 00 02 0b 00
			15 01 00 00 00 00 02 0c 00
			15 01 00 00 00 00 02 0d 00
			15 01 00 00 00 00 02 0e 00
			15 01 00 00 00 00 02 0f 00
			15 01 00 00 00 00 02 10 00
			15 01 00 00 00 00 02 11 00
			15 01 00 00 00 00 02 12 00
			15 01 00 00 00 00 02 13 00
			15 01 00 00 00 00 02 14 00
			15 01 00 00 00 00 02 15 09
			15 01 00 00 00 00 02 16 09
			15 01 00 00 00 00 02 17 09
			15 01 00 00 00 00 02 18 00
			15 01 00 00 00 00 02 19 00
			15 01 00 00 00 00 02 1a 00
			15 01 00 00 00 00 02 1b 00
			15 01 00 00 00 00 02 1c 00
			15 01 00 00 00 00 02 1d 00
			15 01 00 00 00 00 02 1e C0
			15 01 00 00 00 00 02 1f 80
			15 01 00 00 00 00 02 20 02
			15 01 00 00 00 00 02 21 09
			15 01 00 00 00 00 02 22 00
			15 01 00 00 00 00 02 23 00
			15 01 00 00 00 00 02 24 00
			15 01 00 00 00 00 02 25 00
			15 01 00 00 00 00 02 26 00
			15 01 00 00 00 00 02 27 00
			15 01 00 00 00 00 02 28 55
			15 01 00 00 00 00 02 29 03
			15 01 00 00 00 00 02 2a 00
			15 01 00 00 00 00 02 2b 00
			15 01 00 00 00 00 02 2c 00
			15 01 00 00 00 00 02 2d 00
			15 01 00 00 00 00 02 2e 00
			15 01 00 00 00 00 02 2f 00
			15 01 00 00 00 00 02 30 00
			15 01 00 00 00 00 02 31 00
			15 01 00 00 00 00 02 32 00
			15 01 00 00 00 00 02 33 00
			15 01 00 00 00 00 02 34 03
			15 01 00 00 00 00 02 35 00
			15 01 00 00 00 00 02 36 05
			15 01 00 00 00 00 02 37 00
			15 01 00 00 00 00 02 38 3C
			15 01 00 00 00 00 02 39 00
			15 01 00 00 00 00 02 3a 00
			15 01 00 00 00 00 02 3b 00
			15 01 00 00 00 00 02 3c 00
			15 01 00 00 00 00 02 3d 00
			15 01 00 00 00 00 02 3e 00
			15 01 00 00 00 00 02 3f 00
			15 01 00 00 00 00 02 40 00
			15 01 00 00 00 00 02 41 00
			15 01 00 00 00 00 02 42 00
			15 01 00 00 00 00 02 43 00
			15 01 00 00 00 00 02 44 00
			15 01 00 00 00 00 02 50 01
			15 01 00 00 00 00 02 51 23
			15 01 00 00 00 00 02 52 45
			15 01 00 00 00 00 02 53 67
			15 01 00 00 00 00 02 54 89
			15 01 00 00 00 00 02 55 ab
			15 01 00 00 00 00 02 56 01
			15 01 00 00 00 00 02 57 23
			15 01 00 00 00 00 02 58 45
			15 01 00 00 00 00 02 59 67
			15 01 00 00 00 00 02 5a 89
			15 01 00 00 00 00 02 5b ab
			15 01 00 00 00 00 02 5c cd
			15 01 00 00 00 00 02 5d ef
			15 01 00 00 00 00 02 5e 01
			15 01 00 00 00 00 02 5f 02
			15 01 00 00 00 00 02 60 02
			15 01 00 00 00 00 02 61 0A
			15 01 00 00 00 00 02 62 08
			15 01 00 00 00 00 02 63 14
			15 01 00 00 00 00 02 64 15
			15 01 00 00 00 00 02 65 0C
			15 01 00 00 00 00 02 66 0D
			15 01 00 00 00 00 02 67 0E
			15 01 00 00 00 00 02 68 0F
			15 01 00 00 00 00 02 69 10
			15 01 00 00 00 00 02 6a 11
			15 01 00 00 00 00 02 6b 06
			15 01 00 00 00 00 02 6c 02
			15 01 00 00 00 00 02 6d 02
			15 01 00 00 00 00 02 6e 02
			15 01 00 00 00 00 02 6f 02
			15 01 00 00 00 00 02 70 02
			15 01 00 00 00 00 02 71 02
			15 01 00 00 00 00 02 72 00
			15 01 00 00 00 00 02 73 02
			15 01 00 00 00 00 02 74 02
			15 01 00 00 00 00 02 75 02
			15 01 00 00 00 00 02 76 02
			15 01 00 00 00 00 02 77 0A
			15 01 00 00 00 00 02 78 06
			15 01 00 00 00 00 02 79 14
			15 01 00 00 00 00 02 7a 15
			15 01 00 00 00 00 02 7b 0F
			15 01 00 00 00 00 02 7c 0E
			15 01 00 00 00 00 02 7d 0D
			15 01 00 00 00 00 02 7e 0C
			15 01 00 00 00 00 02 7f 11
			15 01 00 00 00 00 02 80 10
			15 01 00 00 00 00 02 81 08
			15 01 00 00 00 00 02 82 02
			15 01 00 00 00 00 02 83 02
			15 01 00 00 00 00 02 84 02
			15 01 00 00 00 00 02 85 02
			15 01 00 00 00 00 02 86 02
			15 01 00 00 00 00 02 87 02
			15 01 00 00 00 00 02 88 02
			15 01 00 00 00 00 02 89 02
			15 01 00 00 00 00 02 8A 02
			39 01 00 00 00 00 04 FF 98 81 04
			15 01 00 00 00 00 02 6C 15
			15 01 00 00 00 00 02 6E 24
			15 01 00 00 00 00 02 6F 25
			15 01 00 00 00 00 02 3A 24
			15 01 00 00 00 00 02 8D 2A
			15 01 00 00 00 00 02 87 BA
			15 01 00 00 00 00 02 26 76
			15 01 00 00 00 00 02 B2 D1
			15 01 00 00 00 00 02 88 0B
			15 01 00 00 00 00 02 33 14
			15 01 00 00 00 00 02 35 1F
			15 01 00 00 00 00 02 38 01
			15 01 00 00 00 00 02 39 00
			15 01 00 00 00 00 02 7A 0F
			15 01 00 00 00 00 02 B5 06
			15 01 00 00 00 00 02 31 75
			15 01 00 00 00 00 02 3B 85
			15 01 00 00 00 00 02 00 02
			//power on speed up start
			29 01 00 00 00 00 02 4C 02
			29 01 00 00 00 00 02 52 37
			29 01 00 00 00 00 02 53 37
			29 01 00 00 00 00 02 54 46
			//power on speed up end
			39 01 00 00 00 00 04 FF 98 81 01
			15 01 00 00 00 00 02 22 0A
			15 01 00 00 00 00 02 31 00
			15 01 00 00 00 00 02 50 E0
			15 01 00 00 00 00 02 51 DB
			15 01 00 00 00 00 02 60 28
			15 01 00 00 00 00 02 61 00
			15 01 00 00 00 00 02 62 26
			15 01 00 00 00 00 02 63 00
			15 01 00 00 00 00 02 2E 04
			15 01 00 00 00 00 02 2F 80
			15 01 00 00 00 00 02 70 59
			15 01 00 00 00 00 02 71 55
			15 01 00 00 00 00 02 A0 00
			15 01 00 00 00 00 02 A1 18
			15 01 00 00 00 00 02 A2 27
			15 01 00 00 00 00 02 A3 15
			15 01 00 00 00 00 02 A4 19
			15 01 00 00 00 00 02 A5 2D
			15 01 00 00 00 00 02 A6 21
			15 01 00 00 00 00 02 A7 21
			15 01 00 00 00 00 02 A8 92
			15 01 00 00 00 00 02 A9 1B
			15 01 00 00 00 00 02 AA 27
			15 01 00 00 00 00 02 AB 85
			15 01 00 00 00 00 02 AC 1F
			15 01 00 00 00 00 02 AD 21
			15 01 00 00 00 00 02 AE 55
			15 01 00 00 00 00 02 AF 29
			15 01 00 00 00 00 02 B0 2C
			15 01 00 00 00 00 02 B1 53
			15 01 00 00 00 00 02 B2 5b
			15 01 00 00 00 00 02 B3 19
			15 01 00 00 00 00 02 C0 00
			15 01 00 00 00 00 02 C1 19
			15 01 00 00 00 00 02 C2 27
			15 01 00 00 00 00 02 C3 15
			15 01 00 00 00 00 02 C4 18
			15 01 00 00 00 00 02 C5 2D
			15 01 00 00 00 00 02 C6 21
			15 01 00 00 00 00 02 C7 22
			15 01 00 00 00 00 02 C8 92
			15 01 00 00 00 00 02 C9 1B
			15 01 00 00 00 00 02 CA 28
			15 01 00 00 00 00 02 CB 84
			15 01 00 00 00 00 02 CC 1F
			15 01 00 00 00 00 02 CD 20
			15 01 00 00 00 00 02 CE 55
			15 01 00 00 00 00 02 CF 28
			15 01 00 00 00 00 02 D0 2D
			15 01 00 00 00 00 02 D1 54
			15 01 00 00 00 00 02 D2 5b
			15 01 00 00 00 00 02 D3 34
			39 01 00 00 00 00 04 FF 98 81 00
			15 01 00 00 00 00 02 35 00
			39 01 00 00 3C 00 02 11 00
			39 01 00 00 14 00 02 29 00];
		qcom,mdss-dsi-off-command = [
		39 01 00 00 00 00 04 FF 98 81 00
		05 01 00 00 14 00 02 28 00
		05 01 00 00 78 00 02 10 00];
		qcom,mdss-dsi-on-command-state = "dsi_lp_mode";
		qcom,mdss-dsi-off-command-state = "dsi_lp_mode";
		qcom,mdss-dsi-h-sync-pulse = <1>;
		qcom,mdss-dsi-traffic-mode = "burst_mode";
		qcom,mdss-dsi-lane-map = "lane_map_0123";
		qcom,mdss-dsi-bllp-eof-power-mode;
		qcom,mdss-dsi-bllp-power-mode;
		qcom,mdss-dsi-lane-0-state;
		qcom,mdss-dsi-lane-1-state;
		qcom,mdss-dsi-lane-2-state;
		/delete-property/ qcom,mdss-dsi-panel-timings;
		qcom,mdss-dsi-panel-timings-phy-12nm = [
					0F 08 0C 04 00 06 04 0B];
		qcom,mdss-dsi-t-clk-post = <0x0c>;
		//qcom,mdss-dsi-t-clk-pre = <0x27>;
		qcom,mdss-dsi-bl-min-level = <1>;
		qcom,mdss-dsi-bl-max-level = <4095>;
		qcom,esd-check-enabled;
		qcom,mdss-dsi-panel-status-command      = [06 01 00 01 05 00 01 09];
		qcom,mdss-dsi-panel-status-command-mode = "dsi_lp_mode";
		qcom,mdss-dsi-panel-status-check-mode   = "reg_read";
		qcom,mdss-dsi-panel-status-read-length  = <3>;
		qcom,mdss-dsi-panel-status-valid-params = <3>;
		qcom,mdss-dsi-panel-status-value        = <0x80 0x03 0x06>;
		qcom,mdss-dsi-panel-max-error-count     = <3>;
		qcom,mdss-dsi-dma-trigger = "trigger_sw";
		qcom,mdss-dsi-mdp-trigger = "none";
		qcom,mdss-dsi-bl-pmic-control-type = "bl_ctrl_pwm";
		qcom,mdss-dsi-bl-pmic-pwm-frequency = <100>;
		qcom,mdss-dsi-bl-pmic-bank-select = <0>;
		qcom,mdss-dsi-pwm-gpio = <&pm8953_gpios 8 0>;
		qcom,panel-supply-entries = <&dsi_panel_pwr_supply>;
		qcom,mdss-dsi-reset-sequence = <1 5>, <0 1>, <1 12>;
		/*HS60 code for HS60-248 by sunguoqing at 2019/07/29 start*/
		qcom,mdss-dsi-lp11-init;
		/*HS60 code for HS60-248 by sunguoqing at 2019/07/29 end*/
	};
};
