/* Copyright (c) 2013, The Linux Foundation. All rights reserved.
 *
 * This program is free software; you can redistribute it and/or modify
 * it under the terms of the GNU General Public License version 2 and
 * only version 2 as published by the Free Software Foundation.
 *
 * This program is distributed in the hope that it will be useful,
 * but WITHOUT ANY WARRANTY; without even the implied warranty of
 * MERCHANTABILITY or FITNESS FOR A PARTICULAR PURPOSE.  See the
 * GNU General Public License for more details.
 */

/*---------------------------------------------------------------------------
 * This file is autogenerated file using gcdb parser. Please do not edit it.
 * Update input XML file to add a new entry or update variable in this file
 * VERSION = "1.0"
 *---------------------------------------------------------------------------*/
&mdss_mdp {
	dsi_hsd_jd9365da_720p_video: qcom,mdss_dsi_hsd_jd9365da_720p_video {
		qcom,mdss-dsi-panel-name = "hsd jd9365da 720p video mode dsi panel";
		qcom,mdss-dsi-panel-controller = <&mdss_dsi0>;
		qcom,mdss-dsi-panel-type = "dsi_video_mode";
		qcom,mdss-dsi-panel-destination = "display_1";
		qcom,mdss-dsi-panel-framerate = <60>;
		qcom,mdss-dsi-virtual-channel-id = <0>;
		qcom,mdss-dsi-stream = <0>;
		qcom,mdss-dsi-panel-width = <720>;
		qcom,mdss-dsi-panel-height = <1520>;
		qcom,mdss-dsi-h-front-porch = <152>;
		qcom,mdss-dsi-h-back-porch = <41>;
		qcom,mdss-dsi-h-pulse-width = <10>;
		qcom,mdss-dsi-h-sync-skew = <0>;
		qcom,mdss-dsi-v-back-porch = <12>;
		qcom,mdss-dsi-v-front-porch = <18>;
		qcom,mdss-dsi-v-pulse-width = <4>;
		qcom,mdss-dsi-h-left-border = <0>;
		qcom,mdss-dsi-h-right-border = <0>;
		qcom,mdss-dsi-v-top-border = <0>;
		qcom,mdss-dsi-v-bottom-border = <0>;
		qcom,mdss-dsi-bpp = <24>;
		qcom,mdss-dsi-color-order = "rgb_swap_rgb";
		qcom,mdss-dsi-underflow-color = <0xff>;
		qcom,mdss-dsi-border-color = <0>;
		qcom,mdss-dsi-on-command = [
		39 01 00 00 00 00 02 E0 00
                39 01 00 00 00 00 02 E1 93
                39 01 00 00 00 00 02 E2 65
                39 01 00 00 00 00 02 E3 F8
                39 01 00 00 00 00 02 80 02
                39 01 00 00 00 00 02 E0 01
                39 01 00 00 00 00 02 00 00
                39 01 00 00 00 00 02 01 45
                39 01 00 00 00 00 02 03 00
                39 01 00 00 00 00 02 04 46
                39 01 00 00 00 00 02 17 10
                39 01 00 00 00 00 02 18 0F
                39 01 00 00 00 00 02 19 01
                39 01 00 00 00 00 02 1A 10
                39 01 00 00 00 00 02 1B 0F
                39 01 00 00 00 00 02 1C 01
                39 01 00 00 00 00 02 24 FE
                39 01 00 00 00 00 02 25 20
                39 01 00 00 00 00 02 37 09
                39 01 00 00 00 00 02 38 04
                39 01 00 00 00 00 02 39 08
                39 01 00 00 00 00 02 3A 12
                39 01 00 00 00 00 02 3C 64
                39 01 00 00 00 00 02 3D FF
                39 01 00 00 00 00 02 3E FF
                39 01 00 00 00 00 02 3F 64
                39 01 00 00 00 00 02 40 04
                39 01 00 00 00 00 02 41 BE
                39 01 00 00 00 00 02 42 6B
                39 01 00 00 00 00 02 43 12
                39 01 00 00 00 00 02 44 0F
                39 01 00 00 00 00 02 45 28
                39 01 00 00 00 00 02 4B 04
                39 01 00 00 00 00 02 55 0F
                39 01 00 00 00 00 02 56 01
                39 01 00 00 00 00 02 57 65
                39 01 00 00 00 00 02 58 0A
                39 01 00 00 00 00 02 59 0A
                39 01 00 00 00 00 02 5A 28
                39 01 00 00 00 00 02 5B 0F
                39 01 00 00 00 00 02 5D 7C
                39 01 00 00 00 00 02 5E 51
                39 01 00 00 00 00 02 5F 3A
                39 01 00 00 00 00 02 60 2B
                39 01 00 00 00 00 02 61 24
                39 01 00 00 00 00 02 62 14
                39 01 00 00 00 00 02 63 19
                39 01 00 00 00 00 02 64 0B
                39 01 00 00 00 00 02 65 23
                39 01 00 00 00 00 02 66 25
                39 01 00 00 00 00 02 67 28
                39 01 00 00 00 00 02 68 48
                39 01 00 00 00 00 02 69 37
                39 01 00 00 00 00 02 6A 40
                39 01 00 00 00 00 02 6B 32
                39 01 00 00 00 00 02 6C 2F
                39 01 00 00 00 00 02 6D 23
                39 01 00 00 00 00 02 6E 14
                39 01 00 00 00 00 02 6F 09
                39 01 00 00 00 00 02 70 7C
                39 01 00 00 00 00 02 71 51
                39 01 00 00 00 00 02 72 3A
                39 01 00 00 00 00 02 73 2B
                39 01 00 00 00 00 02 74 24
                39 01 00 00 00 00 02 75 14
                39 01 00 00 00 00 02 76 19
                39 01 00 00 00 00 02 77 0B
                39 01 00 00 00 00 02 78 23
                39 01 00 00 00 00 02 79 25
                39 01 00 00 00 00 02 7A 28
                39 01 00 00 00 00 02 7B 48
                39 01 00 00 00 00 02 7C 37
                39 01 00 00 00 00 02 7D 40
                39 01 00 00 00 00 02 7E 32
                39 01 00 00 00 00 02 7F 2F
                39 01 00 00 00 00 02 80 23
                39 01 00 00 00 00 02 81 14
                39 01 00 00 00 00 02 82 09
                39 01 00 00 00 00 02 E0 02
                39 01 00 00 00 00 02 00 5E
                39 01 00 00 00 00 02 01 5F
                39 01 00 00 00 00 02 02 57
                39 01 00 00 00 00 02 03 58
                39 01 00 00 00 00 02 04 44
                39 01 00 00 00 00 02 05 46
                39 01 00 00 00 00 02 06 48
                39 01 00 00 00 00 02 07 4A
                39 01 00 00 00 00 02 08 40
                39 01 00 00 00 00 02 09 1D
                39 01 00 00 00 00 02 0A 1D
                39 01 00 00 00 00 02 0B 1D
                39 01 00 00 00 00 02 0C 1D
                39 01 00 00 00 00 02 0D 1D
                39 01 00 00 00 00 02 0E 1D
                39 01 00 00 00 00 02 0F 50
                39 01 00 00 00 00 02 10 5F
                39 01 00 00 00 00 02 11 5F
                39 01 00 00 00 00 02 12 5F
                39 01 00 00 00 00 02 13 5F
                39 01 00 00 00 00 02 14 5F
                39 01 00 00 00 00 02 15 5F
                39 01 00 00 00 00 02 16 5E
                39 01 00 00 00 00 02 17 5F
                39 01 00 00 00 00 02 18 57
                39 01 00 00 00 00 02 19 58
                39 01 00 00 00 00 02 1A 45
                39 01 00 00 00 00 02 1B 47
                39 01 00 00 00 00 02 1C 49
                39 01 00 00 00 00 02 1D 4B
                39 01 00 00 00 00 02 1E 41
                39 01 00 00 00 00 02 1F 1D
                39 01 00 00 00 00 02 20 1D
                39 01 00 00 00 00 02 21 1D
                39 01 00 00 00 00 02 22 1D
                39 01 00 00 00 00 02 23 1D
                39 01 00 00 00 00 02 24 1D
                39 01 00 00 00 00 02 25 51
                39 01 00 00 00 00 02 26 5F
                39 01 00 00 00 00 02 27 5F
                39 01 00 00 00 00 02 28 5F
                39 01 00 00 00 00 02 29 5F
                39 01 00 00 00 00 02 2A 5F
                39 01 00 00 00 00 02 2B 5F
                39 01 00 00 00 00 02 2C 1F
                39 01 00 00 00 00 02 2D 1E
                39 01 00 00 00 00 02 2E 17
                39 01 00 00 00 00 02 2F 18
                39 01 00 00 00 00 02 30 0B
                39 01 00 00 00 00 02 31 09
                39 01 00 00 00 00 02 32 07
                39 01 00 00 00 00 02 33 05
                39 01 00 00 00 00 02 34 11
                39 01 00 00 00 00 02 35 1F
                39 01 00 00 00 00 02 36 1F
                39 01 00 00 00 00 02 37 1F
                39 01 00 00 00 00 02 38 1F
                39 01 00 00 00 00 02 39 1F
                39 01 00 00 00 00 02 3A 1F
                39 01 00 00 00 00 02 3B 01
                39 01 00 00 00 00 02 3C 1F
                39 01 00 00 00 00 02 3D 1F
                39 01 00 00 00 00 02 3E 1F
                39 01 00 00 00 00 02 3F 1F
                39 01 00 00 00 00 02 40 1F
                39 01 00 00 00 00 02 41 1F
                39 01 00 00 00 00 02 42 1F
                39 01 00 00 00 00 02 43 1E
                39 01 00 00 00 00 02 44 17
                39 01 00 00 00 00 02 45 18
                39 01 00 00 00 00 02 46 0A
                39 01 00 00 00 00 02 47 08
                39 01 00 00 00 00 02 48 06
                39 01 00 00 00 00 02 49 04
                39 01 00 00 00 00 02 4A 10
                39 01 00 00 00 00 02 4B 1F
                39 01 00 00 00 00 02 4C 1F
                39 01 00 00 00 00 02 4D 1F
                39 01 00 00 00 00 02 4E 1F
                39 01 00 00 00 00 02 4F 1F
                39 01 00 00 00 00 02 50 1F
                39 01 00 00 00 00 02 51 00
                39 01 00 00 00 00 02 52 1F
                39 01 00 00 00 00 02 53 1F
                39 01 00 00 00 00 02 54 1F
                39 01 00 00 00 00 02 55 1F
                39 01 00 00 00 00 02 56 1F
                39 01 00 00 00 00 02 57 1F
                39 01 00 00 00 00 02 58 40
                39 01 00 00 00 00 02 59 00
                39 01 00 00 00 00 02 5A 00
                39 01 00 00 00 00 02 5B 10
                39 01 00 00 00 00 02 5C 0B
                39 01 00 00 00 00 02 5D 30
                39 01 00 00 00 00 02 5E 01
                39 01 00 00 00 00 02 5F 02
                39 01 00 00 00 00 02 60 30
                39 01 00 00 00 00 02 61 03
                39 01 00 00 00 00 02 62 04
                39 01 00 00 00 00 02 63 18
                39 01 00 00 00 00 02 64 52
                39 01 00 00 00 00 02 65 55
                39 01 00 00 00 00 02 66 FF
                39 01 00 00 00 00 02 67 73
                39 01 00 00 00 00 02 68 0D
                39 01 00 00 00 00 02 69 18
                39 01 00 00 00 00 02 6A 4D
                39 01 00 00 00 00 02 6B 00
                39 01 00 00 00 00 02 6C 00
                39 01 00 00 00 00 02 6D 0C
                39 01 00 00 00 00 02 6E 00
                39 01 00 00 00 00 02 6F 08
                39 01 00 00 00 00 02 70 00
                39 01 00 00 00 00 02 71 00
                39 01 00 00 00 00 02 72 06
                39 01 00 00 00 00 02 73 7B
                39 01 00 00 00 00 02 74 00
                39 01 00 00 00 00 02 75 BC
                39 01 00 00 00 00 02 76 00
                39 01 00 00 00 00 02 77 0E
                39 01 00 00 00 00 02 78 12
                39 01 00 00 00 00 02 79 00
                39 01 00 00 00 00 02 7A 00
                39 01 00 00 00 00 02 7B 00
                39 01 00 00 00 00 02 7C 00
                39 01 00 00 00 00 02 7D 03
                39 01 00 00 00 00 02 7E 7B
                39 01 00 00 00 00 02 E0 04
                39 01 00 00 00 00 02 00 06
                39 01 00 00 00 00 02 03 4E
                39 01 00 00 00 00 02 04 01
                39 01 00 00 00 00 02 09 10
                39 01 00 00 00 00 02 0E 2A
                39 01 00 00 00 00 02 0F 87
                39 01 00 00 00 00 02 02 23
                39 01 00 00 00 00 02 26 48
                39 01 00 00 00 00 02 36 49
                39 01 00 00 00 00 02 E0 00
                05 01 00 00 78 00 02 11 00
                05 01 00 00 14 00 02 29 00
                39 01 00 00 00 00 02 35 00
		];
		qcom,mdss-dsi-off-command = [
		05 01 00 00 14 00 02 28 00
                05 01 00 00 78 00 02 10 00
		];
		qcom,mdss-dsi-on-command-state = "dsi_lp_mode";
		qcom,mdss-dsi-off-command-state = "dsi_lp_mode";
		qcom,mdss-dsi-h-sync-pulse = <1>;
		qcom,mdss-dsi-traffic-mode = "burst_mode";
		qcom,mdss-dsi-lane-map = "lane_map_0123";
		qcom,mdss-dsi-bllp-eof-power-mode;
		qcom,mdss-dsi-bllp-power-mode;
		qcom,mdss-dsi-hfp-power-mode;
		qcom,mdss-dsi-lane-0-state;
		qcom,mdss-dsi-lane-1-state;
		qcom,mdss-dsi-lane-2-state;
		qcom,mdss-dsi-panel-timings-phy-12nm = [10 08 0C 04 00 07 04 0B];
		qcom,mdss-dsi-t-clk-post = <0x0C>;
		qcom,mdss-dsi-t-clk-pre = <0x24>;
		qcom,mdss-dsi-bl-min-level = <1>;
		qcom,mdss-dsi-bl-max-level = <4095>;
		qcom,esd-check-enabled;
		qcom,mdss-dsi-panel-status-command      = [06 01 00 01 05 00 01 0A];
		qcom,mdss-dsi-panel-status-command-mode = "dsi_lp_mode";
		qcom,mdss-dsi-panel-status-check-mode   = "reg_read";
		qcom,mdss-dsi-panel-status-read-length  = <1>;
		qcom,mdss-dsi-panel-status-valid-params = <1>;
		qcom,mdss-dsi-panel-status-value        = <0x1C>;
		qcom,mdss-dsi-panel-max-error-count     = <3>;
		qcom,mdss-dsi-dma-trigger = "trigger_sw";
		qcom,mdss-dsi-mdp-trigger = "none";
		qcom,mdss-dsi-bl-pmic-control-type = "bl_ctrl_pwm";
		qcom,mdss-dsi-bl-pmic-pwm-frequency = <100>;
		qcom,mdss-dsi-bl-pmic-bank-select = <0>;
		qcom,mdss-dsi-pwm-gpio = <&pm8953_gpios 8 0>;
		qcom,panel-supply-entries = <&dsi_panel_pwr_supply>;
		qcom,mdss-dsi-reset-sequence = <1 5>, <0 10>, <1 120>;
		qcom,mdss-dsi-lp11-init;
	};
};
