/* Copyright (c) 2013, The Linux Foundation. All rights reserved.
 *
 * This program is free software; you can redistribute it and/or modify
 * it under the terms of the GNU General Public License version 2 and
 * only version 2 as published by the Free Software Foundation.
 *
 * This program is distributed in the hope that it will be useful,
 * but WITHOUT ANY WARRANTY; without even the implied warranty of
 * MERCHANTABILITY or FITNESS FOR A PARTICULAR PURPOSE.  See the
 * GNU General Public License for more details.
 */

/*---------------------------------------------------------------------------
 * This file is autogenerated file using gcdb parser. Please do not edit it.
 * Update input XML file to add a new entry or update variable in this file
 * VERSION = "1.0"
 *---------------------------------------------------------------------------*/
&mdss_mdp {
	dsi_gx_cd_hx8394f_720p_video: qcom,mdss_dsi_gx_cd_hx8394f_720p_video {
		qcom,mdss-dsi-panel-name = "gx cd hx8394f 720p video mode dsi panel";
		qcom,mdss-dsi-panel-controller = <&mdss_dsi0>;
		qcom,mdss-dsi-panel-type = "dsi_video_mode";
		qcom,mdss-dsi-panel-destination = "display_1";
		qcom,mdss-dsi-panel-framerate = <60>;
		qcom,mdss-dsi-virtual-channel-id = <0>;
		qcom,mdss-dsi-stream = <0>;
		qcom,mdss-dsi-panel-width = <720>;
		qcom,mdss-dsi-panel-height = <1520>;
		qcom,mdss-dsi-h-front-porch = <126>;
		qcom,mdss-dsi-h-back-porch = <32>;
		qcom,mdss-dsi-h-pulse-width = <32>;
		qcom,mdss-dsi-h-sync-skew = <0>;
		qcom,mdss-dsi-v-back-porch = <4>;
		qcom,mdss-dsi-v-front-porch = <10>;
		qcom,mdss-dsi-v-pulse-width = <4>;
		qcom,mdss-dsi-h-left-border = <0>;
		qcom,mdss-dsi-h-right-border = <0>;
		qcom,mdss-dsi-v-top-border = <0>;
		qcom,mdss-dsi-v-bottom-border = <0>;
		qcom,mdss-dsi-bpp = <24>;
		qcom,mdss-dsi-color-order = "rgb_swap_rgb";
		qcom,mdss-dsi-underflow-color = <0xff>;
		qcom,mdss-dsi-border-color = <0>;
		qcom,mdss-dsi-on-command = [39 01 00 00 00 00 04 B9 FF 83 94
				39 01 00 00 00 00 07 BA 62 03 68 7B B2 C0
				39 01 00 00 00 00 0B B1 48 14 74 09 31 44 71 71 50 43
				39 01 00 00 00 00 07 B2 00 80 82 06 08 22
				39 01 00 00 00 00 16 B4 01 62 64 62 61 62 01 0C 6D 55 00 3F 01 62 64 62 61 62 01 0C 6D
				39 01 00 00 05 00 23 D3 00 00 04 04 00 00 3F 3F 32 10 01 00 01 52 15 F7 05 F7 32 10 00 00 00 67 43 06 06 27 0D 0D 27 06 40 00
				39 01 00 00 05 00 3B E0 00 07 12 19 1D 23 27 27 53 64 76 73 7B 8A 8C 8D 9A 9E 9B AA B9 5B 5A 5D 61 64 6B 77 7F 00 07 12 19 1D 23 27 27 53 64 77 74 7B 8A 8C 8E 9A 9C 9A AA BB 5C 5A 5E 62 65 6E 7B 7F
				39 01 00 00 00 00 03 B6 3C 3C
				39 01 00 00 00 00 02 BD 02
				39 01 00 00 05 00 05 D3 01 04 00 01
				39 01 00 00 00 00 02 BD 00
				39 01 00 00 05 00 2D D5 24 25 19 19 18 18 18 18 06 07 04 05 02 03 00 01 20 21 18 18 18 18 18 18 18 18 18 18 18 18 18 18 18 18 18 18 18 18 18 18 18 18 18 18
				39 01 00 00 05 00 2D D6 21 20 18 18 19 19 18 18 01 00 03 02 05 04 07 06 25 24 18 18 18 18 18 18 18 18 18 18 18 18 18 18 18 18 18 18 18 18 18 18 18 18 18 18
				39 01 00 00 00 00 02 CC 0B
				39 01 00 00 00 00 03 C0 1F 31
				39 01 00 00 00 00 02 D2 77
				39 01 00 00 00 00 02 D4 02
				39 01 00 00 00 00 02 C6 ED
				05 01 00 00 64 00 02 11 00
				05 01 00 00 14 00 02 29 00
				15 01 00 00 00 00 02 BC 00];
		qcom,mdss-dsi-off-command = [05 01 00 00 32 00 02 28 00
					05 01 00 00 78 00 02 10 00];
		qcom,mdss-dsi-on-command-state = "dsi_lp_mode";
		qcom,mdss-dsi-off-command-state = "dsi_lp_mode";
		qcom,mdss-dsi-h-sync-pulse = <1>;
		qcom,mdss-dsi-traffic-mode = "burst_mode";
		qcom,mdss-dsi-lane-map = "lane_map_0123";
		qcom,mdss-dsi-bllp-eof-power-mode;
		qcom,mdss-dsi-bllp-power-mode;
		qcom,mdss-dsi-lane-0-state;
		qcom,mdss-dsi-lane-1-state;
		qcom,mdss-dsi-lane-2-state;
		/delete-property/ qcom,mdss-dsi-panel-timings;
		qcom,mdss-dsi-panel-timings-phy-12nm = [
					0F 08 0C 04 00 06 04 0B];
		qcom,mdss-dsi-t-clk-post = <0x0c>;
		//qcom,mdss-dsi-t-clk-pre = <0x27>;
		qcom,mdss-dsi-bl-min-level = <1>;
		qcom,mdss-dsi-bl-max-level = <4095>;
		qcom,esd-check-enabled;
		qcom,mdss-dsi-panel-status-command = [14 01 00 01 05 00 01 D9
						06 01 00 01 05 00 01 09
						];
		qcom,mdss-dsi-panel-status-command-state = "dsi_lp_mode";
		qcom,mdss-dsi-panel-status-check-mode = "reg_read";
		qcom,mdss-dsi-panel-status-read-length = <1 3>;
		qcom,mdss-dsi-panel-max-error-count = <2>;
		qcom,mdss-dsi-panel-status-value = <0x80> , <0x80 0x73 0x04>;
		qcom,mdss-dsi-dma-trigger = "trigger_sw";
		qcom,mdss-dsi-mdp-trigger = "none";
		qcom,mdss-dsi-bl-pmic-control-type = "bl_ctrl_pwm";
		qcom,mdss-dsi-bl-pmic-pwm-frequency = <100>;
		qcom,mdss-dsi-bl-pmic-bank-select = <0>;
		qcom,mdss-dsi-pwm-gpio = <&pm8953_gpios 8 0>;
		qcom,panel-supply-entries = <&dsi_panel_pwr_supply>;
		qcom,mdss-dsi-reset-sequence = <1 5>, <0 2>, <1 5>;
		/*HS60 code for HS60-248 by sunguoqing at 2019/07/29 start*/
		qcom,mdss-dsi-lp11-init;
		/*HS60 code for HS60-248 by sunguoqing at 2019/07/29 end*/
	};
};
