/* Copyright (c) 2013, The Linux Foundation. All rights reserved.
 *
 * This program is free software; you can redistribute it and/or modify
 * it under the terms of the GNU General Public License version 2 and
 * only version 2 as published by the Free Software Foundation.
 *
 * This program is distributed in the hope that it will be useful,
 * but WITHOUT ANY WARRANTY; without even the implied warranty of
 * MERCHANTABILITY or FITNESS FOR A PARTICULAR PURPOSE.  See the
 * GNU General Public License for more details.
 */

/*---------------------------------------------------------------------------
 * This file is autogenerated file using gcdb parser. Please do not edit it.
 * Update input XML file to add a new entry or update variable in this file
 * VERSION = "1.0"
 *---------------------------------------------------------------------------*/
&mdss_mdp {
	dsi_hlt_mdt_ili9881c_720p_video: qcom,mdss_dsi_hlt_mdt_ili9881c_720p_video {
		qcom,mdss-dsi-panel-name = "hlt mdt ili9881c 720p video mode dsi panel";
		qcom,mdss-dsi-panel-controller = <&mdss_dsi0>;
		qcom,mdss-dsi-panel-type = "dsi_video_mode";
		qcom,mdss-dsi-panel-destination = "display_1";
		qcom,mdss-dsi-panel-framerate = <60>;
		qcom,mdss-dsi-virtual-channel-id = <0>;
		qcom,mdss-dsi-stream = <0>;
		qcom,mdss-dsi-panel-width = <720>;
		qcom,mdss-dsi-panel-height = <1520>;
		qcom,mdss-dsi-h-front-porch = <152>;
		qcom,mdss-dsi-h-back-porch = <36>;
		qcom,mdss-dsi-h-pulse-width = <12>;
		qcom,mdss-dsi-h-sync-skew = <0>;
		qcom,mdss-dsi-v-back-porch = <18>;
		qcom,mdss-dsi-v-front-porch = <18>;
		qcom,mdss-dsi-v-pulse-width = <2>;
		qcom,mdss-dsi-h-left-border = <0>;
		qcom,mdss-dsi-h-right-border = <0>;
		qcom,mdss-dsi-v-top-border = <0>;
		qcom,mdss-dsi-v-bottom-border = <0>;
		qcom,mdss-dsi-bpp = <24>;
		qcom,mdss-dsi-color-order = "rgb_swap_rgb";
		qcom,mdss-dsi-underflow-color = <0xff>;
		qcom,mdss-dsi-border-color = <0>;
		qcom,mdss-dsi-on-command = [29 01 00 00 00 00 04 FF 98 81 03
				29 01 00 00 00 00 02 01 00
				29 01 00 00 00 00 02 02 00
				29 01 00 00 00 00 02 03 56
				29 01 00 00 00 00 02 04 13
				29 01 00 00 00 00 02 05 00
				29 01 00 00 00 00 02 06 06
				29 01 00 00 00 00 02 07 01
				29 01 00 00 00 00 02 08 00
				29 01 00 00 00 00 02 09 00
				29 01 00 00 00 00 02 0A 03
				29 01 00 00 00 00 02 0B 03
				29 01 00 00 00 00 02 0C 00
				29 01 00 00 00 00 02 0D 00
				29 01 00 00 00 00 02 0E 00
				29 01 00 00 00 00 02 0F 00
				29 01 00 00 00 00 02 10 00
				29 01 00 00 00 00 02 11 00
				29 01 00 00 00 00 02 12 00
				29 01 00 00 00 00 02 13 00
				29 01 00 00 00 00 02 14 00
				29 01 00 00 00 00 02 15 08
				29 01 00 00 00 00 02 16 08
				29 01 00 00 00 00 02 17 00
				29 01 00 00 00 00 02 18 00
				29 01 00 00 00 00 02 19 00
				29 01 00 00 00 00 02 1A 00
				29 01 00 00 00 00 02 1B 00
				29 01 00 00 00 00 02 1C 00
				29 01 00 00 00 00 02 1D 00
				29 01 00 00 00 00 02 1E C4
				29 01 00 00 00 00 02 1F 80
				29 01 00 00 00 00 02 20 00
				29 01 00 00 00 00 02 21 01
				29 01 00 00 00 00 02 22 01
				29 01 00 00 00 00 02 23 00
				29 01 00 00 00 00 02 24 8A
				29 01 00 00 00 00 02 25 8A
				29 01 00 00 00 00 02 26 8A
				29 01 00 00 00 00 02 27 8A
				29 01 00 00 00 00 02 28 3B
				29 01 00 00 00 00 02 29 11
				29 01 00 00 00 00 02 2A 00
				29 01 00 00 00 00 02 2B 00
				29 01 00 00 00 00 02 2C 00
				29 01 00 00 00 00 02 2D 00
				29 01 00 00 00 00 02 2E 00
				29 01 00 00 00 00 02 2F 00
				29 01 00 00 00 00 02 30 00
				29 01 00 00 00 00 02 31 00
				29 01 00 00 00 00 02 32 00
				29 01 00 00 00 00 02 33 00
				29 01 00 00 00 00 02 34 03
				29 01 00 00 00 00 02 35 00
				29 01 00 00 00 00 02 36 00
				29 01 00 00 00 00 02 37 00
				29 01 00 00 00 00 02 38 3C
				29 01 00 00 00 00 02 39 00
				29 01 00 00 00 00 02 3A 00
				29 01 00 00 00 00 02 3B 00
				29 01 00 00 00 00 02 3C 00
				29 01 00 00 00 00 02 3D 00
				29 01 00 00 00 00 02 3E 00
				29 01 00 00 00 00 02 3F 00
				29 01 00 00 00 00 02 40 00
				29 01 00 00 00 00 02 41 00
				29 01 00 00 00 00 02 42 00
				29 01 00 00 00 00 02 43 00
				29 01 00 00 00 00 02 44 00
				29 01 00 00 00 00 02 50 01
				29 01 00 00 00 00 02 51 23
				29 01 00 00 00 00 02 52 45
				29 01 00 00 00 00 02 53 67
				29 01 00 00 00 00 02 54 89
				29 01 00 00 00 00 02 55 AB
				29 01 00 00 00 00 02 56 01
				29 01 00 00 00 00 02 57 23
				29 01 00 00 00 00 02 58 45
				29 01 00 00 00 00 02 59 67
				29 01 00 00 00 00 02 5A 89
				29 01 00 00 00 00 02 5B AB
				29 01 00 00 00 00 02 5C CD
				29 01 00 00 00 00 02 5D EF
				29 01 00 00 00 00 02 5E 01
				29 01 00 00 00 00 02 5F 08
				29 01 00 00 00 00 02 60 01
				29 01 00 00 00 00 02 61 00
				29 01 00 00 00 00 02 62 02
				29 01 00 00 00 00 02 63 0F
				29 01 00 00 00 00 02 64 0E
				29 01 00 00 00 00 02 65 0D
				29 01 00 00 00 00 02 66 0C
				29 01 00 00 00 00 02 67 06
				29 01 00 00 00 00 02 68 02
				29 01 00 00 00 00 02 69 02
				29 01 00 00 00 00 02 6A 02
				29 01 00 00 00 00 02 6B 02
				29 01 00 00 00 00 02 6C 02
				29 01 00 00 00 00 02 6D 02
				29 01 00 00 00 00 02 6E 02
				29 01 00 00 00 00 02 6F 02
				29 01 00 00 00 00 02 70 02
				29 01 00 00 00 00 02 71 02
				29 01 00 00 00 00 02 72 00
				29 01 00 00 00 00 02 73 02
				29 01 00 00 00 00 02 74 02
				29 01 00 00 00 00 02 75 06
				29 01 00 00 00 00 02 76 01
				29 01 00 00 00 00 02 77 00
				29 01 00 00 00 00 02 78 02
				29 01 00 00 00 00 02 79 0C
				29 01 00 00 00 00 02 7A 0D
				29 01 00 00 00 00 02 7B 0E
				29 01 00 00 00 00 02 7C 0F
				29 01 00 00 00 00 02 7D 08
				29 01 00 00 00 00 02 7E 02
				29 01 00 00 00 00 02 7F 02
				29 01 00 00 00 00 02 80 02
				29 01 00 00 00 00 02 81 02
				29 01 00 00 00 00 02 82 02
				29 01 00 00 00 00 02 83 02
				29 01 00 00 00 00 02 84 02
				29 01 00 00 00 00 02 85 02
				29 01 00 00 00 00 02 86 02
				29 01 00 00 00 00 02 87 02
				29 01 00 00 00 00 02 88 00
				29 01 00 00 00 00 02 89 02
				29 01 00 00 00 00 02 8A 02
				29 01 00 00 00 00 04 FF 98 81 04
				29 01 00 00 00 00 02 00 00
				29 01 00 00 00 00 02 6C 15
				29 01 00 00 00 00 02 6E 2B
				29 01 00 00 00 00 02 6F 25
				29 01 00 00 00 00 02 3A A4
				29 01 00 00 00 00 02 8D 1F
				29 01 00 00 00 00 02 87 BA
				29 01 00 00 00 00 02 26 76
				29 01 00 00 00 00 02 B2 D1
				29 01 00 00 00 00 02 88 0B
				29 01 00 00 00 00 02 33 14
				29 01 00 00 00 00 02 35 17
				29 01 00 00 00 00 02 38 01
				29 01 00 00 00 00 02 39 00
				29 01 00 00 00 00 02 7A 0F
				29 01 00 00 00 00 02 B5 02
				29 01 00 00 00 00 02 31 25
				29 01 00 00 00 00 02 3B 98
				//power on speed up start
				29 01 00 00 00 00 02 4C 02
				29 01 00 00 00 00 02 52 37
				29 01 00 00 00 00 02 53 37
				29 01 00 00 00 00 02 54 46
				//power on speed up end
				29 01 00 00 00 00 04 FF 98 81 01
				29 01 00 00 00 00 02 22 0A
				29 01 00 00 00 00 02 2E 04
				29 01 00 00 00 00 02 2F 80
				29 01 00 00 00 00 02 31 00
				29 01 00 00 00 00 02 50 BF
				29 01 00 00 00 00 02 51 BA
				29 01 00 00 00 00 02 60 10
				29 01 00 00 00 00 02 61 00
				29 01 00 00 00 00 02 62 20
				29 01 00 00 00 00 02 63 00
				29 01 00 00 00 00 02 A0 00
				29 01 00 00 00 00 02 A1 1B
				29 01 00 00 00 00 02 A2 2C
				29 01 00 00 00 00 02 A3 16
				29 01 00 00 00 00 02 A4 1B
				29 01 00 00 00 00 02 A5 30
				29 01 00 00 00 00 02 A6 25
				29 01 00 00 00 00 02 A7 24
				29 01 00 00 00 00 02 A8 95
				29 01 00 00 00 00 02 A9 1C
				29 01 00 00 00 00 02 AA 27
				29 01 00 00 00 00 02 AB 77
				29 01 00 00 00 00 02 AC 1A
				29 01 00 00 00 00 02 AD 1B
				29 01 00 00 00 00 02 AE 4F
				29 01 00 00 00 00 02 AF 23
				29 01 00 00 00 00 02 B0 29
				29 01 00 00 00 00 02 B1 50
				29 01 00 00 00 00 02 B2 5F
				29 01 00 00 00 00 02 B3 3F
				29 01 00 00 00 00 02 C0 00
				29 01 00 00 00 00 02 C1 1B
				29 01 00 00 00 00 02 C2 2C
				29 01 00 00 00 00 02 C3 16
				29 01 00 00 00 00 02 C4 1B
				29 01 00 00 00 00 02 C5 30
				29 01 00 00 00 00 02 C6 25
				29 01 00 00 00 00 02 C7 24
				29 01 00 00 00 00 02 C8 95
				29 01 00 00 00 00 02 C9 1C
				29 01 00 00 00 00 02 CA 27
				29 01 00 00 00 00 02 CB 77
				29 01 00 00 00 00 02 CC 1A
				29 01 00 00 00 00 02 CD 1B
				29 01 00 00 00 00 02 CE 4F
				29 01 00 00 00 00 02 CF 23
				29 01 00 00 00 00 02 D0 29
				29 01 00 00 00 00 02 D1 50
				29 01 00 00 00 00 02 D2 5F
				29 01 00 00 00 00 02 D3 3F
				29 01 00 00 00 00 04 FF 98 81 00
				05 01 00 00 3C 00 02 11 00
				05 01 00 00 14 00 02 29 00];
		qcom,mdss-dsi-off-command = [
		39 01 00 00 00 00 04 FF 98 81 00
		05 01 00 00 14 00 02 28 00
		05 01 00 00 78 00 02 10 00];
		qcom,mdss-dsi-on-command-state = "dsi_lp_mode";
		qcom,mdss-dsi-off-command-state = "dsi_lp_mode";
		qcom,mdss-dsi-h-sync-pulse = <1>;
		qcom,mdss-dsi-traffic-mode = "burst_mode";
		qcom,mdss-dsi-lane-map = "lane_map_0123";
		qcom,mdss-dsi-bllp-eof-power-mode;
		qcom,mdss-dsi-bllp-power-mode;
		qcom,mdss-dsi-hfp-power-mode;
		qcom,mdss-dsi-lane-0-state;
		qcom,mdss-dsi-lane-1-state;
		qcom,mdss-dsi-lane-2-state;
		/delete-property/ qcom,mdss-dsi-panel-timings;
		qcom,mdss-dsi-panel-timings-phy-12nm = [
					10 08 0C 04 00 07 04 06];
		qcom,mdss-dsi-t-clk-post = <0x0c>;
		//qcom,mdss-dsi-t-clk-pre = <0x27>;
		qcom,mdss-dsi-bl-min-level = <1>;
		qcom,mdss-dsi-bl-max-level = <4095>;
		qcom,esd-check-enabled;
		qcom,mdss-dsi-panel-status-command      = [06 01 00 01 05 00 01 0A];
		qcom,mdss-dsi-panel-status-command-mode = "dsi_lp_mode";
		qcom,mdss-dsi-panel-status-check-mode   = "reg_read";
		qcom,mdss-dsi-panel-status-read-length  = <1>;
		qcom,mdss-dsi-panel-status-valid-params = <1>;
		qcom,mdss-dsi-panel-status-value        = <0x9C>;
		qcom,mdss-dsi-panel-max-error-count     = <3>;
		qcom,mdss-dsi-dma-trigger = "trigger_sw";
		qcom,mdss-dsi-mdp-trigger = "none";
		qcom,mdss-dsi-bl-pmic-control-type = "bl_ctrl_pwm";
		qcom,mdss-dsi-bl-pmic-pwm-frequency = <100>;
		qcom,mdss-dsi-bl-pmic-bank-select = <0>;
		qcom,mdss-dsi-pwm-gpio = <&pm8953_gpios 8 0>;
		qcom,panel-supply-entries = <&dsi_panel_pwr_supply>;
		qcom,mdss-dsi-reset-sequence = <1 5>, <0 1>, <1 12>;
		qcom,mdss-dsi-lp11-init;
		qcom,mdss-dsi-reset-delay-vsp-ms = <1>;
	};
};
