/* Copyright (c) 2013, The Linux Foundation. All rights reserved.
 *
 * This program is free software; you can redistribute it and/or modify
 * it under the terms of the GNU General Public License version 2 and
 * only version 2 as published by the Free Software Foundation.
 *
 * This program is distributed in the hope that it will be useful,
 * but WITHOUT ANY WARRANTY; without even the implied warranty of
 * MERCHANTABILITY or FITNESS FOR A PARTICULAR PURPOSE.  See the
 * GNU General Public License for more details.
 */

/*---------------------------------------------------------------------------
 * This file is autogenerated file using gcdb parser. Please do not edit it.
 * Update input XML file to add a new entry or update variable in this file
 * VERSION = "1.0"
 *---------------------------------------------------------------------------*/
&mdss_mdp {
	dsi_gx_st7703_720p_video: qcom,mdss_dsi_gx_st7703_720p_video {
		qcom,mdss-dsi-panel-name = "gx st7703 720p video mode dsi panel";
		qcom,mdss-dsi-panel-controller = <&mdss_dsi0>;
		qcom,mdss-dsi-panel-type = "dsi_video_mode";
		qcom,mdss-dsi-panel-destination = "display_1";
		qcom,mdss-dsi-panel-framerate = <60>;
		qcom,mdss-dsi-virtual-channel-id = <0>;
		qcom,mdss-dsi-stream = <0>;
		qcom,mdss-dsi-panel-width = <720>;
		qcom,mdss-dsi-panel-height = <1520>;
		qcom,mdss-dsi-h-front-porch = <132>;
		qcom,mdss-dsi-h-back-porch = <38>;
		qcom,mdss-dsi-h-pulse-width = <10>;
		qcom,mdss-dsi-h-sync-skew = <0>;
		qcom,mdss-dsi-v-back-porch = <11>;
		qcom,mdss-dsi-v-front-porch = <16>;
		qcom,mdss-dsi-v-pulse-width = <4>;
		qcom,mdss-dsi-h-left-border = <0>;
		qcom,mdss-dsi-h-right-border = <0>;
		qcom,mdss-dsi-v-top-border = <0>;
		qcom,mdss-dsi-v-bottom-border = <0>;
		qcom,mdss-dsi-bpp = <24>;
		qcom,mdss-dsi-color-order = "rgb_swap_rgb";
		qcom,mdss-dsi-underflow-color = <0xff>;
		qcom,mdss-dsi-border-color = <0>;
		/*HS60 code for HS60-199 by sunguoqing at 2019/08/02 start*/
		qcom,mdss-dsi-on-command = [29 01 00 00 00 00 04 B9 F1 12 83
		29 01 00 00 00 00 1C BA 32 81 05 F9 0E 0E 20 00 00 00 00 00 00 00 44 25 00 90 0A 00 00 00 4F C1 7D FF 37
		29 01 00 00 00 00 02 B8 75
		29 01 00 00 00 00 06 BF 02 11 00 80 01
		29 01 00 00 00 00 0B B3 07 0B 28 28 03 FF 00 00 00 00
		29 01 00 00 00 00 0A C0 73 73 50 50 A0 C0 08 50 00
		29 01 00 00 00 00 02 BC 46
		29 01 00 00 00 00 02 CC 0B
		29 01 00 00 00 00 02 B4 80
		29 01 00 00 00 00 02 B1 85
		29 01 00 00 00 00 04 B2 04 12 F0
		29 01 00 00 00 00 0F E3 07 07 0B 0B 10 10 00 00 00 00 28 80 C0 10
		29 01 00 00 00 00 0D C1 54 C0 32 32 99 B1 EF EF CE CE BE BE
		29 01 00 00 00 00 07 C6 01 40 FF FF 40 20
		29 01 00 00 00 00 03 B5 0F 0F
		29 01 00 00 00 00 03 B6 60 60
		29 01 00 00 00 00 40 E9 C2 10 06 05 F0 80 81 12 31 23 77 80 80 81 27 16 00 01 01 00 00 00 00 01 01 00 00 00 4F 88 64 20 08 88 88 88 88 88 88 5F 88 75 31 18 88 88 88 88 88 88 00 00 00 01 00 00 00 00 00 00 00 00 00
		29 01 00 00 00 00 3E EA 00 1A 00 00 00 00 02 00 00 00 00 00 18 F8 13 57 58 88 88 88 88 88 88 08 F8 02 46 48 88 88 88 88 88 88 23 30 00 00 87 00 00 00 00 00 00 00 00 00 00 00 00 00 00 00 40 A4 81 00 00 00 00
		29 01 00 00 00 00 23 E0 00 10 17 2C 2C 3F 4B 3B 08 0E 0E 11 12 10 11 10 17 00 10 17 2C 2C 3F 4B 3B 08 0E 0E 11 12 10 11 10 17
		29 01 00 00 00 00 04 EF FF FF 01
		29 01 00 00 00 00 02 C7 10
		05 01 00 00 78 00 02 11 00
		05 01 00 00 14 00 02 29 00];
		/*HS60 code for HS60-199 by sunguoqing at 2019/08/02 end*/
		qcom,mdss-dsi-off-command = [05 01 00 00 32 00 02 28 00
					05 01 00 00 78 00 02 10 00];
		qcom,mdss-dsi-on-command-state = "dsi_lp_mode";
		qcom,mdss-dsi-off-command-state = "dsi_lp_mode";
		qcom,mdss-dsi-h-sync-pulse = <1>;
		qcom,mdss-dsi-traffic-mode = "burst_mode";
		qcom,mdss-dsi-lane-map = "lane_map_0123";
		qcom,mdss-dsi-bllp-eof-power-mode;
		qcom,mdss-dsi-bllp-power-mode;
		qcom,mdss-dsi-lane-0-state;
		qcom,mdss-dsi-lane-1-state;
		qcom,mdss-dsi-lane-2-state;
		/delete-property/ qcom,mdss-dsi-panel-timings;
		qcom,mdss-dsi-panel-timings-phy-12nm = [
					0F 08 0C 04 00 06 04 0B];
		qcom,mdss-dsi-t-clk-post = <0x0c>;
		//qcom,mdss-dsi-t-clk-pre = <0x27>;
		qcom,mdss-dsi-bl-min-level = <1>;
		qcom,mdss-dsi-bl-max-level = <4095>;
		qcom,esd-check-enabled;
		qcom,mdss-dsi-panel-status-command = [14 01 00 01 05 00 01 68
						06 01 00 01 05 00 01 09
						06 01 00 01 05 00 01 F1
						06 01 00 01 05 00 01 EF
						14 01 00 01 05 00 01 AF
						];
		qcom,mdss-dsi-panel-status-command-state = "dsi_lp_mode";
		qcom,mdss-dsi-panel-status-check-mode = "reg_read";
		qcom,mdss-dsi-panel-status-read-length = <1 3 3 3 1>;
		qcom,mdss-dsi-panel-max-error-count = <2>;
		qcom,mdss-dsi-panel-status-value = <0xC0>, <0x80 0x73 0x04>, <0xDF 0x86 0x00>, <0xDF 0x86 0x01>, <0xFD>;
		qcom,mdss-dsi-dma-trigger = "trigger_sw";
		qcom,mdss-dsi-mdp-trigger = "none";
		qcom,mdss-dsi-bl-pmic-control-type = "bl_ctrl_pwm";
		qcom,mdss-dsi-bl-pmic-pwm-frequency = <100>;
		qcom,mdss-dsi-bl-pmic-bank-select = <0>;
		qcom,mdss-dsi-pwm-gpio = <&pm8953_gpios 8 0>;
		qcom,panel-supply-entries = <&dsi_panel_pwr_supply>;
		qcom,mdss-dsi-reset-sequence = <1 20>, <0 2>, <1 20>;
		//qcom,mdss-dsi-lp11-init;
	};
};
