/* Copyright (c) 2018, The Linux Foundation. All rights reserved.
 *
 * This program is free software; you can redistribute it and/or modify
 * it under the terms of the GNU General Public License version 2 and
 * only version 2 as published by the Free Software Foundation.
 *
 * This program is distributed in the hope that it will be useful,
 * but WITHOUT ANY WARRANTY; without even the implied warranty of
 * MERCHANTABILITY or FITNESS FOR A PARTICULAR PURPOSE.  See the
 * GNU General Public License for more details.
 */

/dts-v1/;
/plugin/;

#include <dt-bindings/clock/qcom,gcc-sdm845.h>
#include <dt-bindings/clock/qcom,camcc-sdm845.h>
#include <dt-bindings/clock/qcom,dispcc-sdm845.h>
#include <dt-bindings/clock/qcom,rpmh.h>
#include <dt-bindings/interrupt-controller/arm-gic.h>

#include "../qcom/sdm670-mtp.dtsi"
#include "sdm670-sec-common.dtsi"
#include "sdm670-sec-gtactivexl-pm-common.dtsi"
#include "sdm670-sec-gtactivexl-battery-common.dtsi"

#include "sdm670-sec-gtactivexl-r03.dtsi"
#include "sdm670-sec-gtactivexl-pinctrl-r03.dtsi"

#include "sdm670-sec-gtactivexl-display-r00.dtsi"
#include "sdm670-sec-gtactivexl-eif-r01.dtsi"
#include "sdm670-sec-gtactivexl-displayport-r01.dtsi"
#include "sdm670-sec-gtactivexl-camera-sensor-r00.dtsi"
#include "sdm670-sec-gtactivexl-sensor-r00.dtsi"
#include "sdm670-sec-gtactivexl-nfc-r01.dtsi"

/ {
	model = "Samsung GTACTIVEXL PROJECT (board-id,03)";
	compatible = "qcom,sdm670-mtp", "qcom,sdm670", "qcom,mtp";
	qcom,board-id = <8 3>;
	qcom,pmic-id = <0x0001001b 0x0101011a 0x0 0x0>,
		       <0x0001001b 0x0102001a 0x0 0x0>,
		       <0x0001001b 0x0201011a 0x0 0x0>;
};
