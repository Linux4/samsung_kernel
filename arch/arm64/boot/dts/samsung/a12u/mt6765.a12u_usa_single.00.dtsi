/* 
 * Generated by Samsung 
 * If these files should be changed, then please make a sync with MTK
*/

#include "../../mediatek/k65v1_64_bsp_titan_rat/gpio00_usa.dtsi"
#include "../a12/mt6765-a12_common.dtsi"
#include "../a12/mt6765_a12_camera_04.dtsi"
#include "../a12/mt6765_input_a12_07.dtsi"
#include "../a12/display_lcd_a12u_common.dtsi"

/*End of this file, DO NOT ADD ANYTHING HERE*/
