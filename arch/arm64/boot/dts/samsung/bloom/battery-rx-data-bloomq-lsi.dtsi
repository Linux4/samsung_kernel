/* Copyright (c) 2014, The Linux Foundation. All rights reserved.
 *
 * This program is free software; you can redistribute it and/or modify
 * it under the terms of the GNU General Public License version 2 and
 * only version 2 as published by the Free Software Foundation.
 *
 * This program is distributed in the hope that it will be useful,
 * but WITHOUT ANY WARRANTY; without even the implied warranty of
 * MERCHANTABILITY or FITNESS FOR A PARTICULAR PURPOSE.  See the
 * GNU General Public License for more details.
 */

&qupv3_se11_i2c {
	status = "ok";

	pinctrl-0 = <&qupv3_se11_i2c_active_mfc>;
	pinctrl-1 = <&qupv3_se11_i2c_sleep_mfc>;

	mfc-s2miw04-charger@3b {
		compatible = "lsi,mfc-s2miw04-charger";
		reg = <0x3b>;
		status = "okay";

		interrupt-parent = <&spmi_bus>;
		interrupts = <0x0 0xd0 0 IRQ_TYPE_LEVEL_HIGH>;
		interrupt-names = "default";
		interrupt-controller;
		pinctrl-names = "default";
		pinctrl-0 = <&mfc_irq_default &wpc_pdrc_b_gpio>;
		battery,wpc_det = <&pm8150l_gpios 1 GPIO_ACTIVE_HIGH>; /* WPC_DET */
		battery,wpc_int = <&tlmm 54 GPIO_ACTIVE_LOW>; /* MFC_AP_INT */
		battery,wpc_en = <&tlmm 135 0>; /* WPC_EN */
		battery,wpc_pdrc = <&tlmm 42 0>; /* WPC_PDRC_B */

		battery,charger_name = "max77705-charger";
		battery,fuelgauge_name = "max77705-fuelgauge";
		battery,wireless_charger_name = "mfc-charger";
		battery,fod_data = <0x00 0xAC 0x00 0xAC 0x0F 0x9C 0x0F 0x9C 0x10 0x88 0x10 0x88 0x10 0x88 0x10 0x88 0x19 0x60 0x19 0x60>;
		battery,wc_cover_rpp = <0x44>;
		battery,phone_fod_threshold = <0x3b>;
		battery,oc_fod1 = <1100>;
		battery,tx_gear_min_op_freq_delay = <4000>;
		battery,wireless20_vout_list = <8>; /* WIRELESS_VOUT_10V*/
		battery,wireless20_vrect_list = <10>; /* MFC_AFC_CONF_12V_TX*/
		battery,wireless20_max_power_list = <2>; /* SEC_WIRELESS_RX_POWER_12W*/
		battery,tx_ping_freq_init = <1300>;
		battery,tx_conflict_curr_init = <1500>;
	};
};
