/* Copyright (c) 2016-2017, The Linux Foundation. All rights reserved.
 *
 * This program is free software; you can redistribute it and/or modify
 * it under the terms of the GNU General Public License version 2 and
 * only version 2 as published by the Free Software Foundation.
 *
 * This program is distributed in the hope that it will be useful,
 * but WITHOUT ANY WARRANTY; without even the implied warranty of
 * MERCHANTABILITY or FITNESS FOR A PARTICULAR PURPOSE.  See the
 * GNU General Public License for more details.
 */

/dts-v1/;
/plugin/;

#include <dt-bindings/clock/qcom,gcc-sm8150.h>
#include <dt-bindings/clock/qcom,camcc-sm8150.h>
#include <dt-bindings/clock/qcom,rpmh.h>
#include <dt-bindings/interrupt-controller/arm-gic.h>

#include "../qcom/sm8150-mtp.dtsi"
#include "sm8150-sec-common.dtsi"
#include "sm8150-sec-bloomq-pm-common.dtsi"
#include "sm8150-sec-bloomq-pm-jpn-common.dtsi"
#include "sm8150-sec-bloomq-r07.dtsi"
#include "sm8150-sec-bloomq-pinctrl-r07.dtsi"
#include "sm8150-sec-bloomq-display-r04.dtsi"
#include "sm8150-sec-bloomq-fingerprint-sensor-r01.dtsi"
#include "sm8150-sec-bloomq-mst-r01.dtsi"
#include "sm8150-s2mu106.dtsi"
#include "battery-data-bloomq-r06.dtsi"
#include "sm8150-camera-sensor-bloomq-r01.dtsi"
#include "sm8150-cs40l2x-bloomq.dtsi"
#include "sm8150-sec-bloom-sensor-common.dtsi"
#include "sm8150-sec-bloomq-nfc-r01.dtsi"

/ {
	model = "Samsung BLOOMQ JPN PROJECT Rev07";
	compatible = "qcom,sm8150-mtp", "qcom,sm8150", "qcom,mtp";
	qcom,board-id = <8 7>;
    dtbo-version = <0>;
};
