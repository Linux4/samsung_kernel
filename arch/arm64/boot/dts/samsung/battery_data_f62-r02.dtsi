/*
 * SAMSUNG UNIVERSAL9820 board device tree source
 *
 * Copyright (c) 2018 Samsung Electronics Co., Ltd.
 *		http://www.samsung.com
 *
 * This program is free software; you can redistribute it and/or modify
 * it under the terms of the GNU General Public License version 2 as
 * published by the Free Software Foundation.
 */
#include "battery_data_f62_common.dtsi"
/ {
	fragment@battery {
		target-path = "/";
		__overlay__ {
			battery {
				battery,temp_check_type = <1>;
				battery,chg_temp_check_type = <1>;
			};
		};
	};
};
