/* Copyright (c) 2014, The Linux Foundation. All rights reserved.
 *
 * This program is free software; you can redistribute it and/or modify
 * it under the terms of the GNU General Public License version 2 and
 * only version 2 as published by the Free Software Foundation.
 *
 * This program is distributed in the hope that it will be useful,
 * but WITHOUT ANY WARRANTY; without even the implied warranty of
 * MERCHANTABILITY or FITNESS FOR A PARTICULAR PURPOSE.  See the
 * GNU General Public License for more details.
 */
#include "msm8996-sec-heroqlte-common-battery.dtsi"
&soc {
	battery {
		battery,chg_float_voltage = <43500>;
		battery,fast_charging_current = <1900 450 450 1900 700 1200 1000 500 1200 450 1900 1600 1900 450 450 400 700 1300 300 1000 1500 450 1900 1000 1900 80 1800 1000 1400 450 1000 500 1900 1900 1900 1900 1900>;
		battery,temp_table_adc = <25975 26250 26526 26878 27231 27672 28114 28707 29299 30118
					  30936 31904 32872 33968 35065 36111 37156 37967 38777 39612
					  40448 40981 41514>;
		battery,temp_table_data = <900 850 800 750 700 650 600 550 500 450
					   400 350 300 250 200 150 100 50 0 (-50)
					   (-100) (-150) (-200)>;

		battery,chg_temp_table_adc = <25823 26100 26377 26725 27072 27529 27987 28539 29091 29921
					  30751 31682 32612 33698 34783 35818 36852 37593 38334 39157
					  39981 40526 41071>;
		battery,chg_temp_table_data = <900 850 800 750 700 650 600 550 500 450
					   400 350 300 250 200 150 100 50 0 (-50)
					   (-100) (-150) (-200)>;

		battery,wpc_temp_table_adc = <25823 26100 26377 26725 27072 27529 27987 28539 29091 29921
					  30751 31682 32612 33698 34783 35818 36852 37593 38334 39157
					  39981 40526 41071>;
		battery,wpc_temp_table_data = <900 850 800 750 700 650 600 550 500 450
					   400 350 300 250 200 150 100 50 0 (-50)
					   (-100) (-150) (-200)>;
	};
	max77854-fuelgauge {
		status = "disable";
		fuelgauge,qrtable20 = <0x2080>;
		fuelgauge,qrtable30 = <0x1A03>;
		fuelgauge,rcomp0 = <0x40>;
		fuelgauge,rcomp_charging = <0x40>;
		fuelgauge,capacity = <0x0EA8>;
	};
};
