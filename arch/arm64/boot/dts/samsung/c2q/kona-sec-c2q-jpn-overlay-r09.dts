/* Copyright (c) 2020, The Linux Foundation. All rights reserved.
 *
 * This program is free software; you can redistribute it and/or modify
 * it under the terms of the GNU General Public License version 2 and
 * only version 2 as published by the Free Software Foundation.
 *
 * This program is distributed in the hope that it will be useful,
 * but WITHOUT ANY WARRANTY; without even the implied warranty of
 * MERCHANTABILITY or FITNESS FOR A PARTICULAR PURPOSE.  See the
 * GNU General Public License for more details.
 */

/dts-v1/;
/plugin/;

#include "../common/kona-sec-common.dtsi"
#include "kona-sec-c2q-r09.dtsi"
#include "kona-sec-c2q-pm-jpn-r08.dtsi"
#include "../drivers/camera_sensor_c2q_r07.dtsi"
#include "../drivers/kona-sec-c2q-camera-sensor-pinctrl-r07.dtsi"
#include "../../../../../../techpack/display/msm/samsung/S6E3HAC_AMB687VX01/dsi_panel_S6E3HAC_AMB687VX01_wqhd_octa_cmd_jpn.dtsi"

/ {
	model = "Samsung C2Q PROJECT - SM-N986J_REV06 (board-id,9)";
	compatible = "qcom,kona-mtp", "qcom,kona", "qcom,mtp";
	qcom,board-id = <8 9>;
	dtbo-version = <0>;
};
