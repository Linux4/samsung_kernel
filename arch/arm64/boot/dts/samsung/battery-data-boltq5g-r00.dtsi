/* Copyright (c) 2014, The Linux Foundation. All rights reserved.
 *
 * This program is free software; you can redistribute it and/or modify
 * it under the terms of the GNU General Public License version 2 and
 * only version 2 as published by the Free Software Foundation.
 *
 * This program is distributed in the hope that it will be useful,
 * but WITHOUT ANY WARRANTY; without even the implied warranty of
 * MERCHANTABILITY or FITNESS FOR A PARTICULAR PURPOSE.  See the
 * GNU General Public License for more details.
 */

/* This dtsi is for hw rev 00*/
#include "battery-data-boltq5g-common.dtsi"

&pm8150l_vadc {
	/delete-node/ usb_thm;
};

&soc {
	battery {
		battery,temp_check_type = <3>; /* SEC_BATTERY_TEMP_CHECK_FAKE */
		battery,usb_temp_check_type = <3>;
		battery,chg_temp_check_type = <3>;
		battery,wpc_temp_check_type = <3>;
	};
};
