/* Copyright (c) 2013, The Linux Foundation. All rights reserved.
 *
 * This program is free software; you can redistribute it and/or modify
 * it under the terms of the GNU General Public License version 2 and
 * only version 2 as published by the Free Software Foundation.
 *
 * This program is distributed in the hope that it will be useful,
 * but WITHOUT ANY WARRANTY; without even the implied warranty of
 * MERCHANTABILITY or FITNESS FOR A PARTICULAR PURPOSE.  See the
 * GNU General Public License for more details.
 */

/*---------------------------------------------------------------------------
 * This file is autogenerated file using gcdb parser. Please do not edit it.
 * Update input XML file to add a new entry or update variable in this file
 * VERSION = "1.0"
 *---------------------------------------------------------------------------*/
&mdss_mdp {
	dsi_tm_ili7807g_hd_video: qcom,mdss_dsi_tm_ili7807g_hd_video {
		qcom,mdss-dsi-panel-name = "ili7807g 720p video mode dsi panel";
		qcom,mdss-dsi-panel-controller = <&mdss_dsi0>;
		qcom,mdss-dsi-panel-type = "dsi_video_mode";
		qcom,mdss-dsi-panel-destination = "display_1";
		qcom,mdss-dsi-panel-framerate = <60>;
		qcom,mdss-dsi-virtual-channel-id = <0>;
		qcom,mdss-dsi-init-master-time = <50000>;
		qcom,mdss-dsi-stream = <0>;
		qcom,mdss-dsi-panel-width = <720>;
		qcom,mdss-dsi-panel-height = <1560>;
		qcom,mdss-dsi-h-front-porch = <340>;
		qcom,mdss-dsi-h-back-porch = <340>;
		qcom,mdss-dsi-h-pulse-width = <28>;
		qcom,mdss-dsi-h-sync-skew = <0>;
		qcom,mdss-dsi-v-back-porch = <6>;
		qcom,mdss-dsi-v-front-porch = <38>;
		qcom,mdss-dsi-v-pulse-width = <2>;
		qcom,mdss-dsi-h-left-border = <0>;
		qcom,mdss-dsi-h-right-border = <0>;
		qcom,mdss-dsi-v-top-border = <0>;
		qcom,mdss-dsi-v-bottom-border = <0>;
		qcom,mdss-dsi-bpp = <24>;
		qcom,mdss-dsi-color-order = "rgb_swap_rgb";
		qcom,mdss-dsi-underflow-color = <0xff>;
		qcom,mdss-dsi-border-color = <0>;
		qcom,bklt-dcs-ctrl-mode = <0>;
		qcom,mdss-dsi-on-command = [39 01 00 00 00 00 04 FF 78 07 02
					39 01 00 00 00 00 02 06 A6
					39 01 00 00 00 00 02 07 A6
					39 01 00 00 00 00 02 0F 28
					39 01 00 00 00 00 04 FF 78 07 05
					39 01 00 00 00 00 02 BC 60
					39 01 00 00 00 00 02 48 42
					39 01 00 00 00 00 02 49 42
					39 01 00 00 00 00 04 FF 78 07 06
					39 01 00 00 00 00 02 D6 67
					39 01 00 00 00 00 02 12 10
					39 01 00 00 00 00 02 13 49
					39 01 00 00 00 00 02 14 41
					39 01 00 00 00 00 02 15 06
					39 01 00 00 00 00 02 16 41
					39 01 00 00 00 00 02 17 47
					39 01 00 00 00 00 02 18 3A
					39 01 00 00 00 00 02 B4 CA
					39 01 00 00 00 00 02 B5 23
					39 01 00 00 00 00 04 FF 78 07 07
					39 01 00 00 00 00 02 06 90
					39 01 00 00 00 00 02 03 40
					39 01 00 00 00 00 04 FF 78 07 0E
					39 01 00 00 00 00 02 00 A3
					39 01 00 00 00 00 02 13 06
					39 01 00 00 00 00 02 47 80
					39 01 00 00 00 00 02 41 08
					39 01 00 00 00 00 02 43 6E
					39 01 00 00 00 00 02 B0 31
					39 01 00 00 00 00 02 B3 00
					39 01 00 00 00 00 02 B4 33
					39 01 00 00 00 00 02 BC 04
					39 01 00 00 00 00 02 BD FC
					39 01 00 00 00 00 02 D2 00
					39 01 00 00 00 00 02 D3 A8
					39 01 00 00 00 00 02 D4 00
					39 01 00 00 00 00 02 D5 A8
					39 01 00 00 00 00 02 D6 00
					39 01 00 00 00 00 02 D7 A8
					39 01 00 00 00 00 02 D8 00
					39 01 00 00 00 00 02 d9 A8
					39 01 00 00 00 00 02 e0 0B
					39 01 00 00 00 00 02 e1 00
					39 01 00 00 00 00 02 e2 05
					39 01 00 00 00 00 02 e3 23
					39 01 00 00 00 00 02 e4 04
					39 01 00 00 00 00 02 e5 04
					39 01 00 00 00 00 02 e6 00
					39 01 00 00 00 00 02 e7 05
					39 01 00 00 00 00 02 e8 00
					39 01 00 00 00 00 02 e9 02
					39 01 00 00 00 00 02 ea 07
					39 01 00 00 00 00 02 07 21
					39 01 00 00 00 00 02 4B 13
					39 01 00 00 00 00 04 FF 78 07 0C
					39 01 00 00 00 00 02 00 1F
					39 01 00 00 00 00 02 01 29
					39 01 00 00 00 00 02 02 22
					39 01 00 00 00 00 02 03 43
					39 01 00 00 00 00 02 04 24
					39 01 00 00 00 00 02 05 56
					39 01 00 00 00 00 02 06 21
					39 01 00 00 00 00 02 07 36
					39 01 00 00 00 00 02 08 1F
					39 01 00 00 00 00 02 09 28
					39 01 00 00 00 00 02 0A 20
					39 01 00 00 00 00 02 0B 2F
					39 01 00 00 00 00 02 0C 1E
					39 01 00 00 00 00 02 0D 22
					39 01 00 00 00 00 02 0E 23
					39 01 00 00 00 00 02 0F 50
					39 01 00 00 00 00 02 10 22
					39 01 00 00 00 00 02 11 49
					39 01 00 00 00 00 02 12 1E
					39 01 00 00 00 00 02 13 1B
					39 01 00 00 00 00 02 14 20
					39 01 00 00 00 00 02 15 35
					39 01 00 00 00 00 02 16 23
					39 01 00 00 00 00 02 17 51
					39 01 00 00 00 00 02 18 1E
					39 01 00 00 00 00 02 19 1C
					39 01 00 00 00 00 02 1A 23
					39 01 00 00 00 00 02 1B 4A
					39 01 00 00 00 00 02 1C 21
					39 01 00 00 00 00 02 1D 3C
					39 01 00 00 00 00 02 1E 1E
					39 01 00 00 00 00 02 1F 15
					39 01 00 00 00 00 02 20 1F
					39 01 00 00 00 00 02 21 23
					39 01 00 00 00 00 02 22 22
					39 01 00 00 00 00 02 23 44
					39 01 00 00 00 00 02 24 20
					39 01 00 00 00 00 02 25 30
					39 01 00 00 00 00 02 26 21
					39 01 00 00 00 00 02 27 3D
					39 01 00 00 00 00 04 FF 78 07 03
					15 01 00 00 00 00 02 83 20
					15 01 00 00 00 00 02 84 00
					39 01 00 00 00 00 04 FF 78 07 06
					15 01 00 00 00 00 02 06 C4
					39 01 00 00 00 00 04 FF 78 07 00
					39 01 00 00 00 00 03 68 04 00
					39 01 00 00 00 00 03 51 00 00
					15 01 00 00 00 00 02 53 2C
					15 01 00 00 00 00 02 55 00
					15 01 00 00 50 00 02 11 00
					15 01 00 00 14 00 02 29 00];
		qcom,mdss-dsi-off-command = [39 01 00 00 00 00 04 FF 78 07 00
					05 01 00 00 32 00 02 28 00
					05 01 00 00 78 00 02 10 00];
		qcom,mdss-dsi-on-command-state = "dsi_lp_mode";
		qcom,mdss-dsi-off-command-state = "dsi_lp_mode";
		qcom,mdss-dsi-h-sync-pulse = <1>;
		qcom,mdss-dsi-traffic-mode = "burst_mode";
		qcom,mdss-dsi-lane-map = "lane_map_0123";
		qcom,mdss-dsi-bllp-eof-power-mode;
		qcom,mdss-dsi-bllp-power-mode;
		qcom,mdss-dsi-lane-0-state;
		qcom,mdss-dsi-lane-1-state;
		qcom,mdss-dsi-lane-2-state;
		qcom,mdss-dsi-panel-timings-phy-v2 = [
			26 21 09 0B 06 02 04 A0
			26 21 09 0B 06 02 04 A0
			26 21 09 0B 06 02 04 A0
			26 21 09 0B 06 02 04 A0
			26 20 0A 0B 06 02 04 A0];
		qcom,mdss-dsi-t-clk-post = <0x0F>;
		qcom,mdss-dsi-t-clk-pre = <0x37>;
		qcom,mdss-dsi-bl-min-level = <1>;
		qcom,mdss-dsi-bl-max-level = <4095>;
		qcom,esd-check-enabled;
		qcom,mdss-dsi-panel-status-command = [14 01 00 01 05 00 01 0A];
		qcom,mdss-dsi-panel-status-command-state = "dsi_lp_mode";
		qcom,mdss-dsi-panel-status-check-mode = "reg_read";
		qcom,mdss-dsi-panel-status-read-length = <1>;
		qcom,mdss-dsi-panel-max-error-count = <2>;
		qcom,mdss-dsi-panel-status-value = <0x9C>;
		qcom,mdss-dsi-dma-trigger = "trigger_sw";
		qcom,mdss-dsi-mdp-trigger = "none";
		qcom,mdss-dsi-bl-pmic-control-type = "bl_ctrl_dcs";
		qcom,panel-supply-entries = <&dsi_panel_pwr_supply>;
		qcom,mdss-dsi-reset-sequence = <1 4>, <0 5>, <1 10>;
		qcom,mdss-dsi-lp11-init;
		qcom,mdss-dsi-reset-delay-vsp-ms = <1>;
		qcom,mdss-dsi-reset-keephigh;
	};
};
