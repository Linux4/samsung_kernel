/* Copyright (c) 2013, The Linux Foundation. All rights reserved.
 *
 * This program is free software; you can redistribute it and/or modify
 * it under the terms of the GNU General Public License version 2 and
 * only version 2 as published by the Free Software Foundation.
 *
 * This program is distributed in the hope that it will be useful,
 * but WITHOUT ANY WARRANTY; without even the implied warranty of
 * MERCHANTABILITY or FITNESS FOR A PARTICULAR PURPOSE.  See the
 * GNU General Public License for more details.
 */

/*---------------------------------------------------------------------------
 * This file is autogenerated file using gcdb parser. Please do not edit it.
 * Update input XML file to add a new entry or update variable in this file
 * VERSION = "1.0"
 *---------------------------------------------------------------------------*/
&mdss_mdp {
	dsi_boe_ft8165_720p_video: qcom,mdss_dsi_boe_ft8165_720p_video {
		qcom,mdss-dsi-panel-name = "boe ft8165 720p video mode dsi panel";
		qcom,mdss-dsi-panel-controller = <&mdss_dsi0>;
		qcom,mdss-dsi-panel-type = "dsi_video_mode";
		qcom,mdss-dsi-panel-destination = "display_1";
		qcom,mdss-dsi-panel-framerate = <60>;
		qcom,mdss-dsi-virtual-channel-id = <0>;
		qcom,mdss-dsi-stream = <0>;
		qcom,mdss-dsi-panel-width = <720>;
		qcom,mdss-dsi-panel-height = <1560>;
		qcom,mdss-dsi-h-front-porch = <306>;
		qcom,mdss-dsi-h-back-porch = <300>;
		qcom,mdss-dsi-h-pulse-width = <6>;
		qcom,mdss-dsi-h-sync-skew = <0>;
		qcom,mdss-dsi-v-back-porch = <21>;
		qcom,mdss-dsi-v-front-porch = <120>;
		qcom,mdss-dsi-v-pulse-width = <20>;
		qcom,mdss-dsi-h-left-border = <0>;
		qcom,mdss-dsi-h-right-border = <0>;
		qcom,mdss-dsi-v-top-border = <0>;
		qcom,mdss-dsi-v-bottom-border = <0>;
		qcom,mdss-dsi-bpp = <24>;
		qcom,mdss-dsi-color-order = "rgb_swap_rgb";
		qcom,mdss-dsi-underflow-color = <0xff>;
		qcom,mdss-dsi-border-color = <0>;
		qcom,bklt-dcs-ctrl-mode = <1>;
		qcom,mdss-dsi-on-command = [29 01 00 00 00 00 02 00 00
				29 01 00 00 00 00 04 FF 87 19 01
				29 01 00 00 00 00 02 00 80
				29 01 00 00 00 00 03 FF 87 19
				29 01 00 00 00 00 02 00 90
				29 01 00 00 00 00 02 FF A0
				29 01 00 00 00 00 02 00 A1
				29 01 00 00 00 00 05 B3 02 D0 06 18
				29 01 00 00 00 00 02 00 A5
				29 01 00 00 00 00 02 B3 40
				29 01 00 00 00 00 02 00 A6
				29 01 00 00 00 00 02 B3 F8
				29 01 00 00 00 00 02 00 85
				29 01 00 00 00 00 02 A7 03
				29 01 00 00 00 00 02 00 D0
				29 01 00 00 00 00 02 C3 46
				29 01 00 00 00 00 02 00 D3
				29 01 00 00 00 00 02 C3 30
				29 01 00 00 00 00 02 00 D4
				29 01 00 00 00 00 02 C3 46
				29 01 00 00 00 00 02 00 D7
				29 01 00 00 00 00 02 C3 30
				29 01 00 00 00 00 02 00 D8
				29 01 00 00 00 00 02 C3 46
				29 01 00 00 00 00 02 00 DB
				29 01 00 00 00 00 02 C3 30
				29 01 00 00 00 00 02 00 CA
				29 01 00 00 00 00 02 C0 80
				29 01 00 00 00 00 02 00 80
				29 01 00 00 00 00 11 C2 83 01 01 81 82 01 01 81 82 00 01 81 81 00 01 81
				29 01 00 00 00 00 02 00 90
				29 01 00 00 00 00 11 C2 80 00 01 81 01 00 01 81 02 00 01 81 03 00 01 81
				29 01 00 00 00 00 02 00 A0
				29 01 00 00 00 00 10 C2 8A 0A 00 01 8C 89 0A 00 01 8C 88 0A 00 01 8C
				29 01 00 00 00 00 02 00 B0
				29 01 00 00 00 00 10 C2 87 0A 00 01 8C 00 00 00 01 81 00 00 00 01 81
				29 01 00 00 00 00 02 00 C0
				29 01 00 00 00 00 10 C2 00 00 00 01 81 00 00 00 01 81 00 00 00 01 81
				29 01 00 00 00 00 02 00 D0
				29 01 00 00 00 00 10 C2 00 00 00 01 81 00 00 00 01 81 00 00 00 01 81
				29 01 00 00 00 00 02 00 E0
				29 01 00 00 00 00 0F C2 33 33 33 33 33 33 00 00 12 00 0A 50 01 81
				29 01 00 00 00 00 02 00 F0
				29 01 00 00 00 00 0F C2 80 00 50 05 11 80 00 50 05 11 FF FF FF 01
				29 01 00 00 00 00 02 00 80
				29 01 00 00 00 00 11 CB FD FD FC 01 FD 01 01 FD FE 02 FD 01 FD FD 01 01
				29 01 00 00 00 00 02 00 90
				29 01 00 00 00 00 11 CB FF 00 00 00 FF 00 00 00 FF 00 00 00 00 00 00 00
				29 01 00 00 00 00 02 00 A0
				29 01 00 00 00 00 05 CB 00 00 00 00
				29 01 00 00 00 00 02 00 B0
				29 01 00 00 00 00 05 CB 51 55 A5 55
				29 01 00 00 00 00 02 00 E0
				29 01 00 00 00 00 02 C3 35
				29 01 00 00 00 00 02 00 E4
				29 01 00 00 00 00 02 C3 35
				29 01 00 00 00 00 02 00 E8
				29 01 00 00 00 00 02 C3 35
				29 01 00 00 00 00 02 00 80
				29 01 00 00 00 00 11 CC 00 00 00 00 00 00 00 00 26 29 24 04 04 18 17 16
				29 01 00 00 00 00 02 00 90
				29 01 00 00 00 00 09 CC 07 09 01 25 25 22 24 03
				29 01 00 00 00 00 02 00 80
				29 01 00 00 00 00 11 CD 00 00 00 00 00 00 00 00 26 29 24 04 04 18 17 16
				29 01 00 00 00 00 02 00 90
				29 01 00 00 00 00 09 CD 06 08 01 25 25 22 24 02
				29 01 00 00 00 00 02 00 A0
				29 01 00 00 00 00 11 CC 00 00 00 00 00 00 00 00 26 29 24 04 04 18 17 16
				29 01 00 00 00 00 02 00 B0
				29 01 00 00 00 00 09 CC 08 06 01 25 25 24 23 02
				29 01 00 00 00 00 02 00 A0
				29 01 00 00 00 00 11 CD 00 00 00 00 00 00 00 00 26 29 24 04 04 18 17 16
				29 01 00 00 00 00 02 00 B0
				29 01 00 00 00 00 09 CD 09 07 01 25 25 24 23 03
				29 01 00 00 00 00 02 00 80
				29 01 00 00 00 00 07 C0 00 B0 00 50 00 10
				29 01 00 00 00 00 02 00 A0
				29 01 00 00 00 00 07 C0 01 7D 00 2D 00 10
				29 01 00 00 00 00 02 00 B0
				29 01 00 00 00 00 06 C0 00 B0 01 AF 10
				29 01 00 00 00 00 02 00 C1
				29 01 00 00 00 00 09 C0 00 FA 00 C5 00 A7 01 27
				29 01 00 00 00 00 02 00 D7
				29 01 00 00 00 00 07 C0 00 A7 00 53 00 10
				29 01 00 00 00 00 02 00 A5
				29 01 00 00 00 00 05 C1 00 37 00 02
				29 01 00 00 00 00 02 00 82
				29 01 00 00 00 00 0E CE 01 09 00 90 00 90 00 60 00 60 0D 0E 09
				29 01 00 00 00 00 02 00 90
				29 01 00 00 00 00 09 CE 00 82 0D 5C 00 82 80 09
				29 01 00 00 00 00 02 00 A0
				29 01 00 00 00 00 04 CE 00 00 00
				29 01 00 00 00 00 02 00 B0
				29 01 00 00 00 00 04 CE 11 00 00
				29 01 00 00 00 00 02 00 D1
				29 01 00 00 00 00 08 CE 00 0A 01 01 00 41 01
				29 01 00 00 00 00 02 00 E1
				29 01 00 00 00 00 0C CE 08 02 15 02 15 02 15 00 1E 00 44
				29 01 00 00 00 00 02 00 F1
				29 01 00 00 00 00 0A CE 0F 07 0A 01 43 02 10 01 CE
				29 01 00 00 00 00 02 00 B0
				29 01 00 00 00 00 05 CF 00 00 48 4C
				29 01 00 00 00 00 02 00 B5
				29 01 00 00 00 00 05 CF 03 03 18 1C
				29 01 00 00 00 00 02 00 C0
				29 01 00 00 00 00 05 CF 05 05 DC E0
				29 01 00 00 00 00 02 00 C5
				29 01 00 00 00 00 05 CF 00 00 08 0C
				29 01 00 00 00 00 02 00 90
				29 01 00 00 00 00 07 C0 00 B0 00 50 00 10
				29 01 00 00 00 00 02 00 82
				29 01 00 00 00 00 02 CF 06
				29 01 00 00 00 00 02 00 84
				29 01 00 00 00 00 02 CF 06
				29 01 00 00 00 00 02 00 87
				29 01 00 00 00 00 02 CF 06
				29 01 00 00 00 00 02 00 89
				29 01 00 00 00 00 02 CF 06
				29 01 00 00 00 00 02 00 8A
				29 01 00 00 00 00 02 CF 07
				29 01 00 00 00 00 02 00 8B
				29 01 00 00 00 00 02 CF 00
				29 01 00 00 00 00 02 00 8C
				29 01 00 00 00 00 02 CF 06
				29 01 00 00 00 00 02 00 92
				29 01 00 00 00 00 02 CF 06
				29 01 00 00 00 00 02 00 94
				29 01 00 00 00 00 02 CF 06
				29 01 00 00 00 00 02 00 97
				29 01 00 00 00 00 02 CF 06
				29 01 00 00 00 00 02 00 99
				29 01 00 00 00 00 02 CF 06
				29 01 00 00 00 00 02 00 9A
				29 01 00 00 00 00 02 CF 07
				29 01 00 00 00 00 02 00 9B
				29 01 00 00 00 00 02 CF 00
				29 01 00 00 00 00 02 00 9C
				29 01 00 00 00 00 02 CF 06
				29 01 00 00 00 00 02 00 A0
				29 01 00 00 00 00 02 CF 24
				29 01 00 00 00 00 02 00 A2
				29 01 00 00 00 00 02 CF 06
				29 01 00 00 00 00 02 00 A4
				29 01 00 00 00 00 02 CF 06
				29 01 00 00 00 00 02 00 A7
				29 01 00 00 00 00 02 CF 06
				29 01 00 00 00 00 02 00 A9
				29 01 00 00 00 00 02 CF 06
				29 01 00 00 00 00 02 00 87
				29 01 00 00 00 00 02 A4 0F
				29 01 00 00 00 00 02 00 89
				29 01 00 00 00 00 02 A4 0F
				29 01 00 00 00 00 02 00 8D
				29 01 00 00 00 00 02 A4 0F
				29 01 00 00 00 00 02 00 8F
				29 01 00 00 00 00 02 A4 0F
				29 01 00 00 00 00 02 00 85
				29 01 00 00 00 00 02 A7 00
				29 01 00 00 00 00 02 00 E8
				29 01 00 00 00 00 02 C0 40
				29 01 00 00 00 00 02 00 85
				29 01 00 00 00 00 02 C4 1E
				29 01 00 00 00 00 02 00 00
        			29 01 00 00 00 00 29 E1 00 01 05 0C 28 19 22 29 33 92 3B 42 48 4D EB 52 5A 62 69 B6 70 77 7F 88 B9 92 98 9E A6 48 AE B9 C7 D1 FD DA EB F7 FF 9B
				29 01 00 00 00 00 02 00 00
				29 01 00 00 00 00 29 E2 00 01 05 0B 2B 16 1D 24 2E 62 36 3D 43 48 EB 4D 55 5D 64 B6 6B 71 79 82 B9 8C 92 98 A0 48 A8 B3 C1 CB FD D9 EB F7 FF DB
				29 01 00 00 00 00 02 00 00
				29 01 00 00 00 00 29 E3 00 01 05 0C 28 19 22 29 33 92 3B 42 48 4D EB 52 5A 62 69 B6 70 77 7F 88 B9 92 98 9E A6 48 AE B9 C7 D1 FD DA EB F7 FF 9B
				29 01 00 00 00 00 02 00 00
				29 01 00 00 00 00 29 E4 00 01 05 0B 2B 16 1D 24 2E 62 36 3D 43 48 EB 4D 55 5D 64 B6 6B 71 79 82 B9 8C 92 98 A0 48 A8 B3 C1 CB FD D9 EB F7 FF DB
				29 01 00 00 00 00 02 00 00
				29 01 00 00 00 00 29 E5 00 01 05 0C 28 19 22 29 33 92 3B 42 48 4D EB 52 5A 62 69 B6 70 77 7F 88 B9 92 98 9E A6 48 AE B9 C7 D1 FD DA EB F7 FF 9B
				29 01 00 00 00 00 02 00 00
				29 01 00 00 00 00 29 E6 00 01 05 0B 2B 16 1D 24 2E 62 36 3D 43 48 EB 4D 55 5D 64 B6 6B 71 79 82 B9 8C 92 98 A0 48 A8 B3 C1 CB FD D9 EB F7 FF DB
				29 01 00 00 00 00 02 00 82
				29 01 00 00 00 00 03 C5 50 50
				29 01 00 00 00 00 02 00 84
				29 01 00 00 00 00 04 C5 32 32 60
				29 01 00 00 00 00 02 00 87
				29 01 00 00 00 00 03 C5 60 0C
				29 01 00 00 00 00 02 00 00
				29 01 00 00 00 00 03 D8 29 29
				29 01 00 00 00 00 02 00 A3
				29 01 00 00 00 00 02 C5 19
				29 01 00 00 00 00 02 00 A9
				29 01 00 00 00 00 02 C5 23
				29 01 00 00 00 00 02 00 80
				29 01 00 00 00 00 02 A4 70
				29 01 00 00 00 00 02 00 80
				29 01 00 00 00 00 03 C5 86 86
				29 01 00 00 00 00 02 00 80
				29 01 00 00 00 00 02 A7 03
				29 01 00 00 00 00 02 00 8C
				29 01 00 00 00 00 04 C3 03 00 30
				29 01 00 00 00 00 02 00 B0
				29 01 00 00 00 00 02 F5 00
				29 01 00 00 00 00 02 00 82
				29 01 00 00 00 00 03 A4 29 23
				29 01 00 00 00 00 02 00 89
				29 01 00 00 00 00 04 C0 03 2A 05
				29 01 00 00 00 00 02 00 B0
				29 01 00 00 00 00 03 F3 15 EA
				29 01 00 00 00 00 02 00 CB
				29 01 00 00 00 00 02 C0 19
				29 01 00 00 00 00 02 00 B0
				29 01 00 00 00 00 02 CA 01
				29 01 00 00 00 00 02 00 B2
				29 01 00 00 00 00 02 CA 0C
				29 01 00 00 00 00 02 00 B5
				29 01 00 00 00 00 02 CA 04
				39 01 00 00 00 00 02 00 00
				39 01 00 00 00 00 04 FF 00 00 00
				39 01 00 00 00 00 02 00 80
				39 01 00 00 00 00 03 FF 00 00 //CMD2 Disable
				05 01 00 00 5A 00 01 11
				05 01 00 00 05 00 01 29
				29 01 00 00 00 00 03 51 00 00
				29 01 00 00 00 00 02 53 2C
				29 01 00 00 00 00 02 55 00
				29 01 00 00 14 00 02 35 00
				];
		qcom,mdss-dsi-off-command = [
					05 01 00 00 14 00 01 28
					05 01 00 00 C8 00 01 10
					29 01 00 00 00 00 02 00 00
					29 01 00 00 00 00 05 F7 5A A5 95 27
					39 01 00 00 00 00 02 00 00
					39 01 00 00 00 00 04 FF 87 19 01
					39 01 00 00 00 00 02 00 80
					39 01 00 00 00 00 03 FF 87 19//cmd2 enable
					39 01 00 00 00 00 02 00 00
					39 01 00 00 00 00 04 FF 00 00 00
					];
		qcom,mdss-dsi-on-command-state = "dsi_lp_mode";
		qcom,mdss-dsi-off-command-state = "dsi_lp_mode";
		qcom,mdss-dsi-h-sync-pulse = <1>;
		qcom,mdss-dsi-traffic-mode = "burst_mode";
		qcom,mdss-dsi-lane-map = "lane_map_0123";
		qcom,mdss-dsi-bllp-eof-power-mode;
		qcom,mdss-dsi-bllp-power-mode;
		qcom,mdss-dsi-lane-0-state;
		qcom,mdss-dsi-lane-1-state;
		qcom,mdss-dsi-lane-2-state;
		//qcom,mdss-dsi-lane-3-state;
		qcom,mdss-dsi-panel-timings-phy-v2 = [
			26 21 09 0B 06 02 04 a0
			26 21 09 0B 06 02 04 a0
			26 21 09 0B 06 02 04 a0
			26 21 09 0B 06 02 04 a0
			26 20 0A 0B 06 02 04 a0];
		qcom,mdss-dsi-t-clk-post = <0x0f>;
		qcom,mdss-dsi-t-clk-pre = <0x37>;
		qcom,mdss-dsi-bl-min-level = <1>;
		qcom,mdss-dsi-bl-max-level = <4095>;
		qcom,mdss-dsi-lp11-init;
		qcom,mdss-dsi-init-delay-us = <20000>;
		qcom,esd-check-enabled;
		qcom,mdss-dsi-panel-status-command = [14 01 00 01 00 00 01 0A
				14 01 00 01 00 00 01 0D
				14 01 00 01 00 00 01 0E
				14 01 00 01 05 00 01 AC];
		qcom,mdss-dsi-panel-status-command-state = "dsi_lp_mode";
		qcom,mdss-dsi-panel-status-check-mode = "reg_read";
		qcom,mdss-dsi-panel-status-read-length = <1 1 1 1>;
		qcom,mdss-dsi-panel-max-error-count = <4>;
		qcom,mdss-dsi-panel-status-value = <0x9C>,<0x00>,<0x80>,<0x20>;
		qcom,mdss-dsi-dma-trigger = "trigger_sw";
		qcom,mdss-dsi-mdp-trigger = "none";
		qcom,mdss-dsi-bl-pmic-control-type = "bl_ctrl_dcs";
		qcom,panel-supply-entries = <&dsi_panel_pwr_supply>;
		qcom,mdss-dsi-reset-sequence = <1 5>, <0 1>, <1 12>;
		qcom,mdss-dsi-reset-delay-vsp-ms = <4>;
		qcom,mdss-dsi-reset-keephigh;
		qcom,ulps-enabled;
		qcom,suspend-ulps-enabled;
	};
};
