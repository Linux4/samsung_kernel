/* Copyright (c) 2013, The Linux Foundation. All rights reserved.
 *
 * This program is free software; you can redistribute it and/or modify
 * it under the terms of the GNU General Public License version 2 and
 * only version 2 as published by the Free Software Foundation.
 *
 * This program is distributed in the hope that it will be useful,
 * but WITHOUT ANY WARRANTY; without even the implied warranty of
 * MERCHANTABILITY or FITNESS FOR A PARTICULAR PURPOSE.  See the
 * GNU General Public License for more details.
 */

/*---------------------------------------------------------------------------
 * This file is autogenerated file using gcdb parser. Please do not edit it.
 * Update input XML file to add a new entry or update variable in this file
 * VERSION = "1.0"
 *---------------------------------------------------------------------------*/
&mdss_mdp {
	dsi_txd12_ili7807g_hd_video: qcom,mdss_dsi_txd12_ili7807g_hd_video {
		qcom,mdss-dsi-panel-name = "txd12 ili7807g hd video mode dsi panel";
		qcom,mdss-dsi-panel-controller = <&mdss_dsi0>;
		qcom,mdss-dsi-panel-type = "dsi_video_mode";
		qcom,mdss-dsi-panel-destination = "display_1";
		qcom,mdss-dsi-panel-framerate = <60>;
		qcom,mdss-dsi-virtual-channel-id = <0>;
		qcom,mdss-dsi-stream = <0>;
		qcom,mdss-dsi-panel-width = <720>;
		qcom,mdss-dsi-panel-height = <1560>;
		qcom,mdss-dsi-h-front-porch = <340>;
		qcom,mdss-dsi-h-back-porch = <340>;
		qcom,mdss-dsi-h-pulse-width = <12>;
		qcom,mdss-dsi-h-sync-skew = <0>;
		qcom,mdss-dsi-v-back-porch = <16>;
		qcom,mdss-dsi-v-front-porch = <32>;
		qcom,mdss-dsi-v-pulse-width = <2>;
		qcom,mdss-dsi-h-left-border = <0>;
		qcom,mdss-dsi-h-right-border = <0>;
		qcom,mdss-dsi-v-top-border = <0>;
		qcom,mdss-dsi-v-bottom-border = <0>;
		qcom,mdss-dsi-bpp = <24>;
		qcom,mdss-dsi-color-order = "rgb_swap_rgb";
		qcom,mdss-dsi-underflow-color = <0xff>;
		qcom,mdss-dsi-border-color = <0>;
		qcom,bklt-dcs-ctrl-mode = <0>;
		qcom,mdss-dsi-on-command = [
					39 01 00 00 00 00 04 FF 78 07 01
					39 01 00 00 00 00 02 00 42
					39 01 00 00 00 00 02 01 51
					39 01 00 00 00 00 02 02 00
					39 01 00 00 00 00 02 03 9F
					39 01 00 00 00 00 02 04 00
					39 01 00 00 00 00 02 05 00
					39 01 00 00 00 00 02 06 00
					39 01 00 00 00 00 02 07 00
					39 01 00 00 00 00 02 08 89
					39 01 00 00 00 00 02 09 0A
					39 01 00 00 00 00 02 0a 30
					39 01 00 00 00 00 02 0b 01
					39 01 00 00 00 00 02 0c 04
					39 01 00 00 00 00 02 0e 83
					39 01 00 00 00 00 02 31 07
					39 01 00 00 00 00 02 32 07
					39 01 00 00 00 00 02 33 07
					39 01 00 00 00 00 02 34 07
					39 01 00 00 00 00 02 35 07
					39 01 00 00 00 00 02 36 07
					39 01 00 00 00 00 02 37 07
					39 01 00 00 00 00 02 38 07
					39 01 00 00 00 00 02 39 40
					39 01 00 00 00 00 02 3a 02
					39 01 00 00 00 00 02 3b 24
					39 01 00 00 00 00 02 3c 00
					39 01 00 00 00 00 02 3d 00
					39 01 00 00 00 00 02 3e 30
					39 01 00 00 00 00 02 3f 2F
					39 01 00 00 00 00 02 40 2E
					39 01 00 00 00 00 02 41 10
					39 01 00 00 00 00 02 42 12
					39 01 00 00 00 00 02 43 2D
					39 01 00 00 00 00 02 44 3D
					39 01 00 00 00 00 02 45 3D
					39 01 00 00 00 00 02 46 01
					39 01 00 00 00 00 02 47 24
					39 01 00 00 00 00 02 48 08
					39 01 00 00 00 00 02 49 07
					39 01 00 00 00 00 02 4a 07
					39 01 00 00 00 00 02 4b 07
					39 01 00 00 00 00 02 4c 07
					39 01 00 00 00 00 02 4d 07
					39 01 00 00 00 00 02 4e 07
					39 01 00 00 00 00 02 4f 07
					39 01 00 00 00 00 02 50 07
					39 01 00 00 00 00 02 51 40
					39 01 00 00 00 00 02 52 02
					39 01 00 00 00 00 02 53 24
					39 01 00 00 00 00 02 54 00
					39 01 00 00 00 00 02 55 00
					39 01 00 00 00 00 02 56 30
					39 01 00 00 00 00 02 57 2F
					39 01 00 00 00 00 02 58 2E
					39 01 00 00 00 00 02 59 11
					39 01 00 00 00 00 02 5a 13
					39 01 00 00 00 00 02 5b 2D
					39 01 00 00 00 00 02 5c 3D
					39 01 00 00 00 00 02 5d 3D
					39 01 00 00 00 00 02 5e 01
					39 01 00 00 00 00 02 5f 24
					39 01 00 00 00 00 02 60 09
					39 01 00 00 00 00 02 61 07
					39 01 00 00 00 00 02 62 07
					39 01 00 00 00 00 02 63 07
					39 01 00 00 00 00 02 64 07
					39 01 00 00 00 00 02 65 07
					39 01 00 00 00 00 02 66 07
					39 01 00 00 00 00 02 67 07
					39 01 00 00 00 00 02 68 07
					39 01 00 00 00 00 02 69 40
					39 01 00 00 00 00 02 6a 02
					39 01 00 00 00 00 02 6b 24
					39 01 00 00 00 00 02 6c 01
					39 01 00 00 00 00 02 6d 01
					39 01 00 00 00 00 02 6e 30
					39 01 00 00 00 00 02 6f 2F
					39 01 00 00 00 00 02 70 2E
					39 01 00 00 00 00 02 71 13
					39 01 00 00 00 00 02 72 11
					39 01 00 00 00 00 02 73 2D
					39 01 00 00 00 00 02 74 3D
					39 01 00 00 00 00 02 75 3D
					39 01 00 00 00 00 02 76 24
					39 01 00 00 00 00 02 77 00
					39 01 00 00 00 00 02 78 09
					39 01 00 00 00 00 02 79 07
					39 01 00 00 00 00 02 7a 07
					39 01 00 00 00 00 02 7b 07
					39 01 00 00 00 00 02 7c 07
					39 01 00 00 00 00 02 7d 07
					39 01 00 00 00 00 02 7e 07
					39 01 00 00 00 00 02 7f 07
					39 01 00 00 00 00 02 80 07
					39 01 00 00 00 00 02 81 40
					39 01 00 00 00 00 02 82 02
					39 01 00 00 00 00 02 83 24
					39 01 00 00 00 00 02 84 01
					39 01 00 00 00 00 02 85 01
					39 01 00 00 00 00 02 86 30
					39 01 00 00 00 00 02 87 2F
					39 01 00 00 00 00 02 88 2E
					39 01 00 00 00 00 02 89 12
					39 01 00 00 00 00 02 8a 10
					39 01 00 00 00 00 02 8b 2D
					39 01 00 00 00 00 02 8c 3D
					39 01 00 00 00 00 02 8d 3D
					39 01 00 00 00 00 02 8e 24
					39 01 00 00 00 00 02 8f 00
					39 01 00 00 00 00 02 90 08
					39 01 00 00 00 00 02 92 10
					39 01 00 00 00 00 02 A2 4C
					39 01 00 00 00 00 02 A3 49
					39 01 00 00 00 00 02 A7 10
					39 01 00 00 00 00 02 B0 20
					39 01 00 00 00 00 02 C6 64
					39 01 00 00 00 00 02 C7 00
					39 01 00 00 00 00 02 D1 12
					39 01 00 00 00 00 02 D2 10
					39 01 00 00 00 00 02 D4 04
					39 01 00 00 00 00 02 D5 01
					39 01 00 00 00 00 02 D9 04
					39 01 00 00 00 00 02 D8 40
					39 01 00 00 00 00 02 DF 4A
					39 01 00 00 00 00 02 DE 02
					39 01 00 00 00 00 02 DD 08
					39 01 00 00 00 00 02 E0 40
					39 01 00 00 00 00 02 E1 28
					39 01 00 00 00 00 02 E2 02
					39 01 00 00 00 00 02 E3 35
					39 01 00 00 00 00 02 E4 02
					39 01 00 00 00 00 02 E5 0D
					39 01 00 00 00 00 02 E6 12
					39 01 00 00 00 00 02 E7 B4
					39 01 00 00 00 00 02 ED FC
					39 01 00 00 00 00 04 FF 78 07 02
					39 01 00 00 00 00 02 01 35
					39 01 00 00 00 00 02 06 A6
					39 01 00 00 00 00 02 07 A6
					39 01 00 00 00 00 02 0F 28
					39 01 00 00 00 00 02 78 26
					39 01 00 00 00 00 02 40 0B
					39 01 00 00 00 00 02 41 00
					39 01 00 00 00 00 02 42 08
					39 01 00 00 00 00 02 43 20
					39 01 00 00 00 00 02 46 11
					39 01 00 00 00 00 02 47 02
					39 01 00 00 00 00 02 53 04
					39 01 00 00 00 00 04 FF 78 07 05
					39 01 00 00 00 00 02 27 44
					39 01 00 00 00 00 02 28 54
					39 01 00 00 00 00 02 2B 08
					39 01 00 00 00 00 02 A0 44
					39 01 00 00 00 00 02 A2 54
					39 01 00 00 00 00 02 03 00
					39 01 00 00 00 00 02 04 85
					39 01 00 00 00 00 02 48 42
					39 01 00 00 00 00 02 49 42
					39 01 00 00 00 00 02 63 79
					39 01 00 00 00 00 02 64 79
					39 01 00 00 00 00 02 69 56
					39 01 00 00 00 00 02 6B 56
					39 01 00 00 00 00 02 68 51
					39 01 00 00 00 00 02 6A 51
					39 01 00 00 00 00 04 FF 78 07 06
					39 01 00 00 00 00 02 D6 67
					39 01 00 00 00 00 02 2E 01
					39 01 00 00 00 00 02 C0 0B
					39 01 00 00 00 00 02 C1 03
					39 01 00 00 00 00 02 C2 07
					39 01 00 00 00 00 02 C3 06
					39 01 00 00 00 00 02 DD 10
					39 01 00 00 00 00 02 7C 40
					39 01 00 00 00 00 02 11 03
					39 01 00 00 00 00 02 12 10
					39 01 00 00 00 00 02 13 39
					39 01 00 00 00 00 02 14 41
					39 01 00 00 00 00 02 15 F6
					39 01 00 00 00 00 02 16 40
					39 01 00 00 00 00 02 17 47
					39 01 00 00 00 00 02 18 3A
					39 01 00 00 00 00 02 1D 4B
					39 01 00 00 00 00 02 1E 03
					39 01 00 00 00 00 02 B4 D6
					39 01 00 00 00 00 02 B5 15
					39 01 00 00 00 00 04 FF 78 07 07
					39 01 00 00 00 00 02 03 40
					39 01 00 00 00 00 02 06 90
					39 01 00 00 00 00 04 FF 78 07 08
					39 01 00 00 00 00 29 E0 00 30 48 71 00 92 AB C2 00 D5 E8 F9 15 2F 57 94 29 C3 09 43 2A 45 7A B7 3E DD 10 30 3F 58 65 73 3F 82 93 A6 3F BA CD CF
					39 01 00 00 00 00 29 E1 00 30 48 71 00 92 AB C2 00 D5 E8 F9 15 2F 57 94 29 C3 09 43 2A 45 7A B7 3E DD 10 30 3F 58 65 73 3F 82 93 A6 3F BA CD CF
					39 01 00 00 00 00 04 FF 78 07 09
					39 01 00 00 00 00 29 E0 00 30 49 71 00 93 AC C1 00 D5 E8 F8 15 2E 56 93 29 C2 08 42 2A 43 78 B6 3E DC 0F 2F 3F 57 64 72 3F 81 92 A6 3F BD CD CF
					39 01 00 00 00 00 29 E1 00 30 49 71 00 93 AC C1 00 D5 E8 F8 15 2E 56 93 29 C2 08 42 2A 43 78 B6 3E DC 0F 2F 3F 57 64 72 3F 81 92 A6 3F BD CD CF
					39 01 00 00 00 00 04 FF 78 07 0A
					39 01 00 00 00 00 29 E0 00 30 4D 7B 00 9A B5 CC 10 E1 F3 04 15 38 5E 9C 29 C9 0D 47 2A 48 7D BA 3E DF 12 32 3F 5A 67 74 3F 84 95 A8 3F C2 CE CF
					39 01 00 00 00 00 29 E1 00 30 4D 7B 00 9A B5 CC 10 E1 F3 04 15 38 5E 9C 29 C9 0D 47 2A 48 7D BA 3E DF 12 32 3F 5A 67 74 3F 84 95 A8 3F C2 CE CF
					39 01 00 00 00 00 04 FF 78 07 0E
					39 01 00 00 00 00 02 02 0D
					39 01 00 00 00 00 02 00 A3
					39 01 00 00 00 00 02 13 0B
					39 01 00 00 00 00 02 4D 8C
					39 01 00 00 00 00 02 47 80
					39 01 00 00 00 00 02 41 08
					39 01 00 00 00 00 02 43 6E
					39 01 00 00 00 00 02 49 82
					39 01 00 00 00 00 02 B0 31
					39 01 00 00 00 00 02 B1 8D
					39 01 00 00 00 00 02 B3 00
					39 01 00 00 00 00 02 B4 33
					39 01 00 00 00 00 02 45 09
					39 01 00 00 00 00 02 46 B1
					39 01 00 00 00 00 02 BC 04
					39 01 00 00 00 00 02 BD FC
					39 01 00 00 00 00 02 C0 34
					39 01 00 00 00 00 02 C6 8D
					39 01 00 00 00 00 02 C7 8D
					39 01 00 00 00 00 02 C8 8D
					39 01 00 00 00 00 02 C9 8D
					39 01 00 00 00 00 02 e0 0B
					39 01 00 00 00 00 02 e1 00
					39 01 00 00 00 00 02 e2 08
					39 01 00 00 00 00 02 e3 20
					39 01 00 00 00 00 02 e4 04
					39 01 00 00 00 00 02 e5 04
					39 01 00 00 00 00 02 e6 00
					39 01 00 00 00 00 02 07 20
					39 01 00 00 00 00 02 4B 13
					39 01 00 00 00 00 04 FF 78 07 0C
					39 01 00 00 00 00 02 00 1F
					39 01 00 00 00 00 02 01 29
					39 01 00 00 00 00 02 02 22
					39 01 00 00 00 00 02 03 43
					39 01 00 00 00 00 02 04 24
					39 01 00 00 00 00 02 05 56
					39 01 00 00 00 00 02 06 21
					39 01 00 00 00 00 02 07 36
					39 01 00 00 00 00 02 08 1F
					39 01 00 00 00 00 02 09 28
					39 01 00 00 00 00 02 0A 20
					39 01 00 00 00 00 02 0B 2F
					39 01 00 00 00 00 02 0C 1E
					39 01 00 00 00 00 02 0D 22
					39 01 00 00 00 00 02 0E 23
					39 01 00 00 00 00 02 0F 50
					39 01 00 00 00 00 02 10 22
					39 01 00 00 00 00 02 11 49
					39 01 00 00 00 00 02 12 1E
					39 01 00 00 00 00 02 13 1B
					39 01 00 00 00 00 02 14 20
					39 01 00 00 00 00 02 15 35
					39 01 00 00 00 00 02 16 23
					39 01 00 00 00 00 02 17 51
					39 01 00 00 00 00 02 18 1E
					39 01 00 00 00 00 02 19 1C
					39 01 00 00 00 00 02 1A 23
					39 01 00 00 00 00 02 1B 4A
					39 01 00 00 00 00 02 1C 21
					39 01 00 00 00 00 02 1D 3C
					39 01 00 00 00 00 02 1E 1E
					39 01 00 00 00 00 02 1F 15
					39 01 00 00 00 00 02 20 1F
					39 01 00 00 00 00 02 21 23
					39 01 00 00 00 00 02 22 22
					39 01 00 00 00 00 02 23 44
					39 01 00 00 00 00 02 24 20
					39 01 00 00 00 00 02 25 30
					39 01 00 00 00 00 02 26 21
					39 01 00 00 00 00 02 27 3D
					39 01 00 00 00 00 04 FF 78 07 06
					15 01 00 00 00 00 02 06 c4
					39 01 00 00 00 00 04 FF 78 07 03
					15 01 00 00 00 00 02 83 20
					15 01 00 00 00 00 02 84 00
					39 01 00 00 00 00 04 FF 78 07 00
					39 01 00 00 00 00 03 68 04 00
					39 01 00 00 00 00 03 51 00 00
					15 01 00 00 00 00 02 53 2C
					15 01 00 00 00 00 02 55 00
					15 01 00 00 50 00 02 11 00
					15 01 00 00 14 00 02 29 00];
		qcom,mdss-dsi-off-command = [39 01 00 00 00 00 04 FF 78 07 00
					05 01 00 00 14 00 02 28 00
					05 01 00 00 78 00 02 10 00];
		qcom,mdss-dsi-on-command-state = "dsi_lp_mode";
		qcom,mdss-dsi-off-command-state = "dsi_lp_mode";
		qcom,mdss-dsi-h-sync-pulse = <1>;
		qcom,mdss-dsi-traffic-mode = "burst_mode";
		qcom,mdss-dsi-lane-map = "lane_map_0123";
		qcom,mdss-dsi-bllp-eof-power-mode;
		qcom,mdss-dsi-bllp-power-mode;
		qcom,mdss-dsi-lane-0-state;
		qcom,mdss-dsi-lane-1-state;
		qcom,mdss-dsi-lane-2-state;
		//qcom,mdss-dsi-lane-3-state;
		qcom,mdss-dsi-panel-timings-phy-v2 = [
			26 21 09 0B 06 02 04 A0
			26 21 09 0B 06 02 04 A0
			26 21 09 0B 06 02 04 A0
			26 21 09 0B 06 02 04 A0
			26 21 09 0B 06 02 04 A0];
		qcom,mdss-dsi-t-clk-post = <0x0F>;
		qcom,mdss-dsi-t-clk-pre = <0x37>;
		qcom,mdss-dsi-bl-min-level = <1>;
		qcom,mdss-dsi-bl-max-level = <4095>;
		qcom,esd-check-enabled;
		qcom,mdss-dsi-panel-status-command = [14 01 00 01 05 00 01 0A];
		qcom,mdss-dsi-panel-status-command-state = "dsi_lp_mode";
		qcom,mdss-dsi-panel-status-check-mode = "reg_read";
		qcom,mdss-dsi-panel-status-read-length = <1>;
		qcom,mdss-dsi-panel-max-error-count = <2>;
		qcom,mdss-dsi-panel-status-value = <0x9C>;
		qcom,mdss-dsi-dma-trigger = "trigger_sw";
		qcom,mdss-dsi-mdp-trigger = "none";
		qcom,mdss-dsi-bl-pmic-control-type = "bl_ctrl_dcs";
		qcom,panel-supply-entries = <&dsi_panel_pwr_supply>;
		qcom,mdss-dsi-reset-sequence = <1 4>, <0 5>, <1 10>;
		qcom,mdss-dsi-lp11-init;
		qcom,mdss-dsi-reset-delay-vsp-ms = <1>;
		qcom,mdss-dsi-reset-keephigh;
		qcom,ulps-enabled;
		qcom,suspend-ulps-enabled;
	};
};
