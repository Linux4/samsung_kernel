/* Copyright (c) 2013, The Linux Foundation. All rights reserved.
 *
 * This program is free software; you can redistribute it and/or modify
 * it under the terms of the GNU General Public License version 2 and
 * only version 2 as published by the Free Software Foundation.
 *
 * This program is distributed in the hope that it will be useful,
 * but WITHOUT ANY WARRANTY; without even the implied warranty of
 * MERCHANTABILITY or FITNESS FOR A PARTICULAR PURPOSE.  See the
 * GNU General Public License for more details.
 */

/*---------------------------------------------------------------------------
 * This file is autogenerated file using gcdb parser. Please do not edit it.
 * Update input XML file to add a new entry or update variable in this file
 * VERSION = "1.0"
 *---------------------------------------------------------------------------*/
&mdss_mdp {
	dsi_inx18_ili7807g_hd_video: qcom,mdss_dsi_inx18_ili7807g_hd_video {
		qcom,mdss-dsi-panel-name = "inx18 ili7807g hd video mode dsi panel";
		qcom,mdss-dsi-panel-controller = <&mdss_dsi0>;
		qcom,mdss-dsi-panel-type = "dsi_video_mode";
		qcom,mdss-dsi-panel-destination = "display_1";
		qcom,mdss-dsi-panel-framerate = <60>;
		qcom,mdss-dsi-virtual-channel-id = <0>;
		qcom,mdss-dsi-stream = <0>;
		qcom,mdss-dsi-panel-width = <720>;
		qcom,mdss-dsi-panel-height = <1560>;
		qcom,mdss-dsi-h-front-porch = <340>;
		qcom,mdss-dsi-h-back-porch = <340>;
		qcom,mdss-dsi-h-pulse-width = <28>;
		qcom,mdss-dsi-h-sync-skew = <0>;
		qcom,mdss-dsi-v-back-porch = <6>;
		qcom,mdss-dsi-v-front-porch = <38>;
		qcom,mdss-dsi-v-pulse-width = <2>;
		qcom,mdss-dsi-h-left-border = <0>;
		qcom,mdss-dsi-h-right-border = <0>;
		qcom,mdss-dsi-v-top-border = <0>;
		qcom,mdss-dsi-v-bottom-border = <0>;
		qcom,mdss-dsi-bpp = <24>;
		qcom,mdss-dsi-color-order = "rgb_swap_rgb";
		qcom,mdss-dsi-underflow-color = <0xff>;
		qcom,mdss-dsi-border-color = <0>;
		qcom,bklt-dcs-ctrl-mode = <0>;
		qcom,mdss-dsi-on-command = [
					39 01 00 00 00 00 04 FF 78 07 01
					39 01 00 00 00 00 02 00 40
					39 01 00 00 00 00 02 01 40
					39 01 00 00 00 00 02 02 09
					39 01 00 00 00 00 02 03 78
					39 01 00 00 00 00 02 04 C4
					39 01 00 00 00 00 02 05 41
					39 01 00 00 00 00 02 06 09
					39 01 00 00 00 00 02 07 6C
					39 01 00 00 00 00 02 08 01
					39 01 00 00 00 00 02 09 05
					39 01 00 00 00 00 02 0a 40
					39 01 00 00 00 00 02 0b 01
					39 01 00 00 00 00 02 0c 09
					39 01 00 00 00 00 02 0e 78
					39 01 00 00 00 00 02 16 00
					39 01 00 00 00 00 02 17 00
					39 01 00 00 00 00 02 91 01
					39 01 00 00 00 00 02 92 10
					39 01 00 00 00 00 02 93 09
					39 01 00 00 00 00 02 94 78
					39 01 00 00 00 00 02 31 07
					39 01 00 00 00 00 02 32 07
					39 01 00 00 00 00 02 33 07
					39 01 00 00 00 00 02 34 07
					39 01 00 00 00 00 02 35 07
					39 01 00 00 00 00 02 36 07
					39 01 00 00 00 00 02 37 07
					39 01 00 00 00 00 02 38 07
					39 01 00 00 00 00 02 39 30
					39 01 00 00 00 00 02 3a 2F
					39 01 00 00 00 00 02 3b 2E
					39 01 00 00 00 00 02 3c 08
					39 01 00 00 00 00 02 3d 10
					39 01 00 00 00 00 02 3e 11
					39 01 00 00 00 00 02 3f 12
					39 01 00 00 00 00 02 40 13
					39 01 00 00 00 00 02 41 02
					39 01 00 00 00 00 02 42 36
					39 01 00 00 00 00 02 43 35
					39 01 00 00 00 00 02 44 34
					39 01 00 00 00 00 02 45 29
					39 01 00 00 00 00 02 46 24
					39 01 00 00 00 00 02 47 0C
					39 01 00 00 00 00 02 48 14
					39 01 00 00 00 00 02 49 07
					39 01 00 00 00 00 02 4a 07
					39 01 00 00 00 00 02 4b 07
					39 01 00 00 00 00 02 4c 07
					39 01 00 00 00 00 02 4d 07
					39 01 00 00 00 00 02 4e 07
					39 01 00 00 00 00 02 4f 07
					39 01 00 00 00 00 02 50 07
					39 01 00 00 00 00 02 51 36
					39 01 00 00 00 00 02 52 35
					39 01 00 00 00 00 02 53 34
					39 01 00 00 00 00 02 54 08
					39 01 00 00 00 00 02 55 10
					39 01 00 00 00 00 02 56 11
					39 01 00 00 00 00 02 57 12
					39 01 00 00 00 00 02 58 13
					39 01 00 00 00 00 02 59 02
					39 01 00 00 00 00 02 5a 30
					39 01 00 00 00 00 02 5b 2F
					39 01 00 00 00 00 02 5c 2E
					39 01 00 00 00 00 02 5d 29
					39 01 00 00 00 00 02 5e 24
					39 01 00 00 00 00 02 5f 0C
					39 01 00 00 00 00 02 60 14
					39 01 00 00 00 00 02 61 07
					39 01 00 00 00 00 02 62 07
					39 01 00 00 00 00 02 63 07
					39 01 00 00 00 00 02 64 07
					39 01 00 00 00 00 02 65 07
					39 01 00 00 00 00 02 66 07
					39 01 00 00 00 00 02 67 07
					39 01 00 00 00 00 02 68 07
					39 01 00 00 00 00 02 69 30
					39 01 00 00 00 00 02 6a 2F
					39 01 00 00 00 00 02 6b 2E
					39 01 00 00 00 00 02 6c 24
					39 01 00 00 00 00 02 6d 14
					39 01 00 00 00 00 02 6e 13
					39 01 00 00 00 00 02 6f 12
					39 01 00 00 00 00 02 70 11
					39 01 00 00 00 00 02 71 02
					39 01 00 00 00 00 02 72 36
					39 01 00 00 00 00 02 73 35
					39 01 00 00 00 00 02 74 34
					39 01 00 00 00 00 02 75 29
					39 01 00 00 00 00 02 76 08
					39 01 00 00 00 00 02 77 0C
					39 01 00 00 00 00 02 78 10
					39 01 00 00 00 00 02 79 07
					39 01 00 00 00 00 02 7a 07
					39 01 00 00 00 00 02 7b 07
					39 01 00 00 00 00 02 7c 07
					39 01 00 00 00 00 02 7d 07
					39 01 00 00 00 00 02 7e 07
					39 01 00 00 00 00 02 7f 07
					39 01 00 00 00 00 02 80 07
					39 01 00 00 00 00 02 81 36
					39 01 00 00 00 00 02 82 35
					39 01 00 00 00 00 02 83 34
					39 01 00 00 00 00 02 84 24
					39 01 00 00 00 00 02 85 14
					39 01 00 00 00 00 02 86 13
					39 01 00 00 00 00 02 87 12
					39 01 00 00 00 00 02 88 11
					39 01 00 00 00 00 02 89 02
					39 01 00 00 00 00 02 8a 30
					39 01 00 00 00 00 02 8b 2F
					39 01 00 00 00 00 02 8c 2E
					39 01 00 00 00 00 02 8d 29
					39 01 00 00 00 00 02 8e 08
					39 01 00 00 00 00 02 8f 0C
					39 01 00 00 00 00 02 90 10
					39 01 00 00 00 00 02 D1 11
					39 01 00 00 00 00 02 D2 02
					39 01 00 00 00 00 02 D4 04
					39 01 00 00 00 00 02 D6 25
					39 01 00 00 00 00 02 D8 60
					39 01 00 00 00 00 02 D9 95
					39 01 00 00 00 00 02 DA 15
					39 01 00 00 00 00 02 DB 01
					39 01 00 00 00 00 02 DC 08
					39 01 00 00 00 00 02 DD 98
					39 01 00 00 00 00 02 DF 00
					39 01 00 00 00 00 02 E0 40
					39 01 00 00 00 00 02 E1 08
					39 01 00 00 00 00 02 E3 00
					39 01 00 00 00 00 02 E5 0F
					39 01 00 00 00 00 02 E6 22
					39 01 00 00 00 00 02 ED 6D
					39 01 00 00 00 00 04 FF 78 07 02
					39 01 00 00 00 00 02 01 55
					39 01 00 00 00 00 02 06 A6
					39 01 00 00 00 00 02 07 A6
					39 01 00 00 00 00 02 0F 28
					39 01 00 00 00 00 02 78 26
					39 01 00 00 00 00 02 79 00
					39 01 00 00 00 00 02 40 09
					39 01 00 00 00 00 02 41 00
					39 01 00 00 00 00 02 42 04
					39 01 00 00 00 00 02 43 19
					39 01 00 00 00 00 02 46 11
					39 01 00 00 00 00 02 47 00
					39 01 00 00 00 00 02 53 04
					39 01 00 00 00 00 02 80 33
					39 01 00 00 00 00 04 FF 78 07 05
					39 01 00 00 00 00 02 27 44
					39 01 00 00 00 00 02 28 54
					39 01 00 00 00 00 02 2B 08
					39 01 00 00 00 00 02 A0 44
					39 01 00 00 00 00 02 A2 54
					39 01 00 00 00 00 02 03 00
					39 01 00 00 00 00 02 04 79
					39 01 00 00 00 00 02 48 42
					39 01 00 00 00 00 02 49 42
					39 01 00 00 00 00 02 63 83
					39 01 00 00 00 00 02 64 83
					39 01 00 00 00 00 02 69 6A
					39 01 00 00 00 00 02 6B 42
					39 01 00 00 00 00 02 68 65
					39 01 00 00 00 00 02 6A 3D
					39 01 00 00 00 00 04 FF 78 07 06
					39 01 00 00 00 00 02 D6 67
					39 01 00 00 00 00 02 2E 01
					39 01 00 00 00 00 02 C0 0B
					39 01 00 00 00 00 02 C1 03
					39 01 00 00 00 00 02 C2 07
					39 01 00 00 00 00 02 C3 06
					39 01 00 00 00 00 02 DD 10
					39 01 00 00 00 00 02 7C 40
					39 01 00 00 00 00 02 11 03
					39 01 00 00 00 00 02 12 10
					39 01 00 00 00 00 02 13 41
					39 01 00 00 00 00 02 14 41
					39 01 00 00 00 00 02 15 FE
					39 01 00 00 00 00 02 16 40
					39 01 00 00 00 00 02 17 47
					39 01 00 00 00 00 02 18 3A
					39 01 00 00 00 00 02 1D 4C
					39 01 00 00 00 00 02 1E 03
					39 01 00 00 00 00 02 B4 CA
					39 01 00 00 00 00 02 B5 15
					39 01 00 00 00 00 04 FF 78 07 07
					39 01 00 00 00 00 02 03 40
					39 01 00 00 00 00 02 06 90
					39 01 00 00 00 00 04 FF 78 07 08
					39 01 00 00 00 00 29 E0 00 30 49 73 00 93 AE C6 00 D9 EC FC 15 31 59 96 29 C2 07 3C 2A 3E 72 AD 3E D3 04 24 3F 4E 59 67 3F 76 87 99 3F B1 C6 CF
					39 01 00 00 00 00 29 E1 00 30 49 73 00 93 AE C6 00 D9 EC FC 15 31 59 96 29 C2 07 3C 2A 3E 72 AD 3E D3 04 24 3F 4E 59 67 3F 76 87 99 3F B1 C6 CF
					39 01 00 00 00 00 04 FF 78 07 09
					39 01 00 00 00 00 29 E0 00 30 4B 78 00 99 B4 CB 10 E0 F1 02 15 36 5F 9A 29 C6 09 3F 2A 41 74 AF 3E D5 06 26 3F 4E 5A 68 3F 76 88 9B 3F B2 CC CF
					39 01 00 00 00 00 29 E1 00 30 4B 78 00 99 B4 CB 10 E0 F1 02 15 36 5F 9A 29 C6 09 3F 2A 41 74 AF 3E D5 06 26 3F 4E 5A 68 3F 76 88 9B 3F B2 CC CF
					39 01 00 00 00 00 04 FF 78 07 0A
					39 01 00 00 00 00 29 E0 00 30 4F 7E 00 A1 BC D3 10 E7 F8 09 15 3C 63 9D 29 C8 0A 40 2A 41 74 AF 3E D5 06 25 3F 4E 5A 68 3F 76 88 9A 3F B2 CB CF
					39 01 00 00 00 00 29 E1 00 30 4F 7E 00 A1 BC D3 10 E7 F8 09 15 3C 63 9D 29 C8 0A 40 2A 41 74 AF 3E D5 06 25 3F 4E 5A 68 3F 76 88 9A 3F B2 CB CF
					39 01 00 00 00 00 04 FF 78 07 0E
					39 01 00 00 00 00 02 00 A3
					39 01 00 00 00 00 02 4D 8C
					39 01 00 00 00 00 02 47 80
					39 01 00 00 00 00 02 41 08
					39 01 00 00 00 00 02 43 6E
					39 01 00 00 00 00 02 49 82
					39 01 00 00 00 00 02 B0 31
					39 01 00 00 00 00 02 B1 8D
					39 01 00 00 00 00 02 B3 00
					39 01 00 00 00 00 02 B4 33
					39 01 00 00 00 00 02 45 0A
					39 01 00 00 00 00 02 46 04
					39 01 00 00 00 00 02 BC 04
					39 01 00 00 00 00 02 BD FC
					39 01 00 00 00 00 02 C0 34
					39 01 00 00 00 00 02 C6 8D
					39 01 00 00 00 00 02 C7 8D
					39 01 00 00 00 00 02 C8 8D
					39 01 00 00 00 00 02 C9 8D
					39 01 00 00 00 00 02 D2 00
					39 01 00 00 00 00 02 D3 A8
					39 01 00 00 00 00 02 D4 00
					39 01 00 00 00 00 02 D5 A8
					39 01 00 00 00 00 02 D6 00
					39 01 00 00 00 00 02 D7 A8
					39 01 00 00 00 00 02 D8 00
					39 01 00 00 00 00 02 d9 A8
					39 01 00 00 00 00 02 e0 09
					39 01 00 00 00 00 02 e1 00
					39 01 00 00 00 00 02 e2 04
					39 01 00 00 00 00 02 e3 19
					39 01 00 00 00 00 02 e4 04
					39 01 00 00 00 00 02 e5 04
					39 01 00 00 00 00 02 e6 00
					39 01 00 00 00 00 02 e7 05
					39 01 00 00 00 00 02 e8 00
					39 01 00 00 00 00 02 e9 02
					39 01 00 00 00 00 02 ea 07
					39 01 00 00 00 00 04 FF 78 07 0E
					39 01 00 00 00 00 02 07 21
					39 01 00 00 00 00 02 4B 13
					39 01 00 00 00 00 04 FF 78 07 0C
					39 01 00 00 00 00 02 00 1F
					39 01 00 00 00 00 02 01 29
					39 01 00 00 00 00 02 02 22
					39 01 00 00 00 00 02 03 43
					39 01 00 00 00 00 02 04 24
					39 01 00 00 00 00 02 05 56
					39 01 00 00 00 00 02 06 21
					39 01 00 00 00 00 02 07 36
					39 01 00 00 00 00 02 08 1F
					39 01 00 00 00 00 02 09 28
					39 01 00 00 00 00 02 0A 20
					39 01 00 00 00 00 02 0B 2F
					39 01 00 00 00 00 02 0C 1E
					39 01 00 00 00 00 02 0D 22
					39 01 00 00 00 00 02 0E 23
					39 01 00 00 00 00 02 0F 50
					39 01 00 00 00 00 02 10 22
					39 01 00 00 00 00 02 11 49
					39 01 00 00 00 00 02 12 1E
					39 01 00 00 00 00 02 13 1B
					39 01 00 00 00 00 02 14 20
					39 01 00 00 00 00 02 15 35
					39 01 00 00 00 00 02 16 23
					39 01 00 00 00 00 02 17 51
					39 01 00 00 00 00 02 18 1E
					39 01 00 00 00 00 02 19 1C
					39 01 00 00 00 00 02 1A 23
					39 01 00 00 00 00 02 1B 4A
					39 01 00 00 00 00 02 1C 21
					39 01 00 00 00 00 02 1D 3C
					39 01 00 00 00 00 02 1E 1E
					39 01 00 00 00 00 02 1F 15
					39 01 00 00 00 00 02 20 1F
					39 01 00 00 00 00 02 21 23
					39 01 00 00 00 00 02 22 22
					39 01 00 00 00 00 02 23 44
					39 01 00 00 00 00 02 24 20
					39 01 00 00 00 00 02 25 30
					39 01 00 00 00 00 02 26 21
					39 01 00 00 00 00 02 27 3D
					39 01 00 00 00 00 04 FF 78 07 06//
					15 01 00 00 00 00 02 06 c4
					39 01 00 00 00 00 04 FF 78 07 03
					15 01 00 00 00 00 02 83 20
					15 01 00 00 00 00 02 84 00//
					39 01 00 00 00 00 04 FF 78 07 00
					39 01 00 00 00 00 03 68 04 00
					39 01 00 00 00 00 03 51 00 00
					15 01 00 00 00 00 02 53 2C
					15 01 00 00 00 00 02 55 00
					15 01 00 00 50 00 02 11 00
					15 01 00 00 14 00 02 29 00];
		qcom,mdss-dsi-off-command = [39 01 00 00 00 00 04 FF 78 07 00
					05 01 00 00 14 00 02 28 00
					05 01 00 00 78 00 02 10 00];
		qcom,mdss-dsi-on-command-state = "dsi_lp_mode";
		qcom,mdss-dsi-off-command-state = "dsi_lp_mode";
		qcom,mdss-dsi-h-sync-pulse = <1>;
		qcom,mdss-dsi-traffic-mode = "burst_mode";
		qcom,mdss-dsi-lane-map = "lane_map_0123";
		qcom,mdss-dsi-bllp-eof-power-mode;
		qcom,mdss-dsi-bllp-power-mode;
		qcom,mdss-dsi-lane-0-state;
		qcom,mdss-dsi-lane-1-state;
		qcom,mdss-dsi-lane-2-state;
		//qcom,mdss-dsi-lane-3-state;
		qcom,mdss-dsi-panel-timings-phy-v2 = [
			26 21 09 0B 06 02 04 A0
			26 21 09 0B 06 02 04 A0
			26 21 09 0B 06 02 04 A0
			26 21 09 0B 06 02 04 A0
			26 20 0A 0B 06 02 04 A0];
		qcom,mdss-dsi-t-clk-post = <0x0F>;
		qcom,mdss-dsi-t-clk-pre = <0x37>;
		qcom,mdss-dsi-bl-min-level = <1>;
		qcom,mdss-dsi-bl-max-level = <4095>;
		qcom,esd-check-enabled;
		qcom,mdss-dsi-panel-status-command = [14 01 00 01 05 00 01 0A];
		qcom,mdss-dsi-panel-status-command-state = "dsi_lp_mode";
		qcom,mdss-dsi-panel-status-check-mode = "reg_read";
		qcom,mdss-dsi-panel-status-read-length = <1>;
		qcom,mdss-dsi-panel-max-error-count = <2>;
		qcom,mdss-dsi-panel-status-value = <0x9C>;
		qcom,mdss-dsi-dma-trigger = "trigger_sw";
		qcom,mdss-dsi-mdp-trigger = "none";
		qcom,mdss-dsi-bl-pmic-control-type = "bl_ctrl_dcs";
		qcom,panel-supply-entries = <&dsi_panel_pwr_supply>;
		qcom,mdss-dsi-reset-sequence = <1 4>, <0 5>, <1 10>;
		qcom,mdss-dsi-lp11-init;
		qcom,mdss-dsi-reset-delay-vsp-ms = <1>;
		qcom,mdss-dsi-reset-keephigh;
		qcom,ulps-enabled;
		qcom,suspend-ulps-enabled;
	};
};
