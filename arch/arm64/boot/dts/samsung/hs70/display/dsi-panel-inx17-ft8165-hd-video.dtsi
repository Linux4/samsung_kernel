/* Copyright (c) 2013, The Linux Foundation. All rights reserved.
 *
 * This program is free software; you can redistribute it and/or modify
 * it under the terms of the GNU General Public License version 2 and
 * only version 2 as published by the Free Software Foundation.
 *
 * This program is distributed in the hope that it will be useful,
 * but WITHOUT ANY WARRANTY; without even the implied warranty of
 * MERCHANTABILITY or FITNESS FOR A PARTICULAR PURPOSE.  See the
 * GNU General Public License for more details.
 */

/*---------------------------------------------------------------------------
 * This file is autogenerated file using gcdb parser. Please do not edit it.
 * Update input XML file to add a new entry or update variable in this file
 * VERSION = "1.0"
 *---------------------------------------------------------------------------*/
&mdss_mdp {
	dsi_inx17_ft8165_hd_video: qcom,mdss_dsi_inx17_ft8165_hd_video {
		qcom,mdss-dsi-panel-name = "inx17 ft8615 hd video mode dsi panel";
		qcom,mdss-dsi-panel-controller = <&mdss_dsi0>;
		qcom,mdss-dsi-panel-type = "dsi_video_mode";
		qcom,mdss-dsi-panel-destination = "display_1";
		qcom,mdss-dsi-panel-framerate = <60>;
		qcom,mdss-dsi-virtual-channel-id = <0>;
		qcom,mdss-dsi-stream = <0>;
		qcom,mdss-dsi-panel-width = <720>;
		qcom,mdss-dsi-panel-height = <1560>;
		qcom,mdss-dsi-h-front-porch = <308>;
		qcom,mdss-dsi-h-back-porch = <301>;
		qcom,mdss-dsi-h-pulse-width = <6>;
		qcom,mdss-dsi-h-sync-skew = <0>;
		qcom,mdss-dsi-v-back-porch = <32>;
		qcom,mdss-dsi-v-front-porch = <120>;
		qcom,mdss-dsi-v-pulse-width = <4>;
		qcom,mdss-dsi-h-left-border = <0>;
		qcom,mdss-dsi-h-right-border = <0>;
		qcom,mdss-dsi-v-top-border = <0>;
		qcom,mdss-dsi-v-bottom-border = <0>;
		qcom,mdss-dsi-bpp = <24>;
		qcom,mdss-dsi-color-order = "rgb_swap_rgb";
		qcom,mdss-dsi-underflow-color = <0xff>;
		qcom,mdss-dsi-border-color = <0>;
		qcom,bklt-dcs-ctrl-mode = <1>;
		qcom,mdss-dsi-on-command = [ 29 01 00 00 00 00 02 00 00
		29 01 00 00 00 00 04 FF 87 19 01
		29 01 00 00 00 00 02 00 80
		29 01 00 00 00 00 03 FF 87 19
		29 01 00 00 00 00 02 00 00
		29 01 00 00 00 00 29 E1 13 14 15 17 D7 1E 23 29 33 24 3B 41 47 4C 25 50 58 60 66 F2 6D 74 7C 84 70 8D 93 99 A0 80 A8 B3 C0 CA 8C D5 E6 F3 FB E7
		29 01 00 00 00 00 02 00 00
		29 01 00 00 00 00 29 E2 04 06 08 0F 4C 1C 25 2C 36 20 3E 44 4A 4F 25 53 5B 63 69 F2 70 75 7C 84 40 8D 93 99 A0 80 A8 B3 C0 CA 8C D5 E6 F3 FB E7
		29 01 00 00 00 00 02 00 00
		29 01 00 00 00 00 29 E3 13 14 15 17 D7 1E 23 29 33 24 3B 41 47 4C 25 50 58 60 66 F2 6D 74 7C 84 70 8D 93 99 A0 80 A8 B3 C0 CA 8C D5 E6 F3 FB E7
		29 01 00 00 00 00 02 00 00
		29 01 00 00 00 00 29 E4 04 06 08 0F 4C 1C 25 2C 36 20 3E 44 4A 4F 25 53 5B 63 69 F2 70 75 7C 84 40 8D 93 99 A0 80 A8 B3 C0 CA 8C D5 E6 F3 FB E7
		29 01 00 00 00 00 02 00 00
		29 01 00 00 00 00 29 E5 13 14 15 17 D7 1E 23 29 33 24 3B 41 47 4C 25 50 58 60 66 F2 6D 74 7C 84 70 8D 93 99 A0 80 A8 B3 C0 CA 8C D5 E6 F3 FB E7
		29 01 00 00 00 00 02 00 00
		29 01 00 00 00 00 29 E6 04 06 08 0F 4C 1C 25 2C 36 20 3E 44 4A 4F 25 53 5B 63 69 F2 70 75 7C 84 40 8D 93 99 A0 80 A8 B3 C0 CA 8C D5 E6 F3 FB E7
		29 01 00 00 00 00 02 00 B0
		29 01 00 00 00 00 02 CA 01 //pwm 15K
		29 01 00 00 00 00 02 00 B2
		29 01 00 00 00 00 02 CA 0C
		29 01 00 00 00 00 02 00 B5
		29 01 00 00 00 00 02 CA 04 // dimming 16 frame
		29 01 00 00 00 00 02 00 00
		29 01 00 00 00 00 04 FF FF FF FF
		29 01 00 00 00 00 03 51 00 00
		29 01 00 00 00 00 02 53 2C
		29 01 00 00 00 00 02 55 00
		29 01 00 00 14 00 02 35 00
		05 01 00 00 5A 00 01 11
		05 01 00 00 05 00 01 29];
		qcom,mdss-dsi-off-command = [05 01 00 00 0A 00 01 28
		05 01 00 00 78 00 01 10
		29 01 00 00 00 00 02 00 00
		29 01 00 00 00 00 05 F7 5A A5 95 27];
		qcom,mdss-dsi-on-command-state = "dsi_lp_mode";
		qcom,mdss-dsi-off-command-state = "dsi_lp_mode";
		qcom,mdss-dsi-h-sync-pulse = <1>;
		qcom,mdss-dsi-traffic-mode = "burst_mode";
		qcom,mdss-dsi-lane-map = "lane_map_0123";
		qcom,mdss-dsi-bllp-eof-power-mode;
		qcom,mdss-dsi-bllp-power-mode;
		qcom,mdss-dsi-lane-0-state;
		qcom,mdss-dsi-lane-1-state;
		qcom,mdss-dsi-lane-2-state;
		qcom,mdss-dsi-panel-timings-phy-v2 = [
			26 21 09 0B 06 02 04 A0
			26 21 09 0B 06 02 04 A0
			26 21 09 0B 06 02 04 A0
			26 21 09 0B 06 02 04 A0
			26 20 0A 0B 06 02 04 A0];
		qcom,mdss-dsi-t-clk-post = <0x0F>;
		qcom,mdss-dsi-t-clk-pre = <0x37>;
		qcom,mdss-dsi-bl-min-level = <1>;
		qcom,mdss-dsi-bl-max-level = <4095>;
		qcom,mdss-dsi-lp11-init;
		qcom,mdss-dsi-init-delay-us = <20000>;
		qcom,esd-check-enabled;
		qcom,mdss-dsi-panel-status-command = [14 01 00 01 05 00 01 0A];
		qcom,mdss-dsi-panel-status-command-state = "dsi_lp_mode";
		qcom,mdss-dsi-panel-status-check-mode = "reg_read";
		qcom,mdss-dsi-panel-status-read-length = <1>;
		qcom,mdss-dsi-panel-max-error-count = <2>;
		qcom,mdss-dsi-panel-status-value = <0x9C>;
		qcom,mdss-dsi-dma-trigger = "trigger_sw";
		qcom,mdss-dsi-mdp-trigger = "none";
		qcom,mdss-dsi-bl-pmic-control-type = "bl_ctrl_dcs";
		qcom,panel-supply-entries = <&dsi_panel_pwr_supply>;
		qcom,mdss-dsi-reset-sequence = <1 5>, <0 1>, <1 12>;
		qcom,mdss-dsi-reset-delay-vsp-ms = <4>;
		qcom,mdss-dsi-reset-keephigh;
		qcom,ulps-enabled;
		qcom,suspend-ulps-enabled;
	};
};
