/* Copyright (c) 2013, The Linux Foundation. All rights reserved.
 *
 * This program is free software; you can redistribute it and/or modify
 * it under the terms of the GNU General Public License version 2 and
 * only version 2 as published by the Free Software Foundation.
 *
 * This program is distributed in the hope that it will be useful,
 * but WITHOUT ANY WARRANTY; without even the implied warranty of
 * MERCHANTABILITY or FITNESS FOR A PARTICULAR PURPOSE.  See the
 * GNU General Public License for more details.
 */

/*---------------------------------------------------------------------------
 * This file is autogenerated file using gcdb parser. Please do not edit it.
 * Update input XML file to add a new entry or update variable in this file
 * VERSION = "1.0"
 *---------------------------------------------------------------------------*/
&mdss_mdp {
	dsi_txd16_hx83104a_hd_video: qcom,mdss_dsi_txd16_hx83104a_hd_video {
		qcom,mdss-dsi-panel-name = "txd16 hx83104a hd video mode dsi panel";
		qcom,mdss-dsi-panel-controller = <&mdss_dsi0>;
		qcom,mdss-dsi-panel-type = "dsi_video_mode";
		qcom,mdss-dsi-panel-destination = "display_1";
		qcom,mdss-dsi-panel-framerate = <60>;
		qcom,mdss-dsi-virtual-channel-id = <0>;
		qcom,mdss-dsi-stream = <0>;
		qcom,mdss-dsi-panel-width = <720>;
		qcom,mdss-dsi-panel-height = <1560>;
		qcom,mdss-dsi-h-front-porch = <286>;
		qcom,mdss-dsi-h-back-porch = <200>;
		qcom,mdss-dsi-h-pulse-width = <200>;
		qcom,mdss-dsi-h-sync-skew = <0>;
		qcom,mdss-dsi-v-back-porch = <15>;
		qcom,mdss-dsi-v-front-porch = <54>;
		qcom,mdss-dsi-v-pulse-width = <2>;
		qcom,mdss-dsi-h-left-border = <0>;
		qcom,mdss-dsi-h-right-border = <0>;
		qcom,mdss-dsi-v-top-border = <0>;
		qcom,mdss-dsi-v-bottom-border = <0>;
		qcom,mdss-dsi-bpp = <24>;
		qcom,mdss-dsi-color-order = "rgb_swap_rgb";
		qcom,mdss-dsi-underflow-color = <0xff>;
		qcom,mdss-dsi-border-color = <0>;
		qcom,bklt-dcs-ctrl-mode = <0>;
		qcom,mdss-dsi-on-command = [
					39 01 00 00 00 00 04 B9 83 11 2A
					39 01 00 00 00 00 09 B1 08 31 31 80 80 4A 4F AA
					39 01 00 00 00 00 10 B2 00 02 00 62 18 00 0F 34 19 11 04 01 15 A3 87
					39 01 00 00 00 00 1C B4 04 E0 04 E0 00 00 08 E2 00 00 08 E2 00 FF 00 FF 00 00 0C 0F 00 37 08 0D 0F 00 88
					39 01 00 00 00 00 04 B6 7B 7B E3
					39 01 00 00 00 00 11 BA 72 23 64 33 33 33 33 11 10 00 00 10 08 3D 02 76
					39 01 00 00 00 00 03 C0 22 22
					15 01 00 00 00 00 02 C1 01
					39 01 00 00 00 00 07 C7 00 00 04 E0 33 00
					15 01 00 00 00 00 02 E9 C3
					39 01 00 00 00 00 03 CB D2 32
					15 01 00 00 00 00 02 E9 3F
					15 01 00 00 00 00 02 CC 08
					39 01 00 00 00 00 03 D2 33 33
					39 01 00 00 05 00 30 D3 C0 00 00 00 00 01 00 14 14 03 01 11 08 08 08 08 08 32 10 05 00 00 32 10 0F 00 0F 32 10 0F 00 00 00 00 00 00 00 00 00 00 00 00 00 00 00 EA 1C
					39 01 00 00 05 00 31 D5 18 18 18 18 18 18 18 18 18 18 18 18 18 18 C0 C0 C0 C0 18 18 40 40 18 18 18 18 31 31 30 30 2F 2F 01 00 03 02 20 20 C0 C0 C0 C0 19 19 40 40 25 24
					39 01 00 00 05 00 31 D6 18 18 18 18 18 18 18 18 18 18 18 18 18 18 40 40 40 40 18 18 40 40 18 18 18 18 31 31 30 30 2F 2F 02 03 00 01 20 20 40 40 40 40 40 40 19 19 24 25
					39 01 00 00 00 00 0D D8 AA AA AA AA FF EA AA AA AA AA FF EA
					39 01 00 00 00 00 1A E7 0F 0F 1E 78 1E 77 00 50 20 14 00 00 02 02 02 05 14 14 32 B9 23 B9 08 13 69
					15 01 00 00 00 00 02 BD 01
					39 01 00 00 00 00 04 B1 64 01 09
					39 01 00 00 00 00 05 BF 1A BF 01 0A
					39 01 00 00 00 00 04 CB 25 11 01
					39 01 00 00 00 00 3A C1 FF FB F7 F4 F0 EC E9 E2 DE DB D8 D4 D1 CD C9 C6 C2 BF BC B4 AC A5 9D 95 8E 86 7E 76 6E 65 5D 55 4C 44 3C 33 2A 21 18 0E 0A 07 05 01 00 2C 39 F2 7D D0 86 1A B9 24 16 0B 00
					39 01 00 00 00 00 0D D8 AA AA AF FF FF FF AA AA AF FF FF FF
					39 01 00 00 00 00 09 E7 02 00 6C 01 6E 0E 20 0F
					15 01 00 00 00 00 02 BD 02
					39 01 00 00 00 00 0A B4 00 92 12 11 88 12 12 00 53
					39 01 00 00 00 00 3A C1 FF FB F7 F4 F0 EC E9 E2 DE DB D8 D4 D1 CD C9 C6 C2 BF BC B4 AC A5 9D 95 8E 86 7E 76 6E 65 5D 55 4C 44 3C 33 2A 21 18 0E 0A 07 05 01 00 2C 39 F2 7D D0 86 1A B9 24 16 0B 00
					39 01 00 00 00 00 0D D8 AA AA AF FF FF FF AA AA AF FF FF FF
					39 01 00 00 00 00 1E E7 00 00 08 40 01 00 00 00 00 00 00 00 00 00 00 00 00 00 00 00 00 00 04 00 70 01 70 02 00
					15 01 00 00 00 00 02 BD 03
					39 01 00 00 00 00 19 D8 AA AA AE AA AA BE AA AA AE AA AA BE AA AA AF FF FF FF AA AA AF FF FF FF
					39 01 00 00 00 00 3A C1 FF FB F7 F4 F0 EC E9 E2 DE DB D8 D4 D1 CD C9 C6 C2 BF BC B4 AC A5 9D 95 8E 86 7E 76 6E 65 5D 55 4C 44 3C 33 2A 21 18 0E 0A 07 05 01 00 2C 39 F2 7D D0 86 1A B9 24 16 0B 00
					39 01 00 00 00 00 05 CF 00 14 00 40
					15 01 00 00 00 00 02 BD 00
					39 01 00 00 00 00 1B E4 2D 01 2C 00 08 00 10 08 04 04 00 80 40 E8 34 70 98 C8 FF A5 FF EF 10 38 10 00
					05 01 00 00 28 00 01 11
					05 01 00 00 32 00 01 29
					39 01 00 00 05 00 03 51 0F FF
					39 01 00 00 05 00 05 C9 04 0A 94 01
					15 01 00 00 0A 00 02 55 00
					15 01 00 00 05 00 02 53 2C
					];
		qcom,mdss-dsi-off-command = [
					05 01 00 00 14 00 02 28 00
					05 01 00 00 78 00 02 10 00
					];
		qcom,mdss-dsi-on-command-state = "dsi_lp_mode";
		qcom,mdss-dsi-off-command-state = "dsi_lp_mode";
		qcom,mdss-dsi-h-sync-pulse = <1>;
		qcom,mdss-dsi-traffic-mode = "burst_mode";
		qcom,mdss-dsi-lane-map = "lane_map_0123";
		qcom,mdss-dsi-bllp-eof-power-mode;
		qcom,mdss-dsi-bllp-power-mode;
		qcom,mdss-dsi-lane-0-state;
		qcom,mdss-dsi-lane-1-state;
		qcom,mdss-dsi-lane-2-state;
		//qcom,mdss-dsi-lane-3-state;
		qcom,mdss-dsi-panel-timings-phy-v2 = [
			26 21 09 0B 06 02 04 a0
			26 21 09 0B 06 02 04 a0
			26 21 09 0B 06 02 04 a0
			26 21 09 0B 06 02 04 a0
			26 20 0A 0B 06 02 04 a0];
		qcom,mdss-dsi-t-clk-post = <0x0f>;
		qcom,mdss-dsi-t-clk-pre = <0x37>;
		qcom,mdss-dsi-bl-min-level = <1>;
		qcom,mdss-dsi-bl-max-level = <4095>;
		qcom,mdss-dsi-lp11-init;
		qcom,mdss-dsi-init-delay-us = <20000>;
		qcom,esd-check-enabled;
		qcom,mdss-dsi-panel-status-command = [
				14 01 00 01 00 00 01 0A
				06 01 00 01 05 00 01 09
				];
		qcom,mdss-dsi-panel-status-command-state = "dsi_lp_mode";
		qcom,mdss-dsi-panel-status-check-mode = "reg_read";
		qcom,mdss-dsi-panel-status-read-length = <1 3>;
		qcom,mdss-dsi-panel-max-error-count = <4>;
		qcom,mdss-dsi-panel-status-value = <0x9d>,<0x80 0x73 0x04>;
		qcom,mdss-dsi-dma-trigger = "trigger_sw";
		qcom,mdss-dsi-mdp-trigger = "none";
		qcom,mdss-dsi-bl-pmic-control-type = "bl_ctrl_dcs";
		qcom,panel-supply-entries = <&dsi_panel_pwr_supply>;
		qcom,mdss-dsi-reset-sequence = <1 1>, <0 1>, <1 50>;
		qcom,mdss-dsi-reset-delay-vsp-ms = <4>;
		qcom,mdss-dsi-reset-keephigh;
		qcom,ulps-enabled;
		qcom,suspend-ulps-enabled;
	};
};
