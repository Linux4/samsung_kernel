/* 
 * Generated by Samsung 
 * If these files should be changed, then please make a sync with MTK
*/

#include "mt6833-a13x_common.dtsi"
#include "mt6833-a13x_camera_00.dtsi"
#include "display_lcd_a13x_common.dtsi"
/*End of this file, DO NOT ADD ANYTHING HERE*/
