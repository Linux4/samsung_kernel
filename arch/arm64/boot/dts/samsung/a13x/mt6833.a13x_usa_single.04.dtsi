/* 
 * Generated by Samsung 
 * If these files should be changed, then please make a sync with MTK
*/

#include "mt6833-a13x_common.dtsi"
#include "mt6833-a13x_camera_00.dtsi"
#include "display_lcd_a13xu_common.dtsi"

&mt6360_typec {
	mt6360pd,vbus_dischg_gpio = <&pio 182 0x0>;
	mt6360pd,vbus_dischg_gpio_num = <182>;
};

/*End of this file, DO NOT ADD ANYTHING HERE*/
