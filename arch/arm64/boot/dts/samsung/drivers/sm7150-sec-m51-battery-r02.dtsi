/* Copyright (c) 2020, The Linux Foundation. All rights reserved.
 *
 * This program is free software; you can redistribute it and/or modify
 * it under the terms of the GNU General Public License version 2 and
 * only version 2 as published by the Free Software Foundation.
 *
 * This program is distributed in the hope that it will be useful,
 * but WITHOUT ANY WARRANTY; without even the implied warranty of
 * MERCHANTABILITY or FITNESS FOR A PARTICULAR PURPOSE.  See the
 * GNU General Public License for more details.
 */


&soc {
battery_params {
		battery,battery_data =
			<
			/***** battery data for 4.38 *****/
			/* battery,battery_table3 */
			160 10 23 10 159 9 46 9 195 8
			96 8 6 8 184 7 113 7 17 7
			196 6 150 6 115 6 89 6 67 6
			43 6 4 6 214 5 150 5 123 5
			159 3 84 2 0 8 154 7 53 7
			207 6 105 6 4 6 158 5 57 5
			211 4 109 4 8 4 162 3 60 3
			215 2 113 2 11 2 166 1 64 1
			219 0 117 0 15 0 248 15


			/* battery,battery_table4 */
			10 10 10 10 41 41 41 41 41 41
			41 42 42 42 42 43 43 43 44 46
			79 154 


			/* battery,batcap */
			0x70 0x69 0x7F 0x0E  /* [0x0E] [0x0F] [0x10] [0x11] */
			/* battery,accum */ 
			0x00 0x08 /* [0x44] [0x45] */

			/* battery,soc_arr_val */
			10000 9504 9007 8511 8015 7519 7022 6526 6030 5533 
			5037 4541 4045 3548 3052 2556 2060 1563 1067 571 
			74 (-39)

			/* battery,ocv_arr_val */
			43280 42611 42027 41475 40952 40469 40030 39647 39301 38835 
			38457 38230 38060 37933 37827 37709 37518 37296 36981 36852
			34527 32908

			/* battery,tunning */
			0x00

			/***** battery data for 4.36 *****/
			/* battery,battery_table3 */
			160 10 23 10 159 9 46 9 195 8
			96 8 6 8 184 7 113 7 17 7
			196 6 150 6 115 6 89 6 67 6
			43 6 4 6 214 5 150 5 123 5
			159 3 84 2 8 8 172 7 69 7
			222 6 120 6 17 6 171 5 68 5
			222 4 119 4 17 4 170 3 68 3
			221 2 119 2 16 2 170 1 67 1
			220 0 118 0 15 0 248 15

			/* battery,battery_table4 */
			10 10 10 10 41 41 41 41 41 41
			41 42 42 42 42 43 43 43 44 46
			79 154


			/* battery,batcap */
			0x18 0x6A 0xE4 0x13 /* [0x0E] [0x0F] [0x10] [0x11] */
			/* battery,accum */ 
			0x00 0x08 /* [0x44] [0x45] */

			/* battery,soc_arr_val */
			10088 9588 9087 8586 8086 7585 7084 6584 6083 5582
			5082 4581 4080 3580 3079 2578 2078 1577 1076 576
			75 (-39)
			
			/* battery,ocv_arr_val */
			43280 42611 42027 41475 40952 40469 40030 39647 39301 38835
			38457 38230 38060 37933 37827 37709 37518 37296 36981 36852
			34527 32908

			/* battery,tunning */
			0x00

			/***** battery data for 4.34 *****/
			/* battery,battery_table3 */
			160 10 23 10 159 9 46 9 195 8
			96 8 6 8 184 7 113 7 17 7
			196 6 150 6 115 6 89 6 67 6
			43 6 4 6 214 5 150 5 123 5
			159 3 84 2 49 8 201 7 97 7
			249 6 145 6 41 6 193 5 89 5
			240 4 136 4 32 4 184 3 80 3
			232 2 128 2 24 2 176 1 72 1
			224 0 120 0 16 0 248 15

			/* battery,battery_table4 */
			10 10 10 10 41 41 41 41 41 41
			41 42 42 42 42 43 43 43 44 46
			79 154

			/* battery,batcap */
			0x88 0x68 0x99 0x13 /* [0x0E] [0x0F] [0x10] [0x11] */
			/* battery,accum */
			0x00 0x8 /* [0x44] [0x45] */

			/* battery,soc_arr_val */
			10239 9731 9223 8715 8207 7698 7190 6682 6174 5666
			5158 4650 4141 3633 3125 2617 2109 1601 1093 584
			76 (-40)

			
			/* battery,ocv_arr_val */
			43280 42611 42027 41475 40952 40469 40030 39647 39301 38835
			38457 38230 38060 37933 37827 37709 37518 37296 36981 36852
			34527 32908

			/* battery,tunning */
			0x00

			/***** battery data for 4.32 *****/
			/* battery,battery_table3 */
			160 10 23 10 159 9 46 9 195 8
			96 8 6 8 184 7 113 7 17 7
			196 6 150 6 115 6 89 6 67 6
			43 6 4 6 214 5 150 5 123 5
			159 3 84 2 84 8 234 7 128 7
			23 7 173 6 67 6 217 5 111 5
			6 5 156 4 50 4 200 3 94 3
			245 2 139 2 33 2 183 1 77 1
			227 0 122 0 16 0 248 15

			/* battery,battery_table4 */
			10 10 10 10 41 41 41 41 41 41
			41 42 42 42 42 43 43 43 44 46
			79 154

			/* battery,batcap */
			0xD0 0x66 0x47 0x13 /* [0x0E] [0x0F] [0x10] [0x11] */
			/* battery,accum */
			0x00 0x8 /* [0x44] [0x45] */

			/* battery,soc_arr_val */
			10410 9894 9377 8861 8344 7827 7311 6794 6277 5761
			5244 4727 4211 3694 3177 2661 2144 1627 1111 594
			77 (-40)


			/* battery,ocv_arr_val */
			43280 42611 42027 41475 40952 40469 40030 39647 39301 38835
			38457 38230 38060 37933 37827 37709 37518 37296 36981 36852
			34527 32908

			/* battery,tunning */
			0x00

			/***** battery data for 4.27 *****/
			/* battery,battery_table3 */
			160 10 23 10 159 9 46 9 195 8
			96 8 6 8 184 7 113 7 17 7
			196 6 150 6 115 6 89 6 67 6
			43 6 4 6 214 5 150 5 123 5
			159 3 84 2 179 8 68 8 214 7
			103 7 249 6 138 6 28 6 173 5
			63 5 208 4 98 4 243 3 133 3
			22 3 168 2 57 2 203 1 92 1
			238 0 127 0 17 0 247 15

			/* battery,battery_table4 */
			10 10 10 10 41 41 41 41 41 41
			41 42 42 42 42 43 43 43 44 46
			79 154

			/* battery,batcap */
			0x70 0x62 0x75 0x12 /* [0x0E] [0x0F] [0x10] [0x11] */
			/* battery,accum */
			0x00 0x8 /* [0x44] [0x45] */

			/* battery,soc_arr_val */
			10873 10334 9794 9254 8715 8175 7636 7096 6556 6017
			5477 4938 4398 3858 3319 2779 2239 1700 1160 621
			81 (-42)
			
			/* battery,ocv_arr_val */
			43280 42611 42027 41475 40952 40469 40030 39647 39301 38835
			38457 38230 38060 37933 37827 37709 37518 37296 36981 36852
			34527 32908

			/* battery,tunning */
			0x00
			>;

	battery,battery_table3 = <
			160 10 23 10 159 9 46 9 195 8
			96 8 6 8 184 7 113 7 17 7
			196 6 150 6 115 6 89 6 67 6
			43 6 4 6 214 5 150 5 123 5
			159 3 84 2 0 8 154 7 53 7
			207 6 105 6 4 6 158 5 57 5
			211 4 109 4 8 4 162 3 60 3
			215 2 113 2 11 2 166 1 64 1
			219 0 117 0 15 0 248 15
			>;

	battery,battery_table4 = <
			10 10 10 10 41 41 41 41 41 41
			41 42 42 42 42 43 43 43 44 46
			79 154 
			>;

	battery,batcap = <0x70 0x69 0x7F 0x0E>; /* [0x0E] [0x0F] [0x10] [0x11] */

	battery,soc_arr_val = <
			10000 9504 9007 8511 8015 7519 7022 6526 6030 5533 
			5037 4541 4045 3548 3052 2556 2060 1563 1067 571 
			74 (-39)
			>;

	battery,ocv_arr_val = <
			43280 42611 42027 41475 40952 40469 40030 39647 39301 38835 
			38457 38230 38060 37933 37827 37709 37518 37296 36981 36852
			34527 32908
			>;	
	};

	battery {
		battery,batt_data_version = <4>;
	};
};
