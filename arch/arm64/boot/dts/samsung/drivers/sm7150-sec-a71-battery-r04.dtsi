/* Copyright (c) 2019, The Linux Foundation. All rights reserved.
 *
 * This program is free software; you can redistribute it and/or modify
 * it under the terms of the GNU General Public License version 2 and
 * only version 2 as published by the Free Software Foundation.
 *
 * This program is distributed in the hope that it will be useful,
 * but WITHOUT ANY WARRANTY; without even the implied warranty of
 * MERCHANTABILITY or FITNESS FOR A PARTICULAR PURPOSE.  See the
 * GNU General Public License for more details.
 */

&pm6150_vadc {
	bat_thm {
		reg = <ADC_AMUX_THM4_PU2>;
		label = "bat_thm";
		qcom,ratiometric;
		qcom,hw-settle-time = <200>;
		qcom,pre-scaling = <1 1>;
	};
};

&soc {
	battery {

		battery,temp_table_adc = <
					2127 2475 2966 3377 3975 4632 5454 6390 7499 8709
					10058 11543 13049 14708 16403 18129 19883 21326 22780 24007 
					24825 25547 26180
					>;
	
		io-channels = <&pm6150_vadc ADC_AMUX_THM4_PU2>;
	};
};
