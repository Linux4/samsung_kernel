/ {
	fragment@model {
		target-path = "/";
		__overlay__ {
			shub {
				compatible = "shub";
			};
		};
	};
};

/* /home/dpi/qb5_8814/workspace/P4_1716/android/kernel/kmodule/sensorhub/mtk/mt6765_shub/dts/sensorhub_mt6765_shub.a12u_usa_single.00.dtsi */
/ {
	fragment@model {
		target-path = "/";
		__overlay__ {
			shub {
				acc-lis2dlc12-position = <10>;
				acc-motor-coef = <7>;
			};
		};
	};
};
