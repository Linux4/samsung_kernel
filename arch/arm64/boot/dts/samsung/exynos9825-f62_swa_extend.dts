/*
 * SAMSUNG EXYNOS9825 board device tree source
 *
 * Copyright (c) 2017 Samsung Electronics Co., Ltd.
 *		http://www.samsung.com
 *
 * This program is free software; you can redistribute it and/or modify
 * it under the terms of the GNU General Public License version 2 as
 * published by the Free Software Foundation.
*/

/dts-v1/;
/plugin/;

/ {
	compatible = "samsung,F62 SWA INS", "samsung,EXYNOS9825";
	dtbo-hw_rev = <0>;
   	dtbo-hw_rev_end = <255>;
	edtbo-rev = <0>;

	fragment@model {
		target-path = "/";
		__overlay__ {
			#address-cells = <2>;
			#size-cells = <1>;

			model = "Samsung F62 SWA INS Extend based on EXYNOS9825";
		}; /* end of __overlay__ */
	}; /* end of fragment */
}; /* end of root */
