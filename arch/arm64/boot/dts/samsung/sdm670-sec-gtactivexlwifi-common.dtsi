/*
 * Copyright (c) 2017-2019, The Linux Foundation. All rights reserved.
 *
 * This program is free software; you can redistribute it and/or modify
 * it under the terms of the GNU General Public License version 2 and
 * only version 2 as published by the Free Software Foundation.
 *
 * This program is distributed in the hope that it will be useful,
 * but WITHOUT ANY WARRANTY; without even the implied warranty of
 * MERCHANTABILITY or FITNESS FOR A PARTICULAR PURPOSE.  See the
 * GNU General Public License for more details.
 */

&soc {
	qcom,rmnet-ipa {
		status="disabled";
	};
	
	i2c_17: i2c@17 { /* SW I2C */
		status = "ok";

		cell-index = <17>;
		compatible = "i2c-gpio";
		gpios = <&tlmm 91 0 /* sda */
			 &tlmm 92 0 /* scl */>;
		#i2c-gpio,delay-us = <2>;
		#address-cells = <1>;
		#size-cells = <0>;
		pinctrl-names = "default";
		pinctrl-0 = <&grip_i2c_active>;
	};
};

&ipa_hw {
	status="disabled";
};
