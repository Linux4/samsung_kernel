/* Copyright (c) 2020, The Linux Foundation. All rights reserved.
 *
 * This program is free software; you can redistribute it and/or modify
 * it under the terms of the GNU General Public License version 2 and
 * only version 2 as published by the Free Software Foundation.
 *
 * This program is distributed in the hope that it will be useful,
 * but WITHOUT ANY WARRANTY; without even the implied warranty of
 * MERCHANTABILITY or FITNESS FOR A PARTICULAR PURPOSE.  See the
 * GNU General Public License for more details.
 */

&tlmm {
	wakeup-disabled-gpios = <
		0	/* NC : NC */
		3	/* NC : NC */
		6	/* I2C : TSP_SDA_1P8 */
		10	/* LAGOON : DISP_TE */
		11	/* LCD/HW-REVIEW : EL_ON1_DET */
		16	/* MCLK : RCAM4_MCLK */
		21	/* RST_N : FCAM_RST_N */
		22	/* EN : CAM_FLASH_EN */
		23	/* MCLK : FCAM_MCLK */
		24	/* RST_N : RCAM4_RST_N */
		26	/* I2C : CAM_PMIC_I2C_SCL_1P8 */
		28	/* I2C : FCAM_RCAM2_RCAM4_SENSOR_I2C_SCL_1P8 */
		30	/* RST_N : RCAM1_RST_N */
		32	/* RST_N : MCU_nRST */
		34	/* I2C : NFC_SDA_1P8 */
		36	/* LAGOON : NFC_FIRM */
		37	/* LAGOON : NFC_IRQ */
		38	/* HW-REVIEW : BT_UART_CTS */
		39	/* HW-REVIEW : BT_UART_RTS */
		42	/* RST_N : RCAM2_RST_N */
		43	/* HW-REVIEW : MCU_BOOT0_SWCLK */
		45	/* UART : AP_UART_RXD */
		47	/* I2C : CAM_AF_EEP_I2C_SCL_1P8 */
		49	/* LAGOON : BT_FM_SB_CLK */
		52	/* I2C : GRIP_SCL_1P8 */
		53	/* I2C : CC_SDA_1P8 */
		55	/* NC : NC */
		56	/* NC : NC */
		57	/* NC : NC */
		58	/* RST_N : CODEC_RST_N */
		59	/* SPI : BTP_SPI_MISO */
		62	/* SPI : BTP_SPI_CS_N */
		63	/* EN : RCAM1_LDO_EN */
		64	/* EN : RCAM2_RCAM4_LDO_EN */
		65	/* EN : RCAM3_LDO_EN */
		66	/* LAGOON : CAM_SEL */
		67	/* EN : CAM_TORCH_EN */
		68	/* EN : NFC_LDO_EN */
		69	/* LAGOON : T_FLASH_DET */
		74	/* NC : NC */
		78	/* NC : NC */
		84	/* EN : FM_LNA_EN */
		86	/* I2C : AP_MCU_SDA_1P8 */
		87	/* I2C : AP_MCU_SCL_1P8 */
		88	/* I2C : SPK_AMP_SDA_1P8 */
		89	/* I2C : SPK_AMP_SCL_1P8 */
		90	/* HW-REVIEW : SPK_AMP_INT */
		91	/* RST_N : BTP_RST_N */
		93	/* UNUSED : HALL_INT1 */
		94	/* EN : SPK_AMP_EN */
		95	/* HW-REVIEW : FAST_BOOT_SEL0 */
		98	/* HW-REVIEW : FAST_BOOT_SEL3 */
		107	/* HW-REVIEW : FAST_BOOT_SEL2 */
		109	/* LAGOON : CP_WLAN_COEX_RXD */
		114	/* LAGOON : AP_USB_BOOT_POL_SEL */
		115	/* I2C : IF_PMIC_SDA_1P8 */
		116	/* I2C : IF_PMIC_SCL_1P8 */
		118	/* NC : NC */
	>;
};
