/* Copyright (c) 2013, The Linux Foundation. All rights reserved.
 *
 * This program is free software; you can redistribute it and/or modify
 * it under the terms of the GNU General Public License version 2 and
 * only version 2 as published by the Free Software Foundation.
 *
 * This program is distributed in the hope that it will be useful,
 * but WITHOUT ANY WARRANTY; without even the implied warranty of
 * MERCHANTABILITY or FITNESS FOR A PARTICULAR PURPOSE.  See the
 * GNU General Public License for more details.
 */

/*---------------------------------------------------------------------------
 * This file is autogenerated file using gcdb parser. Please do not edit it.
 * Update input XML file to add a new entry or update variable in this file
 * VERSION = "1.0"
 *---------------------------------------------------------------------------*/
&mdss_mdp {
	dsi_liansi_panda_lrpol_ili9882h_720p_video: qcom,mdss_dsi_liansi_panda_lrpol_ili9882h_720p_video {
		qcom,mdss-dsi-panel-name = "liansi panda lrpol ili9882h 720p video mode dsi panel";
		qcom,mdss-dsi-panel-flag = "dsi_liansi_panda_lrpol_ili9882h";
		qcom,mdss-dsi-panel-controller = <&mdss_dsi0>;
		qcom,mdss-dsi-panel-type = "dsi_video_mode";
		qcom,mdss-dsi-panel-destination = "display_1";
		qcom,mdss-dsi-panel-framerate = <60>;
		qcom,mdss-dsi-virtual-channel-id = <0>;
		qcom,mdss-dsi-init-master-time = <50000>;
		qcom,mdss-dsi-stream = <0>;
		qcom,mdss-dsi-panel-width = <720>;
		qcom,mdss-dsi-panel-height = <1600>;
		qcom,mdss-dsi-h-front-porch = <248>;
		qcom,mdss-dsi-h-back-porch = <244>;
		qcom,mdss-dsi-h-pulse-width = <20>;
		qcom,mdss-dsi-h-sync-skew = <0>;
		qcom,mdss-dsi-v-back-porch = <16>;
		qcom,mdss-dsi-v-front-porch = <240>;
		qcom,mdss-dsi-v-pulse-width = <2>;
		qcom,mdss-dsi-h-left-border = <0>;
		qcom,mdss-dsi-h-right-border = <0>;
		qcom,mdss-dsi-v-top-border = <0>;
		qcom,mdss-dsi-v-bottom-border = <0>;
		qcom,mdss-dsi-bpp = <24>;
		qcom,mdss-dsi-color-order = "rgb_swap_rgb";
		qcom,mdss-dsi-underflow-color = <0xff>;
		qcom,mdss-dsi-border-color = <0>;
		qcom,bklt-dcs-ctrl-mode = <0>;
		qcom,mdss-dsi-on-command = [
			39 01 00 00 00 00 04 FF 98 82 01
			39 01 00 00 00 00 02 00 41
			39 01 00 00 00 00 02 01 32
			39 01 00 00 00 00 02 02 01
			39 01 00 00 00 00 02 03 00
			39 01 00 00 00 00 02 04 03
			39 01 00 00 00 00 02 05 30
			39 01 00 00 00 00 02 07 00
			39 01 00 00 00 00 02 08 01
			39 01 00 00 00 00 02 09 80
			39 01 00 00 00 00 02 0a 70
			39 01 00 00 00 00 02 0b 00
			39 01 00 00 00 00 02 0c 0e
			39 01 00 00 00 00 02 0d 0e
			39 01 00 00 00 00 02 0e 00
			39 01 00 00 00 00 02 0f 00
			39 01 00 00 00 00 02 28 88
			39 01 00 00 00 00 02 29 88
			39 01 00 00 00 00 02 2a 00
			39 01 00 00 00 00 02 2b 00
			39 01 00 00 00 00 02 31 07
			39 01 00 00 00 00 02 32 0c
			39 01 00 00 00 00 02 33 22
			39 01 00 00 00 00 02 34 23
			39 01 00 00 00 00 02 35 07
			39 01 00 00 00 00 02 36 08
			39 01 00 00 00 00 02 37 16
			39 01 00 00 00 00 02 38 14
			39 01 00 00 00 00 02 39 12
			39 01 00 00 00 00 02 3a 10
			39 01 00 00 00 00 02 3b 21
			39 01 00 00 00 00 02 3c 07
			39 01 00 00 00 00 02 3d 07
			39 01 00 00 00 00 02 3e 07
			39 01 00 00 00 00 02 3f 07
			39 01 00 00 00 00 02 40 07
			39 01 00 00 00 00 02 41 07
			39 01 00 00 00 00 02 42 07
			39 01 00 00 00 00 02 43 07
			39 01 00 00 00 00 02 44 07
			39 01 00 00 00 00 02 45 07
			39 01 00 00 00 00 02 46 07
			39 01 00 00 00 00 02 47 07
			39 01 00 00 00 00 02 48 0d
			39 01 00 00 00 00 02 49 22
			39 01 00 00 00 00 02 4a 23
			39 01 00 00 00 00 02 4b 07
			39 01 00 00 00 00 02 4c 09
			39 01 00 00 00 00 02 4d 17
			39 01 00 00 00 00 02 4e 15
			39 01 00 00 00 00 02 4f 13
			39 01 00 00 00 00 02 50 11
			39 01 00 00 00 00 02 51 21
			39 01 00 00 00 00 02 52 07
			39 01 00 00 00 00 02 53 07
			39 01 00 00 00 00 02 54 07
			39 01 00 00 00 00 02 55 07
			39 01 00 00 00 00 02 56 07
			39 01 00 00 00 00 02 57 07
			39 01 00 00 00 00 02 58 07
			39 01 00 00 00 00 02 59 07
			39 01 00 00 00 00 02 5a 07
			39 01 00 00 00 00 02 5b 07
			39 01 00 00 00 00 02 5c 07
			39 01 00 00 00 00 02 61 07
			39 01 00 00 00 00 02 62 0d
			39 01 00 00 00 00 02 63 22
			39 01 00 00 00 00 02 64 23
			39 01 00 00 00 00 02 65 07
			39 01 00 00 00 00 02 66 09
			39 01 00 00 00 00 02 67 11
			39 01 00 00 00 00 02 68 13
			39 01 00 00 00 00 02 69 15
			39 01 00 00 00 00 02 6a 17
			39 01 00 00 00 00 02 6b 21
			39 01 00 00 00 00 02 6c 07
			39 01 00 00 00 00 02 6d 07
			39 01 00 00 00 00 02 6e 07
			39 01 00 00 00 00 02 6f 07
			39 01 00 00 00 00 02 70 07
			39 01 00 00 00 00 02 71 07
			39 01 00 00 00 00 02 72 07
			39 01 00 00 00 00 02 73 07
			39 01 00 00 00 00 02 74 07
			39 01 00 00 00 00 02 75 07
			39 01 00 00 00 00 02 76 07
			39 01 00 00 00 00 02 77 07
			39 01 00 00 00 00 02 78 0c
			39 01 00 00 00 00 02 79 22
			39 01 00 00 00 00 02 7a 23
			39 01 00 00 00 00 02 7b 07
			39 01 00 00 00 00 02 7c 08
			39 01 00 00 00 00 02 7d 10
			39 01 00 00 00 00 02 7e 12
			39 01 00 00 00 00 02 7f 14
			39 01 00 00 00 00 02 80 16
			39 01 00 00 00 00 02 81 21
			39 01 00 00 00 00 02 82 07
			39 01 00 00 00 00 02 83 07
			39 01 00 00 00 00 02 84 07
			39 01 00 00 00 00 02 85 07
			39 01 00 00 00 00 02 86 07
			39 01 00 00 00 00 02 87 07
			39 01 00 00 00 00 02 88 07
			39 01 00 00 00 00 02 89 07
			39 01 00 00 00 00 02 8a 07
			39 01 00 00 00 00 02 8b 07
			39 01 00 00 00 00 02 8c 07
			39 01 00 00 00 00 02 b0 33
			39 01 00 00 00 00 02 ba 06
			39 01 00 00 00 00 02 c0 07
			39 01 00 00 00 00 02 c1 00
			39 01 00 00 00 00 02 c2 00
			39 01 00 00 00 00 02 c3 00
			39 01 00 00 00 00 02 c4 00
			39 01 00 00 00 00 02 ca 44
			39 01 00 00 00 00 02 D0 01
			39 01 00 00 00 00 02 D1 22
			39 01 00 00 00 00 02 D3 40
			39 01 00 00 00 00 02 D5 51
			39 01 00 00 00 00 02 D6 20
			39 01 00 00 00 00 02 D7 01
			39 01 00 00 00 00 02 D8 00
			39 01 00 00 00 00 02 Dc c2
			39 01 00 00 00 00 02 DD 10
			39 01 00 00 00 00 02 DF b6
			39 01 00 00 00 00 02 E0 3E
			39 01 00 00 00 00 02 E2 47
			39 01 00 00 00 00 02 E7 54
			39 01 00 00 00 00 02 E6 22
			39 01 00 00 00 00 02 EE 15
			39 01 00 00 00 00 02 F1 00
			39 01 00 00 00 00 02 F2 00
			39 01 00 00 00 00 02 FA DF
			39 01 00 00 00 00 04 FF 98 82 02
			39 01 00 00 00 00 02 F1 1C
			39 01 00 00 00 00 02 40 4B
			39 01 00 00 00 00 02 4B 5A
			39 01 00 00 00 00 02 50 CA
			39 01 00 00 00 00 02 51 50
			39 01 00 00 00 00 02 06 8E
			39 01 00 00 00 00 02 0B A0
			39 01 00 00 00 00 02 0C 00
			39 01 00 00 00 00 02 0D 12
			39 01 00 00 00 00 02 0E F0
			39 01 00 00 00 00 02 4D CE
			39 01 00 00 00 00 04 FF 98 82 03
			39 01 00 00 00 00 02 83 20
			39 01 00 00 00 00 02 84 00
			39 01 00 00 00 00 04 FF 98 82 05
			39 01 00 00 00 00 02 A8 62
			39 01 00 00 00 00 02 03 00
			39 01 00 00 00 00 02 04 AF
			39 01 00 00 00 00 02 63 73
			39 01 00 00 00 00 02 64 73
			39 01 00 00 00 00 02 68 65
			39 01 00 00 00 00 02 69 6B
			39 01 00 00 00 00 02 6A A1
			39 01 00 00 00 00 02 6B 93
			39 01 00 00 00 00 02 00 01
			39 01 00 00 00 00 02 46 00
			39 01 00 00 00 00 02 45 01
			39 01 00 00 00 00 02 17 50
			39 01 00 00 00 00 02 18 01
			39 01 00 00 00 00 02 85 37
			39 01 00 00 00 00 02 86 0F
			39 01 00 00 00 00 04 FF 98 82 06
			39 01 00 00 00 00 02 D9 10
			39 01 00 00 00 00 02 C0 40
			39 01 00 00 00 00 02 C1 16
			39 01 00 00 00 00 02 07 F7
			39 01 00 00 00 00 02 06 A4
			39 01 00 00 00 00 04 FF 98 82 07
			39 01 00 00 00 00 02 00 0C
			39 01 00 00 00 00 04 FF 98 82 08
			39 01 00 00 00 00 1C E0 40 24 98 D2 13 55 44 68 91 B2 A9 E3 09 2A 49 AA 69 92 AE D3 FE F4 21 5B 8E 03 EC
			39 01 00 00 00 00 1C E1 40 24 98 D2 13 55 44 68 91 B2 A9 E3 09 2A 49 AA 69 92 AE D3 FE F4 21 5B 8E 03 EC
			39 01 00 00 00 00 04 FF 98 82 0B
			39 01 00 00 00 00 02 9A 44
			39 01 00 00 00 00 02 9B 7C
			39 01 00 00 00 00 02 9C 03
			39 01 00 00 00 00 02 9D 03
			39 01 00 00 00 00 02 9E 70
			39 01 00 00 00 00 02 9F 70
			39 01 00 00 00 00 02 AB E0
			39 01 00 00 00 00 04 FF 98 82 0E
			39 01 00 00 00 00 02 02 09
			39 01 00 00 00 00 02 11 50
			39 01 00 00 00 00 02 13 10
			39 01 00 00 00 00 02 00 A0
			39 01 00 00 00 00 04 FF 98 82 00
			39 01 00 00 00 00 03 68 04 00
			39 01 00 00 00 00 03 51 00 00
			15 01 00 00 00 00 02 53 2C
			15 01 00 00 00 00 02 55 00
			15 01 00 00 50 00 02 11 00
			15 01 00 00 14 00 02 29 00
			39 01 00 00 00 00 02 35 00];
		qcom,mdss-dsi-on-command1 = [
			39 01 00 00 00 00 04 FF 98 82 01
			39 01 00 00 00 00 02 00 41
			39 01 00 00 00 00 02 01 32
			39 01 00 00 00 00 02 02 01
			39 01 00 00 00 00 02 03 00
			39 01 00 00 00 00 02 04 03
			39 01 00 00 00 00 02 05 30
			39 01 00 00 00 00 02 07 00
			39 01 00 00 00 00 02 08 01
			39 01 00 00 00 00 02 09 80
			39 01 00 00 00 00 02 0a 70
			39 01 00 00 00 00 02 0b 00
			39 01 00 00 00 00 02 0c 0e
			39 01 00 00 00 00 02 0d 0e
			39 01 00 00 00 00 02 0e 00
			39 01 00 00 00 00 02 0f 00
			39 01 00 00 00 00 02 28 88
			39 01 00 00 00 00 02 29 88
			39 01 00 00 00 00 02 2a 00
			39 01 00 00 00 00 02 2b 00
			39 01 00 00 00 00 02 31 07
			39 01 00 00 00 00 02 32 0c
			39 01 00 00 00 00 02 33 22
			39 01 00 00 00 00 02 34 23
			39 01 00 00 00 00 02 35 07
			39 01 00 00 00 00 02 36 08
			39 01 00 00 00 00 02 37 16
			39 01 00 00 00 00 02 38 14
			39 01 00 00 00 00 02 39 12
			39 01 00 00 00 00 02 3a 10
			39 01 00 00 00 00 02 3b 21
			39 01 00 00 00 00 02 3c 07
			39 01 00 00 00 00 02 3d 07
			39 01 00 00 00 00 02 3e 07
			39 01 00 00 00 00 02 3f 07
			39 01 00 00 00 00 02 40 07
			39 01 00 00 00 00 02 41 07
			39 01 00 00 00 00 02 42 07
			39 01 00 00 00 00 02 43 07
			39 01 00 00 00 00 02 44 07
			39 01 00 00 00 00 02 45 07
			39 01 00 00 00 00 02 46 07
			39 01 00 00 00 00 02 47 07
			39 01 00 00 00 00 02 48 0d
			39 01 00 00 00 00 02 49 22
			39 01 00 00 00 00 02 4a 23
			39 01 00 00 00 00 02 4b 07
			39 01 00 00 00 00 02 4c 09
			39 01 00 00 00 00 02 4d 17
			39 01 00 00 00 00 02 4e 15
			39 01 00 00 00 00 02 4f 13
			39 01 00 00 00 00 02 50 11
			39 01 00 00 00 00 02 51 21
			39 01 00 00 00 00 02 52 07
			39 01 00 00 00 00 02 53 07
			39 01 00 00 00 00 02 54 07
			39 01 00 00 00 00 02 55 07
			39 01 00 00 00 00 02 56 07
			39 01 00 00 00 00 02 57 07
			39 01 00 00 00 00 02 58 07
			39 01 00 00 00 00 02 59 07
			39 01 00 00 00 00 02 5a 07
			39 01 00 00 00 00 02 5b 07
			39 01 00 00 00 00 02 5c 07
			39 01 00 00 00 00 02 61 07
			39 01 00 00 00 00 02 62 0d
			39 01 00 00 00 00 02 63 22
			39 01 00 00 00 00 02 64 23
			39 01 00 00 00 00 02 65 07
			39 01 00 00 00 00 02 66 09
			39 01 00 00 00 00 02 67 11
			39 01 00 00 00 00 02 68 13
			39 01 00 00 00 00 02 69 15
			39 01 00 00 00 00 02 6a 17
			39 01 00 00 00 00 02 6b 21
			39 01 00 00 00 00 02 6c 07
			39 01 00 00 00 00 02 6d 07
			39 01 00 00 00 00 02 6e 07
			39 01 00 00 00 00 02 6f 07
			39 01 00 00 00 00 02 70 07
			39 01 00 00 00 00 02 71 07
			39 01 00 00 00 00 02 72 07
			39 01 00 00 00 00 02 73 07
			39 01 00 00 00 00 02 74 07
			39 01 00 00 00 00 02 75 07
			39 01 00 00 00 00 02 76 07
			39 01 00 00 00 00 02 77 07
			39 01 00 00 00 00 02 78 0c
			39 01 00 00 00 00 02 79 22
			39 01 00 00 00 00 02 7a 23
			39 01 00 00 00 00 02 7b 07
			39 01 00 00 00 00 02 7c 08
			39 01 00 00 00 00 02 7d 10
			39 01 00 00 00 00 02 7e 12
			39 01 00 00 00 00 02 7f 14
			39 01 00 00 00 00 02 80 16
			39 01 00 00 00 00 02 81 21
			39 01 00 00 00 00 02 82 07
			39 01 00 00 00 00 02 83 07
			39 01 00 00 00 00 02 84 07
			39 01 00 00 00 00 02 85 07
			39 01 00 00 00 00 02 86 07
			39 01 00 00 00 00 02 87 07
			39 01 00 00 00 00 02 88 07
			39 01 00 00 00 00 02 89 07
			39 01 00 00 00 00 02 8a 07
			39 01 00 00 00 00 02 8b 07
			39 01 00 00 00 00 02 8c 07
			39 01 00 00 00 00 02 b0 33
			39 01 00 00 00 00 02 ba 06
			39 01 00 00 00 00 02 c0 07
			39 01 00 00 00 00 02 c1 00
			39 01 00 00 00 00 02 c2 00
			39 01 00 00 00 00 02 c3 00
			39 01 00 00 00 00 02 c4 00
			39 01 00 00 00 00 02 ca 44
			39 01 00 00 00 00 02 D0 01
			39 01 00 00 00 00 02 D1 22
			39 01 00 00 00 00 02 D3 40
			39 01 00 00 00 00 02 D5 51
			39 01 00 00 00 00 02 D6 20
			39 01 00 00 00 00 02 D7 01
			39 01 00 00 00 00 02 D8 00
			39 01 00 00 00 00 02 Dc c2
			39 01 00 00 00 00 02 DD 10
			39 01 00 00 00 00 02 DF b6
			39 01 00 00 00 00 02 E0 3E
			39 01 00 00 00 00 02 E2 47
			39 01 00 00 00 00 02 E7 54
			39 01 00 00 00 00 02 E6 22
			39 01 00 00 00 00 02 EE 15
			39 01 00 00 00 00 02 F1 00
			39 01 00 00 00 00 02 F2 00
			39 01 00 00 00 00 02 FA DF
			39 01 00 00 00 00 04 FF 98 82 02
			39 01 00 00 00 00 02 F1 1C
			39 01 00 00 00 00 02 40 4B
			39 01 00 00 00 00 02 4B 5A
			39 01 00 00 00 00 02 50 CA
			39 01 00 00 00 00 02 51 50
			39 01 00 00 00 00 02 06 8E
			39 01 00 00 00 00 02 0B A0
			39 01 00 00 00 00 02 0C 00
			39 01 00 00 00 00 02 0D 12
			39 01 00 00 00 00 02 0E F0
			39 01 00 00 00 00 02 4D CE
			39 01 00 00 00 00 04 FF 98 82 03
			39 01 00 00 00 00 02 83 20
			39 01 00 00 00 00 02 84 00
			39 01 00 00 00 00 04 FF 98 82 05
			39 01 00 00 00 00 02 A8 62
			39 01 00 00 00 00 02 03 00
			39 01 00 00 00 00 02 04 AF
			39 01 00 00 00 00 02 63 73
			39 01 00 00 00 00 02 64 73
			39 01 00 00 00 00 02 68 1F
			39 01 00 00 00 00 02 69 6B
			39 01 00 00 00 00 02 6A 5B
			39 01 00 00 00 00 02 6B 93
			39 01 00 00 00 00 02 00 01
			39 01 00 00 00 00 02 46 00
			39 01 00 00 00 00 02 45 01
			39 01 00 00 00 00 02 17 50
			39 01 00 00 00 00 02 18 01
			39 01 00 00 00 00 02 85 37
			39 01 00 00 00 00 02 86 0F
			39 01 00 00 00 00 04 FF 98 82 06
			39 01 00 00 00 00 02 D9 10
			39 01 00 00 00 00 02 C0 40
			39 01 00 00 00 00 02 C1 16
			39 01 00 00 00 00 02 07 F7
			39 01 00 00 00 00 02 06 A4
			39 01 00 00 00 00 04 FF 98 82 07
			39 01 00 00 00 00 02 00 0C
			39 01 00 00 00 00 04 FF 98 82 08
			39 01 00 00 00 00 1C E0 40 24 98 D2 13 55 44 68 91 B2 A9 E3 09 2A 49 AA 69 92 AE D3 FE F4 21 5B 8E 03 EC
			39 01 00 00 00 00 1C E1 40 24 98 D2 13 55 44 68 91 B2 A9 E3 09 2A 49 AA 69 92 AE D3 FE F4 21 5B 8E 03 EC
			39 01 00 00 00 00 04 FF 98 82 0B
			39 01 00 00 00 00 02 9A 44
			39 01 00 00 00 00 02 9B 7C
			39 01 00 00 00 00 02 9C 03
			39 01 00 00 00 00 02 9D 03
			39 01 00 00 00 00 02 9E 70
			39 01 00 00 00 00 02 9F 70
			39 01 00 00 00 00 02 AB E0
			39 01 00 00 00 00 04 FF 98 82 0E
			39 01 00 00 00 00 02 02 09
			39 01 00 00 00 00 02 11 50
			39 01 00 00 00 00 02 13 10
			39 01 00 00 00 00 02 00 A0
			39 01 00 00 00 00 04 FF 98 82 00
			39 01 00 00 00 00 03 68 04 00
			39 01 00 00 00 00 03 51 00 00
			15 01 00 00 00 00 02 53 2C
			15 01 00 00 00 00 02 55 00
			15 01 00 00 50 00 02 11 00
			15 01 00 00 14 00 02 29 00
			39 01 00 00 00 00 02 35 00];
		qcom,mdss-dsi-on-command2 = [
			39 01 00 00 00 00 04 FF 98 82 01
			39 01 00 00 00 00 02 00 41
			39 01 00 00 00 00 02 01 32
			39 01 00 00 00 00 02 02 01
			39 01 00 00 00 00 02 03 00
			39 01 00 00 00 00 02 04 03
			39 01 00 00 00 00 02 05 30
			39 01 00 00 00 00 02 07 00
			39 01 00 00 00 00 02 08 01
			39 01 00 00 00 00 02 09 80
			39 01 00 00 00 00 02 0a 70
			39 01 00 00 00 00 02 0b 00
			39 01 00 00 00 00 02 0c 0e
			39 01 00 00 00 00 02 0d 0e
			39 01 00 00 00 00 02 0e 00
			39 01 00 00 00 00 02 0f 00
			39 01 00 00 00 00 02 28 88
			39 01 00 00 00 00 02 29 88
			39 01 00 00 00 00 02 2a 00
			39 01 00 00 00 00 02 2b 00
			39 01 00 00 00 00 02 31 07
			39 01 00 00 00 00 02 32 0c
			39 01 00 00 00 00 02 33 22
			39 01 00 00 00 00 02 34 23
			39 01 00 00 00 00 02 35 07
			39 01 00 00 00 00 02 36 08
			39 01 00 00 00 00 02 37 16
			39 01 00 00 00 00 02 38 14
			39 01 00 00 00 00 02 39 12
			39 01 00 00 00 00 02 3a 10
			39 01 00 00 00 00 02 3b 21
			39 01 00 00 00 00 02 3c 07
			39 01 00 00 00 00 02 3d 07
			39 01 00 00 00 00 02 3e 07
			39 01 00 00 00 00 02 3f 07
			39 01 00 00 00 00 02 40 07
			39 01 00 00 00 00 02 41 07
			39 01 00 00 00 00 02 42 07
			39 01 00 00 00 00 02 43 07
			39 01 00 00 00 00 02 44 07
			39 01 00 00 00 00 02 45 07
			39 01 00 00 00 00 02 46 07
			39 01 00 00 00 00 02 47 07
			39 01 00 00 00 00 02 48 0d
			39 01 00 00 00 00 02 49 22
			39 01 00 00 00 00 02 4a 23
			39 01 00 00 00 00 02 4b 07
			39 01 00 00 00 00 02 4c 09
			39 01 00 00 00 00 02 4d 17
			39 01 00 00 00 00 02 4e 15
			39 01 00 00 00 00 02 4f 13
			39 01 00 00 00 00 02 50 11
			39 01 00 00 00 00 02 51 21
			39 01 00 00 00 00 02 52 07
			39 01 00 00 00 00 02 53 07
			39 01 00 00 00 00 02 54 07
			39 01 00 00 00 00 02 55 07
			39 01 00 00 00 00 02 56 07
			39 01 00 00 00 00 02 57 07
			39 01 00 00 00 00 02 58 07
			39 01 00 00 00 00 02 59 07
			39 01 00 00 00 00 02 5a 07
			39 01 00 00 00 00 02 5b 07
			39 01 00 00 00 00 02 5c 07
			39 01 00 00 00 00 02 61 07
			39 01 00 00 00 00 02 62 0d
			39 01 00 00 00 00 02 63 22
			39 01 00 00 00 00 02 64 23
			39 01 00 00 00 00 02 65 07
			39 01 00 00 00 00 02 66 09
			39 01 00 00 00 00 02 67 11
			39 01 00 00 00 00 02 68 13
			39 01 00 00 00 00 02 69 15
			39 01 00 00 00 00 02 6a 17
			39 01 00 00 00 00 02 6b 21
			39 01 00 00 00 00 02 6c 07
			39 01 00 00 00 00 02 6d 07
			39 01 00 00 00 00 02 6e 07
			39 01 00 00 00 00 02 6f 07
			39 01 00 00 00 00 02 70 07
			39 01 00 00 00 00 02 71 07
			39 01 00 00 00 00 02 72 07
			39 01 00 00 00 00 02 73 07
			39 01 00 00 00 00 02 74 07
			39 01 00 00 00 00 02 75 07
			39 01 00 00 00 00 02 76 07
			39 01 00 00 00 00 02 77 07
			39 01 00 00 00 00 02 78 0c
			39 01 00 00 00 00 02 79 22
			39 01 00 00 00 00 02 7a 23
			39 01 00 00 00 00 02 7b 07
			39 01 00 00 00 00 02 7c 08
			39 01 00 00 00 00 02 7d 10
			39 01 00 00 00 00 02 7e 12
			39 01 00 00 00 00 02 7f 14
			39 01 00 00 00 00 02 80 16
			39 01 00 00 00 00 02 81 21
			39 01 00 00 00 00 02 82 07
			39 01 00 00 00 00 02 83 07
			39 01 00 00 00 00 02 84 07
			39 01 00 00 00 00 02 85 07
			39 01 00 00 00 00 02 86 07
			39 01 00 00 00 00 02 87 07
			39 01 00 00 00 00 02 88 07
			39 01 00 00 00 00 02 89 07
			39 01 00 00 00 00 02 8a 07
			39 01 00 00 00 00 02 8b 07
			39 01 00 00 00 00 02 8c 07
			39 01 00 00 00 00 02 b0 33
			39 01 00 00 00 00 02 ba 06
			39 01 00 00 00 00 02 c0 07
			39 01 00 00 00 00 02 c1 00
			39 01 00 00 00 00 02 c2 00
			39 01 00 00 00 00 02 c3 00
			39 01 00 00 00 00 02 c4 00
			39 01 00 00 00 00 02 ca 44
			39 01 00 00 00 00 02 D0 01
			39 01 00 00 00 00 02 D1 22
			39 01 00 00 00 00 02 D3 40
			39 01 00 00 00 00 02 D5 51
			39 01 00 00 00 00 02 D6 20
			39 01 00 00 00 00 02 D7 01
			39 01 00 00 00 00 02 D8 00
			39 01 00 00 00 00 02 Dc c2
			39 01 00 00 00 00 02 DD 10
			39 01 00 00 00 00 02 DF b6
			39 01 00 00 00 00 02 E0 3E
			39 01 00 00 00 00 02 E2 47
			39 01 00 00 00 00 02 E7 54
			39 01 00 00 00 00 02 E6 22
			39 01 00 00 00 00 02 EE 15
			39 01 00 00 00 00 02 F1 00
			39 01 00 00 00 00 02 F2 00
			39 01 00 00 00 00 02 FA DF
			39 01 00 00 00 00 04 FF 98 82 02
			39 01 00 00 00 00 02 F1 1C
			39 01 00 00 00 00 02 40 4B
			39 01 00 00 00 00 02 4B 5A
			39 01 00 00 00 00 02 50 CA
			39 01 00 00 00 00 02 51 50
			39 01 00 00 00 00 02 06 8E
			39 01 00 00 00 00 02 0B A0
			39 01 00 00 00 00 02 0C 00
			39 01 00 00 00 00 02 0D 12
			39 01 00 00 00 00 02 0E F0
			39 01 00 00 00 00 02 4D CE
			39 01 00 00 00 00 04 FF 98 82 03
			39 01 00 00 00 00 02 83 20
			39 01 00 00 00 00 02 84 00
			39 01 00 00 00 00 04 FF 98 82 05
			39 01 00 00 00 00 02 A8 62
			39 01 00 00 00 00 02 03 00
			39 01 00 00 00 00 02 04 AF
			39 01 00 00 00 00 02 63 73
			39 01 00 00 00 00 02 64 73
			39 01 00 00 00 00 02 68 1F
			39 01 00 00 00 00 02 69 6B
			39 01 00 00 00 00 02 6A 5B
			39 01 00 00 00 00 02 6B 93
			39 01 00 00 00 00 02 00 01
			39 01 00 00 00 00 02 46 00
			39 01 00 00 00 00 02 45 01
			39 01 00 00 00 00 02 17 50
			39 01 00 00 00 00 02 18 01
			39 01 00 00 00 00 02 85 37
			39 01 00 00 00 00 02 86 0F
			39 01 00 00 00 00 04 FF 98 82 06
			39 01 00 00 00 00 02 D9 10
			39 01 00 00 00 00 02 C0 40
			39 01 00 00 00 00 02 C1 16
			39 01 00 00 00 00 02 07 F7
			39 01 00 00 00 00 02 06 A4
			39 01 00 00 00 00 04 FF 98 82 07
			39 01 00 00 00 00 02 00 0C
			39 01 00 00 00 00 04 FF 98 82 08
			39 01 00 00 00 00 1C E0 40 24 98 D2 13 55 44 68 91 B2 A9 E3 09 2A 49 AA 69 92 AE D3 FE F4 21 5B 8E 03 EC
			39 01 00 00 00 00 1C E1 40 24 98 D2 13 55 44 68 91 B2 A9 E3 09 2A 49 AA 69 92 AE D3 FE F4 21 5B 8E 03 EC
			39 01 00 00 00 00 04 FF 98 82 0B
			39 01 00 00 00 00 02 9A 44
			39 01 00 00 00 00 02 9B 7C
			39 01 00 00 00 00 02 9C 03
			39 01 00 00 00 00 02 9D 03
			39 01 00 00 00 00 02 9E 70
			39 01 00 00 00 00 02 9F 70
			39 01 00 00 00 00 02 AB E0
			39 01 00 00 00 00 04 FF 98 82 0E
			39 01 00 00 00 00 02 02 09
			39 01 00 00 00 00 02 11 50
			39 01 00 00 00 00 02 13 10
			39 01 00 00 00 00 02 00 A0
			39 01 00 00 00 00 04 FF 98 82 00
			39 01 00 00 00 00 03 68 04 00
			39 01 00 00 00 00 03 51 00 00
			15 01 00 00 00 00 02 53 2C
			15 01 00 00 00 00 02 55 00
			15 01 00 00 50 00 02 11 00
			15 01 00 00 14 00 02 29 00
			39 01 00 00 00 00 02 35 00];
		qcom,mdss-dsi-on-command3 = [
			39 01 00 00 00 00 04 FF 98 82 01
			39 01 00 00 00 00 02 00 41
			39 01 00 00 00 00 02 01 32
			39 01 00 00 00 00 02 02 01
			39 01 00 00 00 00 02 03 00
			39 01 00 00 00 00 02 04 03
			39 01 00 00 00 00 02 05 30
			39 01 00 00 00 00 02 07 00
			39 01 00 00 00 00 02 08 01
			39 01 00 00 00 00 02 09 80
			39 01 00 00 00 00 02 0a 70
			39 01 00 00 00 00 02 0b 00
			39 01 00 00 00 00 02 0c 0e
			39 01 00 00 00 00 02 0d 0e
			39 01 00 00 00 00 02 0e 00
			39 01 00 00 00 00 02 0f 00
			39 01 00 00 00 00 02 28 88
			39 01 00 00 00 00 02 29 88
			39 01 00 00 00 00 02 2a 00
			39 01 00 00 00 00 02 2b 00
			39 01 00 00 00 00 02 31 07
			39 01 00 00 00 00 02 32 0c
			39 01 00 00 00 00 02 33 22
			39 01 00 00 00 00 02 34 23
			39 01 00 00 00 00 02 35 07
			39 01 00 00 00 00 02 36 08
			39 01 00 00 00 00 02 37 16
			39 01 00 00 00 00 02 38 14
			39 01 00 00 00 00 02 39 12
			39 01 00 00 00 00 02 3a 10
			39 01 00 00 00 00 02 3b 21
			39 01 00 00 00 00 02 3c 07
			39 01 00 00 00 00 02 3d 07
			39 01 00 00 00 00 02 3e 07
			39 01 00 00 00 00 02 3f 07
			39 01 00 00 00 00 02 40 07
			39 01 00 00 00 00 02 41 07
			39 01 00 00 00 00 02 42 07
			39 01 00 00 00 00 02 43 07
			39 01 00 00 00 00 02 44 07
			39 01 00 00 00 00 02 45 07
			39 01 00 00 00 00 02 46 07
			39 01 00 00 00 00 02 47 07
			39 01 00 00 00 00 02 48 0d
			39 01 00 00 00 00 02 49 22
			39 01 00 00 00 00 02 4a 23
			39 01 00 00 00 00 02 4b 07
			39 01 00 00 00 00 02 4c 09
			39 01 00 00 00 00 02 4d 17
			39 01 00 00 00 00 02 4e 15
			39 01 00 00 00 00 02 4f 13
			39 01 00 00 00 00 02 50 11
			39 01 00 00 00 00 02 51 21
			39 01 00 00 00 00 02 52 07
			39 01 00 00 00 00 02 53 07
			39 01 00 00 00 00 02 54 07
			39 01 00 00 00 00 02 55 07
			39 01 00 00 00 00 02 56 07
			39 01 00 00 00 00 02 57 07
			39 01 00 00 00 00 02 58 07
			39 01 00 00 00 00 02 59 07
			39 01 00 00 00 00 02 5a 07
			39 01 00 00 00 00 02 5b 07
			39 01 00 00 00 00 02 5c 07
			39 01 00 00 00 00 02 61 07
			39 01 00 00 00 00 02 62 0d
			39 01 00 00 00 00 02 63 22
			39 01 00 00 00 00 02 64 23
			39 01 00 00 00 00 02 65 07
			39 01 00 00 00 00 02 66 09
			39 01 00 00 00 00 02 67 11
			39 01 00 00 00 00 02 68 13
			39 01 00 00 00 00 02 69 15
			39 01 00 00 00 00 02 6a 17
			39 01 00 00 00 00 02 6b 21
			39 01 00 00 00 00 02 6c 07
			39 01 00 00 00 00 02 6d 07
			39 01 00 00 00 00 02 6e 07
			39 01 00 00 00 00 02 6f 07
			39 01 00 00 00 00 02 70 07
			39 01 00 00 00 00 02 71 07
			39 01 00 00 00 00 02 72 07
			39 01 00 00 00 00 02 73 07
			39 01 00 00 00 00 02 74 07
			39 01 00 00 00 00 02 75 07
			39 01 00 00 00 00 02 76 07
			39 01 00 00 00 00 02 77 07
			39 01 00 00 00 00 02 78 0c
			39 01 00 00 00 00 02 79 22
			39 01 00 00 00 00 02 7a 23
			39 01 00 00 00 00 02 7b 07
			39 01 00 00 00 00 02 7c 08
			39 01 00 00 00 00 02 7d 10
			39 01 00 00 00 00 02 7e 12
			39 01 00 00 00 00 02 7f 14
			39 01 00 00 00 00 02 80 16
			39 01 00 00 00 00 02 81 21
			39 01 00 00 00 00 02 82 07
			39 01 00 00 00 00 02 83 07
			39 01 00 00 00 00 02 84 07
			39 01 00 00 00 00 02 85 07
			39 01 00 00 00 00 02 86 07
			39 01 00 00 00 00 02 87 07
			39 01 00 00 00 00 02 88 07
			39 01 00 00 00 00 02 89 07
			39 01 00 00 00 00 02 8a 07
			39 01 00 00 00 00 02 8b 07
			39 01 00 00 00 00 02 8c 07
			39 01 00 00 00 00 02 b0 33
			39 01 00 00 00 00 02 ba 06
			39 01 00 00 00 00 02 c0 07
			39 01 00 00 00 00 02 c1 00
			39 01 00 00 00 00 02 c2 00
			39 01 00 00 00 00 02 c3 00
			39 01 00 00 00 00 02 c4 00
			39 01 00 00 00 00 02 ca 44
			39 01 00 00 00 00 02 D0 01
			39 01 00 00 00 00 02 D1 22
			39 01 00 00 00 00 02 D3 40
			39 01 00 00 00 00 02 D5 51
			39 01 00 00 00 00 02 D6 20
			39 01 00 00 00 00 02 D7 01
			39 01 00 00 00 00 02 D8 00
			39 01 00 00 00 00 02 Dc c2
			39 01 00 00 00 00 02 DD 10
			39 01 00 00 00 00 02 DF b6
			39 01 00 00 00 00 02 E0 3E
			39 01 00 00 00 00 02 E2 47
			39 01 00 00 00 00 02 E7 54
			39 01 00 00 00 00 02 E6 22
			39 01 00 00 00 00 02 EE 15
			39 01 00 00 00 00 02 F1 00
			39 01 00 00 00 00 02 F2 00
			39 01 00 00 00 00 02 FA DF
			39 01 00 00 00 00 04 FF 98 82 02
			39 01 00 00 00 00 02 F1 1C
			39 01 00 00 00 00 02 40 4B
			39 01 00 00 00 00 02 4B 5A
			39 01 00 00 00 00 02 50 CA
			39 01 00 00 00 00 02 51 50
			39 01 00 00 00 00 02 06 8E
			39 01 00 00 00 00 02 0B A0
			39 01 00 00 00 00 02 0C 00
			39 01 00 00 00 00 02 0D 12
			39 01 00 00 00 00 02 0E F0
			39 01 00 00 00 00 02 4D CE
			39 01 00 00 00 00 04 FF 98 82 03
			39 01 00 00 00 00 02 83 20
			39 01 00 00 00 00 02 84 00
			39 01 00 00 00 00 04 FF 98 82 05
			39 01 00 00 00 00 02 A8 62
			39 01 00 00 00 00 02 03 00
			39 01 00 00 00 00 02 04 AF
			39 01 00 00 00 00 02 63 73
			39 01 00 00 00 00 02 64 73
			39 01 00 00 00 00 02 68 1F
			39 01 00 00 00 00 02 69 6B
			39 01 00 00 00 00 02 6A 5B
			39 01 00 00 00 00 02 6B 93
			39 01 00 00 00 00 02 00 01
			39 01 00 00 00 00 02 46 00
			39 01 00 00 00 00 02 45 01
			39 01 00 00 00 00 02 17 50
			39 01 00 00 00 00 02 18 01
			39 01 00 00 00 00 02 85 37
			39 01 00 00 00 00 02 86 0F
			39 01 00 00 00 00 04 FF 98 82 06
			39 01 00 00 00 00 02 D9 10
			39 01 00 00 00 00 02 C0 40
			39 01 00 00 00 00 02 C1 16
			39 01 00 00 00 00 02 07 F7
			39 01 00 00 00 00 02 06 A4
			39 01 00 00 00 00 04 FF 98 82 07
			39 01 00 00 00 00 02 00 0C
			39 01 00 00 00 00 04 FF 98 82 08
			39 01 00 00 00 00 1C E0 40 24 98 D2 13 55 44 68 91 B2 A9 E3 09 2A 49 AA 69 92 AE D3 FE F4 21 5B 8E 03 EC
			39 01 00 00 00 00 1C E1 40 24 98 D2 13 55 44 68 91 B2 A9 E3 09 2A 49 AA 69 92 AE D3 FE F4 21 5B 8E 03 EC
			39 01 00 00 00 00 04 FF 98 82 0B
			39 01 00 00 00 00 02 9A 44
			39 01 00 00 00 00 02 9B 7C
			39 01 00 00 00 00 02 9C 03
			39 01 00 00 00 00 02 9D 03
			39 01 00 00 00 00 02 9E 70
			39 01 00 00 00 00 02 9F 70
			39 01 00 00 00 00 02 AB E0
			39 01 00 00 00 00 04 FF 98 82 0E
			39 01 00 00 00 00 02 02 09
			39 01 00 00 00 00 02 11 50
			39 01 00 00 00 00 02 13 10
			39 01 00 00 00 00 02 00 A0
			39 01 00 00 00 00 04 FF 98 82 00
			39 01 00 00 00 00 03 68 04 00
			39 01 00 00 00 00 03 51 00 00
			15 01 00 00 00 00 02 53 2C
			15 01 00 00 00 00 02 55 00
			15 01 00 00 50 00 02 11 00
			15 01 00 00 14 00 02 29 00
			39 01 00 00 00 00 02 35 00];
		qcom,mdss-dsi-off-command = [
			39 01 00 00 00 00 04 FF 98 82 00
			05 01 00 00 14 00 02 28 00
			05 01 00 00 78 00 02 10 00];
		qcom,mdss-dsi-on-command-state = "dsi_lp_mode";
		qcom,mdss-dsi-off-command-state = "dsi_lp_mode";
		qcom,mdss-dsi-h-sync-pulse = <1>;
		qcom,mdss-dsi-traffic-mode = "burst_mode";
		qcom,mdss-dsi-lane-map = "lane_map_0123";
		qcom,mdss-dsi-bllp-eof-power-mode;
		qcom,mdss-dsi-bllp-power-mode;
		qcom,mdss-dsi-lane-0-state;
		qcom,mdss-dsi-lane-1-state;
		qcom,mdss-dsi-lane-2-state;
		qcom,mdss-dsi-panel-timings-phy-v2 = [
			26 21 09 0b 06 02 04 a0
			26 21 09 0b 06 02 04 a0
			26 21 09 0b 06 02 04 a0
			26 21 09 0b 06 02 04 a0
			26 20 0a 0b 06 02 04 a0];
		qcom,mdss-dsi-t-clk-post = <0x0f>;
		qcom,mdss-dsi-t-clk-pre = <0x37>;
		qcom,mdss-dsi-bl-min-level = <1>;
		qcom,mdss-dsi-bl-max-level = <4095>;
		qcom,esd-check-enabled;
		qcom,mdss-dsi-panel-status-command = [14 01 00 01 05 00 01 0A];
		qcom,mdss-dsi-panel-status-command-state = "dsi_lp_mode";
		qcom,mdss-dsi-panel-status-check-mode = "reg_read";
		qcom,mdss-dsi-panel-status-read-length = <1>;
		qcom,mdss-dsi-panel-max-error-count = <2>;
		qcom,mdss-dsi-panel-status-value = <0x9C>;
		qcom,mdss-dsi-dma-trigger = "trigger_sw";
		qcom,mdss-dsi-mdp-trigger = "none";
		qcom,mdss-dsi-bl-pmic-control-type = "bl_ctrl_dcs";
		qcom,panel-supply-entries = <&dsi_panel_pwr_supply>;
		qcom,mdss-dsi-reset-sequence = <1 4>, <0 5>, <1 10>;
		qcom,mdss-dsi-lp11-init;
		qcom,mdss-dsi-reset-delay-vsp-ms = <1>;
		qcom,mdss-dsi-code-reload-flag;
		qcom,mdss-dsi-reset-keephigh;
		qcom,mdss-dsi-reset-force-pull-low;
		qcom,ulps-enabled;
		qcom,suspend-ulps-enabled;
	};
};
