/* Copyright (c) 2013, The Linux Foundation. All rights reserved.
 *
 * This program is free software; you can redistribute it and/or modify
 * it under the terms of the GNU General Public License version 2 and
 * only version 2 as published by the Free Software Foundation.
 *
 * This program is distributed in the hope that it will be useful,
 * but WITHOUT ANY WARRANTY; without even the implied warranty of
 * MERCHANTABILITY or FITNESS FOR A PARTICULAR PURPOSE.  See the
 * GNU General Public License for more details.
 */

/*---------------------------------------------------------------------------
 * This file is autogenerated file using gcdb parser. Please do not edit it.
 * Update input XML file to add a new entry or update variable in this file
 * VERSION = "1.0"
 *---------------------------------------------------------------------------*/
&mdss_mdp {
	dsi_truly_truly_rs460_nt3652bh_swid41_720p_video: qcom,mdss_dsi_truly_truly_rs460_nt3652bh_swid41_720p_video {
		qcom,mdss-dsi-panel-name = "truly truly rs460 nt3652bh 720p video mode dsi panel";
		qcom,mdss-dsi-panel-controller = <&mdss_dsi0>;
		qcom,mdss-dsi-panel-type = "dsi_video_mode";
		qcom,mdss-dsi-panel-destination = "display_1";
		qcom,mdss-dsi-panel-framerate = <60>;
		qcom,mdss-dsi-virtual-channel-id = <0>;
		qcom,mdss-dsi-init-master-time = <50000>;
		qcom,mdss-dsi-stream = <0>;
		qcom,mdss-dsi-panel-width = <720>;
		qcom,mdss-dsi-panel-height = <1600>;
		qcom,mdss-dsi-h-front-porch = <100>;
		qcom,mdss-dsi-h-back-porch = <80>;
		qcom,mdss-dsi-h-pulse-width = <20>;
		qcom,mdss-dsi-h-sync-skew = <0>;
		qcom,mdss-dsi-v-back-porch = <252>;
		qcom,mdss-dsi-v-front-porch = <8>;
		qcom,mdss-dsi-v-pulse-width = <2>;
		qcom,mdss-dsi-h-left-border = <0>;
		qcom,mdss-dsi-h-right-border = <0>;
		qcom,mdss-dsi-v-top-border = <0>;
		qcom,mdss-dsi-v-bottom-border = <0>;
		qcom,mdss-dsi-bpp = <24>;
		qcom,mdss-dsi-color-order = "rgb_swap_rgb";
		qcom,mdss-dsi-underflow-color = <0xff>;
		qcom,mdss-dsi-border-color = <0>;
		qcom,bklt-dcs-ctrl-mode = <0>;
		qcom,mdss-dsi-on-command = [
			15 01 00 00 00 00 02 FF 20
			15 01 00 00 00 00 02 FB 01
			15 01 00 00 00 00 02 03 54
			15 01 00 00 00 00 02 05 A9
			15 01 00 00 00 00 02 07 69
			15 01 00 00 00 00 02 08 B7
			15 01 00 00 00 00 02 0E 87
			15 01 00 00 00 00 02 0F 55
			15 01 00 00 00 00 02 1F 01
			15 01 00 00 00 00 02 69 A9
			15 01 00 00 00 00 02 94 00
			15 01 00 00 00 00 02 95 F5
			15 01 00 00 00 00 02 96 F5
			15 01 00 00 00 00 02 FF 23
			15 01 00 00 00 00 02 FB 01
			15 01 00 00 00 00 02 00 80
			15 01 00 00 00 00 02 07 00
			15 01 00 00 00 00 02 08 01
			15 01 00 00 00 00 02 09 40
			15 01 00 00 00 00 02 12 B4
			15 01 00 00 00 00 02 15 E9
			15 01 00 00 00 00 02 16 0B
			15 01 00 00 00 00 02 FF 24
			15 01 00 00 00 00 02 FB 01
			15 01 00 00 00 00 02 00 06
			15 01 00 00 00 00 02 01 00
			15 01 00 00 00 00 02 02 00
			15 01 00 00 00 00 02 03 1D
			15 01 00 00 00 00 02 04 00
			15 01 00 00 00 00 02 05 04
			15 01 00 00 00 00 02 06 05
			15 01 00 00 00 00 02 07 01
			15 01 00 00 00 00 02 08 01
			15 01 00 00 00 00 02 09 0C
			15 01 00 00 00 00 02 0A 0C
			15 01 00 00 00 00 02 0B 0D
			15 01 00 00 00 00 02 0C 0D
			15 01 00 00 00 00 02 0D 0E
			15 01 00 00 00 00 02 0E 0E
			15 01 00 00 00 00 02 0F 0F
			15 01 00 00 00 00 02 10 0F
			15 01 00 00 00 00 02 11 00
			15 01 00 00 00 00 02 12 00
			15 01 00 00 00 00 02 13 00
			15 01 00 00 00 00 02 14 00
			15 01 00 00 00 00 02 15 00
			15 01 00 00 00 00 02 16 06
			15 01 00 00 00 00 02 17 00
			15 01 00 00 00 00 02 18 00
			15 01 00 00 00 00 02 19 1D
			15 01 00 00 00 00 02 1A 00
			15 01 00 00 00 00 02 1B 04
			15 01 00 00 00 00 02 1C 05
			15 01 00 00 00 00 02 1D 01
			15 01 00 00 00 00 02 1E 01
			15 01 00 00 00 00 02 1F 0C
			15 01 00 00 00 00 02 20 0C
			15 01 00 00 00 00 02 21 0D
			15 01 00 00 00 00 02 22 0D
			15 01 00 00 00 00 02 23 0E
			15 01 00 00 00 00 02 24 0E
			15 01 00 00 00 00 02 25 0F
			15 01 00 00 00 00 02 26 0F
			15 01 00 00 00 00 02 27 00
			15 01 00 00 00 00 02 28 00
			15 01 00 00 00 00 02 29 00
			15 01 00 00 00 00 02 2A 00
			15 01 00 00 00 00 02 2B 00
			15 01 00 00 00 00 02 2F 08
			15 01 00 00 00 00 02 30 06
			15 01 00 00 00 00 02 31 43
			15 01 00 00 00 00 02 37 44
			15 01 00 00 00 00 02 3A 21
			15 01 00 00 00 00 02 3B 90
			15 01 00 00 00 00 02 3D 93
			15 01 00 00 00 00 02 4D 12
			15 01 00 00 00 00 02 4E 34
			15 01 00 00 00 00 02 55 87
			15 01 00 00 00 00 02 56 44
			15 01 00 00 00 00 02 5A 21
			15 01 00 00 00 00 02 5B 90
			15 01 00 00 00 00 02 5C 9F
			15 01 00 00 00 00 02 5D 08
			15 01 00 00 00 00 02 5E 04
			15 01 00 00 00 00 02 60 80
			15 01 00 00 00 00 02 61 90
			15 01 00 00 00 00 02 64 11
			15 01 00 00 00 00 02 82 09
			15 01 00 00 00 00 02 83 07
			15 01 00 00 00 00 02 92 B4
			15 01 00 00 00 00 02 93 08
			15 01 00 00 00 00 02 94 0E
			15 01 00 00 00 00 02 AB 00
			15 01 00 00 00 00 02 AD 00
			15 01 00 00 00 00 02 B0 05
			15 01 00 00 00 00 02 B1 B0
			15 01 00 00 00 00 02 FF 25
			15 01 00 00 00 00 02 FB 01
			15 01 00 00 00 00 02 0A 82
			15 01 00 00 00 00 02 0B 26
			15 01 00 00 00 00 02 0C 01
			15 01 00 00 00 00 02 17 82
			15 01 00 00 00 00 02 18 06
			15 01 00 00 00 00 02 19 0F
			15 01 00 00 00 00 02 FF 26
			15 01 00 00 00 00 02 FB 01
			15 01 00 00 00 00 02 00 A0
			15 01 00 00 00 00 02 FF 27
			15 01 00 00 00 00 02 FB 01
			15 01 00 00 00 00 02 13 00
			15 01 00 00 00 00 02 15 B4
			15 01 00 00 00 00 02 1F 55
			15 01 00 00 00 00 02 26 0F
			15 01 00 00 00 00 02 C0 18
			15 01 00 00 00 00 02 C1 F0
			15 01 00 00 00 00 02 C2 00
			15 01 00 00 00 00 02 C3 00
			15 01 00 00 00 00 02 C4 F0
			15 01 00 00 00 00 02 C5 00
			15 01 00 00 00 00 02 C6 00
			15 01 00 00 00 00 02 FF 10
			15 01 00 00 00 00 02 FB 01
			15 01 00 00 00 00 02 35 00
			39 01 00 00 00 00 03 51 00 00
			15 01 00 00 00 00 02 53 2C
			15 01 00 00 00 00 02 55 00
			39 01 00 00 00 00 03 68 04 01
			15 01 00 00 00 00 02 FF 10
			15 01 00 00 00 00 02 FB 01
			15 01 00 00 00 00 02 BA 02
			05 01 00 00 46 00 02 11 00
			05 01 00 00 14 00 02 29 00];
		qcom,mdss-dsi-off-command = [
			05 01 00 00 14 00 02 28 00
			05 01 00 00 78 00 02 10 00];
		qcom,mdss-dsi-on-command-state = "dsi_lp_mode";
		qcom,mdss-dsi-off-command-state = "dsi_lp_mode";
		qcom,mdss-dsi-h-sync-pulse = <1>;
		qcom,mdss-dsi-traffic-mode = "burst_mode";
		qcom,mdss-dsi-lane-map = "lane_map_0123";
		qcom,mdss-dsi-bllp-eof-power-mode;
		qcom,mdss-dsi-bllp-power-mode;
		qcom,mdss-dsi-lane-0-state;
		qcom,mdss-dsi-lane-1-state;
		qcom,mdss-dsi-lane-2-state;
		qcom,mdss-dsi-panel-timings-phy-v2 = [
			23 1e 07 09 05 02 04 a0
			23 1e 07 09 05 02 04 a0
			23 1e 07 09 05 02 04 a0
			23 1e 07 09 05 02 04 a0
			23 19 07 08 05 02 04 a0];
		qcom,mdss-dsi-t-clk-post = <0x0d>;
		qcom,mdss-dsi-t-clk-pre = <0x2d>;
		qcom,mdss-dsi-bl-min-level = <1>;
		qcom,mdss-dsi-bl-max-level = <4095>;
		qcom,esd-check-enabled;
		qcom,mdss-dsi-panel-status-command = [
			14 01 00 01 05 00 01 0A
			14 01 00 01 05 00 01 BA];
		qcom,mdss-dsi-panel-status-command-state = "dsi_lp_mode";
		qcom,mdss-dsi-panel-status-check-mode = "reg_read";
		qcom,mdss-dsi-panel-status-read-length = <1 1>;
		qcom,mdss-dsi-panel-max-error-count = <2>;
		qcom,mdss-dsi-panel-status-value = <0x9C>, <0x02>;
		qcom,mdss-dsi-dma-trigger = "trigger_sw";
		qcom,mdss-dsi-mdp-trigger = "none";
		qcom,mdss-dsi-bl-pmic-control-type = "bl_ctrl_dcs";
		qcom,panel-supply-entries = <&dsi_panel_pwr_supply>;
		qcom,mdss-dsi-reset-sequence = <1 10>, <0 10>, <1 10>,<0 10>, <1 10>;
		qcom,mdss-dsi-lp11-init;
		qcom,mdss-dsi-reset-delay-vsp-ms = <1>;
		qcom,mdss-dsi-reset-keephigh;
		qcom,mdss-dsi-reset-force-pull-low;
		qcom,ulps-enabled;
		qcom,suspend-ulps-enabled;
	};
};
