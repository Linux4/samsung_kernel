/* Copyright (c) 2013, The Linux Foundation. All rights reserved.
 *
 * This program is free software; you can redistribute it and/or modify
 * it under the terms of the GNU General Public License version 2 and
 * only version 2 as published by the Free Software Foundation.
 *
 * This program is distributed in the hope that it will be useful,
 * but WITHOUT ANY WARRANTY; without even the implied warranty of
 * MERCHANTABILITY or FITNESS FOR A PARTICULAR PURPOSE.  See the
 * GNU General Public License for more details.
 */

/*---------------------------------------------------------------------------
 * This file is autogenerated file using gcdb parser. Please do not edit it.
 * Update input XML file to add a new entry or update variable in this file
 * VERSION = "1.0"
 *---------------------------------------------------------------------------*/
&mdss_mdp {
	dsi_gx_boe_9mask_epd6301_swid62_720p_video: qcom,mdss_dsi_gx_boe_9mask_epd6301_swid62_720p_video {
		qcom,mdss-dsi-panel-name = "gx boe 9mask epd6301 swid62 720p video mode dsi panel";
		qcom,mdss-dsi-panel-controller = <&mdss_dsi0>;
		qcom,mdss-dsi-panel-type = "dsi_video_mode";
		qcom,mdss-dsi-panel-destination = "display_1";
		qcom,mdss-dsi-panel-framerate = <60>;
		qcom,mdss-dsi-virtual-channel-id = <0>;
		qcom,mdss-dsi-init-master-time = <50000>;
		qcom,mdss-dsi-stream = <0>;
		qcom,mdss-dsi-panel-width = <720>;
		qcom,mdss-dsi-panel-height = <1600>;
		qcom,mdss-dsi-h-front-porch = <332>;
		qcom,mdss-dsi-h-back-porch = <300>;
		qcom,mdss-dsi-h-pulse-width = <20>;
		qcom,mdss-dsi-h-sync-skew = <0>;
		qcom,mdss-dsi-v-back-porch = <24>;
		qcom,mdss-dsi-v-front-porch = <42>;
		qcom,mdss-dsi-v-pulse-width = <4>;
		qcom,mdss-dsi-h-left-border = <0>;
		qcom,mdss-dsi-h-right-border = <0>;
		qcom,mdss-dsi-v-top-border = <0>;
		qcom,mdss-dsi-v-bottom-border = <0>;
		qcom,mdss-dsi-bpp = <24>;
		qcom,mdss-dsi-color-order = "rgb_swap_rgb";
		qcom,mdss-dsi-underflow-color = <0xff>;
		qcom,mdss-dsi-border-color = <0>;
		qcom,bklt-dcs-ctrl-mode = <0>;
		qcom,mdss-dsi-on-command = [
			39 01 00 00 00 00 04 FF 98 82 01
			39 01 00 00 00 00 02 00 42
			39 01 00 00 00 00 02 01 11
			39 01 00 00 00 00 02 02 00
			39 01 00 00 00 00 02 03 00
			39 01 00 00 00 00 02 05 00
			39 01 00 00 00 00 02 08 8D
			39 01 00 00 00 00 02 09 08
			39 01 00 00 00 00 02 0a 30
			39 01 00 00 00 00 02 0b 00
			39 01 00 00 00 00 02 0c 00
			39 01 00 00 00 00 02 0d 00
			39 01 00 00 00 00 02 0e 0A
			39 01 00 00 00 00 02 0f 0A
			39 01 00 00 00 00 02 29 5F
			39 01 00 00 00 00 02 2A 48
			39 01 00 00 00 00 02 2B 89
			39 01 00 00 00 00 02 31 07
			39 01 00 00 00 00 02 32 22
			39 01 00 00 00 00 02 33 22
			39 01 00 00 00 00 02 34 08
			39 01 00 00 00 00 02 35 00
			39 01 00 00 00 00 02 36 01
			39 01 00 00 00 00 02 37 2B
			39 01 00 00 00 00 02 38 2B
			39 01 00 00 00 00 02 39 23
			39 01 00 00 00 00 02 3A 0D
			39 01 00 00 00 00 02 3B 0D
			39 01 00 00 00 00 02 3C 12
			39 01 00 00 00 00 02 3D 10
			39 01 00 00 00 00 02 3E 00
			39 01 00 00 00 00 02 3F 02
			39 01 00 00 00 00 02 40 02
			39 01 00 00 00 00 02 41 07
			39 01 00 00 00 00 02 42 07
			39 01 00 00 00 00 02 43 07
			39 01 00 00 00 00 02 44 07
			39 01 00 00 00 00 02 45 07
			39 01 00 00 00 00 02 46 07
			39 01 00 00 00 00 02 47 07
			39 01 00 00 00 00 02 48 22
			39 01 00 00 00 00 02 49 22
			39 01 00 00 00 00 02 4A 09
			39 01 00 00 00 00 02 4B 00
			39 01 00 00 00 00 02 4C 01
			39 01 00 00 00 00 02 4D 2B
			39 01 00 00 00 00 02 4E 2B
			39 01 00 00 00 00 02 4F 23
			39 01 00 00 00 00 02 50 0D
			39 01 00 00 00 00 02 51 0D
			39 01 00 00 00 00 02 52 13
			39 01 00 00 00 00 02 53 11
			39 01 00 00 00 00 02 54 00
			39 01 00 00 00 00 02 55 02
			39 01 00 00 00 00 02 56 07
			39 01 00 00 00 00 02 57 07
			39 01 00 00 00 00 02 58 07
			39 01 00 00 00 00 02 59 07
			39 01 00 00 00 00 02 5A 07
			39 01 00 00 00 00 02 5B 07
			39 01 00 00 00 00 02 5C 07
			39 01 00 00 00 00 02 61 07
			39 01 00 00 00 00 02 62 22
			39 01 00 00 00 00 02 63 22
			39 01 00 00 00 00 02 64 09
			39 01 00 00 00 00 02 65 00
			39 01 00 00 00 00 02 66 01
			39 01 00 00 00 00 02 67 2B
			39 01 00 00 00 00 02 68 2B
			39 01 00 00 00 00 02 69 23
			39 01 00 00 00 00 02 6A 0D
			39 01 00 00 00 00 02 6B 0D
			39 01 00 00 00 00 02 6C 11
			39 01 00 00 00 00 02 6D 13
			39 01 00 00 00 00 02 6E 01
			39 01 00 00 00 00 02 6F 02
			39 01 00 00 00 00 02 70 02
			39 01 00 00 00 00 02 71 07
			39 01 00 00 00 00 02 72 07
			39 01 00 00 00 00 02 73 07
			39 01 00 00 00 00 02 74 07
			39 01 00 00 00 00 02 75 07
			39 01 00 00 00 00 02 76 07
			39 01 00 00 00 00 02 77 07
			39 01 00 00 00 00 02 78 22
			39 01 00 00 00 00 02 79 22
			39 01 00 00 00 00 02 7A 08
			39 01 00 00 00 00 02 7B 00
			39 01 00 00 00 00 02 7C 01
			39 01 00 00 00 00 02 7D 2B
			39 01 00 00 00 00 02 7E 2B
			39 01 00 00 00 00 02 7F 23
			39 01 00 00 00 00 02 80 0D
			39 01 00 00 00 00 02 81 0D
			39 01 00 00 00 00 02 82 10
			39 01 00 00 00 00 02 83 12
			39 01 00 00 00 00 02 84 01
			39 01 00 00 00 00 02 85 02
			39 01 00 00 00 00 02 86 07
			39 01 00 00 00 00 02 87 07
			39 01 00 00 00 00 02 88 07
			39 01 00 00 00 00 02 89 07
			39 01 00 00 00 00 02 8A 07
			39 01 00 00 00 00 02 8B 07
			39 01 00 00 00 00 02 8C 07
			39 01 00 00 00 00 02 A0 01
			39 01 00 00 00 00 02 A1 00
			39 01 00 00 00 00 02 A2 00
			39 01 00 00 00 00 02 A3 00
			39 01 00 00 00 00 02 A4 00
			39 01 00 00 00 00 02 A5 00
			39 01 00 00 00 00 02 A6 00
			39 01 00 00 00 00 02 A7 00
			39 01 00 00 00 00 02 A8 00
			39 01 00 00 00 00 02 A9 00
			39 01 00 00 00 00 02 AA 00
			39 01 00 00 00 00 02 AB 00
			39 01 00 00 00 00 02 AC 00
			39 01 00 00 00 00 02 AD 00
			39 01 00 00 00 00 02 AE 00
			39 01 00 00 00 00 02 B8 00
			39 01 00 00 00 00 02 B9 20
			39 01 00 00 00 00 02 BA 21
			39 01 00 00 00 00 02 C1 2F
			39 01 00 00 00 00 02 C2 4C
			39 01 00 00 00 00 02 B0 00
			39 01 00 00 00 00 02 D0 01
			39 01 00 00 00 00 02 D1 01
			39 01 00 00 00 00 02 D2 50
			39 01 00 00 00 00 02 D5 25
			39 01 00 00 00 00 02 D6 51
			39 01 00 00 00 00 02 Dc 40
			39 01 00 00 00 00 02 D8 0A
			39 01 00 00 00 00 02 D9 22
			39 01 00 00 00 00 02 DA 54
			39 01 00 00 00 00 02 DC 93
			39 01 00 00 00 00 02 DD 00
			39 01 00 00 00 00 02 E0 0E
			39 01 00 00 00 00 02 E2 51
			39 01 00 00 00 00 02 E6 23
			39 01 00 00 00 00 02 EA 0F
			39 01 00 00 00 00 02 E7 54
			39 01 00 00 00 00 04 FF 98 82 02
			39 01 00 00 00 00 02 06 9E
			39 01 00 00 00 00 02 0B A0
			39 01 00 00 00 00 02 0C 00
			39 01 00 00 00 00 02 0D 1C
			39 01 00 00 00 00 02 0E 2A
			39 01 00 00 00 00 02 F1 1C
			39 01 00 00 00 00 02 4B 5A
			39 01 00 00 00 00 02 50 CA
			39 01 00 00 00 00 02 51 00
			39 01 00 00 00 00 02 4E 11
			39 01 00 00 00 00 04 FF 98 82 05
			39 01 00 00 00 00 02 03 00
			39 01 00 00 00 00 02 04 81
			39 01 00 00 00 00 02 50 0F
			39 01 00 00 00 00 02 58 61
			39 01 00 00 00 00 02 63 88
			39 01 00 00 00 00 02 64 88
			39 01 00 00 00 00 02 68 15
			39 01 00 00 00 00 02 69 1B
			39 01 00 00 00 00 02 6A 51
			39 01 00 00 00 00 02 6B 43
			39 01 00 00 00 00 02 85 37
			39 01 00 00 00 00 04 FF 98 82 06
			39 01 00 00 00 00 02 D9 10
			39 01 00 00 00 00 02 C0 40
			39 01 00 00 00 00 02 C1 16
			39 01 00 00 00 00 02 06 A4
			39 01 00 00 00 00 04 FF 98 82 08
			39 01 00 00 00 00 1C E0 00 24 6F A3 E4 55 18 41 71 97 A9 D4 05 32 5C EA 88 BC DD 05 FF 26 50 83 AE 03 EC
			39 01 00 00 00 00 1C E1 00 24 6F A3 E4 55 18 41 71 97 A9 D4 05 32 5C EA 88 BC DD 05 FF 26 50 83 AE 03 EC
			39 01 00 00 00 00 04 FF 98 82 0B
			39 01 00 00 00 00 02 9A 44
			39 01 00 00 00 00 02 9B FE
			39 01 00 00 00 00 02 9C 04
			39 01 00 00 00 00 02 9D 04
			39 01 00 00 00 00 02 9E 7D
			39 01 00 00 00 00 02 9F 7D
			39 01 00 00 00 00 02 AB E0
			39 01 00 00 00 00 04 FF 98 82 0C
			39 01 00 00 00 00 02 00 1E
			39 01 00 00 00 00 02 01 4C
			39 01 00 00 00 00 02 02 1E
			39 01 00 00 00 00 02 03 4F
			39 01 00 00 00 00 02 04 1E
			39 01 00 00 00 00 02 05 4B
			39 01 00 00 00 00 02 06 1E
			39 01 00 00 00 00 02 07 46
			39 01 00 00 00 00 02 08 1E
			39 01 00 00 00 00 02 09 49
			39 01 00 00 00 00 02 0A 1E
			39 01 00 00 00 00 02 0B 47
			39 01 00 00 00 00 02 0C 1E
			39 01 00 00 00 00 02 0D 48
			39 01 00 00 00 00 02 0E 1E
			39 01 00 00 00 00 02 0F 50
			39 01 00 00 00 00 02 10 1E
			39 01 00 00 00 00 02 11 4E
			39 01 00 00 00 00 02 12 1E
			39 01 00 00 00 00 02 13 4D
			39 01 00 00 00 00 02 14 1E
			39 01 00 00 00 00 02 15 4A
			39 01 00 00 00 00 02 16 1F
			39 01 00 00 00 00 02 17 59
			39 01 00 00 00 00 02 18 1E
			39 01 00 00 00 00 02 19 4C
			39 01 00 00 00 00 02 1A 1D
			39 01 00 00 00 00 02 1B 49
			39 01 00 00 00 00 02 1C 1D
			39 01 00 00 00 00 02 1D 46
			39 01 00 00 00 00 02 1E 1D
			39 01 00 00 00 00 02 1F 41
			39 01 00 00 00 00 02 20 1D
			39 01 00 00 00 00 02 21 40
			39 01 00 00 00 00 02 22 1C
			39 01 00 00 00 00 02 23 3C
			39 01 00 00 00 00 02 24 1E
			39 01 00 00 00 00 02 25 56
			39 01 00 00 00 00 02 26 1D
			39 01 00 00 00 00 02 27 4A
			39 01 00 00 00 00 02 28 1D
			39 01 00 00 00 00 02 29 48
			39 01 00 00 00 00 02 2A 1D
			39 01 00 00 00 00 02 2B 45
			39 01 00 00 00 00 02 2C 1E
			39 01 00 00 00 00 02 2D 54
			39 01 00 00 00 00 02 2E 1D
			39 01 00 00 00 00 02 2F 47
			39 01 00 00 00 00 02 30 1E
			39 01 00 00 00 00 02 31 4D
			39 01 00 00 00 00 02 32 1E
			39 01 00 00 00 00 02 33 4B
			39 01 00 00 00 00 02 34 1E
			39 01 00 00 00 00 02 35 4F
			39 01 00 00 00 00 02 36 1E
			39 01 00 00 00 00 02 37 52
			39 01 00 00 00 00 02 38 1C
			39 01 00 00 00 00 02 39 3D
			39 01 00 00 00 00 02 3A 1C
			39 01 00 00 00 00 02 3B 3E
			39 01 00 00 00 00 02 3C 1E
			39 01 00 00 00 00 02 3D 50
			39 01 00 00 00 00 04 FF 98 82 0E
			39 01 00 00 00 00 02 49 C8
			39 01 00 00 00 00 02 11 10
			39 01 00 00 00 00 02 13 10
			39 01 00 00 00 00 02 45 0B
			39 01 00 00 00 00 02 46 D1
			39 01 00 00 00 00 02 4D 8C
			39 01 00 00 00 00 02 D0 01
			39 01 00 00 00 00 02 00 A3
			39 01 00 00 00 00 02 4B 0A
			39 01 00 00 00 00 02 07 21
			39 01 00 00 00 00 02 D1 01
			39 01 00 00 00 00 02 D2 F1
			39 01 00 00 00 00 02 D3 60
			39 01 00 00 00 00 02 D4 39
			39 01 00 00 00 00 02 D5 C1
			39 01 00 00 00 00 02 D6 8C
			39 01 00 00 00 00 02 D7 8C
			39 01 00 00 00 00 02 D8 8C
			39 01 00 00 00 00 02 D9 8C
			39 01 00 00 00 00 02 DA 44
			39 01 00 00 00 00 02 DB 44
			39 01 00 00 00 00 02 DC 44
			39 01 00 00 00 00 02 DD 40
			39 01 00 00 00 00 02 C0 01
			39 01 00 00 00 00 02 C1 80
			39 01 00 00 00 00 02 40 07
			39 01 00 00 00 00 02 02 19
			39 01 00 00 00 00 02 C4 04
			39 01 00 00 00 00 04 FF 98 82 03
			39 01 00 00 00 00 02 83 20
			39 01 00 00 00 00 02 84 00
			39 01 00 00 00 00 04 FF 98 82 00
			39 01 00 00 00 00 03 68 04 00
			39 01 00 00 00 00 03 51 00 00
			39 01 00 00 00 00 02 53 2C
			39 01 00 00 00 00 02 55 00
			39 01 00 00 50 00 02 11 00
			39 01 00 00 14 00 02 29 00
			39 01 00 00 00 00 02 35 00];
		qcom,mdss-dsi-off-command = [
			39 01 00 00 00 00 04 FF 98 82 00
			05 01 00 00 14 00 02 28 00
			05 01 00 00 78 00 02 10 00];
		qcom,mdss-dsi-on-command-state = "dsi_lp_mode";
		qcom,mdss-dsi-off-command-state = "dsi_lp_mode";
		qcom,mdss-dsi-h-sync-pulse = <1>;
		qcom,mdss-dsi-traffic-mode = "burst_mode";
		qcom,mdss-dsi-lane-map = "lane_map_0123";
		qcom,mdss-dsi-bllp-eof-power-mode;
		qcom,mdss-dsi-bllp-power-mode;
		qcom,mdss-dsi-lane-0-state;
		qcom,mdss-dsi-lane-1-state;
		qcom,mdss-dsi-lane-2-state;
		qcom,mdss-dsi-panel-timings-phy-v2 = [
			26 21 09 0B 06 02 04 a0
			26 21 09 0B 06 02 04 a0
			26 21 09 0B 06 02 04 a0
			26 21 09 0B 06 02 04 a0
			26 20 0A 0B 06 02 04 a0];
		qcom,mdss-dsi-t-clk-post = <0x0F>;
		qcom,mdss-dsi-t-clk-pre = <0x37>;
		qcom,mdss-dsi-bl-min-level = <1>;
		qcom,mdss-dsi-bl-max-level = <3685>;
		qcom,esd-check-enabled;
		qcom,mdss-dsi-panel-status-command = [14 01 00 01 05 00 01 0A];
		qcom,mdss-dsi-panel-status-command-state = "dsi_lp_mode";
		qcom,mdss-dsi-panel-status-check-mode = "reg_read";
		qcom,mdss-dsi-panel-status-read-length = <1>;
		qcom,mdss-dsi-panel-max-error-count = <2>;
		qcom,mdss-dsi-panel-status-value = <0x9C>;
		qcom,mdss-dsi-dma-trigger = "trigger_sw";
		qcom,mdss-dsi-mdp-trigger = "none";
		qcom,mdss-dsi-bl-pmic-control-type = "bl_ctrl_dcs";
		qcom,panel-supply-entries = <&dsi_panel_pwr_supply>;
		qcom,mdss-dsi-reset-sequence = <1 4>, <0 5>, <1 10>;
		qcom,mdss-dsi-lp11-init;
		qcom,mdss-dsi-reset-delay-vsp-ms = <1>;
		qcom,mdss-dsi-reset-keephigh;
		qcom,mdss-dsi-reset-force-pull-low;
		qcom,ulps-enabled;
		qcom,suspend-ulps-enabled;
	};
};
