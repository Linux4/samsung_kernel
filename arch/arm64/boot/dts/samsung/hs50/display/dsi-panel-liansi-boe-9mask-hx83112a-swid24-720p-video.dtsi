/* Copyright (c) 2013, The Linux Foundation. All rights reserved.
 *
 * This program is free software; you can redistribute it and/or modify
 * it under the terms of the GNU General Public License version 2 and
 * only version 2 as published by the Free Software Foundation.
 *
 * This program is distributed in the hope that it will be useful,
 * but WITHOUT ANY WARRANTY; without even the implied warranty of
 * MERCHANTABILITY or FITNESS FOR A PARTICULAR PURPOSE.  See the
 * GNU General Public License for more details.
 */

/*---------------------------------------------------------------------------
 * This file is autogenerated file using gcdb parser. Please do not edit it.
 * Update input XML file to add a new entry or update variable in this file
 * VERSION = "1.0"
 *---------------------------------------------------------------------------*/
&mdss_mdp {
	dsi_liansi_boe_9mask_hx83112a_swid24_720p_video: qcom,mdss_dsi_liansi_boe_9mask_hx83112a_swid24_720p_video {
		qcom,mdss-dsi-panel-name = "liansi boe 9mask hx83112a swid24 720p video mode dsi panel";
		qcom,mdss-dsi-panel-controller = <&mdss_dsi0>;
		qcom,mdss-dsi-panel-type = "dsi_video_mode";
		qcom,mdss-dsi-panel-destination = "display_1";
		qcom,mdss-dsi-panel-framerate = <60>;
		qcom,mdss-dsi-virtual-channel-id = <0>;
		qcom,mdss-dsi-init-master-time = <50000>;
		qcom,mdss-dsi-stream = <0>;
		qcom,mdss-dsi-panel-width = <720>;
		qcom,mdss-dsi-panel-height = <1600>;
		qcom,mdss-dsi-h-front-porch = <240>;
		qcom,mdss-dsi-h-back-porch = <200>;
		qcom,mdss-dsi-h-pulse-width = <200>;
		qcom,mdss-dsi-h-sync-skew = <0>;
		qcom,mdss-dsi-v-back-porch = <15>;
		qcom,mdss-dsi-v-front-porch = <54>;
		qcom,mdss-dsi-v-pulse-width = <2>;
		qcom,mdss-dsi-h-left-border = <0>;
		qcom,mdss-dsi-h-right-border = <0>;
		qcom,mdss-dsi-v-top-border = <0>;
		qcom,mdss-dsi-v-bottom-border = <0>;
		qcom,mdss-dsi-bpp = <24>;
		qcom,mdss-dsi-color-order = "rgb_swap_rgb";
		qcom,mdss-dsi-underflow-color = <0xff>;
		qcom,mdss-dsi-border-color = <0>;
		qcom,bklt-dcs-ctrl-mode = <0>;
		qcom,mdss-dsi-on-command = [
			39 01 00 00 00 00 04 B9 83 11 2A
			39 01 00 00 00 00 09 B1 08 2B 2B 80 80 4A 4F AA
			39 01 00 00 00 00 10 B2 00 02 00 62 40 00 0F 34 12 11 04 01 15 A3 87
			39 01 00 00 00 00 1C B4 04 DF 04 DF 00 00 08 DF 00 00 08 DF 00 FF 00 FF 00 00 0C 0F 00 36 08 0D 0F 00 88
			39 01 00 00 00 00 11 BA 72 23 64 33 33 33 33 11 10 00 00 10 08 3D 02 76
			39 01 00 00 00 00 03 C0 22 22
			39 01 00 00 00 00 02 C1 01
			39 01 00 00 00 00 07 C7 00 00 04 E0 33 00
			39 01 00 00 00 00 02 E9 C3
			39 01 00 00 00 00 03 CB D2 24
			39 01 00 00 00 00 02 E9 3F
			39 01 00 00 00 00 02 CC 08
			39 01 00 00 00 00 03 D2 2D 2D
			39 01 00 00 00 00 30 D3 C0 00 00 00 00 01 00 14 14 03 01 11 08 08 08 08 08 32 10 05 00 00 32 10 0F 00 0F 32 10 0F 00 00 00 00 00 00 00 00 00 00 00 00 00 00 00 EA 1C
			39 01 00 00 00 00 31 D5 18 18 18 18 18 18 18 18 18 18 18 18 18 18 C0 C0 C0 C0 18 18 40 40 18 18 18 18 31 31 30 30 2F 2F 01 00 03 02 20 20 C0 C0 C0 C0 19 19 40 40 25 24
			39 01 00 00 00 00 31 D6 18 18 18 18 18 18 18 18 18 18 18 18 18 18 40 40 40 40 18 18 40 40 18 18 18 18 31 31 30 30 2F 2F 02 03 00 01 20 20 40 40 40 40 40 40 19 19 24 25
			39 01 00 00 00 00 0D D8 AA AA AA AA FF EA AA AA AA AA FF EA
			39 01 00 00 00 00 1A E7 0F 0F 1E 76 1E 74 00 50 20 14 00 00 02 02 02 05 14 14 32 B9 23 B9 08 13 69
			39 01 00 00 00 00 02 BD 01
			39 01 00 00 00 00 05 BF 1A BF 01 0A
			39 01 00 00 00 00 04 B1 64 01 09
			39 01 00 00 00 00 04 CB 25 11 01
			39 01 00 00 00 00 3A C1 FF FE FC F0 EA E7 E1 D6 D2 CB C4 BE B7 B0 AA A4 9E 97 92 87 7E 75 6C 63 5B 53 4B 45 3F 39 32 2C 26 21 1C 17 12 0D 09 05 02 02 01 01 00 07 6B 56 EA 77 60 BF DE E1 7A DC 40
			39 01 00 00 00 00 0D D8 AA AA AF FF FF FF AA AA AF FF FF FF
			39 01 00 00 00 00 09 E7 02 00 6C 01 6E 0E 48 0F
			39 01 00 00 00 00 02 BD 02
			39 01 00 00 00 00 0A B4 00 92 12 11 88 12 12 00 53
			39 01 00 00 00 00 3A C1 FF FA F5 EF EA E5 DF D4 CE C8 C2 BC B5 AF A9 A3 9D 97 92 87 7D 74 6B 62 5A 53 4B 45 3F 39 32 2C 26 21 1C 17 12 0E 09 05 03 02 01 01 00 12 ED D1 E9 B6 E6 C6 4A E1 8B 1C 40
			39 01 00 00 00 00 0D D8 AA AA AF FF FF FF AA AA AF FF FF FF
			39 01 00 00 00 00 1E E7 00 00 08 40 01 00 00 00 00 00 00 00 00 00 00 00 00 00 00 00 00 00 04 00 70 01 70 02 00
			39 01 00 00 00 00 02 BD 03
			39 01 00 00 00 00 19 D8 AA AA AE BF AA BE AA AA AE BF AA BE AA AA AF FF FF FF AA AA AF FF FF FF
			39 01 00 00 00 00 3A C1 FF FE F1 F0 E3 E0 DB D0 CA C5 C1 BC B6 B0 AB A6 A0 98 93 87 7D 74 6B 63 5B 54 4C 46 40 3A 34 2D 28 22 1D 18 12 0E 09 05 02 02 01 01 00 1B BD BD 70 BB F9 CF E3 20 CF D8 40
			39 01 00 00 00 00 02 BD 00
			39 01 00 00 00 00 05 CF 00 14 00 C0
			39 01 00 00 00 00 1B E4 2D 01 2C 00 08 00 10 08 04 04 00 80 40 E8 34 70 98 C8 FF A5 FF EF 10 38 10 00
			39 01 00 00 00 00 02 BD 01
			39 01 00 00 00 00 04 CB 25 11 01
			39 01 00 00 00 00 02 BD 00
			05 01 00 00 28 00 02 11 00
			05 01 00 00 32 00 02 29 00
			39 01 00 00 05 00 03 51 00 00
			39 01 00 00 05 00 05 C9 04 0A 94 01
			15 01 00 00 05 00 02 55 00
			15 01 00 00 05 00 02 53 2C];
		qcom,mdss-dsi-off-command = [
			05 01 00 00 32 00 02 28 00
			05 01 00 00 78 00 02 10 00];
		qcom,mdss-dsi-on-command-state = "dsi_lp_mode";
		qcom,mdss-dsi-off-command-state = "dsi_lp_mode";
		qcom,mdss-dsi-h-sync-pulse = <1>;
		qcom,mdss-dsi-traffic-mode = "burst_mode";
		qcom,mdss-dsi-lane-map = "lane_map_0123";
		qcom,mdss-dsi-bllp-eof-power-mode;
		qcom,mdss-dsi-bllp-power-mode;
		qcom,mdss-dsi-lane-0-state;
		qcom,mdss-dsi-lane-1-state;
		qcom,mdss-dsi-lane-2-state;
		qcom,mdss-dsi-panel-timings-phy-v2 = [
			26 21 09 0b 06 02 04 a0
			26 21 09 0b 06 02 04 a0
			26 21 09 0b 06 02 04 a0
			26 21 09 0b 06 02 04 a0
			26 21 09 0b 06 02 04 a0];
		qcom,mdss-dsi-t-clk-post = <0x0f>;
		qcom,mdss-dsi-t-clk-pre = <0x37>;
		qcom,mdss-dsi-bl-min-level = <1>;
		qcom,mdss-dsi-bl-max-level = <4095>;
		qcom,esd-check-enabled;
		qcom,mdss-dsi-panel-status-command = [14 01 00 01 00 00 01 0A];
		qcom,mdss-dsi-panel-status-command-state = "dsi_lp_mode";
		qcom,mdss-dsi-panel-status-check-mode = "reg_read";
		qcom,mdss-dsi-panel-status-read-length = <1>;
		qcom,mdss-dsi-panel-max-error-count = <2>;
		qcom,mdss-dsi-panel-status-value = <0x9D>;
		qcom,mdss-dsi-dma-trigger = "trigger_sw";
		qcom,mdss-dsi-mdp-trigger = "none";
		qcom,mdss-dsi-bl-pmic-control-type = "bl_ctrl_dcs";
		qcom,panel-supply-entries = <&dsi_panel_pwr_supply>;
		qcom,mdss-dsi-reset-sequence = <1 4>, <0 5>, <1 60>;
		qcom,mdss-dsi-lp11-init;
		qcom,mdss-dsi-reset-delay-vsp-ms = <4>;
		qcom,mdss-dsi-reset-keephigh;
		qcom,mdss-dsi-reset-force-pull-low;
		qcom,ulps-enabled;
		qcom,suspend-ulps-enabled;
	};
};
