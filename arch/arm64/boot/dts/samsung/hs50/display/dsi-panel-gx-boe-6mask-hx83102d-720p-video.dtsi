/* Copyright (c) 2013, The Linux Foundation. All rights reserved.
 *
 * This program is free software; you can redistribute it and/or modify
 * it under the terms of the GNU General Public License version 2 and
 * only version 2 as published by the Free Software Foundation.
 *
 * This program is distributed in the hope that it will be useful,
 * but WITHOUT ANY WARRANTY; without even the implied warranty of
 * MERCHANTABILITY or FITNESS FOR A PARTICULAR PURPOSE.  See the
 * GNU General Public License for more details.
 */

/*---------------------------------------------------------------------------
 * This file is autogenerated file using gcdb parser. Please do not edit it.
 * Update input XML file to add a new entry or update variable in this file
 * VERSION = "1.0"
 *---------------------------------------------------------------------------*/
&mdss_mdp {
	dsi_gx_boe_hx83102d_6mask_720p_video: qcom,mdss_dsi_gx_boe_6mask_hx83102d_720p_video {
		qcom,mdss-dsi-panel-name = "guoxian boe 6mask hx83102d 720p video mode dsi panel";
		qcom,mdss-dsi-panel-controller = <&mdss_dsi0>;
		qcom,mdss-dsi-panel-type = "dsi_video_mode";
		qcom,mdss-dsi-panel-destination = "display_1";
		qcom,mdss-dsi-panel-framerate = <60>;
		qcom,mdss-dsi-virtual-channel-id = <0>;
		qcom,mdss-dsi-init-master-time = <50000>;
		qcom,mdss-dsi-stream = <0>;
		qcom,mdss-dsi-panel-width = <720>;
		qcom,mdss-dsi-panel-height = <1600>;
		qcom,mdss-dsi-h-front-porch = <24>;
		qcom,mdss-dsi-h-back-porch = <24>;
		qcom,mdss-dsi-h-pulse-width = <24>;
		qcom,mdss-dsi-h-sync-skew = <0>;
		qcom,mdss-dsi-v-back-porch = <16>;
		qcom,mdss-dsi-v-front-porch = <240>;
		qcom,mdss-dsi-v-pulse-width = <2>;
		qcom,mdss-dsi-h-left-border = <0>;
		qcom,mdss-dsi-h-right-border = <0>;
		qcom,mdss-dsi-v-top-border = <0>;
		qcom,mdss-dsi-v-bottom-border = <0>;
		qcom,mdss-dsi-bpp = <24>;
		qcom,mdss-dsi-color-order = "rgb_swap_rgb";
		qcom,mdss-dsi-underflow-color = <0xff>;
		qcom,mdss-dsi-border-color = <0>;
		qcom,bklt-dcs-ctrl-mode = <0>;
		qcom,mdss-dsi-on-command = [
			39 01 00 00 00 00 04 B9 83 10 2D
			39 01 00 00 00 00 0C C0 33 33 00 00 19 42 00 08 00 1A 1B
			39 01 00 00 00 00 0C B1 22 44 31 31 22 34 2F 57 0D 0D 0D
			39 01 00 00 00 00 0F B2 00 00 06 40 00 0E EE 34 13 00 00 01 85 E0
			39 01 00 00 00 00 0F B4 58 4F 58 4F 58 52 58 4F 05 FF 03 03 00 FF
			15 01 00 00 00 00 02 CC 02
			39 01 00 00 00 00 1A D3 04 04 01 01 00 08 00 47 00 43 33 0B 0B 00 00 32 10 07 00 07 54 15 A8 05 A8
			39 01 00 00 00 00 2D D5 18 18 18 18 3A 3A 18 18 20 21 22 23 19 19 19 19 04 05 06 07 00 01 02 03 18 18 18 18 18 18 18 18 18 18 18 18 18 18 18 18 18 18 18 18
			39 01 00 00 00 00 2D D6 18 18 19 19 3A 3A 18 18 23 22 21 20 18 18 19 19 03 02 01 00 07 06 05 04 18 18 18 18 18 18 18 18 18 18 18 18 18 18 18 18 18 18 18 18
			39 01 00 00 00 00 03 E7 FF 0F
			15 01 00 00 00 00 02 BD 01
			15 01 00 00 00 00 02 E7 01
			39 01 00 00 00 00 0D D8 3F FF FF 00 00 00 3F FF FF 00 00 00
			15 01 00 00 00 00 02 BD 00
			39 01 00 00 00 00 2F E0 00 07 0B 0F 13 1A 2D 33 3A 38 55 61 6D 82 86 96 A4 BC C0 61 6B 77 7F 00 07 0B 0F 13 1A 2D 33 3A 38 55 61 6D 82 86 96 A4 BC C0 61 6B 77 7F
			39 01 00 00 00 00 14 BA 71 23 A8 97 B2 C0 C0 01 10 00 00 00 0D 3D 82 77 04 01 00
			39 01 00 00 00 00 08 BF FC 00 04 9E F6 00 51
			39 01 00 00 00 00 06 CB 00 13 00 02 47
			15 01 00 00 00 00 02 BD 01
			15 01 00 00 00 00 02 CB 01
			15 01 00 00 00 00 02 BD 02
			39 01 00 00 00 00 09 B4 42 00 33 00 33 88 B3 00
			39 01 00 00 00 00 04 B1 7F 03 F5
			15 01 00 00 00 00 02 BD 01
			39 01 00 00 00 00 0D D8 3F FF FF 00 00 00 3F FF FF 00 00 00
			15 01 00 00 00 00 02 BD 00
			05 01 00 00 3C 00 01 11
			05 01 00 00 14 00 01 29
			39 01 00 00 00 00 03 51 00 00
			39 01 00 00 00 00 05 C9 04 0C B2 01
			15 01 00 00 05 00 02 55 00
			15 01 00 00 00 00 02 53 2C];
		qcom,mdss-dsi-off-command = [
			05 01 00 00 3C 00 02 28 00
			05 01 00 00 78 00 02 10 00];
		qcom,mdss-dsi-on-command-state = "dsi_lp_mode";
		qcom,mdss-dsi-off-command-state = "dsi_lp_mode";
		qcom,mdss-dsi-h-sync-pulse = <1>;
		qcom,mdss-dsi-traffic-mode = "burst_mode";
		qcom,mdss-dsi-lane-map = "lane_map_0123";
		qcom,mdss-dsi-bllp-eof-power-mode;
		qcom,mdss-dsi-bllp-power-mode;
		qcom,mdss-dsi-lane-0-state;
		qcom,mdss-dsi-lane-1-state;
		qcom,mdss-dsi-lane-2-state;
		qcom,mdss-dsi-panel-timings-phy-v2 = [
			21 1d 07 08 04 02 04 a0
			21 1d 07 08 04 02 04 a0
			21 1d 07 08 04 02 04 a0
			21 1d 07 08 04 02 04 a0
			21 16 06 07 04 02 04 a0];
		qcom,mdss-dsi-t-clk-post = <0x0c>;
		qcom,mdss-dsi-t-clk-pre = <0x29>;
		qcom,mdss-dsi-bl-min-level = <1>;
		qcom,mdss-dsi-bl-max-level = <4032>;
		qcom,esd-check-enabled;
		qcom,mdss-dsi-panel-status-command = [14 01 00 01 00 00 01 0A];
		qcom,mdss-dsi-panel-status-command-state = "dsi_lp_mode";
		qcom,mdss-dsi-panel-status-check-mode = "reg_read";
		qcom,mdss-dsi-panel-status-read-length = <1>;
		qcom,mdss-dsi-panel-max-error-count = <2>;
		qcom,mdss-dsi-panel-status-value = <0x9D>;
		qcom,mdss-dsi-dma-trigger = "trigger_sw";
		qcom,mdss-dsi-mdp-trigger = "none";
		qcom,mdss-dsi-bl-pmic-control-type = "bl_ctrl_dcs";
		qcom,panel-supply-entries = <&dsi_panel_pwr_supply>;
		qcom,mdss-dsi-reset-sequence = <1 4>, <0 5>, <1 60>;
		qcom,mdss-dsi-lp11-init;
		qcom,mdss-dsi-reset-delay-vsp-ms = <4>;
		qcom,mdss-dsi-reset-keephigh;
		qcom,mdss-dsi-reset-force-pull-low;
		qcom,ulps-enabled;
		qcom,suspend-ulps-enabled;
	};
};
