/* Copyright (c) 2013, The Linux Foundation. All rights reserved.
 *
 * This program is free software; you can redistribute it and/or modify
 * it under the terms of the GNU General Public License version 2 and
 * only version 2 as published by the Free Software Foundation.
 *
 * This program is distributed in the hope that it will be useful,
 * but WITHOUT ANY WARRANTY; without even the implied warranty of
 * MERCHANTABILITY or FITNESS FOR A PARTICULAR PURPOSE.  See the
 * GNU General Public License for more details.
 */

/*---------------------------------------------------------------------------
 * This file is autogenerated file using gcdb parser. Please do not edit it.
 * Update input XML file to add a new entry or update variable in this file
 * VERSION = "1.0"
 *---------------------------------------------------------------------------*/
&mdss_mdp {
	dsi_txd_qc_ili9882n_720p_video: qcom,mdss_dsi_txd_qc_ili9882n_720p_video {
		qcom,mdss-dsi-panel-name = "txd qc ili9882n 720p video mode dsi panel";
		qcom,mdss-dsi-panel-controller = <&mdss_dsi0>;
		qcom,mdss-dsi-panel-type = "dsi_video_mode";
		qcom,mdss-dsi-panel-destination = "display_1";
		qcom,mdss-dsi-panel-framerate = <60>;
		qcom,mdss-dsi-virtual-channel-id = <0>;
		qcom,mdss-dsi-init-master-time = <50000>;
		qcom,mdss-dsi-stream = <0>;
		qcom,mdss-dsi-panel-width = <720>;
		qcom,mdss-dsi-panel-height = <1600>;
		qcom,mdss-dsi-h-front-porch = <244>;
		qcom,mdss-dsi-h-back-porch = <240>;
		qcom,mdss-dsi-h-pulse-width = <40>;
		qcom,mdss-dsi-h-sync-skew = <0>;
		qcom,mdss-dsi-v-back-porch = <10>;
		qcom,mdss-dsi-v-front-porch = <230>;
		qcom,mdss-dsi-v-pulse-width = <4>;
		qcom,mdss-dsi-h-left-border = <0>;
		qcom,mdss-dsi-h-right-border = <0>;
		qcom,mdss-dsi-v-top-border = <0>;
		qcom,mdss-dsi-v-bottom-border = <0>;
		qcom,mdss-dsi-bpp = <24>;
		qcom,mdss-dsi-color-order = "rgb_swap_rgb";
		qcom,mdss-dsi-underflow-color = <0xff>;
		qcom,mdss-dsi-border-color = <0>;
		qcom,bklt-dcs-ctrl-mode = <0>;
		qcom,mdss-dsi-on-command = [
			39 01 00 00 00 00 04 FF 98 82 01
			39 01 00 00 00 00 02 00 40
			39 01 00 00 00 00 02 01 00
			39 01 00 00 00 00 02 02 10
			39 01 00 00 00 00 02 03 00
			39 01 00 00 00 00 02 08 01
			39 01 00 00 00 00 02 09 05
			39 01 00 00 00 00 02 0a 40
			39 01 00 00 00 00 02 0b 00
			39 01 00 00 00 00 02 0c 10
			39 01 00 00 00 00 02 0d 10
			39 01 00 00 00 00 02 0e 00
			39 01 00 00 00 00 02 0f 00
			39 01 00 00 00 00 02 10 00
			39 01 00 00 00 00 02 11 00
			39 01 00 00 00 00 02 12 00
			39 01 00 00 00 00 02 31 07
			39 01 00 00 00 00 02 32 07
			39 01 00 00 00 00 02 33 07
			39 01 00 00 00 00 02 34 02
			39 01 00 00 00 00 02 35 02
			39 01 00 00 00 00 02 36 02
			39 01 00 00 00 00 02 37 02
			39 01 00 00 00 00 02 38 2B
			39 01 00 00 00 00 02 39 2A
			39 01 00 00 00 00 02 3A 14
			39 01 00 00 00 00 02 3B 13
			39 01 00 00 00 00 02 3C 12
			39 01 00 00 00 00 02 3D 11
			39 01 00 00 00 00 02 3E 10
			39 01 00 00 00 00 02 3F 08
			39 01 00 00 00 00 02 40 07
			39 01 00 00 00 00 02 41 07
			39 01 00 00 00 00 02 42 07
			39 01 00 00 00 00 02 43 02
			39 01 00 00 00 00 02 44 02
			39 01 00 00 00 00 02 45 06
			39 01 00 00 00 00 02 46 06
			39 01 00 00 00 00 02 47 07
			39 01 00 00 00 00 02 48 07
			39 01 00 00 00 00 02 49 07
			39 01 00 00 00 00 02 4A 02
			39 01 00 00 00 00 02 4B 02
			39 01 00 00 00 00 02 4C 02
			39 01 00 00 00 00 02 4D 02
			39 01 00 00 00 00 02 4E 2B
			39 01 00 00 00 00 02 4F 2A
			39 01 00 00 00 00 02 50 14
			39 01 00 00 00 00 02 51 13
			39 01 00 00 00 00 02 52 12
			39 01 00 00 00 00 02 53 11
			39 01 00 00 00 00 02 54 10
			39 01 00 00 00 00 02 55 08
			39 01 00 00 00 00 02 56 07
			39 01 00 00 00 00 02 57 07
			39 01 00 00 00 00 02 58 07
			39 01 00 00 00 00 02 59 02
			39 01 00 00 00 00 02 5A 02
			39 01 00 00 00 00 02 5B 06
			39 01 00 00 00 00 02 5C 06
			39 01 00 00 00 00 02 61 07
			39 01 00 00 00 00 02 62 07
			39 01 00 00 00 00 02 63 07
			39 01 00 00 00 00 02 64 02
			39 01 00 00 00 00 02 65 02
			39 01 00 00 00 00 02 66 02
			39 01 00 00 00 00 02 67 02
			39 01 00 00 00 00 02 68 2B
			39 01 00 00 00 00 02 69 2A
			39 01 00 00 00 00 02 6A 10
			39 01 00 00 00 00 02 6B 11
			39 01 00 00 00 00 02 6C 12
			39 01 00 00 00 00 02 6D 13
			39 01 00 00 00 00 02 6E 14
			39 01 00 00 00 00 02 6F 08
			39 01 00 00 00 00 02 70 07
			39 01 00 00 00 00 02 71 07
			39 01 00 00 00 00 02 72 07
			39 01 00 00 00 00 02 73 02
			39 01 00 00 00 00 02 74 02
			39 01 00 00 00 00 02 75 06
			39 01 00 00 00 00 02 76 06
			39 01 00 00 00 00 02 77 07
			39 01 00 00 00 00 02 78 07
			39 01 00 00 00 00 02 79 07
			39 01 00 00 00 00 02 7A 02
			39 01 00 00 00 00 02 7B 02
			39 01 00 00 00 00 02 7C 02
			39 01 00 00 00 00 02 7D 02
			39 01 00 00 00 00 02 7E 2B
			39 01 00 00 00 00 02 7F 2A
			39 01 00 00 00 00 02 80 10
			39 01 00 00 00 00 02 81 11
			39 01 00 00 00 00 02 82 12
			39 01 00 00 00 00 02 83 13
			39 01 00 00 00 00 02 84 14
			39 01 00 00 00 00 02 85 08
			39 01 00 00 00 00 02 86 07
			39 01 00 00 00 00 02 87 07
			39 01 00 00 00 00 02 88 07
			39 01 00 00 00 00 02 89 02
			39 01 00 00 00 00 02 8A 02
			39 01 00 00 00 00 02 8B 06
			39 01 00 00 00 00 02 8C 06
			39 01 00 00 00 00 02 b0 33
			39 01 00 00 00 00 02 b1 33
			39 01 00 00 00 00 02 b2 00
			39 01 00 00 00 00 02 c3 ff
			39 01 00 00 00 00 02 ca 44
			39 01 00 00 00 00 02 d0 01
			39 01 00 00 00 00 02 d1 12
			39 01 00 00 00 00 02 d2 10
			39 01 00 00 00 00 02 d5 55
			39 01 00 00 00 00 02 d8 01
			39 01 00 00 00 00 02 d9 02
			39 01 00 00 00 00 02 da 80
			39 01 00 00 00 00 02 dc 10
			39 01 00 00 00 00 02 dd 40
			39 01 00 00 00 00 02 df b6
			39 01 00 00 00 00 02 e2 75
			39 01 00 00 00 00 02 e6 23
			39 01 00 00 00 00 02 e7 54
			39 01 00 00 00 00 04 FF 98 82 02
			39 01 00 00 00 00 02 F1 1C
			39 01 00 00 00 00 02 4B 5A
			39 01 00 00 00 00 02 50 CA
			39 01 00 00 00 00 02 51 00
			39 01 00 00 00 00 02 06 8F
			39 01 00 00 00 00 02 0B A0
			39 01 00 00 00 00 02 0C 00
			39 01 00 00 00 00 02 0D 0E
			39 01 00 00 00 00 02 0E E6
			39 01 00 00 00 00 02 4E 11
			39 01 00 00 00 00 04 FF 98 82 05
			39 01 00 00 00 00 02 03 01
			39 01 00 00 00 00 02 04 17
			39 01 00 00 00 00 02 50 0F
			39 01 00 00 00 00 02 58 61
			39 01 00 00 00 00 02 63 9C
			39 01 00 00 00 00 02 64 9C
			39 01 00 00 00 00 02 68 29
			39 01 00 00 00 00 02 69 2F
			39 01 00 00 00 00 02 6A 3D
			39 01 00 00 00 00 02 6B 2F
			39 01 00 00 00 00 02 85 37
			39 01 00 00 00 00 02 46 00
			39 01 00 00 00 00 04 FF 98 82 06
			39 01 00 00 00 00 02 D9 10
			39 01 00 00 00 00 02 C0 40
			39 01 00 00 00 00 02 C1 16
			39 01 00 00 00 00 02 48 0F
			39 01 00 00 00 00 02 4D 80
			39 01 00 00 00 00 02 4E 40
			39 01 00 00 00 00 02 83 00
			39 01 00 00 00 00 02 84 00
			39 01 00 00 00 00 02 C7 05
			39 01 00 00 00 00 02 06 A4
			39 01 00 00 00 00 04 FF 98 82 08
			39 01 00 00 00 00 1C E0 40 24 AE E9 2C 55 5E 85 B2 D5 AA 0B 35 5B 80 EA A6 D4 F0 14 FF 31 57 85 AB 03 EC
			39 01 00 00 00 00 1C E1 40 24 AE E9 2C 55 5E 85 B2 D5 AA 0B 35 5B 80 EA A6 D4 F0 14 FF 31 57 85 AB 03 EC
			39 01 00 00 00 00 04 FF 98 82 0B
			39 01 00 00 00 00 02 9A 44
			39 01 00 00 00 00 02 9B 84
			39 01 00 00 00 00 02 9C 03
			39 01 00 00 00 00 02 9D 03
			39 01 00 00 00 00 02 9E 71
			39 01 00 00 00 00 02 9F 71
			39 01 00 00 00 00 02 AB E0
			39 01 00 00 00 00 04 FF 98 82 0E
			39 01 00 00 00 00 02 11 10
			39 01 00 00 00 00 02 13 10
			39 01 00 00 00 00 02 00 A0
			39 01 00 00 00 00 04 FF 98 82 03
			39 01 00 00 00 00 02 83 20
			39 01 00 00 00 00 02 84 00
			39 01 00 00 00 00 04 FF 98 82 00
			39 01 00 00 00 00 03 68 04 00
			39 01 00 00 00 00 03 51 00 00
			15 01 00 00 00 00 02 53 2C
			15 01 00 00 00 00 02 55 00
			15 01 00 00 50 00 02 11 00
			15 01 00 00 14 00 02 29 00
			39 01 00 00 00 00 02 35 00];
		qcom,mdss-dsi-off-command = [
			39 01 00 00 00 00 04 FF 98 82 00
			05 01 00 00 14 00 02 28 00
			05 01 00 00 78 00 02 10 00];
		qcom,mdss-dsi-on-command-state = "dsi_lp_mode";
		qcom,mdss-dsi-off-command-state = "dsi_lp_mode";
		qcom,mdss-dsi-h-sync-pulse = <1>;
		qcom,mdss-dsi-traffic-mode = "burst_mode";
		qcom,mdss-dsi-lane-map = "lane_map_0123";
		qcom,mdss-dsi-bllp-eof-power-mode;
		qcom,mdss-dsi-bllp-power-mode;
		qcom,mdss-dsi-lane-0-state;
		qcom,mdss-dsi-lane-1-state;
		qcom,mdss-dsi-lane-2-state;
		qcom,mdss-dsi-panel-timings-phy-v2 = [
			26 20 0a 0b 06 02 04 a0
			26 20 0a 0b 06 02 04 a0
			26 20 0a 0b 06 02 04 a0
			26 20 0a 0b 06 02 04 a0
			26 20 0a 0b 06 02 04 a0];
		qcom,mdss-dsi-t-clk-post = <0x0f>;
		qcom,mdss-dsi-t-clk-pre = <0x37>;
		qcom,mdss-dsi-bl-min-level = <1>;
		qcom,mdss-dsi-bl-max-level = <4095>;
		qcom,esd-check-enabled;
		qcom,mdss-dsi-panel-status-command = [14 01 00 01 05 00 01 0A];
		qcom,mdss-dsi-panel-status-command-state = "dsi_lp_mode";
		qcom,mdss-dsi-panel-status-check-mode = "reg_read";
		qcom,mdss-dsi-panel-status-read-length = <1>;
		qcom,mdss-dsi-panel-max-error-count = <2>;
		qcom,mdss-dsi-panel-status-value = <0x9C>;
		qcom,mdss-dsi-dma-trigger = "trigger_sw";
		qcom,mdss-dsi-mdp-trigger = "none";
		qcom,mdss-dsi-bl-pmic-control-type = "bl_ctrl_dcs";
		qcom,panel-supply-entries = <&dsi_panel_pwr_supply>;
		qcom,mdss-dsi-reset-sequence = <1 4>, <0 5>, <1 10>;
		qcom,mdss-dsi-lp11-init;
		qcom,mdss-dsi-reset-delay-vsp-ms = <1>;
		qcom,mdss-dsi-reset-keephigh;
		qcom,mdss-dsi-reset-force-pull-low;
		qcom,ulps-enabled;
		qcom,suspend-ulps-enabled;
	};
};
