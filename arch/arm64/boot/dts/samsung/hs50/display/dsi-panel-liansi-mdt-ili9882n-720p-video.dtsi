/* Copyright (c) 2013, The Linux Foundation. All rights reserved.
 *
 * This program is free software; you can redistribute it and/or modify
 * it under the terms of the GNU General Public License version 2 and
 * only version 2 as published by the Free Software Foundation.
 *
 * This program is distributed in the hope that it will be useful,
 * but WITHOUT ANY WARRANTY; without even the implied warranty of
 * MERCHANTABILITY or FITNESS FOR A PARTICULAR PURPOSE.  See the
 * GNU General Public License for more details.
 */

/*---------------------------------------------------------------------------
 * This file is autogenerated file using gcdb parser. Please do not edit it.
 * Update input XML file to add a new entry or update variable in this file
 * VERSION = "1.0"
 *---------------------------------------------------------------------------*/
&mdss_mdp {
	dsi_liansi_mdt_ili9882n_720p_video: qcom,mdss_dsi_liansi_mdt_ili9882n_720p_video {
		qcom,mdss-dsi-panel-name = "liansi mdt ili9882n 720p video mode dsi panel";
		qcom,mdss-dsi-panel-controller = <&mdss_dsi0>;
		qcom,mdss-dsi-panel-type = "dsi_video_mode";
		qcom,mdss-dsi-panel-destination = "display_1";
		qcom,mdss-dsi-panel-framerate = <60>;
		qcom,mdss-dsi-virtual-channel-id = <0>;
		qcom,mdss-dsi-init-master-time = <50000>;
		qcom,mdss-dsi-stream = <0>;
		qcom,mdss-dsi-panel-width = <720>;
		qcom,mdss-dsi-panel-height = <1600>;
		qcom,mdss-dsi-h-front-porch = <240>;
		qcom,mdss-dsi-h-back-porch = <240>;
		qcom,mdss-dsi-h-pulse-width = <40>;
		qcom,mdss-dsi-h-sync-skew = <0>;
		qcom,mdss-dsi-v-back-porch = <16>;
		qcom,mdss-dsi-v-front-porch = <230>;
		qcom,mdss-dsi-v-pulse-width = <4>;
		qcom,mdss-dsi-h-left-border = <0>;
		qcom,mdss-dsi-h-right-border = <0>;
		qcom,mdss-dsi-v-top-border = <0>;
		qcom,mdss-dsi-v-bottom-border = <0>;
		qcom,mdss-dsi-bpp = <24>;
		qcom,mdss-dsi-color-order = "rgb_swap_rgb";
		qcom,mdss-dsi-underflow-color = <0xff>;
		qcom,mdss-dsi-border-color = <0>;
		qcom,bklt-dcs-ctrl-mode = <0>;
		qcom,mdss-dsi-on-command = [
			39 01 00 00 00 00 04 FF 98 82 01
			15 01 00 00 00 00 02 00 46
			15 01 00 00 00 00 02 01 16
			15 01 00 00 00 00 02 02 00
			15 01 00 00 00 00 02 03 00
			15 01 00 00 00 00 02 08 80
			15 01 00 00 00 00 02 09 0A
			15 01 00 00 00 00 02 0a 71
			15 01 00 00 00 00 02 0b 00
			15 01 00 00 00 00 02 0d 00
			15 01 00 00 00 00 02 0e 01
			15 01 00 00 00 00 02 0f 01
			15 01 00 00 00 00 02 10 01
			15 01 00 00 00 00 02 11 01
			15 01 00 00 00 00 02 12 01
			15 01 00 00 00 00 02 24 01
			15 01 00 00 00 00 02 25 0b
			15 01 00 00 00 00 02 26 00
			15 01 00 00 00 00 02 27 00
			15 01 00 00 00 00 02 31 21
			15 01 00 00 00 00 02 32 07
			15 01 00 00 00 00 02 33 01
			15 01 00 00 00 00 02 34 00
			15 01 00 00 00 00 02 35 02
			15 01 00 00 00 00 02 36 07
			15 01 00 00 00 00 02 37 07
			15 01 00 00 00 00 02 38 07
			15 01 00 00 00 00 02 39 07
			15 01 00 00 00 00 02 3a 17
			15 01 00 00 00 00 02 3b 15
			15 01 00 00 00 00 02 3c 07
			15 01 00 00 00 00 02 3d 07
			15 01 00 00 00 00 02 3e 13
			15 01 00 00 00 00 02 3f 11
			15 01 00 00 00 00 02 40 09
			15 01 00 00 00 00 02 41 07
			15 01 00 00 00 00 02 42 07
			15 01 00 00 00 00 02 43 07
			15 01 00 00 00 00 02 44 07
			15 01 00 00 00 00 02 45 07
			15 01 00 00 00 00 02 46 07
			15 01 00 00 00 00 02 47 20
			15 01 00 00 00 00 02 48 07
			15 01 00 00 00 00 02 49 01
			15 01 00 00 00 00 02 4a 00
			15 01 00 00 00 00 02 4b 02
			15 01 00 00 00 00 02 4c 07
			15 01 00 00 00 00 02 4d 07
			15 01 00 00 00 00 02 4e 07
			15 01 00 00 00 00 02 4f 07
			15 01 00 00 00 00 02 50 16
			15 01 00 00 00 00 02 51 14
			15 01 00 00 00 00 02 52 07
			15 01 00 00 00 00 02 53 07
			15 01 00 00 00 00 02 54 12
			15 01 00 00 00 00 02 55 10
			15 01 00 00 00 00 02 56 08
			15 01 00 00 00 00 02 57 07
			15 01 00 00 00 00 02 58 07
			15 01 00 00 00 00 02 59 07
			15 01 00 00 00 00 02 5a 07
			15 01 00 00 00 00 02 5b 07
			15 01 00 00 00 00 02 5c 07
			15 01 00 00 00 00 02 61 08
			15 01 00 00 00 00 02 62 07
			15 01 00 00 00 00 02 63 01
			15 01 00 00 00 00 02 64 00
			15 01 00 00 00 00 02 65 02
			15 01 00 00 00 00 02 66 07
			15 01 00 00 00 00 02 67 07
			15 01 00 00 00 00 02 68 07
			15 01 00 00 00 00 02 69 07
			15 01 00 00 00 00 02 6a 10
			15 01 00 00 00 00 02 6b 12
			15 01 00 00 00 00 02 6c 07
			15 01 00 00 00 00 02 6d 07
			15 01 00 00 00 00 02 6e 14
			15 01 00 00 00 00 02 6f 16
			15 01 00 00 00 00 02 70 20
			15 01 00 00 00 00 02 71 07
			15 01 00 00 00 00 02 72 07
			15 01 00 00 00 00 02 73 07
			15 01 00 00 00 00 02 74 07
			15 01 00 00 00 00 02 75 07
			15 01 00 00 00 00 02 76 07
			15 01 00 00 00 00 02 77 09
			15 01 00 00 00 00 02 78 07
			15 01 00 00 00 00 02 79 01
			15 01 00 00 00 00 02 7a 00
			15 01 00 00 00 00 02 7b 02
			15 01 00 00 00 00 02 7c 07
			15 01 00 00 00 00 02 7d 07
			15 01 00 00 00 00 02 7e 07
			15 01 00 00 00 00 02 7f 07
			15 01 00 00 00 00 02 80 11
			15 01 00 00 00 00 02 81 13
			15 01 00 00 00 00 02 82 07
			15 01 00 00 00 00 02 83 07
			15 01 00 00 00 00 02 84 15
			15 01 00 00 00 00 02 85 17
			15 01 00 00 00 00 02 86 21
			15 01 00 00 00 00 02 87 07
			15 01 00 00 00 00 02 88 07
			15 01 00 00 00 00 02 89 07
			15 01 00 00 00 00 02 8a 07
			15 01 00 00 00 00 02 8b 07
			15 01 00 00 00 00 02 8c 07
			15 01 00 00 00 00 02 B0 12
			15 01 00 00 00 00 02 B1 33
			15 01 00 00 00 00 02 B2 22
			15 01 00 00 00 00 02 b9 40
			15 01 00 00 00 00 02 d0 01
			15 01 00 00 00 00 02 d1 00
			15 01 00 00 00 00 02 dc 35
			15 01 00 00 00 00 02 dd 42
			15 01 00 00 00 00 02 e2 00
			15 01 00 00 00 00 02 e6 22
			15 01 00 00 00 00 02 e7 54
			39 01 00 00 00 00 04 FF 98 82 02
			15 01 00 00 00 00 02 F1 1C
			15 01 00 00 00 00 02 4B 5A
			15 01 00 00 00 00 02 50 CA
			15 01 00 00 00 00 02 51 00
			15 01 00 00 00 00 02 06 8C
			15 01 00 00 00 00 02 0B A0
			15 01 00 00 00 00 02 0C 00
			15 01 00 00 00 00 02 0D 1C
			15 01 00 00 00 00 02 0E FA
			15 01 00 00 00 00 02 4E 11
			15 01 00 00 00 00 02 01 14
			15 01 00 00 00 00 02 02 0A
			39 01 00 00 00 00 04 FF 98 82 05
			15 01 00 00 00 00 02 03 00
			15 01 00 00 00 00 02 04 BD
			15 01 00 00 00 00 02 58 61
			15 01 00 00 00 00 02 63 88
			15 01 00 00 00 00 02 64 88
			15 01 00 00 00 00 02 68 A1
			15 01 00 00 00 00 02 69 A7
			15 01 00 00 00 00 02 6A 79
			15 01 00 00 00 00 02 6B 6B
			15 01 00 00 00 00 02 85 37
			15 01 00 00 00 00 02 46 00
			15 01 00 00 00 00 02 23 42
			15 01 00 00 00 00 02 24 52
			39 01 00 00 00 00 04 FF 98 82 06
			15 01 00 00 00 00 02 D9 10
			15 01 00 00 00 00 02 C0 40
			15 01 00 00 00 00 02 C1 16
			39 01 00 00 00 00 04 FF 98 82 08
			39 01 00 00 00 00 1C E0 00 24 7A B0 F1 55 24 4B 78 9B A5 D2 FD 24 49 AA 70 A2 C2 EB FF 0E 3A 71 9E 03 EC
			39 01 00 00 00 00 1C E1 00 24 7A B0 F1 55 24 4B 78 9B A5 D2 FD 24 49 AA 70 A2 C2 EB FF 0E 3A 71 9E 03 EC
			39 01 00 00 00 00 04 FF 98 82 0B
			15 01 00 00 00 00 02 9A 44
			15 01 00 00 00 00 02 9B 80
			15 01 00 00 00 00 02 9C 03
			15 01 00 00 00 00 02 9D 03
			15 01 00 00 00 00 02 9E 70
			15 01 00 00 00 00 02 9F 70
			15 01 00 00 00 00 02 AB E0
			39 01 00 00 00 00 04 FF 98 82 0E
			15 01 00 00 00 00 02 11 10
			15 01 00 00 00 00 02 13 14
			15 01 00 00 00 00 02 00 A0
			39 01 00 00 00 00 04 FF 98 82 03
			39 01 00 00 00 00 02 83 20
			39 01 00 00 00 00 02 84 00
			39 01 00 00 00 00 04 FF 98 82 06
			39 01 00 00 00 00 02 06 A4
			39 01 00 00 00 00 04 FF 98 82 00
			39 01 00 00 00 00 03 68 04 00
			39 01 00 00 00 00 03 51 00 00
			15 01 00 00 00 00 02 53 2C
			15 01 00 00 00 00 02 35 00
			15 01 00 00 3C 00 02 11 00
			15 01 00 00 14 00 02 29 00];
		qcom,mdss-dsi-off-command = [
			39 01 00 00 00 00 04 FF 98 82 00
			05 01 00 00 14 00 02 28 00
			05 01 00 00 78 00 02 10 00];
		qcom,mdss-dsi-on-command-state = "dsi_lp_mode";
		qcom,mdss-dsi-off-command-state = "dsi_lp_mode";
		qcom,mdss-dsi-h-sync-pulse = <1>;
		qcom,mdss-dsi-traffic-mode = "burst_mode";
		qcom,mdss-dsi-lane-map = "lane_map_0123";
		qcom,mdss-dsi-bllp-eof-power-mode;
		qcom,mdss-dsi-bllp-power-mode;
		qcom,mdss-dsi-lane-0-state;
		qcom,mdss-dsi-lane-1-state;
		qcom,mdss-dsi-lane-2-state;
		qcom,mdss-dsi-panel-timings-phy-v2 = [
			26 20 0a 0b 06 02 04 a0
			26 20 0a 0b 06 02 04 a0
			26 20 0a 0b 06 02 04 a0
			26 20 0a 0b 06 02 04 a0
			26 20 0a 0b 06 02 04 a0];
		qcom,mdss-dsi-t-clk-post = <0x0f>;
		qcom,mdss-dsi-t-clk-pre = <0x37>;
		qcom,mdss-dsi-bl-min-level = <1>;
		qcom,mdss-dsi-bl-max-level = <4095>;
		qcom,esd-check-enabled;
		qcom,mdss-dsi-panel-status-command = [14 01 00 01 05 00 01 0A];
		qcom,mdss-dsi-panel-status-command-state = "dsi_lp_mode";
		qcom,mdss-dsi-panel-status-check-mode = "reg_read";
		qcom,mdss-dsi-panel-status-read-length = <1>;
		qcom,mdss-dsi-panel-max-error-count = <2>;
		qcom,mdss-dsi-panel-status-value = <0x9C>;
		qcom,mdss-dsi-dma-trigger = "trigger_sw";
		qcom,mdss-dsi-mdp-trigger = "none";
		qcom,mdss-dsi-bl-pmic-control-type = "bl_ctrl_dcs";
		qcom,panel-supply-entries = <&dsi_panel_pwr_supply>;
		qcom,mdss-dsi-reset-sequence = <1 4>, <0 5>, <1 10>;
		qcom,mdss-dsi-lp11-init;
		qcom,mdss-dsi-reset-delay-vsp-ms = <1>;
		qcom,mdss-dsi-reset-keephigh;
		qcom,mdss-dsi-reset-force-pull-low;
		qcom,ulps-enabled;
		qcom,suspend-ulps-enabled;
	};
};
