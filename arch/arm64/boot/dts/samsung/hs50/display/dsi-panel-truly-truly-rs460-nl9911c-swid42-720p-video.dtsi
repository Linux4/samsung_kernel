/* Copyright (c) 2013, The Linux Foundation. All rights reserved.
 *
 * This program is free software; you can redistribute it and/or modify
 * it under the terms of the GNU General Public License version 2 and
 * only version 2 as published by the Free Software Foundation.
 *
 * This program is distributed in the hope that it will be useful,
 * but WITHOUT ANY WARRANTY; without even the implied warranty of
 * MERCHANTABILITY or FITNESS FOR A PARTICULAR PURPOSE.  See the
 * GNU General Public License for more details.
 */

/*---------------------------------------------------------------------------
 * This file is autogenerated file using gcdb parser. Please do not edit it.
 * Update input XML file to add a new entry or update variable in this file
 * VERSION = "1.0"
 *---------------------------------------------------------------------------*/
&mdss_mdp {
dsi_truly_truly_rs460_nl9911c_swid42_720p_video: qcom,mdss_dsi_truly_truly_rs460_nl9911c_swid42_720p_video {
		qcom,mdss-dsi-panel-name = "truly truly rs460 nl9911c swid42 720p video mode dsi panel";
		qcom,mdss-dsi-panel-controller = <&mdss_dsi0>;
		qcom,mdss-dsi-panel-type = "dsi_video_mode";
		qcom,mdss-dsi-panel-destination = "display_1";
		qcom,mdss-dsi-panel-framerate = <60>;
		qcom,mdss-dsi-virtual-channel-id = <0>;
		qcom,mdss-dsi-init-master-time = <50000>;
		qcom,mdss-dsi-stream = <0>;
		qcom,mdss-dsi-panel-width = <720>;
		qcom,mdss-dsi-panel-height = <1600>;
		qcom,mdss-dsi-h-front-porch = <120>;
		qcom,mdss-dsi-h-back-porch = <116>;
		qcom,mdss-dsi-h-pulse-width = <4>;
		qcom,mdss-dsi-h-sync-skew = <0>;
		qcom,mdss-dsi-v-back-porch = <12>;
		qcom,mdss-dsi-v-front-porch = <124>;
		qcom,mdss-dsi-v-pulse-width = <4>;
		qcom,mdss-dsi-h-left-border = <0>;
		qcom,mdss-dsi-h-right-border = <0>;
		qcom,mdss-dsi-v-top-border = <0>;
		qcom,mdss-dsi-v-bottom-border = <0>;
		qcom,mdss-dsi-bpp = <24>;
		qcom,mdss-dsi-color-order = "rgb_swap_rgb";
		qcom,mdss-dsi-underflow-color = <0xff>;
		qcom,mdss-dsi-border-color = <0>;
		qcom,bklt-dcs-ctrl-mode = <0>;
		qcom,mdss-dsi-on-command = [
			29 01 00 00 00 00 03 F0 5A 59
			29 01 00 00 00 00 03 F1 A5 A6
			29 01 00 00 00 00 1F B0 87 86 85 84 88 89 00 00 33 33 33 33 00 05 05 80 05 00 0F 05 04 03 02 01 02 03 04 00 00 00
			29 01 00 00 00 00 1E B1 53 43 85 00 00 05 05 80 05 00 04 08 54 00 00 00 44 40 02 01 40 02 01 40 02 01 40 02 01
			29 01 00 00 00 00 1D B5 08 00 00 C0 00 04 06 C1 C1 0C 0C 0E 0E 10 10 12 12 03 03 03 03 03 FF FF FC 00 00 00
			29 01 00 00 00 00 1D B4 09 00 00 C0 00 05 07 C1 C1 0D 0D 0F 0F 11 11 13 13 03 03 03 03 03 FF FF FC 00 00 00
			29 01 00 00 00 00 19 B8 00 00 00 00 00 00 00 00 00 00 00 00 00 00 00 00 00 00 00 00 00 00 00 00
			29 01 00 00 00 00 0E BB 01 05 09 11 0D 19 1D 55 25 69 00 21 25
			29 01 00 00 00 00 0F BC 00 00 00 00 02 20 FF 00 03 13 01 73 44 00
			29 01 00 00 00 00 0B BD 53 12 4F CF 72 A7 08 44 AE 15
			29 01 00 00 00 00 0B BE 73 73 50 32 0C 77 43 07 0E 0E
			29 01 00 00 00 00 09 BF 07 25 07 25 7F 00 11 04
			29 01 00 00 00 00 0A C0 10 FF FF FF FF FF 00 FF 00
			29 01 00 00 00 00 14 C1 C0 0C 20 7C 04 74 78 04 2A 40 36 00 07 CF FF FF C0 00 C0
			29 01 00 00 00 00 02 C2 00
			29 01 00 00 00 00 0B C3 06 00 FF 00 FF 00 00 81 01 00
			29 01 00 00 00 00 04 C4 84 03 2a
			29 01 00 00 00 00 0C C5 03 1C C0 C0 40 10 42 44 0A 09 14
			29 01 00 00 00 00 0B C6 88 16 20 28 29 33 64 34 08 04
			29 01 00 00 00 00 02 CB 00
			39 01 00 00 01 00 09 D0 80 0D FF 0F 61 0B 08 04
			29 01 00 00 00 00 02 D2 42
			29 01 00 00 00 00 02 D7 DE
			29 01 00 00 00 00 18 E1 FE FE FE FE FE EE F0 80 D0 00 00 00 C0 00 C0 00 F0 F0 00 80 00 04 20
			29 01 00 00 00 00 0E E0 30 00 20 18 01 1F 23 62 DF A0 04 CC 01
			29 01 00 00 00 00 03 F1 5A 59
			29 01 00 00 00 00 03 F0 A5 A6
			29 01 00 00 00 00 02 35 00
			29 01 00 00 00 00 03 51 00 00
			29 01 00 00 00 00 02 53 2C
			29 01 00 00 00 00 02 55 00
			05 01 00 00 78 00 02 11 00
			05 01 00 00 32 00 02 29 00
			29 01 00 00 00 00 02 26 01];
		qcom,mdss-dsi-off-command = [
			29 01 00 00 00 00 02 26 08
			05 01 00 00 32 00 02 28 00
			05 01 00 00 78 00 02 10 00];
		qcom,mdss-dsi-on-command-state = "dsi_lp_mode";
		qcom,mdss-dsi-off-command-state = "dsi_lp_mode";
		qcom,mdss-dsi-h-sync-pulse = <1>;
		qcom,mdss-dsi-traffic-mode = "burst_mode";
		qcom,mdss-dsi-lane-map = "lane_map_0123";
		qcom,mdss-dsi-bllp-eof-power-mode;
		qcom,mdss-dsi-bllp-power-mode;
		qcom,mdss-dsi-lane-0-state;
		qcom,mdss-dsi-lane-1-state;
		qcom,mdss-dsi-lane-2-state;
		qcom,mdss-dsi-panel-timings-phy-v2 = [
			23 1E 07 08 05 02 04 a0
			23 1E 07 08 05 02 04 a0
			23 1E 07 08 05 02 04 a0
			23 1E 07 08 05 02 04 a0
			23 18 07 08 05 02 04 a0];
		qcom,mdss-dsi-t-clk-post = <0x0d>;
		qcom,mdss-dsi-t-clk-pre = <0x2d>;
		qcom,mdss-dsi-bl-min-level = <1>;
		qcom,mdss-dsi-bl-max-level = <4095>;
		qcom,esd-check-enabled;
		qcom,mdss-dsi-panel-status-command = [14 01 00 01 05 00 01 0A];
		qcom,mdss-dsi-panel-status-command-state = "dsi_lp_mode";
		qcom,mdss-dsi-panel-status-check-mode = "reg_read";
		qcom,mdss-dsi-panel-status-read-length = <1>;
		qcom,mdss-dsi-panel-max-error-count = <2>;
		qcom,mdss-dsi-panel-status-value = <0x9C>;
		qcom,mdss-dsi-dma-trigger = "trigger_sw";
		qcom,mdss-dsi-mdp-trigger = "none";
		qcom,mdss-dsi-bl-pmic-control-type = "bl_ctrl_dcs";
		qcom,mdss-dsi-reset-sequence = <1 5>, <0 5>, <1 50>;
		qcom,panel-supply-entries = <&dsi_panel_pwr_supply>;
		qcom,mdss-dsi-lp11-init;
		qcom,mdss-dsi-reset-delay-vsp-ms = <1>;
		qcom,mdss-dsi-reset-keephigh;
		qcom,mdss-dsi-reset-force-pull-low;
		qcom,ulps-enabled;
		qcom,suspend-ulps-enabled;
	};
};
