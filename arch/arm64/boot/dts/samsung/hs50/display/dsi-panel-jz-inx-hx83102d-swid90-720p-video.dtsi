/* Copyright (c) 2013, The Linux Foundation. All rights reserved.
 *
 * This program is free software; you can redistribute it and/or modify
 * it under the terms of the GNU General Public License version 2 and
 * only version 2 as published by the Free Software Foundation.
 *
 * This program is distributed in the hope that it will be useful,
 * but WITHOUT ANY WARRANTY; without even the implied warranty of
 * MERCHANTABILITY or FITNESS FOR A PARTICULAR PURPOSE.  See the
 * GNU General Public License for more details.
 */

/*---------------------------------------------------------------------------
 * This file is autogenerated file using gcdb parser. Please do not edit it.
 * Update input XML file to add a new entry or update variable in this file
 * VERSION = "1.0"
 *---------------------------------------------------------------------------*/
&mdss_mdp {
	dsi_jz_inx_hx83102d_swid90_720p_video: qcom,mdss_dsi_jz_inx_hx83102d_swid90_720p_video {
		qcom,mdss-dsi-panel-name = "jz inx hx83102d swid90 720p video mode dsi panel";
		qcom,mdss-dsi-panel-controller = <&mdss_dsi0>;
		qcom,mdss-dsi-panel-type = "dsi_video_mode";
		qcom,mdss-dsi-panel-destination = "display_1";
		qcom,mdss-dsi-panel-framerate = <60>;
		qcom,mdss-dsi-virtual-channel-id = <0>;
		qcom,mdss-dsi-init-master-time = <50000>;
		qcom,mdss-dsi-stream = <0>;
		qcom,mdss-dsi-panel-width = <720>;
		qcom,mdss-dsi-panel-height = <1600>;
		qcom,mdss-dsi-h-front-porch = <12>;
		qcom,mdss-dsi-h-back-porch = <12>;
		qcom,mdss-dsi-h-pulse-width = <12>;
		qcom,mdss-dsi-h-sync-skew = <0>;
		qcom,mdss-dsi-v-back-porch = <9>;
		qcom,mdss-dsi-v-front-porch = <240>;
		qcom,mdss-dsi-v-pulse-width = <2>;
		qcom,mdss-dsi-h-left-border = <0>;
		qcom,mdss-dsi-h-right-border = <0>;
		qcom,mdss-dsi-v-top-border = <0>;
		qcom,mdss-dsi-v-bottom-border = <0>;
		qcom,mdss-dsi-bpp = <24>;
		qcom,mdss-dsi-color-order = "rgb_swap_rgb";
		qcom,mdss-dsi-underflow-color = <0xff>;
		qcom,mdss-dsi-border-color = <0>;
		qcom,bklt-dcs-ctrl-mode = <0>;
		qcom,mdss-dsi-on-command = [
			39 01 00 00 00 00 04 B9 83 10 2D
			39 01 00 00 00 00 0C B1 22 44 2D 2D 11 10 12 11 08 08 08
			15 01 00 00 00 00 02 BD 01
			39 01 00 00 00 00 05 B1 01 9B 02 32
			15 01 00 00 00 00 02 BD 00
			39 01 00 00 00 00 0F B2 00 00 06 40 00 07 EE 35 11 11 00 01 85 A0
			39 01 00 00 00 00 0F B4 56 50 56 50 56 50 56 50 05 6F 03 00 00 FF
			15 01 00 00 00 00 02 CC 02
			39 01 00 00 05 00 1A D3 06 02 01 01 00 05 05 14 00 13 33 0B 0B 00 00 32 10 0A 00 0A 54 15 A8 05 A8
			15 01 00 00 00 00 02 BD 01
			39 01 00 00 05 00 03 D3 01 40
			15 01 00 00 00 00 02 BD 00
			39 01 00 00 05 00 2D D5 18 18 18 18 18 18 18 18 18 18 18 18 18 18 19 19 18 18 04 04 03 03 02 02 01 01 00 00 20 20 18 18 18 18 18 18 18 18 18 18 19 19 19 19
			39 01 00 00 05 00 2D D6 18 18 18 18 18 18 18 18 18 18 18 18 18 18 19 19 18 18 00 00 01 01 02 02 03 03 04 04 20 20 18 18 18 18 18 18 18 18 18 18 19 19 19 19
			39 01 00 00 00 00 03 E7 FF 0A
			15 01 00 00 00 00 02 BD 01
			15 01 00 00 00 00 02 E7 01
			15 01 00 00 00 00 02 BD 00
			39 01 00 00 00 00 19 D8 02 AB BF F8 0A F0 02 AB BF F8 0A F0 02 AB AA A8 00 00 0A AB AA A8 0A F0
			15 01 00 00 00 00 02 BD 01
			39 01 00 00 00 00 19 D8 02 AA FF F8 0A F0 02 AA FF F8 0A F0 02 AA FF F8 0A F0 02 AA FF F8 0A F0
			15 01 00 00 00 00 02 BD 02
			39 01 00 00 00 00 0D D8 02 56 FF F8 05 50 02 56 FF F8 05 50
			15 01 00 00 00 00 02 BD 03
			39 01 00 00 00 00 19 D8 02 AB BF F8 0A F0 02 AB BF F8 0A F0 02 AA FF FC 0A F0 02 AA FF FC 0A F0
			15 01 00 00 00 00 02 BD 00
			39 01 00 00 00 00 2F E0 00 0E 20 2B 35 67 82 8B 92 8E A7 AC B1 BF BD C4 CC DE DB 6C 72 7B 7F 00 0E 20 2B 35 67 82 8B 92 8E A7 AC B1 BF BD C4 CC DE DB 6C 72 7B 7F
			39 01 00 00 00 00 14 BA 71 23 A8 97 B2 C0 C0 01 10 00 00 00 0D 3D 82 77 04 01 00
			39 01 00 00 00 00 08 BF FC 00 04 9E F6 00 4D
			39 01 00 00 00 00 06 CB 00 13 00 02 49
			15 01 00 00 00 00 02 BD 01
			15 01 00 00 00 00 02 CB 01
			15 01 00 00 00 00 02 BD 02
			39 01 00 00 00 00 09 B4 42 00 33 00 33 88 B3 00
			39 01 00 00 00 00 04 B1 7F 03 F5
			15 01 00 00 00 00 02 BD 00
			39 01 00 00 00 00 0C C0 33 33 00 00 19 42 00 08 00 1A 1B
			39 01 00 00 00 00 07 C7 00 C2 00 10 42 C0
			05 01 00 00 3C 00 01 11
			05 01 00 00 14 00 01 29
			39 01 00 00 00 00 03 51 00 00
			39 01 00 00 00 00 05 C9 04 0C B2 01
			15 01 00 00 05 00 02 55 00
			15 01 00 00 00 00 02 53 2C];
		qcom,mdss-dsi-off-command = [
			05 01 00 00 3C 00 02 28 00
			05 01 00 00 78 00 02 10 00];
		qcom,mdss-dsi-on-command-state = "dsi_lp_mode";
		qcom,mdss-dsi-off-command-state = "dsi_lp_mode";
		qcom,mdss-dsi-h-sync-pulse = <1>;
		qcom,mdss-dsi-traffic-mode = "burst_mode";
		qcom,mdss-dsi-lane-map = "lane_map_0123";
		qcom,mdss-dsi-bllp-eof-power-mode;
		qcom,mdss-dsi-bllp-power-mode;
		qcom,mdss-dsi-lane-0-state;
		qcom,mdss-dsi-lane-1-state;
		qcom,mdss-dsi-lane-2-state;
		qcom,mdss-dsi-panel-timings-phy-v2 = [
			21 1E 06 07 04 02 04 a0
			21 1E 06 07 04 02 04 a0
			21 1E 06 07 04 02 04 a0
			21 1E 06 07 04 02 04 a0
			21 14 06 07 04 02 04 a0];
		qcom,mdss-dsi-t-clk-post = <0x0C>;
		qcom,mdss-dsi-t-clk-pre = <0x27>;
		qcom,mdss-dsi-bl-min-level = <1>;
		qcom,mdss-dsi-bl-max-level = <4095>;
		qcom,esd-check-enabled;
		qcom,mdss-dsi-panel-status-command = [14 01 00 01 05 00 01 0A];
		qcom,mdss-dsi-panel-status-command-state = "dsi_lp_mode";
		qcom,mdss-dsi-panel-status-check-mode = "reg_read";
		qcom,mdss-dsi-panel-status-read-length = <1>;
		qcom,mdss-dsi-panel-max-error-count = <2>;
		qcom,mdss-dsi-panel-status-value = <0x9D>;
		qcom,mdss-dsi-dma-trigger = "trigger_sw";
		qcom,mdss-dsi-mdp-trigger = "none";
		qcom,mdss-dsi-bl-pmic-control-type = "bl_ctrl_dcs";
		qcom,panel-supply-entries = <&dsi_panel_pwr_supply>;
		qcom,mdss-dsi-reset-sequence = <1 4>, <0 5>, <1 60>;
		qcom,mdss-dsi-lp11-init;
		qcom,mdss-dsi-reset-delay-vsp-ms = <4>;
		qcom,mdss-dsi-reset-keephigh;
		qcom,mdss-dsi-reset-force-pull-low;
		qcom,ulps-enabled;
		qcom,suspend-ulps-enabled;
	};
};
