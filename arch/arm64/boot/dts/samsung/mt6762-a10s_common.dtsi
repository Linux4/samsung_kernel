/* 
 * Generated by Samsung 
 * If these files should be changed, then please make a sync with WINGTECH
*/

#include "samsung/modem-MTKcommon-pdata.dtsi"

/* Add Samsung configuration over here */
/ {
	fragment@model {
		target-path = "/";
		__overlay__ {
			usb_notifier {
				compatible = "samsung,usb-notifier";
			};
		};
	};
};

