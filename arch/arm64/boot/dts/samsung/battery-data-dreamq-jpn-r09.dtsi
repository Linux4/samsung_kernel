/* Copyright (c) 2014, The Linux Foundation. All rights reserved.
 *
 * This program is free software; you can redistribute it and/or modify
 * it under the terms of the GNU General Public License version 2 and
 * only version 2 as published by the Free Software Foundation.
 *
 * This program is distributed in the hope that it will be useful,
 * but WITHOUT ANY WARRANTY; without even the implied warranty of
 * MERCHANTABILITY or FITNESS FOR A PARTICULAR PURPOSE.  See the
 * GNU General Public License for more details.
 */
#include "battery-data-dreamq-common.dtsi"

&soc {
	battery {
		battery,vsys_volt_check = <0>;
		battery,max_input_current = <2700>;  /* mA */
	};

	cable-info {
		default_input_current = <1600>;
		default_charging_current = <1700>;
	};
};
