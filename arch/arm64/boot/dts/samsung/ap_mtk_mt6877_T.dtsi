#include <dt-bindings/clock/mt6877-clk.h>
/* /home/dpi/qb5_8814/workspace/P4_1716/android/kernel/kmodule/ap/mtk/mt6877/ap_mtk_mt6877_T.m53x_eur.04.dtsi */

#include "../../mediatek/k6877v1_64_titan_syberian_tiger_k419/Board_00.dts"
#include "../../mediatek/k6877v1_64_titan_syberian_tiger_k419/gpio_04.dtsi"

