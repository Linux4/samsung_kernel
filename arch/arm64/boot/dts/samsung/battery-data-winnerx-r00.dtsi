/*
 * SAMSUNG board device tree source
 *
 * Copyright (c) 2018 Samsung Electronics Co., Ltd.
 *		http://www.samsung.com
 *
 * This program is free software; you can redistribute it and/or modify
 * it under the terms of the GNU General Public License version 2 as
 * published by the Free Software Foundation.
 */
/* This dtsi is for hw rev from 00 to 01 */
#include "battery-data-winnerx-common.dtsi"

&soc {

	sec-dual-battery {
		battery,main_bat_enb_gpio = <&tlmm 148 0>;
		battery,sub_bat_enb_gpio = <&expander_gpios 8 0>;
	};
};
