
&smd {
	s2mu106_charger: s2mu106-charger {
		status = "disable";
		compatible = "samsung,s2mu106-charger";
	};
};


/* /home/dpi/qb5_8815/workspace/P4_1716/android/kernel/kmodule/battery/charger/s2mu106_charger/s2mu106_charger.a51xq.dtsi */

&s2mu106_charger {
		charger,mrstbtmr_factory = <1>;
		charger,reduce_async_debounce_time;
};

