/* Copyright (c) 2013, Samsung Electronics Corporation. All rights reserved.
 *
 * This program is free software; you can redistribute it and/or modify
 * it under the terms of the GNU General Public License version 2 and
 * only version 2 as published by the Free Software Foundation.
 *
 * This program is distributed in the hope that it will be useful,
 * but WITHOUT ANY WARRANTY; without even the implied warranty of
 * MERCHANTABILITY or FITNESS FOR A PARTICULAR PURPOSE.  See the
 * GNU General Public License for more details.
 */

&soc {

	/* NFC */
	i2c@75b6000 { /* BLSP2 QUP1 */
		sec-nfc@27 {
			compatible = "sec-nfc";
			reg = <0x27>;
			interrupt-parent = <&tlmm>;
			interrupts = <126 0>;
			sec-nfc,ven-gpio = <&pm8004_mpps 4 0x0>;
			sec-nfc,firm-gpio = <&expander_gpios 5 0x0>;
			sec-nfc,irq-gpio = <&tlmm 126 0x01>;
			sec-nfc,i2c_1p8-supply = <&pm8994_l6>;
		};

		/delete-node/ pn547@2B;
		felica_i2c@2B {
			compatible = "felica,felica-i2c";
			reg = <0x2B>;
		};
	};
};
