/* 
 * Generated by Samsung 
 * If these files should be changed, then please make a sync with MTK
*/

#include "../../mediatek/k65v1_64_bsp_titan_rat/gpio03.dtsi"
#include "mt6765-a12_common.dtsi"
#include "mt6765_a12_camera_01.dtsi"

/*End of this file, DO NOT ADD ANYTHING HERE*/
