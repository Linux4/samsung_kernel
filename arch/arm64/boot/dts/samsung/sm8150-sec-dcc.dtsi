/* Copyright (c) 2016-2017, The Linux Foundation. All rights reserved.
 *
 * This program is free software; you can redistribute it and/or modify
 * it under the terms of the GNU General Public License version 2 and
 * only version 2 as published by the Free Software Foundation.
 *
 * This program is distributed in the hope that it will be useful,
 * but WITHOUT ANY WARRANTY; without even the implied warranty of
 * MERCHANTABILITY or FITNESS FOR A PARTICULAR PURPOSE.  See the
 * GNU General Public License for more details.
 */

#include <dt-bindings/soc/qcom,dcc_v2.h>

&dcc {
	qcom,link-list = <DCC_READ 0x0C267000 9 0>,
				 <DCC_READ 0x0C26705C 2 0>,
				 <DCC_READ 0x0C267024 3 0>,
				 <DCC_READ 0x0C267054 2 0>,
				 <DCC_READ 0x0C267030 1 0>,
				 <DCC_READ 0x0C267040 5 0>,
				/*APM END */
				 <DCC_READ 0x18220d14 3 0>,
				 <DCC_READ 0x18220d30 4 0>,
				 <DCC_READ 0x18220d44 4 0>,
				 <DCC_READ 0x18220d58 4 0>,
				 <DCC_READ 0x18220fb4 3 0>,
				 <DCC_READ 0x18220fd0 4 0>,
				 <DCC_READ 0x18220fe4 4 0>,
				 <DCC_READ 0x18220ff8 4 0>,
				 <DCC_READ 0x18220d04 1 0>,
				 <DCC_READ 0x18220d00 1 0>,
				 <DCC_READ 0x18200d04 1 0>,
				 <DCC_READ 0x18230d04 1 0>,

				/*RSC_RSCC_RSC*/
				 <DCC_READ 0x18210400 1 0>,
				 <DCC_READ 0x18220400 1 0>,
				 <DCC_READ 0x18230400 1 0>,
				 <DCC_READ 0x18210404 1 0>,
				 <DCC_READ 0x18220404 1 0>,
				 <DCC_READ 0x18230404 1 0>,
				 <DCC_READ 0x18210408 1 0>,
				 <DCC_READ 0x18220408 1 0>,
				 <DCC_READ 0x18230408 1 0>,
				 <DCC_READ 0x18200d00 1 0>,
				 <DCC_READ 0x18210d00 1 0>,
				 <DCC_READ 0x18230d00 1 0>,
				 <DCC_READ 0x18200d08 1 0>,
				 <DCC_READ 0x18210d08 1 0>,
				 <DCC_READ 0x18220d08 1 0>,
				 <DCC_READ 0x18230d08 1 0>,
				 <DCC_READ 0x18230d10 1 0>,
				 <DCC_READ 0x18230fb0 1 0>,
				 <DCC_READ 0x18231250 1 0>,
				 <DCC_READ 0x18230d14 1 0>,
				 <DCC_READ 0x18230fb4 1 0>,
				 
				 <DCC_READ 0x18231254 1 0>,
				 <DCC_READ 0x18230fb8 1 0>,
				 <DCC_READ 0x18231258 1 0>,
				 <DCC_READ 0x18230d1c 1 0>,
				 <DCC_READ 0x18230fbc 1 0>,
				 <DCC_READ 0x1823125c 1 0>,
				 <DCC_READ 0x18230d40 1 0>,
				 <DCC_READ 0x18200010 1 0>,
				 <DCC_READ 0x18210010 1 0>,
				 <DCC_READ 0x18220010 1 0>,
				 <DCC_READ 0x18230010 1 0>,
				 <DCC_READ 0x18200014 1 0>,
				 <DCC_READ 0x18210014 1 0>,
				 <DCC_READ 0x18220014 1 0>,
				 <DCC_READ 0x18230014 1 0>,
				 <DCC_READ 0x18200018 1 0>,
				 <DCC_READ 0x18210018 1 0>,
				 <DCC_READ 0x18220018 1 0>,
				 <DCC_READ 0x18230018 1 0>,

				/*RSC_PDC_PCU*/
				 <DCC_READ 0x18000024 1 0>,
				 <DCC_READ 0x18000040 4 0>,
				 <DCC_READ 0x18010024 1 0>,
				 <DCC_READ 0x18010040 4 0>,
				 <DCC_READ 0x18020024 1 0>,
				 <DCC_READ 0x18020040 4 0>,
				 <DCC_READ 0x18030024 1 0>,
				 <DCC_READ 0x18030040 4 0>,
				 <DCC_READ 0x18040024 1 0>,
				 <DCC_READ 0x18040040 4 0>,
				 <DCC_READ 0x18050024 1 0>,
				 <DCC_READ 0x18050040 4 0>,
				 <DCC_READ 0x18060024 1 0>,
				 <DCC_READ 0x18060040 4 0>,
				 <DCC_READ 0x18070024 1 0>,
				 <DCC_READ 0x18070040 4 0>,

				 <DCC_READ 0x180800FC 1 0>,
				 <DCC_READ 0x18080100 1 0>,
				 <DCC_READ 0x18080104 1 0>,
				 <DCC_READ 0x18080168 1 0>,
				 <DCC_READ 0x18080198 1 0>,
				 <DCC_READ 0x18080128 1 0>,
				 <DCC_READ 0x18080024 1 0>,
				 <DCC_READ 0x18080040 3 0>,
				 <DCC_READ 0x18200400 3 0>,
				 <DCC_READ 0x0b201020 2 0>,
				/*CPRh*/
				 <DCC_READ 0x18101908 1 0>,
				 <DCC_READ 0x18101c18 1 0>,
				 <DCC_READ 0x18390810 1 0>,
				 <DCC_READ 0x18390c50 1 0>,
				 <DCC_READ 0x18390814 1 0>,
				 <DCC_READ 0x18390c54 1 0>,
				 <DCC_READ 0x18390818 1 0>,
				 <DCC_READ 0x18390c58 1 0>,
				 <DCC_READ 0x18393a84 2 0>,
				 <DCC_READ 0x18100908 1 0>,
				 <DCC_READ 0x18100c18 1 0>,
				 <DCC_READ 0x183a0810 1 0>,
				 <DCC_READ 0x183a0c50 1 0>,
				 <DCC_READ 0x183a0814 1 0>,
				 <DCC_READ 0x183a0c54 1 0>,
				 <DCC_READ 0x183a0818 1 0>,
				 <DCC_READ 0x183a0c58 1 0>,
				 <DCC_READ 0x183a3a84 2 0>,
				 <DCC_READ 0x18393500 1 0>,
				 <DCC_READ 0x18393580 1 0>,
				 <DCC_READ 0x183A3500 1 0>,
			     <DCC_READ 0x183A3580 1 0>,
				/*APSS_OSM*/
				 <DCC_READ 0x18321700 13 0>,
				 <DCC_READ 0x18321744 1 0>,
				 <DCC_READ 0x18321780 1 0>,
				 <DCC_READ 0x18321804 16 0>,
				 <DCC_READ 0x18321920 1 0>,
				 <DCC_READ 0x18322c14 2 0>,
				 <DCC_READ 0x18322d70 1 0>,
				 <DCC_READ 0x18322d88 1 0>,
				 <DCC_READ 0x18323700 13 0>,
				 <DCC_READ 0x18323744 1 0>,
				 <DCC_READ 0x18323780 1 0>,
				 <DCC_READ 0x18323804 16 0>,
				 <DCC_READ 0x18323920 1 0>,
				 <DCC_READ 0x18324c14 2 0>,
				 <DCC_READ 0x18324d70 1 0>,
				 <DCC_READ 0x18324d88 1 0>,
				 <DCC_READ 0x18325f00 13 0>,
				 <DCC_READ 0x18325f44 1 0>,
				 <DCC_READ 0x18325f80 1 0>,
				 <DCC_READ 0x18326004 16 0>,
				 <DCC_READ 0x18326120 1 0>,
				 <DCC_READ 0x18327414 2 0>,
				 <DCC_READ 0x18327570 1 0>,
				 <DCC_READ 0x18327588 1 0>,
				 <DCC_READ 0x18327f00 13 0>,
				 <DCC_READ 0x18327f44 1 0>,
				 <DCC_READ 0x18327f80 1 0>,
				 <DCC_READ 0x18328004 16 0>,
				 <DCC_READ 0x18328120 1 0>,
				 <DCC_READ 0x18329414 2 0>,
				 <DCC_READ 0x18329570 1 0>,
				 <DCC_READ 0x18329588 1 0>,
				 <DCC_READ 0x18230D18 1 0>,
				 <DCC_READ 0x18230D3C 1 0>,
				 <DCC_READ 0x18230D30 1 0>,
				 <DCC_READ 0x18230D34 1 0>,
				 <DCC_READ 0x18230D38 1 0>,
				 /* Gladiator */
				 <DCC_READ 0x09680008 1 0>, 
    			 <DCC_READ 0x09680078 6 0>,   
				 <DCC_LOOP 8 0 0>, 
				 <DCC_READ 0x09681000 1 0>, 
    			 <DCC_LOOP 1 0 0>,
    			 <DCC_READ 0x09681014 9 0>, 
    			 <DCC_READ 0x0968103C 1 0>,
    			 <DCC_READ 0x09688008 1 0>, 
    			 <DCC_READ 0x09688078 6 0>,
    			 <DCC_LOOP 8 0 0>,
    			 <DCC_READ 0x09689000 1 0>,
    			 <DCC_LOOP 1 0 0>,
    			 <DCC_READ 0x09689014 9 0>,
    			 <DCC_READ 0x0968903C 1 0>,
    			 <DCC_READ 0x09698110 1 0>,
    			 <DCC_READ 0x09698120 8 0>,
    			 <DCC_READ 0x096AA090 1 0>,
    			 <DCC_READ 0x096AA100 1 0>,
    			 <DCC_READ 0x096B8090 1 0>,
    			 <DCC_READ 0x096B8100 1 0>,
    			 <DCC_READ 0x096BD090 1 0>,
    			 <DCC_READ 0x096BD100 1 0>,
    			 <DCC_READ 0x18282000 4 0>,
    			 <DCC_READ 0x18282028 1 0>,
    			 <DCC_READ 0x18282038 1 0>,
    			 <DCC_READ 0x18282080 5 0>,
    			 <DCC_READ 0x18286000 4 0>,
    			 <DCC_READ 0x18286028 1 0>,
    			 <DCC_READ 0x18286038 1 0>,
    			 <DCC_READ 0x18286080 5 0>,
   				 <DCC_READ 0x0C201244 1 0>,
    			 <DCC_READ 0x0C202244 1 0>,
    			 <DCC_READ 0x18300000 1 0>,
        			/*SNOC*/
    			 <DCC_READ 0x1620500 4 0>,
    			 <DCC_READ 0x1620700 4 0>,
    			 <DCC_READ 0x1620900 1 0>,
    			 <DCC_READ 0x1620D00 2 0>,
    			 <DCC_READ 0x1620F00 1 0>,
    			 <DCC_READ 0x1638100 1 0>,
    			 /*GOLD*/
    			 <DCC_READ 0x1829208C 1 0>,
    			 <DCC_WRITE 0x1829209C 0x78 0>,
    			 <DCC_WRITE 0x1829209C 0x0 0>,
    			 <DCC_WRITE 0x18292048 0x1 0>,
    			 <DCC_WRITE 0x18292090 0x0 0>,
    			 <DCC_WRITE 0x18292090 0x25 0>,
    			 <DCC_READ 0x18292098 1 0>,
    			 <DCC_WRITE 0x18292048 0x1D 0>,
    			 <DCC_WRITE 0x18292090 0x0 0>,
    			 <DCC_WRITE 0x18292090 0x25 0>,
    			 <DCC_READ 0x18292098 1 0>,
    			/*GOLD+ */
    			 <DCC_READ 0x1829608C 1 0>,
    			 <DCC_WRITE 0x1829609C 0x78 0>,
    			 <DCC_WRITE 0x1829609C 0x0 0>,
    			 <DCC_WRITE 0x18296048 0x1 0>,
    			 <DCC_WRITE 0x18296090 0x0 0>,
    			 <DCC_WRITE 0x18296090 0x25 0>,
    			 <DCC_READ 0x18296098 1 0>,
    			 <DCC_WRITE 0x18296048 0x1D 0>,
    			 <DCC_WRITE 0x18296090 0x0 0>,
    			 <DCC_WRITE 0x18296090 0x25 0>,
    			 <DCC_READ 0x18296098 1 0>,
				/*CORE HANG VALUE*/
    			 <DCC_READ 0x1800005C 1 0>,
    			 <DCC_READ 0x1801005C 1 0>,
    			 <DCC_READ 0x1802005C 1 0>,
    			 <DCC_READ 0x1803005C 1 0>,
    			 <DCC_READ 0x1804005C 1 0>,
    			 <DCC_READ 0x1805005C 1 0>,
    			 <DCC_READ 0x1806005C 1 0>,
    			 <DCC_READ 0x1807005C 1 0>,

    			 <DCC_READ 0x1829600C 1 0>, /* GOLDPLUS_ACDDCR */
    			 <DCC_READ 0x1829200C 1 0>, /* GOLD_ACDDCR */
    			 <DCC_READ 0x1829603C 1 0>, /* GOLDPLUS_ACD_GFMUX_CFG */
    			 <DCC_READ 0x1829203C 1 0>, /* GOLD_ACD_GFMUX_CFG */

    			/*DDRSS*/
    			/*GEMNOC*/
    			 <DCC_READ 0x09698500 8 0>,
    			 <DCC_READ 0x09698700 8 0>,
    			/*SHRM CSR*/
    			 <DCC_READ 0x09050008 1 0>,
    			 <DCC_READ 0x09050078 1 0>,
    			/*MCCC*/
    			 <DCC_READ 0x090B0280 1 0>,
    			 <DCC_READ 0x090B0288 7 0>,
    			/*LLCC/CABO*/
    			 <DCC_READ 0x09601000 2 0>,
    			 <DCC_READ 0x09232100 1 0>,
    			 <DCC_READ 0x092360B0 1 0>,
    			 <DCC_READ 0x09236044 4 0>,
    		 	 <DCC_READ 0x0923E030 2 0>,
    			 <DCC_READ 0x09241000 1 0>,
    			 <DCC_READ 0x09242028 1 0>,
    			 <DCC_READ 0x09248058 4 0>,
    			 <DCC_READ 0x09260410 3 0>,
    			 <DCC_READ 0x09260420 2 0>,
    			 <DCC_READ 0x09260430 1 0>,
    			 <DCC_READ 0x09260440 1 0>,
    			 <DCC_READ 0x09260448 1 0>,
    			 <DCC_READ 0x092604A0 1 0>,
    			 <DCC_READ 0x092B2100 1 0>,
    			 <DCC_READ 0x092B60B0 1 0>,
    			 <DCC_READ 0x092B6044 4 0>,
    			 <DCC_READ 0x092BE030 2 0>,
    			 <DCC_READ 0x092C1000 1 0>,
    			 <DCC_READ 0x092C2028 1 0>,
    			 <DCC_READ 0x092C8058 4 0>,
    			 <DCC_READ 0x092E0410 3 0>,
    			 <DCC_READ 0x092E0420 2 0>,
    			 <DCC_READ 0x092E0430 1 0>,
    			 <DCC_READ 0x092E0440 1 0>,
    			 <DCC_READ 0x092E0448 1 0>,
    			 <DCC_READ 0x092E04A0 1 0>,
    			 <DCC_READ 0x09332100 1 0>,
    			 <DCC_READ 0x093360B0 1 0>,
    			 <DCC_READ 0x09336044 4 0>,
    			 <DCC_READ 0x0933E030 2 0>,
    			 <DCC_READ 0x09341000 1 0>,
    			 <DCC_READ 0x09342028 1 0>,
    			 <DCC_READ 0x09348058 4 0>,
    			 <DCC_READ 0x09360410 3 0>,
    			 <DCC_READ 0x09360420 2 0>,
    			 <DCC_READ 0x09360430 1 0>,
    			 <DCC_READ 0x09360440 2 0>,
    			 <DCC_READ 0x09360448 1 0>,
    			 <DCC_READ 0x093604A0 1 0>,
    			 <DCC_READ 0x093B2100 1 0>,
    			 <DCC_READ 0x093B60B0 1 0>,
    			 <DCC_READ 0x093B6044 4 0>,
    			 <DCC_READ 0x093BE030 2 0>,
    			 <DCC_READ 0x093C1000 1 0>,
    			 <DCC_READ 0x093C2028 1 0>,
    			 <DCC_READ 0x093C8058 4 0>,
    			 <DCC_READ 0x093E0410 3 0>,
    			 <DCC_READ 0x093E0420 2 0>,
    			 <DCC_READ 0x093E0430 1 0>,
    			 <DCC_READ 0x093E0440 1 0>,
    			 <DCC_READ 0x093E0448 1 0>,
    			 <DCC_READ 0x093E04A0 1 0>,
    			 <DCC_READ 0x09601000 1 0>,
    			 <DCC_READ 0x09601004 1 0>,
    			 <DCC_READ 0x09602000 1 0>,
    			 <DCC_READ 0x09602004 1 0>,
    			 <DCC_READ 0x09603000 1 0>,
    			 <DCC_READ 0x09603004 1 0>,
    			 <DCC_READ 0x09604000 1 0>,
    			 <DCC_READ 0x09604004 1 0>,
    			 <DCC_READ 0x09605000 1 0>,
    			 <DCC_READ 0x09605004 1 0>,
    			 <DCC_READ 0x09606000 1 0>,
    			 <DCC_READ 0x09606004 1 0>,
    			 <DCC_READ 0x09607000 1 0>,
    			 <DCC_READ 0x09607004 1 0>,
    			 <DCC_READ 0x09608000 1 0>,
    			 <DCC_READ 0x09608004 1 0>,
    			 <DCC_READ 0x09609000 1 0>,
    			 <DCC_READ 0x09609004 1 0>,
    			 <DCC_READ 0x0960a000 1 0>,
    			 <DCC_READ 0x0960a004 1 0>,
    			 <DCC_READ 0x0960b000 1 0>,
    			 <DCC_READ 0x0960b004 1 0>,
    			 <DCC_READ 0x0960c000 1 0>,
    			 <DCC_READ 0x0960c004 1 0>,
    			 <DCC_READ 0x0960d000 1 0>,
    			 <DCC_READ 0x0960d004 1 0>,
    			 <DCC_READ 0x0960e000 1 0>,
    			 <DCC_READ 0x0960e004 1 0>,
     			 <DCC_READ 0x0960f000 1 0>,
    			 <DCC_READ 0x0960f004 1 0>,
    			 <DCC_READ 0x09610000 1 0>,
    			 <DCC_READ 0x09610004 1 0>,
    			 <DCC_READ 0x09611000 1 0>,
    			 <DCC_READ 0x09611004 1 0>,
    			 <DCC_READ 0x09612000 1 0>,
    			 <DCC_READ 0x09612004 1 0>,
    			 <DCC_READ 0x09613000 1 0>,
    			 <DCC_READ 0x09613004 1 0>,
    			 <DCC_READ 0x09614000 1 0>,
    			 <DCC_READ 0x09614004 1 0>,
    			 <DCC_READ 0x09615000 1 0>,
    			 <DCC_READ 0x09615004 1 0>,
    			 <DCC_READ 0x09616000 1 0>,
    			 <DCC_READ 0x09616004 1 0>,
    			 <DCC_READ 0x09617000 1 0>,
    			 <DCC_READ 0x09617004 1 0>,
    			 <DCC_READ 0x09618000 1 0>,
    			 <DCC_READ 0x09618004 1 0>,
    			 <DCC_READ 0x09619000 1 0>,
    			 <DCC_READ 0x09619004 1 0>,
    			 <DCC_READ 0x0961a000 1 0>,
    			 <DCC_READ 0x0961a004 1 0>,
    			 <DCC_READ 0x0961b000 1 0>,
    			 <DCC_READ 0x0961b004 1 0>,
    			 <DCC_READ 0x0961c000 1 0>,
    			 <DCC_READ 0x0961c004 1 0>,
    			 <DCC_READ 0x0961d000 1 0>,
    			 <DCC_READ 0x0961d004 1 0>,
    			 <DCC_READ 0x0961e000 1 0>,
    			 <DCC_READ 0x0961e004 1 0>,
    			 <DCC_READ 0x0961f000 1 0>,
    			 <DCC_READ 0x0961f004 1 0>,
    			 <DCC_READ 0x09266418 1 0>,
    			 <DCC_READ 0x092e6418 1 0>,
    			 <DCC_READ 0x09366418 1 0>,
    			 <DCC_READ 0x093e6418 1 0>,
    			 <DCC_READ 0x09265804 1 0>,
    			 <DCC_READ 0x092e5804 1 0>,
    			 <DCC_READ 0x09365804 1 0>,
    			 <DCC_READ 0x093e5804 1 0>,
    			 <DCC_READ 0x092604b8 1 0>,
    			 <DCC_READ 0x092e04b8 1 0>,
    			 <DCC_READ 0x093604b8 1 0>,
    			 <DCC_READ 0x093e04b8 1 0>,
    			/*SHRM*/
    			 <DCC_WRITE 0x06A0E00C 0x00600007 1>,
    			 <DCC_WRITE 0x06A0E01C 0x00136800 1>,
    			 <DCC_READ 0x06A0E014 1 1>,
    			 <DCC_WRITE 0x06A0E01C 0x00136810 1>,
    			 <DCC_READ 0x06A0E014 1 1>,
    			 <DCC_WRITE 0x06A0E01C 0x00136820 1>,
    			 <DCC_READ 0x06A0E014 1 1>,
    			 <DCC_WRITE 0x06A0E01C 0x00136830 1>,
    			 <DCC_READ 0x06A0E014 1 1>,
    			 <DCC_WRITE 0x06A0E01C 0x00136840 1>,
    			 <DCC_READ 0x06A0E014 1 1>,
    			 <DCC_WRITE 0x06A0E01C 0x00136850 1>,
    			 <DCC_READ 0x06A0E014 1 1>,
    			 <DCC_WRITE 0x06A0E01C 0x00136860 1>,
    			 <DCC_READ 0x06A0E014 1 1>,
    			 <DCC_WRITE 0x06A0E01C 0x00136870 1>,
    			 <DCC_READ 0x06A0E014 1 1>,
    			 <DCC_WRITE 0x06A0E01C 0x0003e9a0 1>,
    			 <DCC_WRITE 0x06A0E01C 0x001368a0 1>,
    			 <DCC_READ 0x06A0E014 1 1>,
    			 <DCC_WRITE 0x06A0E01C 0x0003c0a0 1>,
    			 <DCC_WRITE 0x06A0E01C 0x001368a0 1>,
    			 <DCC_READ 0x06A0E014 1 1>,
    			 <DCC_WRITE 0x06A0E01C 0x0003d1a0 1>,
    			 <DCC_WRITE 0x06A0E01C 0x001368a0 1>,
    			 <DCC_READ 0x06A0E014 1 1>,
    			 <DCC_WRITE 0x06A0E01C 0x0003d2a0 1>,
    			 <DCC_WRITE 0x06A0E01C 0x001368a0 1>,
    			 <DCC_READ 0x06A0E014 1 1>,
    			 <DCC_WRITE 0x06A0E01C 0x0003d5a0 1>,
    			 <DCC_WRITE 0x06A0E01C 0x001368a0 1>,
    			 <DCC_READ 0x06A0E014 1 1>,
    			 <DCC_WRITE 0x06A0E01C 0x0003d6a0 1>,
    			 <DCC_WRITE 0x06A0E01C 0x001368a0 1>,
    			 <DCC_READ 0x06A0E014 1 1>,
    			 <DCC_WRITE 0x06A0E01C 0x0003e8a0 1>,
    			 <DCC_WRITE 0x06A0E01C 0x001368a0 1>,
    			 <DCC_READ 0x06A0E014 1 1>,
    			 <DCC_WRITE 0x06A0E01C 0x0003eea0 1>,
    			 <DCC_WRITE 0x06A0E01C 0x001368a0 1>,
    			 <DCC_READ 0x06A0E014 1 1>,
    			 <DCC_WRITE 0x06A0E01C 0x0003b1a0 1>,
    			 <DCC_WRITE 0x06A0E01C 0x001368a0 1>,
    			 <DCC_READ 0x06A0E014 1 1>,
    			 <DCC_WRITE 0x06A0E01C 0x0003b2a0 1>,
    			 <DCC_WRITE 0x06A0E01C 0x001368a0 1>,
    			 <DCC_READ 0x06A0E014 1 1>,
    			 <DCC_WRITE 0x06A0E01C 0x0003b5a0 1>,
    			 <DCC_WRITE 0x06A0E01C 0x001368a0 1>,
    			 <DCC_READ 0x06A0E014 1 1>,
    			 <DCC_WRITE 0x06A0E01C 0x0003b6a0 1>,
    			 <DCC_WRITE 0x06A0E01C 0x001368a0 1>,
    			 <DCC_READ 0x06A0E014 1 1>,
    			 <DCC_WRITE 0x06A0E01C 0x0003c2a0 1>,
    			 <DCC_WRITE 0x06A0E01C 0x001368a0 1>,
    			 <DCC_READ 0x06A0E014 1 1>,
    			 <DCC_WRITE 0x06A0E01C 0x0003c5a0 1>,
    			 <DCC_WRITE 0x06A0E01C 0x001368a0 1>,
    			 <DCC_READ 0x06A0E014 1 1>,
    			 <DCC_WRITE 0x06A0E01C 0x0003c6a0 1>,
    			 <DCC_WRITE 0x06A0E01C 0x001368a0 1>,
    			 <DCC_READ 0x06A0E014 1 1>,
    			 <DCC_WRITE 0x06A0E014 0x00020B38 1>,
    			 <DCC_WRITE 0x06A0E01C 0x000368B0 1>,
    			 <DCC_WRITE 0x06A0E01C 0x00000BA8 1>,
    			 <DCC_WRITE 0x06A0E01C 0x0013B6A0 1>,
    			 <DCC_WRITE 0x06A0E01C 0x00F1E000 1>,
    			 <DCC_WRITE 0x06A0E008 0x00000007 1>,
    			 <DCC_READ 0x09067E00 124 0>, 
    			/*PHY*/
    			 <DCC_WRITE 0x090C80F8 0x00000001 1>,
    			 <DCC_READ 0x091800C8 1 0>,
    			 <DCC_READ 0x09180740 1 0>,
    			 <DCC_READ 0x09183740 1 0>,
    			 <DCC_READ 0x091900C8 1 0>,
    			 <DCC_READ 0x09190740 1 0>,
    			 <DCC_READ 0x09193740 1 0>,
    			 <DCC_READ 0x09181254 2 0>,
    			 <DCC_READ 0x09181624 1 0>,
    			 <DCC_READ 0x09181740 1 0>,
    			 <DCC_READ 0x09181768 1 0>,
    			 <DCC_READ 0x0918182C 1 0>,
    			 <DCC_READ 0x09182254 2 0>,
    			 <DCC_READ 0x09182624 1 0>,
    			 <DCC_READ 0x09182740 1 0>,
    			 <DCC_READ 0x09182768 1 0>,
    			 <DCC_READ 0x0918282C 1 0>,
    			 <DCC_READ 0x09184254 2 0>,
    			 <DCC_READ 0x09184624 1 0>,
    			 <DCC_READ 0x09184740 1 0>,
    			 <DCC_READ 0x09184768 1 0>,
    			 <DCC_READ 0x0918482C 1 0>,
    			 <DCC_READ 0x09185254 2 0>,
    			 <DCC_READ 0x09185624 1 0>,
    			 <DCC_READ 0x09185740 1 0>,
    			 <DCC_READ 0x09185768 1 0>,
    			 <DCC_READ 0x0918582C 1 0>,
    			 <DCC_READ 0x09191254 2 0>,
    			 <DCC_READ 0x09191624 1 0>,
    			 <DCC_READ 0x09191740 1 0>,
    			 <DCC_READ 0x09191768 1 0>,
    			 <DCC_READ 0x0919182C 1 0>,
    			 <DCC_READ 0x09192254 2 0>,
    			 <DCC_READ 0x09192624 1 0>,
    			 <DCC_READ 0x09192740 1 0>,
    			 <DCC_READ 0x09192768 1 0>,
    			 <DCC_READ 0x0919282C 1 0>,
    			 <DCC_READ 0x09194254 2 0>,
    			 <DCC_READ 0x09194624 1 0>,
    			 <DCC_READ 0x09194740 1 0>,
    			 <DCC_READ 0x09194768 1 0>,
    			 <DCC_READ 0x0919482C 1 0>,
    			 <DCC_READ 0x09195254 2 0>,
    			 <DCC_READ 0x09195624 1 0>,
    			 <DCC_READ 0x09195740 1 0>,
    			 <DCC_READ 0x09195768 1 0>,
    			 <DCC_READ 0x0919582C 1 0>,
    			 <DCC_READ 0x09186048 1 0>,
    			 <DCC_READ 0x09186054 1 0>,
    			 <DCC_READ 0x09186164 1 0>,
    			 <DCC_READ 0x09186170 1 0>,
    			 <DCC_READ 0x09186410 1 0>,
    			 <DCC_READ 0x09186618 4 0>,
    			 <DCC_READ 0x091866E0 1 0>,
    			 <DCC_READ 0x09186700 2 0>,
    			 <DCC_READ 0x09196048 1 0>,
    			 <DCC_READ 0x09196054 1 0>,
    			 <DCC_READ 0x09196164 1 0>,
    			 <DCC_READ 0x09196170 1 0>,
    			 <DCC_READ 0x09196410 1 0>,
    			 <DCC_READ 0x09196618 4 0>,
    			 <DCC_READ 0x091966E0 1 0>,
    			 <DCC_READ 0x09196700 2 0>,
				/*AGG_NOC*/
    			 <DCC_READ 0x016e0300 3 0>,
    			 <DCC_READ 0x01700300 2 0>,
    			 <DCC_READ 0x01700500 3 0>,
    			 <DCC_READ 0x01700700 1 0>,
    			 <DCC_READ 0x01700900 5 0>,
    			 <DCC_READ 0x01700b00 2 0>,
    			 <DCC_READ 0x01700d00 1 0>,
    			 /*APM STUCK*/
    			 <DCC_READ 0x18080054 1 0>,
    			 <DCC_READ 0x17C00044 1 0>,
    			 <DCC_READ 0x182A0074 1 0>,
    			 <DCC_READ 0x17A0E104 29 0>,
    		/* GIC */
    			 <DCC_READ 0x180801F0 1 0>,
    			 <DCC_READ 0x18080070 1 0>,
    			 <DCC_READ 0x17A2E000 1 0>,  
    			 <DCC_READ 0x17A2FFC8 1 0>,  
    			 <DCC_READ 0x17A20008 1 0>,  
    			 <DCC_READ 0x17A20048 1 0>,  
    			 <DCC_READ 0x17A20088 1 0>,  
    			 <DCC_READ 0x17A200C8 1 0>,  
    			 <DCC_READ 0x17A20108 1 0>,  
    			 <DCC_READ 0x17A20148 1 0>,  
    			 <DCC_READ 0x17A20188 1 0>,  
    			 <DCC_READ 0x17A201C8 1 0>,  
    			 <DCC_READ 0x17A20208 1 0>,  
    			 <DCC_READ 0x17A20248 1 0>,  
    			 <DCC_READ 0x17A20288 1 0>,  
    			 <DCC_READ 0x17A202C8 1 0>,  
    			 <DCC_READ 0x17A20308 1 0>,  
    			 <DCC_READ 0x17A20348 1 0>,  
    			 <DCC_READ 0x17A20020 1 0>,  
    			 <DCC_READ 0x17A20060 1 0>,  
    			 <DCC_READ 0x17A200A0 1 0>,  
    			 <DCC_READ 0x17A200E0 1 0>,  
    			 <DCC_READ 0x17A20120 1 0>,  
    			 <DCC_READ 0x17A20160 1 0>,  
    			 <DCC_READ 0x17A201A0 1 0>,  
    			 <DCC_READ 0x17A201E0 1 0>,  
    			 <DCC_READ 0x17A20220 1 0>,  
    			 <DCC_READ 0x17A20260 1 0>,  
    			 <DCC_READ 0x17A202A0 1 0>,  
    			 <DCC_READ 0x17A202E0 1 0>,  
    			 <DCC_READ 0x17A20320 1 0>,  
    			 <DCC_READ 0x17A20360 1 0>,  
    			 <DCC_READ 0x17A20010 1 0>,
    			 <DCC_READ 0x17A20050 1 0>,
    			 <DCC_READ 0x17A20090 1 0>,
    			 <DCC_READ 0x17A200D0 1 0>,
    			 <DCC_READ 0x17A20110 1 0>,
    			 <DCC_READ 0x17A20150 1 0>,
    			 <DCC_READ 0x17A20190 1 0>,
    			 <DCC_READ 0x17A201D0 1 0>,
    			 <DCC_READ 0x17A20210 1 0>,
    			 <DCC_READ 0x17A20250 1 0>,
    			 <DCC_READ 0x17A20290 1 0>,
    			 <DCC_READ 0x17A202D0 1 0>,
    			 <DCC_READ 0x17A20310 1 0>,
    			 <DCC_READ 0x17A20350 1 0>,
    			 <DCC_READ 0x17A00204 29 0>,
    			 <DCC_READ 0x17A00104 29 0>,
    			/* APSS GEMNOC handshake */
    			 <DCC_READ 0x17E00044 1 0>,
    			/* SLPI */
    			 <DCC_READ 0x24B0000 7 0>,
    			 <DCC_READ 0x24B004C 2 0>,
    			 <DCC_READ 0x24B00D0 3 0>,
    			 <DCC_READ 0x24B0100 1 0>,
    			 <DCC_READ 0x24B0200 5 0>,
    			 <DCC_READ 0x24B0400 4 0>,
    			 <DCC_READ 0x24B0450 1 0>,
    			 <DCC_READ 0x24B0460 2 0>,
    			 <DCC_READ 0x24B0490 8 0>,
    			 <DCC_READ 0x24B0600 1 0>;
};
