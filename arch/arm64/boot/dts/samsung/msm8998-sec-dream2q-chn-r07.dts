/* Copyright (c) 2016, The Linux Foundation. All rights reserved.
 *
 * This program is free software; you can redistribute it and/or modify
 * it under the terms of the GNU General Public License version 2 and
 * only version 2 as published by the Free Software Foundation.
 *
 * This program is distributed in the hope that it will be useful,
 * but WITHOUT ANY WARRANTY; without even the implied warranty of
 * MERCHANTABILITY or FITNESS FOR A PARTICULAR PURPOSE.  See the
 * GNU General Public License for more details.
 */


/dts-v1/;

#include "../qcom/msm8998-v2.1.dtsi"
#include "../qcom/msm8998-mtp.dtsi"
#include "msm8998-sec-common.dtsi"
#include "msm8998-sec-dream2q-common.dtsi"
#include "msm8998-sec-dreamq-common-pm.dtsi"
#include "battery-data-dream2q-r07.dtsi"
#include "msm8998-sec-dream2q-r07.dtsi"
#include "msm8998-sec-dreamq-pm-r02.dtsi"
/ {
	model = "Samsung DREAM2Q CHN PROJECT Rev07";
	compatible = "qcom,msm8998-mtp", "qcom,msm8998", "qcom,mtp";
	qcom,board-id = <8 7>;

};
