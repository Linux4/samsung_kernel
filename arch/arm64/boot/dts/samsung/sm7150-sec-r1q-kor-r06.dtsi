/* Copyright (c) 2018, The Linux Foundation. All rights reserved.
 *
 * This program is free software; you can redistribute it and/or modify
 * it under the terms of the GNU General Public License version 2 and
 * only version 2 as published by the Free Software Foundation.
 *
 * This program is distributed in the hope that it will be useful,
 * but WITHOUT ANY WARRANTY; without even the implied warranty of
 * MERCHANTABILITY or FITNESS FOR A PARTICULAR PURPOSE.  See the
 * GNU General Public License for more details.
 */

#include "sm7150-sec-r1q-kor-r05.dtsi"

&pm6150_charger {

	/* Adding for SBUx short & water detection */
	pinctrl-names = "default";
    pinctrl-0 = <&hiccup_default>;
	hiccup-gpio = <&pm6150_gpios 4 GPIO_ACTIVE_LOW>;
	
	water-det-enable;
	#sub-short-detect-enable;
};
