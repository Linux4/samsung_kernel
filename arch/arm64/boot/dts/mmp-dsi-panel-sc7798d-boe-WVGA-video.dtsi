&gen_panel {
	dsi_sc7798d_boe_WVGA: gen-panel-sc7798d-boe-WVGA-video {
		gen-panel-manu = "BOE";		/* condensed manufacturer name */
		gen-panel-name = "sc7798d-boe";
		gen-panel-id = <0x55b8f0>;
		gen-panel-type = "video_mode";
		gen-panel-refresh = <60>;
		gen-panel-xres = <480>;
		gen-panel-yres = <800>;
		gen-panel-width= <60>;			/* screen width in mm */
		gen-panel-height = <100>;		/* screen height in mm */
		gen-panel-h-front-porch = <140>;	/* right margin */
		gen-panel-h-back-porch = <132>;		/* left margin */
		gen-panel-h-sync-width = <4>;		/* hsync len */
		gen-panel-v-front-porch = <10>;		/* lower margin */
		gen-panel-v-back-porch = <12>;		/* upper margin */
		gen-panel-v-sync-width = <4>;		/* vsync len */
		gen-panel-hsync-invert = <0>;		/* hsync invert */
		gen-panel-vsync-invert = <0>;		/* vsync invert */
		gen-panel-lanes = <2>;
		gen-panel-burst-mode = <2>;
		gen-panel-master-mode;
		/* gen-panel-hfp-en; */
		gen-panel-hbp-en;
		/* gen-panel-adaptive-fps-en; */
		gen-panel-adaptive-fps-en;
		gen-panel-switch-fps = <50>;		/* switching fps */
		gen-panel-default-fps = <60>;		/* default fps */
		gen-panel-flipcnt-wait = <1000>;	/* fps checking time */

		/*
		 * DSI PACKET HEADER INFO
		 * @ data type : 1byte
		 * @ tx mode : 1byte
		 * @ delay(msec) : 2byte
		 * @ size of data : 2byte
		 */
		gen-panel-pkt-dinfo-addr-offset = <0>;
		gen-panel-pkt-dinfo-addr-length = <1>;
		gen-panel-pkt-dinfo-data-offset = <1>;
		gen-panel-pkt-dinfo-data-length = <1>;
		gen-panel-init-cmds = [
			39 00 00 00 00 04	B9 F1 08 00
			39 00 00 00 00 08	B1 31 0C 0C A7 33 01 B7
			39 00 00 00 00 04	C6 00 00 FD
			39 00 00 00 00 05	E3 03 03 03 03
			39 00 00 0A 00 03	B8 06 22
			39 00 00 00 00 13	BA 31 00 44 25 91 0A 00 00 C2 34 00 00 04 02 1D
								B9 EE 40
			39 00 00 00 00 09	B3 00 00 00 00 0C 0A 25 20
			15 00 00 00 00 02	B4 00
			15 00 00 00 00 02	CC 0E
			15 00 00 00 00 02	BC 67
			15 00 00 00 00 02	B2 03
			39 00 00 00 00 06	C0 73 50 00 08 70
			39 00 00 00 00 34	E9 00 00 06 00 00 6E 29 12 30 00 48 08 6E 29 47
								03 00 00 00 00 00 18 00 00 89 98 33 11 77 55 13
								00 00 89 98 22 00 66 44 02 00 00 00 00 00 00 00
								00 00 00 00
			39 00 00 00 00 25	EA 00 00 98 98 44 66 00 22 20 00 00 98 98 55 77
								11 33 31 30 00 00 FF 01 00 00 00 00 00 00 00 00
								00 00 00 00 00
			39 00 00 00 00 23	E0 01 09 0D 2E 36 3F 10 31 07 0D 11 15 13 16 15
								32 38 01 05 05 30 35 3F 0E 30 04 09 0A 0D 12 0D
								0F 2C 35
		];
		gen-panel-enable-cmds = [
			05 00 00 79 00 01	11
			05 00 00 0A 00 01	29
		];
		gen-panel-disable-cmds = [
			05 00 00 0A 00 01	28
			05 00 00 79 00 01	10
		];
		/*
		 * mDNIe
		 */
		gen-panel-mdnie-ui-mode-cmds = [
			39 00 00 00 00 71	E6 5A 00 00 23 00 00 00 00 00 00 00 00 00 00 00
								00 00 00 00 00 00 00 FF 00 FF 00 FF FF 00 00 FF
								00 FF 00 FF FF 00 00 FF 00 FF 00 FF FF 00 02 ff
								00 20 00 20 00 20 00 20 00 20 00 20 00 20 00 20
								00 20 00 20 00 20 00 20 00 20 00 20 00 20 00 20
								00 20 00 20 00 20 00 20 00 20 00 20 00 20 00 04
								b5 1f 88 1f c3 1f e9 04 54 1f c3 1f e9 1f 88 04
								8f
		];
		gen-panel-mdnie-video-mode-cmds = [
			39 00 00 00 00 71	E6 5A 00 00 23 00 00 00 00 00 00 00 00 00 00 00
								00 00 00 00 00 00 00 FF 00 FF 00 FF FF 00 00 FF
								00 FF 00 FF FF 00 00 FF 00 FF 00 FF FF 00 03 ff
								00 08 bf 20 0f a6 16 a6 16 a6 16 a6 16 a6 16 a0
								0a a0 0a a0 0a a0 0a 9e 07 9e 07 9e 07 9e 07 9a
								03 9a 03 9a 03 9a 03 14 00 14 00 14 00 14 00 04
								b5 1f 88 1f c3 1f e9 04 54 1f c3 1f e9 1f 88 04
								8f
		];
		gen-panel-mdnie-camera-mode-cmds = [
			39 00 00 00 00 71	E6 5A 00 00 23 00 00 00 00 00 00 00 00 00 00 00
								00 00 00 00 00 00 00 FF 00 FF 00 FF FF 00 00 FF
								00 FF 00 FF FF 00 00 FF 00 FF 00 FF FF 00 02 ff
								00 20 00 20 00 20 00 20 00 20 00 20 00 20 00 20
								00 20 00 20 00 20 00 20 00 20 00 20 00 20 00 20
								00 20 00 20 00 20 00 20 00 20 00 20 00 20 00 04
								b5 1f 88 1f c3 1f e9 04 54 1f c3 1f e9 1f 88 04
								8f
		];
		gen-panel-mdnie-gallery-mode-cmds = [
			39 00 00 00 00 71	E6 5A 00 00 23 00 00 00 00 00 00 00 00 00 00 00
								00 00 00 00 00 00 00 FF 00 FF 00 FF FF 00 00 FF
								00 FF 00 FF FF 00 00 FF 00 FF 00 FF FF 00 02 ff
								00 20 00 20 00 20 00 20 00 20 00 20 00 20 00 20
								00 20 00 20 00 20 00 20 00 20 00 20 00 20 00 20
								00 20 00 20 00 20 00 20 00 20 00 20 00 20 00 04
								b5 1f 88 1f c3 1f e9 04 54 1f c3 1f e9 1f 88 04
								8f
		];
		gen-panel-mdnie-negative-mode-cmds = [
			39 00 00 00 00 71	E6 5A 00 00 32 00 00 00 00 00 00 00 00 00 00 00
								00 00 00 00 00 00 ff 00 ff 00 ff 00 00 ff ff 00
								ff 00 ff 00 00 ff ff 00 ff 00 ff 00 00 ff 00 ff
								00 20 00 20 00 20 00 20 00 20 00 20 00 20 00 20
								00 20 00 20 00 20 00 20 00 20 00 20 00 20 00 20
								00 20 00 20 00 20 00 20 00 20 00 20 00 20 00 04
								00 00 00 00 00 00 00 04 00 00 00 00 00 00 00 04
								00
		];
		gen-panel-mdnie-vt-mode-cmds = [
			39 00 00 00 00 71	E6 5A 00 00 23 00 00 00 00 00 00 00 00 00 00 00
								00 00 00 00 00 00 00 FF 00 FF 00 FF FF 00 00 FF
								00 FF 00 FF FF 00 00 FF 00 FF 00 FF FF 00 02 ff
								00 20 00 20 00 20 00 20 00 20 00 20 00 20 00 20
								00 20 00 20 00 20 00 20 00 20 00 20 00 20 00 20
								00 20 00 20 00 20 00 20 00 20 00 20 00 20 00 04
								b5 1f 88 1f c3 1f e9 04 54 1f c3 1f e9 1f 88 04
								8f
		];
		gen-panel-mdnie-browser-mode-cmds = [
			39 00 00 00 00 71	E6 5A 00 00 23 00 00 00 00 00 00 00 00 00 00 00
								00 00 00 00 00 00 00 FF 00 FF 00 FF FF 00 00 FF
								00 FF 00 FF FF 00 00 FF 00 FF 00 FF FF 00 02 ff
								00 20 00 20 00 20 00 20 00 20 00 20 00 20 00 20
								00 20 00 20 00 20 00 20 00 20 00 20 00 20 00 20
								00 20 00 20 00 20 00 20 00 20 00 20 00 20 00 04
								b5 1f 88 1f c3 1f e9 04 54 1f c3 1f e9 1f 88 04
								8f
		];
		gen-panel-mdnie-ebook-mode-cmds = [
			39 00 00 00 00 71	E6 5A 00 00 33 00 00 00 00 00 00 00 00 00 00 00
								00 00 00 00 00 00 00 d6 00 f5 00 ff FF 00 00 FF
								00 FF 00 FF FF 00 00 FF 00 FF 00 FF FF 00 02 ff
								00 20 00 20 00 20 00 20 00 20 00 20 00 20 00 20
								00 20 00 20 00 20 00 20 00 20 00 20 00 20 00 20
								00 20 00 20 00 20 00 20 00 20 00 20 00 20 00 04
								b5 1f 88 1f c3 1f e9 04 54 1f c3 1f e9 1f 88 04
								8f
		];
		gen-panel-mdnie-email-mode-cmds = [
			39 00 00 00 00 71	E6 5A 00 00 33 00 00 00 00 00 00 00 00 00 00 00
								00 00 00 00 00 00 00 de 00 f1 00 ff FF 00 00 FF
								00 FF 00 FF FF 00 00 FF 00 FF 00 FF FF 00 02 ff
								00 20 00 20 00 20 00 20 00 20 00 20 00 20 00 20
								00 20 00 20 00 20 00 20 00 20 00 20 00 20 00 20
								00 20 00 20 00 20 00 20 00 20 00 20 00 20 00 04
								b5 1f 88 1f c3 1f e9 04 54 1f c3 1f e9 1f 88 04
								8f
		];
		gen-panel-mdnie-outdoor-mode-cmds = [
			39 00 00 00 00 71	E6 5A 00 00 33 00 00 00 00 00 00 00 00 00 00 00
								00 00 00 00 00 00 00 FF 00 FF 00 FF FF 00 00 FF
								00 FF 00 FF FF 00 00 FF 00 FF 00 FF FF 00 03 ff
								00 17 48 18 40 1a 33 1b 2e 1e 23 22 19 22 19 22
								19 22 19 22 19 22 19 28 10 28 10 28 10 28 10 28
								10 32 08 32 08 32 08 32 08 32 08 48 03 7b 00 04
								b5 1f 88 1f c3 1f e9 04 54 1f c3 1f e9 1f 88 04
								8f
		];
		gen-panel-read-id = [
			DA 00 01
			DB 00 01
			DC 00 01
		];
		gen-panel-read-status-reg = [0A];
		gen-panel-read-status-ok = [9A];
		status = "okay";
	};
};
