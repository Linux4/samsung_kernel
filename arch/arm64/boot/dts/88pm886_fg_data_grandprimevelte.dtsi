/*
 * Copyright (C) 2014 Marvell
 * Yi Zhang <yizhang@marvell.com>
 */

/* ocv table is for RosaM battery */
/* ntc table is for NCP03XH223E05RL */

&pmic0 {
	charger {
		prechg-current = <450>;
		prechg-voltage = <3000>;
		status = "okay";
	};

	battery {
		sleep-period = <1000>;		/* second */
		low-threshold = <30>;		/* % */
		high-threshold = <50>;		/* % */
		alart-percent = <5>;		/* % */

		cc-fixup = <100>;

		power-off-th = <3350>;		/* mv */
		safe-power-off-th = <3000>;	/* mv */

		io-channels = <&gpadc 7>,  /* vbat */
			           <&gpadc 13>, /* vbat_slp */
				   <&gpadc 14>, /* gpadc0_res */
				   <&gpadc 15>, /* gpadc1_res */
				   <&gpadc 16>, /* gpadc2_res */
				   <&gpadc 17>; /* gpadc3_res */
		io-channel-names = "vbat",
				   "vbat_slp",
				   "gpadc0_res",
				   "gpadc1_res",
				   "gpadc2_res",
				   "gpadc3_res";

		bat-capacity = <2600>;	/* mAh */
		ocv-table = <
			3292
			3453
			3548
			3613
			3653
			3671
			3678
			3681
			3683
			3685
			3686
			3688
			3691
			3697
			3706
			3715
			3724
			3732
			3738
			3743
			3748
			3752
			3756
			3759
			3761
			3764
			3766
			3767
			3769
			3770
			3771
			3773
			3774
			3775
			3777
			3779
			3781
			3783
			3786
			3788
			3791
			3794
			3797
			3801
			3804
			3808
			3812
			3816
			3820
			3824
			3829
			3834
			3839
			3845
			3852
			3859
			3867
			3875
			3884
			3893
			3902
			3910
			3919
			3927
			3935
			3943
			3951
			3958
			3965
			3972
			3977
			3982
			3988
			3996
			4007
			4020
			4035
			4048
			4058
			4066
			4073
			4081
			4090
			4099
			4109
			4120
			4130
			4140
			4150
			4161
			4171
			4182
			4193
			4204
			4215
			4227
			4239
			4251
			4265
			4282
			4304
		>;

		abs-lowest-temp = <20>;
		t1-degree = <0>;	/* -20C */
		t2-degree = <20>;	/* 0C */
		t3-degree = <50>;	/* 30C */
		t4-degree = <65>;	/* 45C */

		times-in-minus-ten = <2>;
		offset-in-minus-ten = <100>;
		times-in-zero = <1>;
		offset-in-zero = <0>;

		soc-low-th-cycle = <15>;
		soc-high-th-cycle = <85>;

		default-temp-ohm = <22000>;

		zero-degree-ohm = <59881>;

		/* -25C, -24C, ..., 64C, 65C */
		ntc-table =
			<192629 25>,/* -25 ~ -21 */
			<183133 24>,
			<174166 23>,
			<165695 22>,
			<157689 21>,
			<150121 20>,/* -20 ~ -11 */
			<142980 19>,
			<136222 18>,
			<129825 17>,
			<123767 16>,
			<118029 15>,
			<112591 14>,
			<107437 13>,
			<102549 12>,
			<97913 11>,
			<93514 10>,/* -10 ~ -1 */
			<89319 9>,
			<85339 8>,
			<81560 7>,
			<77972 6>,
			<74563 5>,
			<71323 4>,
			<68244 3>,
			<65316 2>,
			<62531 1>,/* negative temperature */
			<59881 0>,/* 0 ~ 9 */
			<57367 1>,
			<54973 2>,
			<52692 3>,
			<50518 4>,
			<48446 5>,
			<46471 6>,
			<44586 7>,
			<42789 8>,
			<41074 9>,
			<39436 10>,/* 10 ~ 19 */
			<37871 11>,
			<36376 12>,
			<34948 13>,
			<33585 14>,
			<32282 15>,
			<31037 16>,
			<29846 17>,
			<28708 18>,
			<27619 19>,
			<26577 20>,/* 20 ~ 29 */
			<25582 21>,
			<24628 22>,
			<23715 23>,
			<22839 24>,
			<22000 25>,
			<21195 26>,
			<20424 27>,
			<19683 28>,
			<18973 29>,
			<18292 30>,/* 30 ~ 39 */
			<17640 31>,
			<17014 32>,
			<16414 33>,
			<15838 34>,
			<15285 35>,
			<14755 36>,
			<14245 37>,
			<13756 38>,
			<13286 39>,
			<12834 40>,/* 40 ~ 49 */
			<12400 41>,
			<11980 42>,
			<11577 43>,
			<11190 44>,
			<10817 45>,
			<10459 46>,
			<10114 47>,
			<9782 48>,
			<9462 49>,
			<9154 50>,/* 50 ~ 59 */
			<8858 51>,
			<8572 52>,
			<8297 53>,
			<8032 54>,
			<7777 55>,
			<7531 56>,
			<7294 57>,
			<7065 58>,
			<6844 59>,
			<6631 60>,/* 60 ~ 65 */
			<6429 61>,
			<6429 62>,
			<6046 63>,
			<5865 64>,
			<5690 65>;
		};
};
