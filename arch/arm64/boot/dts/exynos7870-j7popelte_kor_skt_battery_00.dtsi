/* * SAMSUNG UNIVERSAL5433 board device tree source * * Copyright (c) 2013 Samsung Electronics Co., Ltd. *		http://www.samsung.com * * This program is free software; you can redistribute it and/or modify * it under the terms of the GNU General Public License version 2 as * published by the Free Software Foundation.*/#include "exynos7870-j7popelte-common-battery.dtsi"/ {	battery_params {		battery,id = <0>;		battery0,battery_type = <4400>; /* 4200 4350 4400 */		battery0,battery_table0 = <0x1400 0x1BC3 0x1CA3 0x1D69 0x1D89 0x1DBE 0x1DF1 0x1E3A 0x1E94 0x1F00 0x1F74 0x200A 0x208A 0x20AF 0x21E5 0x2400>;		battery0,battery_table1 = <0x1400 0x1BC3 0x1CA3 0x1D69 0x1D89 0x1DBE 0x1DF1 0x1E3A 0x1E94 0x1F00 0x1F74 0x200A 0x208A 0x20AF 0x21E5 0x2400>;		battery0,battery_table2 = <0x0 0x36 0x9B 0x144 0x296 0x3E8 0x53A 0x7DE 0xBD3 0xE77 0xFC9 0x126D 0x13BF 0x1468 0x17F8 0x180B>;		battery0,temp_std = <25>;		battery0,temp_offset = <10>;		battery0,temp_offset_cal = <0x01>;		battery0,rce_value = <0x0749 0x0580 0x371>;		battery0,dtcd_value = <0x1>;		battery0,rs_value = <0x1ae 0x47a 0x3800 0x007a>; /*rs mix_factor max min*/		battery0,vit_period = <0x3506>;		battery0,mix_value = <0x0403 0x0004>; /*mix_rate init_blank*/		battery0,topoff_soc = <0x0 0x5>; /*enable soc*/		battery0,tem_poff = <3400 100 3320 100>;		battery0,charge_offset_cal = <0x03>;		battery0,volt_cal = <0x808A>;		battery0,curr_cal = <0x7785>;		battery0,ext_temp_cal = <0 10 1 1 1 7 1 1>;	};	battery {		battery,full_condition_soc = <89>;		battery,full_condition_vcell = <4250>;		battery,recharge_condition_vcell = <4240>;		battery,chg_float_voltage = <4310>;	};	charger {		battery,chg_float_voltage = <4310>;	};};