/*
 * SAMSUNG UNIVERSAL7580 board device tree source
 *
 * Copyright (c) 2014 Samsung Electronics Co., Ltd.
 *             http://www.samsung.com
 *
 * This program is free software; you can redistribute it and/or modify
 * it under the terms of the GNU General Public License version 2 as
 * published by the Free Software Foundation.
*/

#include "modem-carmen2-pdata.dtsi"
/ {
	/* over-riding shared memory reserved map */
	/* DRAM 3GB + CP reserved map 116+4MB */
	shmem: shmem@0xB0000000 {
		reg = <0x0 0xF0000000 0x0 0x7800000>;
		shmem,ipc_offset = <0x7400000>;
		shmem,ipc_size = <0x400000>;
	};
};
