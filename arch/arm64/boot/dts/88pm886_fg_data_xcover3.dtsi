/*
 * Copyright (C) 2014 Marvell
 * Yi Zhang <yizhang@marvell.com>
 */

/* ocv table is for RosaM battery */
/* ntc table is for NCP03XH223E05RL */

&pmic0 {
	charger {
		prechg-current = <450>;
		prechg-voltage = <3000>;
		status = "okay";
	};

	battery {
		sleep-period = <1000>;		/* second */
		low-threshold = <30>;		/* % */
		high-threshold = <50>;		/* % */
		alart-percent = <5>;		/* % */

		cc-fixup = <100>;

		power-off-th = <3350>;		/* mv */
		safe-power-off-th = <3000>;	/* mv */

		io-channels = <&gpadc 7>,  /* vbat */
			           <&gpadc 13>, /* vbat_slp */
				   <&gpadc 14>, /* gpadc0_res */
				   <&gpadc 15>, /* gpadc1_res */
				   <&gpadc 16>, /* gpadc2_res */
				   <&gpadc 17>; /* gpadc3_res */
		io-channel-names = "vbat",
				   "vbat_slp",
				   "gpadc0_res",
				   "gpadc1_res",
				   "gpadc2_res",
				   "gpadc3_res";

		bat-capacity = <2200>;	/* mAh */
		ocv-table = <
			3262 3402 3494 3562 3614 3650 3664 3670 3674 3677
			3679 3681 3683 3686 3692 3702 3711 3719 3727 3734
			3739 3743 3747 3751 3755 3759 3762 3766 3768 3771
			3774 3777 3779 3782 3785 3788 3791 3794 3798 3801
			3805 3809 3813 3817 3821 3825 3830 3835 3839 3845
			3850 3855 3861 3867 3874 3881 3889 3899 3909 3921
			3932 3943 3953 3963 3972 3981 3989 3998 4007 4016
			4025 4034 4044 4053 4063 4073 4083 4093 4103 4114
			4124 4135 4146 4157 4168 4179 4191 4202 4213 4225
			4237 4248 4260 4272 4284 4296 4308 4320 4333 4348 4364
		>;

		abs-lowest-temp = <20>;
		t1-degree = <0>;	/* -20C */
		t2-degree = <20>;	/* 0C */
		t3-degree = <50>;	/* 30C */
		t4-degree = <65>;	/* 45C */

		times-in-minus-ten = <2>;
		offset-in-minus-ten = <100>;
		times-in-zero = <1>;
		offset-in-zero = <0>;

		soc-low-th-cycle = <15>;
		soc-high-th-cycle = <85>;

		default-temp-ohm = <22000>;

		zero-degree-ohm = <59881>;

		ntc-table =
				/* -25 ~ -21 */
				<192629 25>,
					<183133 24>,
				<174166 23>,
				<165695 22>,
				<157689 21>,

				/* -20 ~ -11 */
				<150121 20>,
				<142980 19>,
				<136118 18>,
				<129748 17>,
				<123714 16>,
				<118029 15>,
				<112591 14>,
				<107437 13>,
				<102549 12>,
				<97913 11>,

				/* -10 ~ -1 */
				<93514 10>,
				<89319 9>,
				<85339 8>,
				<81560 7>,
				<77972 6>,
				<74563 5>,
				<71323 4>,
				<68244 3>,
				<65316 2>,
				<62531 1>, /* negative temperature */

				/* 0 ~ 9 */
				<59881 0>,

				<57367 1>,
				<54973 2>,
				<52692 3>,
				<50518 4>,
				<48446 5>,
				<46471 6>,
				<44586 7>,
				<42789 8>,
				<41074 9>,

				/* 10 ~ 19 */
				<39436 10>,
				<37871 11>,
				<36376 12>,
				<34948 13>,
				<33585 14>,
				<32282 15>,
				<31037 16>,
				<29846 17>,
				<28708 18>,
				<27619 19>,

				/* 20 ~ 29 */
				<26577 20>,
				<25582 21>,
				<24628 22>,
				<23715 23>,
				<22839 24>,
				<22000 25>,
				<21195 26>,
				<20424 27>,
				<19683 28>,
				<18973 29>,

				/* 30 ~ 39 */
				<18292 30>,
				<17640 31>,
				<17014 32>,
				<16414 33>,
				<15838 34>,
				<15285 35>,
				<14755 36>,
				<14245 37>,
				<13756 38>,
				<13286 39>,

				/* 40 ~ 49 */
				<12843 40>,
				<12400 41>,
				<11980 42>,
				<11577 43>,
				<11190 44>,
				<10817 45>,
				<10459 46>,
				<10114 47>,
				<9786 48>,
				<9784 49>,

				/* 50 ~ 59 */
				<9782 50>,
				<8858 51>,
				<8572 52>,
				<8297 53>,
				<8032 54>,
				<7777 55>,
				<7531 56>,
				<7294 57>,
				<7065 58>,
				<6844 59>,

				/* 60 ~ 65 */
				<6631 60>,
				<6429 61>,
				<6250 62>,
				<6046 63>,
				<5865 64>,
				<5690 65>,

				/* 66 ~ 90 */
				<5515 66>,
				<5340 67>,
				<5165 68>,
				<4990 69>,
				<4815 70>,
				<4640 71>,
				<4465 72>,
				<4290 73>,
				<4115 74>,
				<3940 75>,
				<3765 76>,
				<3590 77>,
				<3415 78>,
				<3240 79>,
				<3065 80>,
				<2890 81>,
				<2715 82>,
				<2540 83>,
				<2365 84>,
				<2190 85>,
				<2015 86>,
				<1840 87>,
				<1665 88>,
				<1490 89>,
				<1315 90>;
	};
};
