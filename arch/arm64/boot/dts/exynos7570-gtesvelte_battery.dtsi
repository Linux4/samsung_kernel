/*
 * SAMSUNG UNIVERSAL7570 board device tree source
 *
 * Copyright (c) 2013 Samsung Electronics Co., Ltd.
 *		http://www.samsung.com
 *
 * This program is free software; you can redistribute it and/or modify
 * it under the terms of the GNU General Public License version 2 as
 * published by the Free Software Foundation.
*/

/ {
	s2mpu06-fuelgauge {
		status = "disable";
		compatible = "samsung,s2mpu06-fuelgauge";
		fuelgauge,fuel_alert_soc = <1>;
		fuelgauge,capacity_max = <975>;
		fuelgauge,capacity_max_margin = <250>;
		fuelgauge,capacity_min = <0>;
		fuelgauge,capacity_calculation_type = <28>;
		fuelgauge,type_str = "SDI";
		fuelgauge,model_type = <1>;
	};

	battery {
		status = "okay";

		pinctrl-names = "default";

		compatible = "samsung,sec-battery";
		battery,vendor = "SDI SDI";
		battery,charger_name = "s2mpu06-charger";
		battery,fuelgauge_name = "s2mpu06-fuelgauge";
		battery,technology = <2>; /* POWER_SUPPLY_TECHNOLOGY_LION */

		battery,chip_vendor = "LSI";

		/* battery,battery_type = <&gpd1 5 0x1>; */

		battery,temp_adc_type = <1>; /* SEC_BATTERY_ADC_TYPE_AP */

		battery,polling_time = <10 30 30 30 3600>;

		battery,temp_table_adc = <308 360 456 471 486 501 516 531 548 565 583 600 617 637 656 676 695 715 734 754 773 793 812
			837 862 888 913 938 971 1004 1036 1069 1102 1134 1166 1198 1230 1262 1298 1333 1369 1404 1440
			1480 1520 1559 1599 1639 1680 1721 1763 1804 1845 1888 1931 1974 2017 2060 2103 2146 2188 2231 2274
			2318 2362 2406 2450 2494 2536 2578 2619 2661 2703 2742 2781 2819 2858 2897 2933 2968 3004 3039 3075
			3107 3139 3171 3203 3235 3263 3292 3320 3349 3377 3400 3423 3445 3468 3491 3510 3529 3549 3568 3587>;

		battery,temp_table_data = <900 850 800 790 780 770 760 750 740 730 720 710 700 690 680 670 660 650 640 630 620 610 600
			590 580 570 560 550 540 530 520 510 500 490 480 470 460 450 440 430 420 410 400
			390 380 370 360 350 340 330 320 310 300 290 280 270 260 250 240 230 220 210 200
			190 180 170 160 150 140 130 120 110 100 90 80 70 60 50 40 30 20 10 0
			(-10) (-20) (-30) (-40) (-50) (-60) (-70) (-80) (-90) (-100) (-110) (-120) (-130) (-140) (-150) (-160) (-170) (-180) (-190) (-200)>;

		battery,input_current_limit = <1750 460 460 1750 460 900 1000 460 1000 0 820 820 820 1000 1000 0 1750 400 700 1000 300 1000 1000 0 1667 1667 1000 1667 80 1750 1667 1400 1000 1000 820 820>;
		battery,fast_charging_current = <2000 0 0 2000 460 1200 1000 460 1200 0 1200 1200 1200 1200 1200 0 2000 400 700 1200 300 1000 1200 0 2000 2000 1000 2000 80 1800 1000 1400 0 1000 1200 1200>;
		battery,full_check_current_1st = <380 0 0 380 380 380 380 380 380 0 380 380 380 380 380 0 380 380 380 380 380 380 380 0 380 380 380 380 0 380 380 380 0 380 380 380>;
		battery,full_check_current_2nd = <270 0 0 270 270 270 270 270 270 0 270 270 270 270 270 0 270 270 270 270 270 270 270 0 270 270 270 270 0 270 270 270 0 270 270 270>;

		battery,wireless_cc_cv = <86>;

		battery,inbat_voltage = <1>;
		battery,inbat_voltage_table_adc = <2819 2809 2790 2764 2737 2708 2683 2656 2628 2608 2576 2547 2517 2492 2463 2435 2414 2386 2358 2328 2300 2274 2245 2219>;
		battery,inbat_voltage_table_data = <4400 4380 4350 4300 4250 4200 4150 4100 4050 4000 3950 3900 3850 3800 3750 3700 3650 3600 3550 3500 3450 3400 3350 3300>;
		battery,adc_check_count = <5>;

		battery,cable_check_type = <4>; /* SEC_BATTERY_CABLE_CHECK_PSY */
		battery,cable_source_type = <1>; /* SEC_BATTERY_CABLE_SOURCE_EXTERNAL */
		battery,polling_type = <1>; /* SEC_BATTERY_MONITOR_ALARM */
		battery,monitor_initial_count = <0>;

		battery,battery_check_type = <5>; /* SEC_BATTERY_CHECK_CHARGER */
		battery,check_count = <0>;

		battery,ovp_uvlo_check_type = <3>; /* SEC_BATTERY_OVP_UVLO_CHGPOLLING */

		battery,check_adc_max = <1440>;
		battery,check_adc_min = <0>;

		battery,thermal_source = <2>; /* SEC_BATTERY_THERMAL_SOURCE_ADC */

		battery,temp_check_type = <2>; /* SEC_BATTERY_TEMP_CHECK_TEMP */
		battery,temp_check_count = <1>;
		battery,temp_highlimit_threshold_normal = <800>;
		battery,temp_highlimit_recovery_normal = <750>;
		battery,temp_high_threshold_normal = <500>;
		battery,temp_high_recovery_normal = <450>;
		battery,temp_low_threshold_normal = <0>;
		battery,temp_low_recovery_normal = <50>;
		battery,temp_highlimit_threshold_lpm = <800>;
		battery,temp_highlimit_recovery_lpm = <750>;
		battery,temp_high_threshold_lpm = <510>;
		battery,temp_high_recovery_lpm = <450>;
		battery,temp_low_threshold_lpm = <0>;
		battery,temp_low_recovery_lpm = <50>;

		battery,full_check_type = <7>; /* SEC_BATTERY_FULLCHARGED_CHGPSY */
		battery,full_check_type_2nd = <7>; /* SEC_BATTERY_FULLCHARGED_CHGPSY */
		battery,full_check_count = <1>;
		battery,chg_gpio_full_check = <0>;
		battery,chg_polarity_full_check = <1>;

		battery,chg_high_temp_1st = <530>;
		battery,chg_high_temp_2nd = <530>;
		battery,chg_high_temp_recovery = <525>;
		battery,chg_charging_limit_current = <1300>;
		battery,chg_charging_limit_current_2nd = <1300>;
		battery,chg_skip_check_capacity = <10>;
		battery,chg_skip_check_time = <600>;

		battery,wpc_high_temp = <420>;
		battery,wpc_high_temp_recovery = <410>;
		battery,wpc_charging_limit_current = <450>;

		/* SEC_BATTERY_FULL_CONDITION_SOC |
		   SEC_BATTERY_FULL_CONDITION_NOTIMEFULL |
		   SEC_BATTERY_FULL_CONDITION_VCELL */
		battery,full_condition_type = <15>;
		battery,full_condition_soc = <93>;
		battery,full_condition_vcell = <4200>;
		/* battery,full_condition_vcell2 = <4280>; */

		battery,recharge_check_count = <2>;
		battery,recharge_condition_type = <4>; /* SEC_BATTERY_RECHARGE_CONDITION_VCELL */
		battery,recharge_condition_soc = <98>;
		battery,recharge_condition_vcell = <4230>;
		/* battery,recharge_condition_vcell2 = <4340>; */

		battery,charging_by_single;
		battery,standard_curr = <1900>;
		battery,recharging_expired_time = <5400>;
		battery,expired_time = <18000>; /*2nd EOC 150min */

		battery,chg_float_voltage = <4300>;
		/* battery,chg_float_voltage2 = <4380>; */

		battery,swelling_high_temp_block = <410>;
		battery,swelling_high_temp_recov = <390>;

		battery,swelling_low_temp_2step_mode = <1>;
		battery,swelling_low_temp_block_1st = <150>;
		battery,swelling_low_temp_recov_1st = <200>;
		battery,swelling_low_temp_block_2nd = <50>;
		battery,swelling_low_temp_recov_2nd = <100>;

		battery,swelling_high_temp_current = <1580>;
		battery,swelling_low_temp_current = <1060>;
		battery,swelling_low_temp_topoff = <270>;
		battery,swelling_high_temp_topoff = <270>;

		battery,swelling_drop_float_voltage = <4100>;
		battery,swelling_high_rechg_voltage = <3950>;
		battery,swelling_low_rechg_voltage = <3950>;
		battery,swelling_block_time = <600>;

		/* cycle, chg_float_voltage, recharge_condition_vcell, full_condition_vcell, full_condition_soc */
		battery,age_data = <0 4300 4230 4200 93
				200 4280 4210 4180 91
				250 4260 4190 4160 89
				300 4240 4170 4140 87
				1000 4190 4120 4090 81>;

		io-channels = <&exynos_adc 1>, <&exynos_adc 5>;
		io-channel-names = "adc-temp", "adc-in-bat";
		#io-channel-cells = <2>;
		io-channel-ranges;
	};

	s2mpu06-charger {
		status = "disable";
		compatible = "samsung,s2mpu06-charger";
		battery,is_1MHz_switching = <1>;
		battery,chg_gpio_en = <0>;
		battery,chg_polarity_en = <0>;
		battery,chg_gpio_status = <0>;
		battery,chg_polarity_status = <0>;
		charger,ivr_threshold = <0xA4>; /* IVR : 4.3V */
		charger,slow_charging_current = <1000>;
	};
};
