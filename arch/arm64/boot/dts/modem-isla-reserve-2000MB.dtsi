/*
 * SAMSUNG UNIVERSAL7580 board device tree source
 *
 * Copyright (c) 2014 Samsung Electronics Co., Ltd.
 *             http://www.samsung.com
 *
 * This program is free software; you can redistribute it and/or modify
 * it under the terms of the GNU General Public License version 2 as
 * published by the Free Software Foundation.
*/

#include "modem-carmen2-pdata.dtsi"
/ {
	/* over-riding shared memory reserved map */
	/* DRAM 1.5GB + CP reserved map 88+4MB */
	shmem: shmem@0xB0000000 {
		reg = <0x0 0xB0000000 0x0 0x5C00000>;
		shmem,ipc_offset = <0x5800000>;
		shmem,ipc_size = <0x400000>;
	};
};
