&gen_panel {
	dsi_s6d7aa0x62_boe_HD: gen-panel-s6d7aa0x62-boe-HD-video {
		gen-panel-manu = "BOE";		/* condensed manufacturer name */
		gen-panel-name = "s6d7aa0x62-boe";
		gen-panel-id = <0x59B810>;
		gen-panel-type = "video_mode";
		gen-panel-refresh = <60>;
		gen-panel-xres = <720>;
		gen-panel-yres = <1280>;
		gen-panel-width= <69>;		/* screen width in mm */
		gen-panel-height = <124>;	/* screen height in mm */
		gen-panel-h-back-porch = <97>;	/* left margin */
		gen-panel-h-front-porch = <50>;	/* right margin */
		gen-panel-h-sync-width = <14>;	/* hsync len */
		gen-panel-v-back-porch = <12>;	/* upper margin */
		gen-panel-v-front-porch = <16>;	/* lower margin */
		gen-panel-v-sync-width = <4>;	/* vsync len */
		gen-panel-hsync-invert = <0>;	/* hsync invert */
		gen-panel-vsync-invert = <0>;	/* vsync invert */
		gen-panel-lanes = <4>;
		gen-panel-burst-mode = <2>;
		gen-panel-master-mode;
		gen-panel-hfp-en;
		/* gen-panel-hbp-en; */
		gen-panel-rgb-order = <1>;	/* 0 - RGB, 1 - BGR */

		/*
		 * DSI PACKET HEADER INFO
		 * @ data type : 1byte
		 * @ tx mode : 1byte
		 * @ delay(msec) : 2byte
		 * @ size of data : 2byte
		 */
		gen-panel-pkt-dinfo-addr-offset = <0>;
		gen-panel-pkt-dinfo-addr-length = <1>;
		gen-panel-pkt-dinfo-data-offset = <1>;
		gen-panel-pkt-dinfo-data-length = <1>;
		gen-panel-init-cmds = [
			39 00 00 00 00 03	F0 5A 5A
			39 00 00 00 00 03	F1 5A 5A
			39 00 00 00 00 03	FC A5 A5
			39 00 00 00 00 03	D0 00 10
			39 00 00 00 00 02	B1 12
			39 00 00 00 00 05	B2 14 22 2F 18
			39 00 00 00 00 02	B3 11
			39 00 00 00 00 0A	BA 03 19 19 11 03 05 18 18 77
			39 00 00 00 00 04	BC 00 4E 0B
			39 00 00 00 00 04	C0 80 80 30
			39 00 00 00 00 02	C1 03
			39 00 00 00 00 02	C2 00
			39 00 00 00 00 04	C3 40 00 28
			39 00 00 00 00 09	EE A8 00 95 00 A8 00 95 00
			39 00 00 00 00 06	F2 02 10 10 44 10
			39 00 00 00 00 0B	F3 01 93 20 22 80 05 25 3C 26 00
			39 00 00 00 00 21	F7 01 1B 08 0C 09 0D 01 01 01 04 06 01 01 00 00
						1A 01 1B 0A 0E 0B 0F 01 01 01 05 07 01 01 00 00
						1A
			39 00 00 00 00 12	EF 34 12 98 BA 10 80 24 80 80 80 00 00 00 44 A0
						82 00
			39 00 00 00 00 07	F6 60 25 05 00 00 03
			39 00 00 00 00 0E	CD 2E 2E 2E 2E 2E 2E 2E 2E 2E 2E 2E 2E 2E
			39 00 00 00 00 0E	CE 00 00 00 00 00 00 00 00 00 00 00 00 00
			39 00 00 00 00 02	53 2C
			39 00 00 00 00 02	55 00
			39 00 00 00 00 12	FA 00 3F 08 0F 06 09 0F 0E 10 17 1B 1C 1E 1F 21
						24 30
			39 00 00 00 00 12	FB 00 3F 08 0E 06 09 0F 0E 10 17 1B 1C 1E 1F 21
						24 30
			39 00 00 00 00 06	FD 16 10 11 23 09
			39 00 00 00 00 07	FE 00 02 03 21 80 78
			05 00 00 78 00 01	11
			05 00 00 14 00 01	29
		];
		gen-panel-disable-cmds = [
			05 00 00 32 00 01	28
			05 00 00 78 00 01	10
		];
		/*
		 * mDNIe
		 */
		gen-panel-mdnie-bypass-mode-cmds = [
			39 00 00 00 00 11	E8 00 00 00 00 00 00 00 00 00 00 00 00 00 00 00
						00
			39 00 00 00 00 19	E9 00 FF FF 00 FF 00 FF 00 00 FF FF 00 FF 00 FF
						00 00 FF FF 00 FF 00 FF 00
			39 00 00 00 00 19	EA 00 20 00 20 00 20 00 20 00 20 00 20 00 20 00
						20 00 20 00 20 00 20 00 20
			39 00 00 00 00 19	EB 00 20 00 20 00 20 00 20 00 20 00 20 00 20 00
						20 00 20 00 20 00 20 00 FF
			39 00 00 00 00 13	EC 04 00 00 00 00 00 00 00 04 00 00 00 00 00 00
						00 04 00
			39 00 00 00 00 08	E7 00 00 02 D0 05 00 00

		];
		gen-panel-mdnie-ui-mode-cmds = [
			39 00 00 00 00 11	E8 00 00 00 00 00 00 00 00 00 00 00 00 00 00 00
						00
			39 00 00 00 00 19	E9 00 FF FF 00 FF 00 FF 00 00 FF FF 00 FF 00 FF
						00 00 FF FF 00 FF 00 FF 00
			39 00 00 00 00 19	EA 00 20 00 20 00 20 00 20 00 20 00 20 00 20 00
						20 00 20 00 20 00 20 00 20
			39 00 00 00 00 19	EB 00 20 00 20 00 20 00 20 00 20 00 20 00 20 00
						20 00 20 00 20 00 20 00 FF
			39 00 00 00 00 13	EC 04 88 1F A6 1F D2 1F EE 04 3F 1F D2 1F EE 1F
						A6 04 6C
			39 00 00 00 00 08	E7 08 03 02 D0 05 00 02
		];
		gen-panel-mdnie-video-mode-cmds = [
			39 00 00 00 00 11	E8 00 00 00 00 00 00 00 00 00 00 00 00 00 00 00
						00
			39 00 00 00 00 19	E9 00 FF FF 00 FF 00 FF 00 00 FF FF 00 FF 00 FF
						00 00 FF FF 00 FF 00 FF 00
			39 00 00 00 00 19	EA 00 1C 00 1C 00 1C 00 1C 00 1C 00 1C 00 1C 00
						1C 00 1C 00 1C 00 1C 00 1C
			39 00 00 00 00 19	EB 00 1C 0D A4 0D A4 0D A4 0D A4 0D A4 0D A4 0D
						A4 0D A4 25 1C 4A 17 00 FF
			39 00 00 00 00 13	EC 04 88 1F A6 1F D2 1F EE 04 3F 1F D2 1F EE 1F
						A6 04 6C
			39 00 00 00 00 08	E7 08 03 02 D0 05 00 07
		];
		gen-panel-mdnie-camera-mode-cmds = [
			39 00 00 00 00 11	E8 00 00 00 00 00 00 00 00 00 00 00 00 00 00 00
						00
			39 00 00 00 00 19	E9 00 FF FF 00 FF 00 FF 00 00 FF FF 00 FF 00 FF
						00 00 FF FF 00 FF 00 FF 00
			39 00 00 00 00 19	EA 00 20 00 20 00 20 00 20 00 20 00 20 00 20 00
						20 00 20 00 20 00 20 00 20
			39 00 00 00 00 19	EB 00 20 00 20 00 20 00 20 00 20 00 20 00 20 00
						20 00 20 00 20 00 20 00 FF
			39 00 00 00 00 13	EC 04 88 1F A6 1F D2 1F EE 04 3F 1F D2 1F EE 1F
						A6 04 6C
			39 00 00 00 00 08	E7 08 03 02 D0 05 00 02
		];
		gen-panel-mdnie-gallery-mode-cmds = [
			39 00 00 00 00 11	E8 00 00 00 00 00 00 00 00 00 00 00 00 00 00 00
						00
			39 00 00 00 00 19	E9 00 FF FF 00 FF 00 FF 00 00 FF FF 00 FF 00 FF
						00 00 FF FF 00 FF 00 FF 00
			39 00 00 00 00 19	EA 00 20 00 20 00 20 00 20 00 20 00 20 00 20 00
						20 00 20 00 20 00 20 00 20
			39 00 00 00 00 19	EB 00 20 00 20 00 20 00 20 00 20 00 20 00 20 00
						20 00 20 00 20 00 20 00 FF
			39 00 00 00 00 13	EC 04 88 1F A6 1F D2 1F EE 04 3F 1F D2 1F EE 1F
						A6 04 6C
			39 00 00 00 00 08	E7 08 03 02 D0 05 00 02
		];
		gen-panel-mdnie-negative-mode-cmds = [
			39 00 00 00 00 11	E8 00 00 00 00 00 00 00 00 00 00 00 00 00 00 00
						00
			39 00 00 00 00 19	E9 FF 00 00 FF 00 FF 00 FF FF 00 00 FF 00 FF 00
						FF FF 00 00 FF 00 FF 00 FF
			39 00 00 00 00 19	EA 00 20 00 20 00 20 00 20 00 20 00 20 00 20 00
						20 00 20 00 20 00 20 00 20
			39 00 00 00 00 19	EB 00 20 00 20 00 20 00 20 00 20 00 20 00 20 00
						20 00 20 00 20 00 20 00 FF
			39 00 00 00 00 13	EC 04 00 00 00 00 00 00 00 00 00 00 00 00 00 00
						00 04 00
			39 00 00 00 00 08	E7 08 30 02 D0 05 00 00
		];
		gen-panel-mdnie-vt-mode-cmds = [
			39 00 00 00 00 11	E8 00 00 00 00 00 00 00 00 00 00 00 00 00 00 00
						00
			39 00 00 00 00 19	E9 00 FF FF 00 FF 00 FF 00 00 FF FF 00 FF 00 FF
						00 00 FF FF 00 FF 00 FF 00
			39 00 00 00 00 19	EA 00 20 00 20 00 20 00 20 00 20 00 20 00 20 00
						20 00 20 00 20 00 20 00 20
			39 00 00 00 00 19	EB 00 20 00 20 00 20 00 20 00 20 00 20 00 20 00
						20 00 20 00 20 00 20 00 FF
			39 00 00 00 00 13	EC 04 88 1F A6 1F D2 1F EE 04 3F 1F D2 1F EE 1F
						A6 04 6C
			39 00 00 00 00 08	E7 08 03 02 D0 05 00 06
		];
		gen-panel-mdnie-browser-mode-cmds = [
			39 00 00 00 00 11	E8 00 00 00 00 00 00 00 00 00 00 00 00 00 00 00
						00
			39 00 00 00 00 19	E9 00 FF FF 00 FF 00 FF 00 00 FF FF 00 FF 00 FF
						00 00 FF FF 00 FF 00 FF 00
			39 00 00 00 00 19	EA 00 20 00 20 00 20 00 20 00 20 00 20 00 20 00
						20 00 20 00 20 00 20 00 20
			39 00 00 00 00 19	EB 00 20 00 20 00 20 00 20 00 20 00 20 00 20 00
						20 00 20 00 20 00 20 00 FF
			39 00 00 00 00 13	EC 04 88 1F A6 1F D2 1F EE 04 3F 1F D2 1F EE 1F
						A6 04 6C
			39 00 00 00 00 08	E7 08 33 02 D0 05 00 02
		];
		gen-panel-mdnie-ebook-mode-cmds = [
			39 00 00 00 00 11	E8 00 00 00 00 00 00 00 00 00 00 00 00 00 00 00
						00
			39 00 00 00 00 19	E9 00 FF FF 00 FF 00 FF 00 00 FF FF 00 FF 00 FF
						00 00 FF D6 00 EA 00 FF 00
			39 00 00 00 00 19	EA 00 20 00 20 00 20 00 20 00 20 00 20 00 20 00
						20 00 20 00 20 00 20 00 20
			39 00 00 00 00 19	EB 00 20 00 20 00 20 00 20 00 20 00 20 00 20 00
						20 00 20 00 20 00 20 00 FF
			39 00 00 00 00 13	EC 04 00 00 00 00 00 00 00 04 00 00 00 00 00 00
						00 04 00
			39 00 00 00 00 08	E7 08 30 02 D0 05 00 00
		];
		gen-panel-mdnie-email-mode-cmds = [
			39 00 00 00 00 11	E8 00 00 00 00 00 00 00 00 00 00 00 00 00 00 00
						00
			39 00 00 00 00 19	E9 00 FF FF 00 FF 00 FF 00 00 FF FF 00 FF 00 FF
						00 00 FF FF 00 FF 00 F7 00
			39 00 00 00 00 19	EA 00 20 00 20 00 20 00 20 00 20 00 20 00 20 00
						20 00 20 00 20 00 20 00 20
			39 00 00 00 00 19	EB 00 20 00 20 00 20 00 20 00 20 00 20 00 20 00
						20 00 20 00 20 00 20 00 FF
			39 00 00 00 00 13	EC 04 00 00 00 00 00 00 00 04 00 00 00 00 00 00
						00 04 00
			39 00 00 00 00 08	E7 08 30 02 D0 05 00 00
		];
		gen-panel-mdnie-outdoor-mode-cmds = [
			39 00 00 00 00 11	E8 00 00 00 00 00 00 00 00 00 00 00 00 00 00 00
						00
			39 00 00 00 00 19	E9 00 FF FF 00 FF 00 FF 00 00 FF FF 00 FF 00 FF
						00 00 FF FF 00 FF 00 FF 00
			39 00 00 00 00 19	EA 00 7B 03 48 08 32 08 32 08 32 08 32 08 32 10
						28 10 28 10 28 10 28 10 28
			39 00 00 00 00 19	EB 19 22 19 22 19 22 19 22 19 22 19 22 23 1E 2E
						1B 33 1A 40 18 48 17 00 FF
			39 00 00 00 00 13	EC 04 88 1F A6 1F D2 1F EE 04 3F 1F D2 1F EE 1F
						A6 04 6C
			39 00 00 00 00 08	E7 08 03 02 D0 05 00 03
		];
		gen-panel-mdnie-gray-scale-cmds = [
			39 00 00 00 00 11	E8 00 00 00 00 00 00 00 00 00 00 00 00 00 00 00
						00
			39 00 00 00 00 19	E9 E2 1D E2 1D E2 1D 69 96 69 96 69 96 B3 4C B3
						4C B3 4C FF 00 FF 00 FF 00
			39 00 00 00 00 19	EA 00 20 00 20 00 20 00 20 00 20 00 20 00 20 00
						20 00 20 00 20 00 20 00 20
			39 00 00 00 00 19	EB 00 20 00 20 00 20 00 20 00 20 00 20 00 20 00
						20 00 20 00 20 00 20 00 FF
			39 00 00 00 00 13	EC 04 00 00 00 00 00 00 00 04 00 00 00 00 00 00
						00 04 00
			39 00 00 00 00 08	E7 08 30 02 D0 05 00 00
		];
		gen-panel-mdnie-gray-scale-negative-cmds = [
			39 00 00 00 00 11	E8 00 00 00 00 00 00 00 00 00 00 00 00 00 00 00
						00
			39 00 00 00 00 19	E9 1D E2 1D E2 1D E2 96 69 96 69 96 69 4C B3 4C
						B3 4C B3 00 FF 00 FF 00 FF
			39 00 00 00 00 19	EA 00 20 00 20 00 20 00 20 00 20 00 20 00 20 00
						20 00 20 00 20 00 20 00 20
			39 00 00 00 00 19	EB 00 20 00 20 00 20 00 20 00 20 00 20 00 20 00
						20 00 20 00 20 00 20 00 FF
			39 00 00 00 00 13	EC 04 00 00 00 00 00 00 00 04 00 00 00 00 00 00
						00 04 00
			39 00 00 00 00 08	E7 08 30 02 D0 05 00 00
		];
		gen-panel-mdnie-color-adjustment-mode-cmds = [
			39 00 00 00 00 11	E8 00 00 00 00 00 00 00 00 00 00 00 00 00 00 00
						00
			39 00 00 00 00 19	E9 00 FF FF 00 FF 00 FF 00 00 FF FF 00 FF 00 FF
						00 00 FF FF 00 FF 00 FF 00
			39 00 00 00 00 19	EA 00 20 00 20 00 20 00 20 00 20 00 20 00 20 00
						20 00 20 00 20 00 20 00 20
			39 00 00 00 00 19	EB 00 20 00 20 00 20 00 20 00 20 00 20 00 20 00
						20 00 20 00 20 00 20 00 FF
			39 00 00 00 00 13	EC 04 00 00 00 00 00 00 00 04 00 00 00 00 00 00
						00 04 00
			39 00 00 00 00 08	E7 08 30 02 D0 05 00 00
		];
		gen-panel-mdnie-color-adjustment-mode-reg = <0xE9>;
		gen-panel-backlight-set-brightness-cmds = [
			39 00 00 05 00 02	51 80
		];
		gen-panel-backlight-set-brightness-reg = <0x51>;
		gen-panel-backlight-get-brightness-reg = <0x51>;
		gen-panel-read-id = [
			DA 00 01
			DB 00 01
			DC 00 01
		];
		gen-panel-read-status-reg = [0A];
		gen-panel-read-status-ok = [9A];
		status = "okay";
	};
};
