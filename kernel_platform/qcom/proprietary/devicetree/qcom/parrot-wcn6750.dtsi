#include "parrot.dtsi"

&soc {
};

&qupv3_se2_i2c {
	status = "ok";
	nq@64 {
		compatible = "rtc6226";
		reg = <0x64>;
		fmint-gpio = <&tlmm 105 0>;
		vdd-supply = <&L5E>;
		rtc6226,vdd-supply-voltage = <2800000 2800000>;
		rtc6226,vdd-load = <15000>;
		vio-supply = <&L22B>;
		rtc6226,vio-supply-voltage = <1800000 1800000>;
	};
};
