&soc {
	/* QUPv3_0  wrapper  instance */
	qupv3_0: qcom,qupv3_0_geni_se@9c0000 {
		compatible = "qcom,qupv3-geni-se";
		reg = <0x9c0000 0x2000>;
		qcom,msm-bus,num-paths = <3>;
		interconnect-names = "qup-core", "snoc-llcc", "qup-ddr";
		interconnects =
		<&clk_virt MASTER_QUP_CORE_0 &clk_virt SLAVE_QUP_CORE_0>,
		<&system_noc MASTER_A2NOC_SNOC &gem_noc SLAVE_LLCC>,
		<&aggre2_noc MASTER_QUP_0 &mc_virt SLAVE_EBI1>;
		/*
		 * iommus = <&apps_smmu 0x5a3 0x0>;
		 * qcom,iommu-dma-addr-pool = <0x40000000 0x10000000>;
		 * qcom,iommu-geometry = <0x40000000 0x10000000>;
		 * qcom,iommu-dma = "fastmap";
		 * dma-coherent;
		 */
		status = "ok";
	};

	/* Debug UART Instance */
	qupv3_se6_2uart: qcom,qup_uart@998000 {
		compatible = "qcom,msm-geni-console";
		reg = <0x998000 0x4000>;
		reg-names = "se_phys";
		interrupts = <GIC_SPI 607 IRQ_TYPE_LEVEL_HIGH>;
		clock-names = "se-clk", "m-ahb", "s-ahb";
		clocks = <&gcc GCC_QUPV3_WRAP0_S6_CLK>,
			<&gcc GCC_QUPV3_WRAP_0_M_AHB_CLK>,
			<&gcc GCC_QUPV3_WRAP_0_S_AHB_CLK>;
		pinctrl-names = "default", "sleep";
		pinctrl-0 = <&qupv3_se6_2uart_active>;
		pinctrl-1 = <&qupv3_se6_2uart_sleep>;
		qcom,wrapper-core = <&qupv3_0>;
		status = "disabled";
	};
};

