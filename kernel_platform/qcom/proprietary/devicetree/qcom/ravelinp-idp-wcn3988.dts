/dts-v1/;

#include "ravelinp.dtsi"
#include "ravelinp-idp-wcn3988.dtsi"

/ {
	model = "Qualcomm Technologies, Inc. RavelinP IDP + WCN3988";
	compatible = "qcom,ravelinp-idp", "qcom,ravelinp", "qcom,idp";
	qcom,board-id = <34 1>;
};
