/*
 * sm5714 battery device tree common
 *
 * Copyright (c) 2021 Samsung Electronics Co., Ltd.
 *		http://www.samsung.com
 *
 * This program is free software; you can redistribute it and/or modify
 * it under the terms of the GNU General Public License version 2 as
 * published by the Free Software Foundation.
 */

&smd {
	sm5714_fuelgauge: sm5714-fuelgauge {
		status = "okay";
		fuelgauge,fuel_alert_soc = <1>;
		fuelgauge,capacity_max = <1000>;
		fuelgauge,capacity_max_margin = <300>;
		fuelgauge,capacity_min = <0>;
		fuelgauge,capacity_calculation_type = <0x1F>;
		fuelgauge,using_temp_compensation;
		fuelgauge,low_temp_limit = <100>;
		fuelgauge,using_hw_vempty;
		fuelgauge,sw_v_empty_voltage = <3200>;
		fuelgauge,sw_v_empty_voltage_cisd = <3100>;
		fuelgauge,sw_v_empty_recover_voltage = <3480>;
		fuelgauge,capacity = <4000>;
#if 1
		fuelgauge,bat_id_gpio = <
				SEC_GPIO_REF(AP,tlmm,97) 0  /* BAT_ID_1 */
				>;
#elif 0
		fuelgauge,bat_id_gpio = <
				SEC_GPIO_REF(${bat_id_gpio_02}) 0  /* BAT_ID_2 */
				SEC_GPIO_REF(${bat_id_gpio_01}) 0  /* BAT_ID_1 */
				>;
#endif

	};
};


&smd {
	battery {
		battery,fgsrc_switch_name = "sm5714-fuelgauge";
	};
};

/* /home/dpi/qb5_8814/workspace/P4_1716/android/kernel_platform/kmodule/battery/stable/gts9/fuelgauge/sm5714/sm5714_fuelgauge.gts9(wifi).dtsi */
/*
 * Gts9 battery device tree common
 *
 * Copyright (c) 2023 Samsung Electronics Co., Ltd.
 *		http://www.samsung.com
 *
 * This program is free software; you can redistribute it and/or modify
 * it under the terms of the GNU General Public License version 2 as
 * published by the Free Software Foundation.
 */

&smd {
	sm5714-fuelgauge {
		status = "okay";
		fuelgauge,fuel_alert_soc = <1>;
		fuelgauge,capacity_max = <1000>;
		fuelgauge,capacity_max_margin = <300>;
		fuelgauge,capacity_min = <0>;
		fuelgauge,capacity_calculation_type = <0x1F>;
		fuelgauge,using_temp_compensation;
		fuelgauge,low_temp_limit = <100>;
		fuelgauge,using_hw_vempty;
		fuelgauge,sw_v_empty_voltage = <3200>;
		fuelgauge,sw_v_empty_voltage_cisd = <3100>;
		fuelgauge,sw_v_empty_recover_voltage = <3480>;
		fuelgauge,capacity = <10090>;
		battery_params {
		/*
		 * BAT_ID_1/BAT_ID_2
		 * 0: SDI, 1: ATL
		 */

			/* 0 : battery data  */

			battery,id = <0>;
			battery0,battery_type = <4440 0x3C76>; /* batt_v_max, cap */
			battery0,battery_table0 = <
				0x1400 0x1A32 0x1AEF 0x1BDF 0x1C7D 0x1CEF 0x1D48 0x1D73
				0x1D84 0x1D93 0x1DBA 0x1DF2 0x1E30 0x1E58 0x1E89 0x1ED0
				0x1F10 0x1F8D 0x2018 0x20B9 0x216B 0x21E8 0x2319 0x2400
				>;
			battery0,battery_table1 = <
				0x0000 0x0019 0x0099 0x0199 0x02B3 0x03B3 0x04B3 0x05B3
				0x07CC 0x0BE6 0x0E66 0x1399 0x1B4C 0x2066 0x2819 0x2FB3
				0x34E6 0x3A00 0x41B3 0x4966 0x5100 0x5633 0x6400 0x64E6
				>;
			battery0,battery_table2 = <
				0x4B7F 0x323A 0x2A2D 0x2226 0x1F20 0x1D1E 0x1C1C 0x1B1B
				0x4B7F 0x323A 0x2A2D 0x2226 0x1F20 0x1D1E 0x1C1C 0x1B1B
				>;
			/*spare min max factor chg_factor dischg_factor manvalue*/
			battery0,rs_value = <0x0048 0x0048 0x3800 0x010A 0x0599 0x0599 0x0050>;
			battery0,v_alarm = <3100 200>;
			battery0,topoff = <816>;
			battery0,i_cal = <1 0x0 0x0800 0x0800 0 0x0 0x07F0 0x0838>;
			battery0,v_cal = <1 0 0 1 0 0 0>;
			battery0,temp_std = <25>;
			battery0,tem_poff = <3400 50 3250 50>;
			battery0,aux_ctrl = <0x322 0x5800>;
			battery0,data_ver = <5>;
			battery0,v_max_table = <0x2319 0x22F0 0x22C8 0x226A>;
			battery0,q_max_table = <0x3C76 0x3C2F 0x3BE9 0x3739>;

			/* 1 : battery data  */

			battery1,battery_type = <4440 0x3CA7>; /* batt_v_max, cap */
			battery1,battery_table0 = <
				0x1400 0x1ACD 0x1B64 0x1BD4 0x1C76 0x1CEF 0x1D4C 0x1D79
				0x1D89 0x1D96 0x1DBE 0x1DF9 0x1E24 0x1E56 0x1E99 0x1EE2
				0x1F22 0x1FA2 0x202F 0x2106 0x217E 0x21FB 0x231F 0x2400
				>;
			battery1,battery_table1 = <
				0x0000 0x0099 0x0119 0x0199 0x0299 0x0399 0x04B3 0x05B3
				0x07B3 0x0BCC 0x0E66 0x1380 0x18B3 0x1DCC 0x2800 0x2FB3
				0x34CC 0x3A00 0x41B3 0x4BE6 0x5100 0x5633 0x6400 0x64E6
				>;
			battery1,battery_table2 = <
				0x497A 0x3139 0x292D 0x2225 0x1E20 0x1C1D 0x1B1C 0x1B1B
				0x497A 0x3139 0x292D 0x2225 0x1E20 0x1C1D 0x1B1C 0x1B1B
				>;
			/*spare min max factor chg_factor dischg_factor manvalue*/
			battery1,rs_value = <0x0048 0x0048 0x3800 0x010A 0x0599 0x0599 0x0050>;
			battery1,v_alarm = <3100 200>;
			battery1,topoff = <816>;
			battery1,i_cal = <1 0x0 0x0800 0x0800 0 0x0 0x07DC 0x0838>;
			battery1,v_cal = <1 0 0 1 0 0 0>;
			battery1,temp_std = <25>;
			battery1,tem_poff = <3400 50 3250 50>;
			battery1,aux_ctrl = <0x322 0x5800>;
			battery1,data_ver = <7>;
			battery1,v_max_table = <0x231F 0x22F6 0x22CD 0x2261>;
			battery1,q_max_table = <0x3CA7 0x3C60 0x3C1A 0x36BE>;
		};
	};
};


&smd {
		battery {
			battery,fuelgauge_name = "sm5714-fuelgauge";
			battery,fgsrc_switch_name = "sm5714-fuelgauge";
		};
};

/* /home/dpi/qb5_8814/workspace/P4_1716/android/kernel_platform/kmodule/battery/stable/gts9/fuelgauge/sm5714/sm5714_fuelgauge.gts9(wifi).02.dtsi */
/* Battery data same as sm5714_fuelgauge.gts9.dtsi*/
