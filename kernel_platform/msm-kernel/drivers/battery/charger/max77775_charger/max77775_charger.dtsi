&smd {
	max77775_charger: max77775-charger {
			charger,fac_vsys = <3800>;
	};

	battery {
		battery,fgsrc_switch_name = "max77775-charger";
		battery,otg_name = "max77775-otg";
	};
};


/* /home/dpi/qb5_8814/workspace/P4_1716/android/kernel_platform/kmodule/battery/suwon/charger/max77775/max77775_charger.b6q.dtsi */
&max77775_charger {
	charger,enable_sysovlo_irq;
	charger,fac_vsys = <4400>;
	charger,fsw = <0>; /* 3MHz */
	charger,default_vtrack_voltage = <240>;
	charger,vtrack_rs = <1>;
	charger,icl_tolerance_wa;
};
