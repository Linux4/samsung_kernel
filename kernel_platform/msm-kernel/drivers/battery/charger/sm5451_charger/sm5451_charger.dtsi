&qupv3_se15_i2c {
	status = "okay";

	sm5451_charger: sm5451@63 {
		compatible = "siliconmitus,sm5451";
		reg = <0x63>;
	};
};

/* /home/dpi/qb5_8814/workspace/P4_1716/android/kernel_platform/kmodule/battery/stable/suwon_2207/charger/sm5451/sm5451_charger.q4q.dtsi */
&sm5451_charger {
	sm5451,pps_lr = <260000>;
	sm5451,rpcm =   <31000>;
};
