&qupv3_hub_i2c3 {
	status = "okay";

	sm5440_charger: sm5440@63 {
		compatible = "siliconmitus,sm5440";
		reg = <0x63>;
	};
};

/* /home/dpi/qb5_8814/workspace/P4_1716/android/kernel_platform/kmodule/battery/stable/gts9/charger/sm5440/sm5440_charger.gts9wifi.dtsi */
&sm5440_charger {
	sm5440,freq = <850>;
	sm5440,r_ttl = <320000>;
	sm5440,freq_siop = <450 650>;
	sm5440,en_vbatreg = <0>;
};
