&smd {
	max77705_charger: max77705-charger {
			charger,fac_vsys = <3800>;
	};

	battery {
		battery,fgsrc_switch_name = "max77705-charger";
		battery,otg_name = "max77705-otg";
	};
};


/* /home/dpi/qb5_8816/workspace/P4_1716/android/kernel_platform/kmodule/battery/suwon/charger/max77705/max77705_charger.gts8wifi.dtsi */
&max77705_charger {
	charger,factory_wcin_irq;
	charger,enable_sysovlo_irq;
	charger,fac_vsys = <4400>;
	charger,fsw = <0>; /* 3MHz */
};
