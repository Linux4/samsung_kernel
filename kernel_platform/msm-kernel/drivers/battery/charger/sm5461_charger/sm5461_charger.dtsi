&qupv3_hub_i2c4 {
	status = "okay";

	sm5461_charger: sm5461@63 {
		compatible = "siliconmitus,sm5461";
		reg = <0x63>;

		sm5461,freq = <2>; /* 500kHz */
		sm5461,r_ttl = <520000>;
		sm5461,topoff = <380>;
		sm5461,en_vbatreg = <1>;
		sm5461,single_mode = <1>;
	};
};

/* /home/dpi/qb5_8814/workspace/P4_1716/android/kernel_platform/kmodule/battery/suwon/charger/sm5461/sm5461_charger.q6q.dtsi */
&sm5461_charger {
	sm5461,en_vbatreg = <1>;
	sm5461,single_mode = <1>;
	sm5461,vbus_ctrl_mode = <1>;
	sm5461,fpdo_topoff = <1500000>; /* 1500mA */
	sm5461,fpdo_vnow_reg = <5000000>; /* 5000mV */
	sm5461,fpdo_mainvbat_reg = <4237000>; /* 4237mV */
	sm5461,fpdo_subvbat_reg = <4203000>; /* 4203mV */
};