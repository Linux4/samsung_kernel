// SPDX-License-Identifier: GPL-2.0
/dts-v1/;
/plugin/;

#include <dt-bindings/samsung/debug/sec_debug.h>

/ {
	/* TODO: I'm still finding how to use this 'reserved-memory' node
	 * during unit testing.
	 */
	reserved-memory {
		#address-cells = <0x02>;
		#size-cells = <0x02>;

		sec_rst_ex_info_region: sec_rst_ex_info_region@8801FF000 {
			compatible = "samsung,carve-out";
			no-map;
			reg = <0x8 0x801FF000 0x0 0x00001000>;
		};
	};

	sec_qcom_rst_exinfo: samsung,qcom-rst_exinfo {
		compatible = "samsung,qcom-rst_exinfo";
		status = "okay";
		sec,die_notifier-priority = <128>;
		sec,panic_notifier-priority = <64>;
		memory-region = <&sec_rst_ex_info_region>;
	};
};
