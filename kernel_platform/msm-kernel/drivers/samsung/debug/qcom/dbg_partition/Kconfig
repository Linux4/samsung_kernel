## security/mstdrv/Kconfig
```kconfig
#@file Kconfig
#@brief Kconfig for MST drivers
#Copyright (c) 2015, Samsung Electronics Corporation. All rights reserved.
#
#This program is free software; you can redistribute it and/or modify
#it under the terms of the GNU General Public License version 2 and
#only version 2 as published by the Free Software Foundation.
#
#This program is distributed in the hope that it will be useful,
#but WITHOUT ANY WARRANTY; without even the implied warranty of
#MERCHANTABILITY or FITNESS FOR A PARTICULAR PURPOSE.  See the
#GNU General Public License for more details. 

config MST_LDO
	bool "MST LDO kernel driver"
	depends on !(SEC_BOLTQ5G_PROJECT) && !(SEC_GTS5L_PROJECT) && !(SEC_GTS5LWIFI_PROJECT) \
			&& !(SEC_GTS6L_PROJECT) && !(SEC_GTS6LWIFI_PROJECT) && !(SEC_R3Q_PROJECT && !(MACH_R3Q_KOR_SINGLE)) \
			&& !(SEC_R5Q_PROJECT && !(MACH_R5Q_EUR_OPEN) && !(MACH_R5Q_USA_OPEN)) && !(SEC_GTS6X_PROJECT) && !(SEC_ZODIAC_PROJECT)
	default n
	help
	This enables the MST LDO kernel driver

config MST_REGULATOR
	bool "MST uses regulator API"
	default n
	help
	This enables regulator API code

config MST_SUPPORT_GPIO
	bool "MST uses support gpio"
	default n
	help
	This enables support gpio check code

config MFC_CHARGER
	bool "MFC IC using model"
	depends on !(SEC_BOLTQ5G_PROJECT) && !(SEC_GTS5L_PROJECT) && !(SEC_GTS5LWIFI_PROJECT) \
			&& !(SEC_GTS6L_PROJECT) && !(SEC_GTS6LWIFI_PROJECT) && !(SEC_R3Q_PROJECT) && !(SEC_R5Q_PROJECT) \
			&& !(SEC_R5QSWA_PROJECT) && !(SEC_GTS6X_PROJECT) && !(SEC_ZODIAC_PROJECT) \
			&& !(SEC_A82XQ_PROJECT)
	default n
	help
	This enables the MFC IC sysfs node

config MFC_LDO_COMMAND
	bool "i2c patch for LDO on MFC IC IDT chip"
	default n
	help
	This enables the i2c patch for LDO on MFC IC IDT chip

config MST_LPM_DISABLE
	bool "MST LPM Disable, this works only in eng binary version"
	depends on !(SEC_BOLTQ5G_PROJECT) && !(SEC_GTS5L_PROJECT) && !(SEC_GTS5LWIFI_PROJECT) \
			&& !(SEC_GTS6L_PROJECT) && !(SEC_GTS6LWIFI_PROJECT) && !(SEC_R3Q_PROJECT) && !(SEC_R5Q_PROJECT) \
			&& !(SEC_R5QSWA_PROJECT) && !(SEC_GTS6X_PROJECT) && !(SEC_ZODIAC_PROJECT)
	default n
	help
	This enables the MST LPM disable funtion in eng binary version

config MST_LPM_CONTROL
	bool "MST control LPM mode for performace"
	default n
	help
	This enables the MST LPM control code
```

## security/qrng/s2q000/Kconfig
```kconfig
config HW_RANDOM_S2Q000
	tristate "Quantum HW random number generator support"
	default n
	help
	  This driver provides the random number generation
	  based on Quantum technology.
	  If you want to use QRNG as HW random number generator
	  say Y here, otherwise say N

config HW_RANDOM_S2Q000_MISC_DEVICE
	tristate "Create character device for qrng"
	default y
	depends on HW_RANDOM_S2Q000
	help
	  This will create /dev/qrandom character device
	  qrandom will be provides random value via QRNG.
	  If you want to use /dev/qrandom character device
	  say Y here, otherwise say N

config HW_RANDOM_S2Q000_QUALITY
	int "Set s2q000 rng quality"
	range 0 999
	default 499
	depends on HW_RANDOM_S2Q000

config HW_RANDOM_S2Q000_TIMER
	tristate "Power down after usage of qrng"
	default y
	depends on HW_RANDOM_S2Q000
	help
	  This will set timer to power down after usage of qrng
	  If you want to use timer to power down after using qrng
	  say Y here, otherwise say N
```

## security/rootrecorder/Kconfig
```kconfig
config ROOT_RECORDER
        bool "Root Recorder Driver"
        default y
        ---help---
        Enable support for recording root action
```

## security/samsung/mz/Kconfig
```kconfig
#
# MZ configuration
#

config MEMORY_ZEROISATION
	bool "Support memory zeroisation"
	default n
	help
      Support memory zeroisation feature which does zeroing of free pages.
      The purpose of this is to zeroise specific memory
      when target process exit.
```

## sound/soc/codecs/audience/Kconfig
```kconfig
config 2MIC_AUDIENCE_ES325
	bool "Audience ES325 driver"
	default n
	help
	  This is Audience voice solution devices.
	  The chip version is ES325.

config SND_CODEC_CONTROL_MCLK
	bool "Audience ES325 doesn't control MCLK"
	default n
	depends on 2MIC_AUDIENCE_ES325
```

## sound/soc/codecs/dbmd2/Kconfig
```kconfig
#
# SoC audio configuration
#

config SND_SOC_DBMD2
	bool "DSPG Voice Trigger/Enhancement Chip"
	default n
```

## sound/soc/codecs/tfa9878/Kconfig
```kconfig
menu "Goodix TFA9878 amplifier configuration"

if SND_SOC_TFA9878
config TFA_STEREO_NODE
        bool "Stereo sysfs node support"
        help
          Enable sysfs nodes for stereo support.

config PLATFORM_EXYNOS
        bool "Exynos platform support"
        default y
        help
          Enable support for Exynos platform.

endif # SND_SOC_TFA9878

endmenu
```

## sound/soc/mediatek/aw87390/Kconfig
```kconfig
# TabA7 Lite code for OT8-5362 by yingboyang at 20220314 start
config SND_SOC_AW87XXX
	tristate "SoC Audio for awinic AW87XXX Smart K PA"
	depends on I2C
	help
	  This option enables support for AW87XXX Smart K PA.
# TabA7 Lite code for OT8-5362 by yingboyang at 20220314 end
```

## sound/soc/samsung/exynos/Kconfig
```kconfig
# SPDX-License-Identifier: GPL-2.0-only
config SND_SOC_SAMSUNG_DISPLAYPORT
	tristate "Samsung DISPLAYPORT Audio"
	help
	  Say Y if you want to use displayport audio.

config SND_SOC_SAMSUNG_EXYNOS8825_S5M3700X_I2C
	tristate "S5M3700X support on exynos8825 with i2c bus"
	select SND_SOC_S5M3700X
	select SND_SOC_S5M3700X_DUMP
	select SND_SOC_S5M3700X_VTS
	select SND_SOC_S5M3700X_HIFI

config SND_SOC_SAMSUNG_EXYNOS_TFA9874
	tristate "TFA9874 amp support on exynos"
	select SND_SOC_TFA9874
	select FW_LOADER_USER_HELPER
	select FW_LOADER_USER_HELPER_FALLBACK

config SND_SOC_SAMSUNG_EXYNOS_TFA9878
	tristate "TFA9878 amp support on exynos"
	select SND_SOC_TFA98XX
	select SND_SOC_TFA9878
	select FW_LOADER_USER_HELPER
	select FW_LOADER_USER_HELPER_FALLBACK
	select SEC_SND_SYNCHRONIZED_IPC

config SND_SOC_SAMSUNG_EXYNOS_CS35L41_I2C
	tristate "CS35L41 support on exynos with i2c bus"
	select SND_SOC_CS35L41_I2C
	select MFD_CS35L41_I2C

config SND_SOC_SAMSUNG_EXYNOS_CS40L26_I2C
	tristate "CS40L26 support on exynos with i2c bus"
	select CIRRUS_FIRMWARE
	select CIRRUS_FIRMWARE_CL_DSP
	select I2C_GPIO
	select INPUT_CS40L26_I2C
	select SND_SOC_CS40L26

config SND_SOC_SAMSUNG_EXYNOS_CS47L92_SPI
	tristate "CS47L92 support on exynos with spi bus"
	select SND_SOC_CS47L92
	select MFD_MADERA
	select MFD_MADERA_SPI
	select MFD_CS47L92
	select MFD_ARIZONA
	select REGULATOR_ARIZONA_LDO1
	select REGULATOR_ARIZONA_MICSUPP
	select EXTCON
	select EXTCON_MADERA
	select EXTCON_MADERA_INPUT_EVENT
	select GPIO_MADERA

config SND_SOC_SAMSUNG_EXYNOS9925_SOUND
	tristate "Sound card support on exynos9925"
	select SND_SOC_SAMSUNG_ABOX
	select SND_SOC_SAMSUNG_VTS
	select SND_SOC_SAMSUNG_MAILBOX
	select SND_SOC_SAMSUNG_SLIF
	select SND_SOC_SAMSUNG_DISPLAYPORT

config SND_SOC_SAMSUNG_EXYNOS8825_SOUND
	tristate "Sound card support on exynos8825"
	select SND_SOC_SAMSUNG_ABOX
	select SND_SOC_SAMSUNG_MAILBOX
	select SND_SOC_SAMSUNG_VTS
	select SND_SOC_SAMSUNG_SLIF

config SND_SOC_SAMSUNG_EXYNOS9935_SOUND
	tristate "Sound card support on exynos9935"
	select SND_SOC_SAMSUNG_ABOX
	select SND_SOC_SAMSUNG_VTS
	select SND_SOC_SAMSUNG_MAILBOX
	select SND_SOC_SAMSUNG_SLIF
	select SND_SOC_SAMSUNG_DISPLAYPORT

config SND_SOC_SAMSUNG_EXYNOS8535_SOUND
	tristate "Sound card support on exynos8535"
	select SND_SOC_SAMSUNG_ABOX

config SND_SOC_SAMSUNG_EXYNOS8835_SOUND
	tristate "Sound card support on exynos8835"
	select SND_SOC_SAMSUNG_ABOX
	select SND_SOC_SAMSUNG_VTS
	select SND_SOC_SAMSUNG_MAILBOX
	select SND_SOC_SAMSUNG_SLIF

config SND_SOC_SAMSUNG_EXYNOS8535_RT5691
	tristate "RT5691 codec support on exynos8535"
	select SND_SOC_SAMSUNG_ABOX
	select SND_SOC_RT5691

config SND_SOC_SAMSUNG_EXYNOS8535_AW882XX
	tristate "AW882XX amp support on exynos8535"
	select SND_SMARTPA_AW882XX
	select SND_AW_FEEDFORWARD
	select SEC_SND_SYNCHRONIZED_IPC

config SND_SOC_SAMSUNG_EXYNOS8535_SMA1305
	tristate "SMA1305 amp support on exynos8535"
	select SND_SOC_SMA1305
	select SND_SOC_APS_ALGO
	select SEC_SND_SYNCHRONIZED_IPC

config SND_SOC_SAMSUNG_AUDIO
	tristate "Audio support for Samsung Projects"
	help
	  Say Y here to enable audio support for the Samsung Audio.

source "sound/soc/samsung/exynos/abox/Kconfig"
source "sound/soc/samsung/exynos/vts/Kconfig"
source "sound/soc/samsung/exynos/slif/Kconfig"
```
