## kernel_platform/msm-kernel/drivers/samsung/debug/qcom/dbg_partition/Kconfig
```kconfig
config SEC_QC_DEBUG_PARTITION
	tristate "SEC Debug Partition for Qualcomm SoC based models"
	help
	  TODO: help is not ready.
```

## kernel_platform/msm-kernel/drivers/samsung/debug/qcom/rdx_bootdev/Kconfig
```kconfig
config SEC_QC_RDX_BOOTDEV
	tristate "SEC RDX Boot-Dev driver for Qualcomm based devices"
	help
	  TODO: help is not ready.
```

## kernel_platform/msm-kernel/drivers/samsung/debug/qcom/reboot_cmd/Kconfig
```kconfig
config SEC_QC_RBCMD
	tristate "SEC Reboot Commands for Qualcomm Based Devices"
	depends on SEC_REBOOT_CMD
	help
	  TODO: help is not ready.
```

## kernel_platform/msm-kernel/drivers/samsung/debug/qcom/rst_exinfo/Kconfig
```kconfig
config SEC_QC_RST_EXINFO
	tristate "SEC Reset extra info for Qualcomm based devices"
	help
	  TODO: help is not ready.
```

## kernel_platform/msm-kernel/drivers/samsung/debug/qcom/soc_id/Kconfig
```kconfig
config SEC_QC_SOC_ID
	tristate "SEC SoC ID for Qualcomm SoC based models"
	help
	  TODO: help is not ready.

config SEC_QC_SOC_ID_TEST_FOR_ON_DEVICE
	tristate "KUnit test for sec_qc_soc_id_test"
	depends on KUNIT
	depends on SEC_QC_SOC_ID
	help
	  TODO: Describe config fully.
	  If you run this test driver on device, SHOULD set this config as 'm' to build test driver modulraly.

config SEC_QC_SOC_ID_TEST_FOR_ONLY_UML
	tristate "KUnit test for sec_qc_soc_id_test"
	depends on KUNIT
	depends on UML
	depends on SEC_QC_SOC_ID
	help
	  TODO: Describe config fully.
	  This CONFIG is recommended to set to y.
```

## kernel_platform/msm-kernel/drivers/samsung/debug/reboot_cmd/Kconfig
```kconfig
config SEC_REBOOT_CMD
	tristate "SEC Reboot Command Iterator"
	help
	  TODO: help is not ready.
```

## kernel_platform/msm-kernel/drivers/samsung/debug/upload_cause/Kconfig
```kconfig
config SEC_UPLOAD_CAUSE
	tristate "SEC Panic Notifier Updating Upload Cause"
	help
	  TODO: help is not ready.
```

## kernel_platform/msm-kernel/drivers/samsung/power/Kconfig
```kconfig
config SEC_EXT_THERMAL_MONITOR
	tristate "Samsung external thermal monitor"
	help
	  This enables external thermal monitor to get hint whether if there's
	  external cause or not.

config SEC_PM_LOG
	tristate "Samsung Power/Thermal Log driver"
	help
	  TODO: help is not ready.

config SKPM
	tristate "Samsung Kernel Power Monitor"
	help
	  Monitor/Measure internal power related value
```

## kernel_platform/msm-kernel/drivers/sec_panel_notifier/Kconfig
```kconfig
#
# samsung panel notifier
#

config SEC_PANEL_NOTIFIER
	tristate "samsung panel notifier"
	help
	  Samsung panel notifier.
```

## kernel_platform/msm-kernel/drivers/secdp/Kconfig
```kconfig
config SEC_DISPLAYPORT
	tristate "SEC DISPLAYPORT feature"
	default n
	help
	   Samsung specific displayport changes.

config SEC_DISPLAYPORT_DBG
	bool "SEC_DISPLAYPORT_DBG feature"
	depends on SEC_DISPLAYPORT
	help
	   Samsung specific debug code for displayport
```

## kernel_platform/msm-kernel/drivers/sensors/Kconfig
```kconfig
# SPDX-License-Identifier: GPL-2.0-only

config SENSORS
	tristate "Sensors Class Support"
	help
	  This option enables the sensor sysfs class in /sys/class/sensors.
	  You'll need this to do anything useful with sensors. If unsure, say N.

#
# grip sensors configuration
#

config SENSORS_SX9380
	depends on I2C
	tristate "SX9380 driver"
	default n
	help
	  Say Y here if you use sx9380.
	  This option enables grip sensors using
	  SemTech sx9380 device driver.
	  Say N here if you do not use sx938x.

config SENSORS_SX9380_SUB
	depends on I2C
	tristate "SX9380 sub driver"
	default n
	help
	  Say Y here if you use sx9380 sub.
	  This option enables grip sensors using
	  SemTech sx9380 sub device driver.
	  Say N here if you do not use sx938x sub.

config SENSORS_SX9380_SUB2
	depends on I2C
	tristate "SX9380 sub2 driver"
	default n
	help
	  Say Y here if you use sx9380 sub2.
	  This option enables grip sensors using
	  SemTech sx9380 sub2 device driver.
	  Say N here if you do not use sx938x sub2.

config SENSORS_CORE_AP
	tristate "Need to use Sensors core ap version"
	default n
	help
	  Say Y here if you using sensors_core.c included under drivers/sensors etc.

config SENSORS_COMMON_VDD_SUB
	bool "SX9380 common VDD"
	default n
	help
	  Say Y here if main and sub sx9380 use common VDD.
	  This option enables function to control irq gpio of sub grip sensor
	  in main grip sensor driver.


config SENSORS_DUMP_DATA
	tristate "Grip sensor dump log"
	default n
	help
	  Enable grip dump log data
	  This option activates log output of grip error data using sensordump_notifier.

config SENSORS_GRIP_FAILURE_DEBUG
	bool "Grip failure debug"
	help
	  Say Y here, Enable Grip failure debug flag.
```

## kernel_platform/msm-kernel/drivers/sensors_lego/Kconfig
```kconfig
#
# grip sensors configuration
#

config SENSORS_ISG6320
	depends on I2C
	tristate "ISG6320 grip"
	default n
	help
	  If you say yes here if you use ISG6320 for grip.
	  This option enables grip sensors using
	  IMAGIS ISG6320 device driver for grip.

config SENSORS_ISG6320_SUB
	depends on I2C
	tristate "ISG6320 grip sub"
	default n
	help
	  If you say yes here if you use ISG6320_SUB for grip sub.
	  This option enables grip sensors using
	  IMAGIS ISG6320_SUB device driver for grip sub.

config SENSORS_ISG6320_SUB2
	depends on I2C
	tristate "ISG6320 grip sub2"
	default n
	help
	  If you say yes here if you use ISG6320_SUB2 for grip sub2.
	  This option enables grip sensors using
	  IMAGIS ISG6320_SUB2 device driver for grip sub2.

config SENSORS_ISG6320_WIFI
	depends on I2C
	tristate "ISG6320 grip wifi"
	default n
	help
	  If you say yes here if you use ISG6320_WIFI for grip wifi.
	  This option enables grip sensors using
	  IMAGIS ISG6320_WIFI device driver for grip wifi.

config SENSORS_SUPPORT_SLSI
	tristate "Need to set if the driver is working based on Exynos Chip Set"
	default n
	help
	  If you say yes here, the driver is working based on Exynos Chip Set.
	  This option enable the feature that is related with Exynos Chip Set.
	  
config SENSORS_SUPPORT_QCOM
	tristate "Need to set if the driver is working based on Snapdragon Chip Set"
	default n
	help
	  If you say yes here, the driver is working based on Snapdragon Chip Set.
	  This option enable the feature that is related with Snapdragon Chip Set.
	  
config SENSORS_SUPPORT_MTK
	tristate "Need to set if the driver is working based on Mediatek Chip Set"
	default n
	help
	  If you say yes here, the driver is working based on Mediatek Chip Set.
	  This option enable the feature that is related with Mediatek Chip Set.

config SENSORS_CORE_AP
	tristate "Need to use Sensors core ap version"
	default n
	help
	  Say Y here if you using sensors_core.c included under drivers/sensors etc.

config TEST_FOR_GRIP
	tristate "Grip sensor test"
	default n
	help
	  Enable grip test
	  This option enables logs or functions for grip test.

config USE_MULTI_CHANNEL
	tristate "Grip sensor multi chennel"
	default n
	help
	  Enable grip multi channel
	  This option enables feature that is related multi-Channel for grip Sensor.
	  
config UNSUPPORT_UNKNOWN_MODE
	tristate "Unsupport unknown mode for specific regions"
	default n
	help
	  This option disable grip unknown mode concept for specific project.

config SUPPORT_MCC_THRESHOLD_CHANGE
	depends on I2C
	tristate "Change grip sensor threshold according to the MCC value"
	default n
	help
	  Say Y here if you need to check mcc(mobile country code).
	  This option enables when it is necessary to adjust the threshold
	  according to the mcc value.
	  Say N here if you do not need to check mcc.
	  
config SENSORS_SKIP_CABLE_RESET
	tristate "skip grip reset when usb/ta/data cable attached"
	default n
	help
	  new ANFR concept to skip grip reset  

config SENSORS_DUMP_DATA
	tristate "Grip sensor dump log"
	default n
	help
	  Enable grip dump log data
	  This option activates log output of grip error data using sensordump_notifier.

config SENSORS_GRIP_FAILURE_DEBUG
	bool "Grip failure debug"
	help
	  Say Y here, Enable Grip failure debug flag.

config SENSORS_GRIP_SCANOFF
	bool "Grip sensor low power sleep mode"
	default n
	help
	  Scan off for low current consumption of the unused grip sensor.
	  This option is for DM USA&CAN models, user binary.
```

## kernel_platform/msm-kernel/drivers/usb/typec/maxim/Kconfig
```kconfig
#
# CCIC devices
#

comment "CCIC configs"

config CCIC_MAX77775
	tristate "CCIC 77775"
	depends on I2C
	default n
	help
	  If you say yes here you will get support for
	  max77775 ccic full version chipset

config MAX77775_CCIC_ALTERNATE_MODE
	bool "support alternate mode"
	depends on CCIC_MAX77775
	default n
	help
	  If you say yes here you will get support for
	  alternate mode function with max77775 ccic chipset

config MUIC_MAX77775
	tristate "Using MAX77775 MUIC"
	depends on USE_MUIC
	default n
	help
	  If you say yes here you will get support for
	  the MAX77775 MUIC chip.
	  To enable this driver,
	  USE_MUIC should be enabled.

config HV_MUIC_MAX77775_AFC
	tristate "Using MAX77775 AFC MUIC"
	default n
	help
	  If you say yes here you will get support for
	  the MAX77775 AFC MUIC.
	  To enable this driver,
	  MUIC_MAX77775 should be enabled.

config MAX77775_MUIC_QC_DISABLE
	bool "Using QC charging"
	depends on USE_MUIC
	default n
	help
	  If you say yes here you will not get support for the QC charging

config MAX77775_UPGRADED_WATER_DETECT
	bool "Using improved water detection"
	depends on CCIC_MAX77775
	default n
	help
	  If you say yes here you will get support for extra water detection
	  driver will check if it is water + no VBUS + no hiccup state,
	  and if the condition is satisfied, it will reset IC.

config MAX77775_GET_UNMASK_VBUS_HWPARAM
	bool "Using get unmask vbus hw param"
	depends on CCIC_MAX77775
	default n
	help
	  If you say yes here you will get support for getting unmask vbus hw param
	  driver will check if it is attach/detach repeat state,
	  and if the condition is satisfied, it will get the hw param.

config MAX77775_ALTERNATE_TEST_FOR_ON_DEVICE
	tristate "KUnit test for max77775_alternate_test"
	depends on KUNIT
	depends on CCIC_MAX77775
	help
	  This is feature for max77775_alternate.c file.
	  If you run this test driver on device, SHOULD set this config as 'm' to build test driver modulraly.

config MAX77775_ALTERNATE_TEST_FOR_ONLY_UML
	tristate "KUnit test for max77775_alternate_test"
	depends on KUNIT
	depends on UML
	depends on CCIC_MAX77775
	help
	  This is feature for max77775_alternate.c file. (UML)
	  This CONFIG is recommended to set to y.
```

## kernel_platform/msm-kernel/drivers/vibrator/common/inputff/Kconfig
```kconfig
config SEC_VIBRATOR_INPUTFF
	tristate "sec vibrator inputff"
	default n
	help
	  If you say yes here you will get support for the
	  sec vibrator inputff driver

config SEC_VIBRATOR_INPUTFF_TEST
        bool "KUnit test for sec_vibrator_inputff_test"
        depends on SEC_KUNIT
        help
          This driver is for inputff test driver
		  sec vibrator kunit test
		  If you want to add some functions,
		  Please make the test case.

config SEC_VIB_FOLD_MODEL
	bool "get support for folder/flip status"
	default n
	help
	  If you enable this feature,
	  you will get event for folder/flip status
	  through event_cmd sysfs
```

## kernel_platform/msm-kernel/kernel/sched/walt/Kconfig
```kconfig
# SPDX-License-Identifier: GPL-2.0-only
#
# QTI WALT based scheduler
#
menu "QTI WALT based scheduler features"

config SCHED_WALT
	tristate "Support window based load tracking"
	depends on SMP
	help
	This feature will allow the scheduler to maintain a tunable window
	based set of metrics for tasks and runqueues. These metrics can be
	used to guide task placement as well as task frequency requirements
	for cpufreq governors.

config SCHED_WALT_DEBUG
	tristate "WALT debug module"
	depends on SCHED_WALT
	select TRACE_PREEMPT_TOGGLE
	select TRACE_IRQFLAGS
	help
	  This module provides the means of debugging long preempt and
	  irq disable code. This helps in identifying the scheduling
	  latencies. The module rely on preemptirq trace hooks and
	  print the stacktrace to the ftrace upon long preempt and irq
	  events. Sysctl knobs are available for the user to configure
	  the thresholds.

	  This module also used to crash the system to catch issues
	  in scenarios like RT throttling and sleeping while in atomic
	  context etc.

config SCHED_CONSERVATIVE_BOOST_LPM_BIAS
	bool "Enable LPM bias if conservative boost is enabled"
	default n
	help
	  This feature will allow the scheduler to disable low power
	  modes on a cpu if conservative boost is active. The cpu
	  will not enter low power mode for a hysteresis time period,
	  which can be configured from userspace.

config RQ_STAT_SHOW
	bool "Enable rq_stat node to check each Cluster's number of task"
	default n
	help
	  This feature creats "/proc/rq_stat" node.
	  It's read only node.
	  shows number of task in each Cluster's rq.
	  first is little cluster and last one is gold/gold+ cluster

config SCHED_POWER_OPTIMIZE
	bool "Enable Power optimize tunning feature"
	default n
	help
	  This feature make "up_delay_freq" sysfs node in Walt Governor.
	  Also, change prediction target load from 80 to 90
	  when conservative prediction load enable condition.
	  if we enable and apply some value,
	  we can make overall system power better.
endmenu
```

## kernel_platform/msm-kernel/samsung/Kconfig
```kconfig
#
# Generate for samsung config
#

config ARCH_X55
	bool "Enable Support for Qualcomm Technologies, Inc. DIWALI"
	depends on ARCH_QCOM
	help
	  This enables support for the Qualcomm Technologies, Inc.'s
	  DIWALI chipset. If you do not wish to build a kernel that
	  runs on this chipset or if you are unsure, say 'N' here.

config CUSTOM_FACTORY_BUILD
	bool "Enable custom factory build"

config CUSTOM_D85_BUILD
	bool "Enable custom D85 build"

# M55 code for SR-QN6887A-01-321 by gaochao at 20230811 start
config CUSTOM_SPI_SPIDEV
	tristate "User mode SPI device driver support"
	help
	  This supports user mode SPI protocol drivers.

	  Note that this application programming interface is EXPERIMENTAL
	  and hence SUBJECT TO CHANGE WITHOUT NOTICE while it stabilizes.
# M55 code for SR-QN6887A-01-321 by gaochao at 20230811 end

# M55 code for SR-QN6887A-01-548 by xiongxiaoliang at 20230814 start
config OEM_GLINK_CHARGER
	tristate "OEM GXY glink charger"
	help
	  To compile the driver as a module, choose M here: the module will be
	  called gxy_glink.

config OEM_PSY_CHARGER
	tristate "OEM PSY battery charger"
	help
	  To compile the driver as a module, choose M here: the module will be
	  called gxy_psy_sysfs.
# M55 code for SR-QN6887A-01-548 by xiongxiaoliang at 20230814 end
```
