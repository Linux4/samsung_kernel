## kernel_platform/msm-kernel/drivers/kq/mesh/Kconfig
```kconfig
config SEC_KQ_MESH_QC
	tristate "Samsung KQ MESH support for QC models"
	default n
	help
	  This option enables Samsung KQ MESH features for QC models.
	  This module created to enhance system stability.
	  Enable this feature to check MESH system functionality.
	  This module only works with MESH application.

config MESH_KERNEL_MEMTEST
	tristate "Mesh kernel space MEMTEST"
	default n
	depends on SEC_KQ_MESH_QC
	help
	  This tests kernel space memory.
```

## kernel_platform/msm-kernel/drivers/mfd/maxim/max17333/Kconfig
```kconfig
config MFD_MAX17333
	tristate "Maxim Integrated MAX17333 PMIC Support"
	depends on I2C=y
	select MFD_CORE
	select REGMAP_I2C
	select REGMAP_IRQ
	help
	  Say yes here to add support for Maxim Integrated MAX17333.
```

## kernel_platform/msm-kernel/drivers/misc/KnoxVault/Kconfig
```kconfig
config KNOXVAULT_POWER
    tristate "regulatore control of KnoxVault2"
    help
      Say m here if you have a KnoxVault2.
      If unsure, say N.
```

## kernel_platform/msm-kernel/drivers/misc/KnoxVaultDev/Kconfig
```kconfig
config I2C_KNOXVAULTDEV
    tristate "regulatore control of I2C_KNOXVAULTDEV"
    help
      Say m here if you have a I2C_KNOXVAULTDEV.
      If unsure, say N.
```

## kernel_platform/msm-kernel/drivers/misc/sec-star/Kconfig
```kconfig
#
# SEC STAR platform devices
#

config STAR_MEMORY_LEAK
	bool "memory leak test in sec-star"
	help
	  memory leak test in sec-star.
	  All allocated memory are listed in array.

config STAR_K250A
	tristate "S.LSI k250a driver"
	help
	  S.LSI k250a driver except ISO7816 protocol layer
	  This driver provides support for S.LSI k250a product.

config STAR_V9RRP
	bool "S.LSI v9rrp driver"
	help
	  S.LSI v9rrp driver except ISO7816 protocol layer
	  This driver provides support for S.LSI v9rrp product.

config SEC_SNVM_WAKELOCK_METHOD
       int "snvm wakelock method"
       default 0
       help
         Different functions must be used depending on the kernel version
         for wakelock initialization.
         0 - auto selection
         1 - wakeup_source_init
         2 - wakeup_source_register
```

## kernel_platform/msm-kernel/drivers/misc/sim_tray/Kconfig
```kconfig
#
# for huaqin mis info
#

config HQ_SIM_TRAY_CHECK
	tristate "check sim stry status"
	help
	  this will create a node to show sim tray status.

	  If unsure, say N.
```

## kernel_platform/msm-kernel/drivers/nfc/Kconfig
```kconfig
#
# Near Field Communication (NFC) devices
#
config SAMSUNG_NFC
	tristate "Samsung NFC driver for module build"
	default n
	help
	  Say Y here if you want to build support for NFC (Near field
	  communication) devices.
	  To compile this support as a module, choose M here: the module will
	  be called nfc.

config SAMSUNG_ESE_ONLY
	tristate "Samsung ESE only driver for module build"
	default n
	help
	  Say Y here if you want to build support for ESE (Embedded secure element) devices.
	  To compile this support as a module, choose M here: the module will
	  be called nfc.

config SEC_NFC
	bool "Samsung NFC driver"
	default n
	help
	  SAMSUNG NFC Driver.
	  This driver provides support for SAMSUNG NFC products.
	  You should select your NFC product and interface.

	  Say Y here to compile support for SAMSUNG NFC driver into the
	  kernel.

config NFC_PVDD_LATE_ENABLE
        bool "PVDD late enable"
        default n
        help
          If lpcharge value is not usable,
          then PVDD is enabled lately by init.nfc.samsung.rc on late-init.
          And this should be enabled from S os projects.

config ESE_P3_LSI
	bool "eSE driver"
	depends on SPI
	default n
	help
	  Oberthur Driver.
	  This driver provides support for LSI NXP combined ESE products.
	  You should select your NFC product and interface.

	  Say Y here to compile support for eSE driver into the kernel.

config ESE_COLDRESET
	bool "eSE support coldreset"
	depends on ESE_P3_LSI
	default n
	help
	  Cold reset function supported.
	  This function supports for LSI ESE products.
	  You should select your NFC product and interface.

	  Say Y here to compile support for eSE driver into the kernel.

config ESE_USE_REGULATOR
	bool "eSE use regulator"
	depends on ESE_P3_LSI
	default n
	help
	  ESE is on and off by regulator.
	  This function supports for LSI ESE products.
	  You should select your NFC product and interface.

	  Say Y here to compile support for eSE driver into the kernel.

config ESE_USE_TZ_API
	bool "use tz api"
	default n
	help
	  Enable when using TZ API.
	  You should select this feature if your NFC product
	  uses S.LSI AP and TZ API.
	  Say Y here to compile support for TZ API.

config SEC_NFC_LOGGER
	bool "NFC logger"
	default n
	help
	  Enable NFC log.
	  NFC log will be recorded at proc folder.
	  but will not included at dumpstate log.
	  so need to copy this file to log folder.

config SEC_NFC_DUPLICATED_IRQ_WQ
	bool "NFC duplicated irq wq"
	default n
	help
	  Enable NFC duplicated irq w/a.
	  If the interrupt occurs twice continuously, the i2c_info.
	  read_irq value is returned to the previous value.
	  Apply W/A received from LSI

config SEC_STAR
        tristate "LSI star platform"
        default n
        help
          LSI star platform
          This driver provides support for LSI star platform.

config STAR_MEMORY_LEAK
        bool "memory leak test in sec-star"
        help
          memory leak test in sec-star.
          All allocated memory are listed in array.

config STAR_K250A
        bool "S.LSI k250a driver"
        help
          S.LSI k250a driver except ISO7816 protocol layer
          This driver provides support for S.LSI k250a product.

config NFC_QTI_I2C
        tristate "QTI NCI based NFC I2C Driver for SNxxx"
        depends on I2C
        help
          This enables the NFC driver for SNxxx based devices.
          This is for I2C connected version. NCI protocol logic
          resides in the usermode and it has no other NFC dependencies.

          If unsure, say N.
```

## kernel_platform/msm-kernel/drivers/nfc/samsung/Kconfig
```kconfig
#
# Near Field Communication (NFC) devices
#

menu "Near Field Communication (NFC) devices"
        depends on NFC

config SEC_NFC
        tristate "Samsung NFC driver"
        default m
        help
          SAMSUNG NFC Driver.
          This driver provides support for SAMSUNG NFC products.
          You should select your NFC product and interface.

          Say Y here to compile support for SAMSUNG NFC driver into the
          kernel.



config SEC_NFC_GPIO_CLK
                bool "SEC NFC GPIO CLK"
                default n
                help
                  SAMSUNG NFC CLR REQ feature.
                  This feature provides support for SAMSUNG NFC products.
                  You should select this feature if your NFC product uses AP CLK.

                  Say Y here to compile support for SAMSUNG NFC CLK REQ feature into the
                  kernel.
config SEC_NFC_DEDICATED_CLK
                tristate "SEC NFC DEDICATED CLK"
                        default m
config SEC_NFC_LDO_EN
                tristate "SEC NFC LDO"
                        default m
config SEC_NFC_PMIC_LDO
                tristate "SEC NFC PMIC LDO"
                        default m
config SEC_ESE_COLDRESET
                tristate "eSE Cold reset"
                        default m
endmenu
```

## kernel_platform/msm-kernel/drivers/optics/Kconfig
```kconfig
config SENSORS_FLICKER_SELF_TEST
	tristate "Flicker EOL test use flash"
	help
		make Test environment using led flash.

config SENSORS_TSL2511
	tristate "AMS TSL2511 ALS, Flicker sensor"
    	depends on I2C
 	help
	  If you say yes here you get support for the ams tsl2511 sensor.
	  This driver can also be built as a module.  If so, the module
	  will be called tsl2511.
```

## kernel_platform/msm-kernel/drivers/power/supply/nopmi/Kconfig
```kconfig
# SPDX-License-Identifier: GPL-2.0-only

menu "No PMI Technologies, Inc. Charger and Fuel Gauge support"

config AFC_GPIO_HVDCP
	tristate "Samsung afc protocol driver"
	depends on I2C
	help
	  Say Y to include support for samsung afc driver.

config UPM6918_CHARGER
	tristate "UP UPM6918 Battery Charger"
	depends on I2C
	help
	  Say Y to include support for UPM6918 Battery Charger.

config UPM6720_CHARGER
	tristate "UP UPM6720 Charger Pump"
	depends on I2C
	help
	  Say Y to include support for UPM6720 Charger Pump.
	  
config SC8541_CHARGER
	tristate "UP SC8541 Charger Pump"
	depends on I2C
	help
	  Say Y to include support for SC8541 Charger Pump.
	  
config CHARGER_SC89890
	tristate "UP SC89890 Battery Charger"
	depends on I2C
	help
	  Say Y to include support for SC89890 Battery Charger.

config FG_SM5602
	tristate "FG_SM5602 battery driver"
	depends on I2C
	help
		Say Y to enable support of FG_SM5602 Battery Charger.

config FG_OZ8806
	tristate "FG_OZ8806 battery driver"
	depends on I2C
	help
		Say Y to enable support of FG_OZ8806 Battery Charger.
config FG_CW221X
	tristate "FG_CW221X battery driver"
	depends on I2C
	help
		Say Y to enable support of FG_OZ8806 Battery Charger.

config CHARGER_SD76030
	tristate "CHARGER_SD76030 battery driver"
	depends on I2C
	help
		Say Y to enable support of CHARGER_SD76030 Charger Charger.

config QCOM_PMIC_VOTER
	tristate "QCOM pmic voter driver"
	help
	  Say Y to include support for QCOM pmic voter driver.

endmenu
```

## kernel_platform/msm-kernel/drivers/pwm/pwm-gpclk/Kconfig
```kconfig
config PWM_GPCLK
	tristate "Qualcomm GP CLK control driver"
	depends on OF
	help
	  Qualcomm GP CLK control driver

config PWM_GPCLK_DEBUG_FEATURE
	tristate "PWM GPLK Debug info enable"
	depends on OF
	help
	  Qualcomm GP CLK control driver's Debug info enable

config PWM_GPCLK_USE_16_BIT_REGISTER
	tristate "PWM GPLK Use 16 bit m, n, d register"
	depends on OF
	help
	  Qualcomm GP CLK control driver use 16 bits registers from SM8550 before that 8 bit registers are used
```

## kernel_platform/msm-kernel/drivers/redriver/ps5169/Kconfig
```kconfig
#
# Combo redriver devices
#

comment "Redriver IC driver configs"

config COMBO_REDRIVER_PS5169
	tristate "ps5169 support"
	depends on I2C
	default n
	help
	  If you say yes here you will get support for
          ps5169 redriver ic.

config SUPPORT_PS5169_ADBTUNE
	bool "ps5169 adb tuning support"
	depends on COMBO_REDRIVER_PS5169
	default n
	help
	  If you say yes here you will get support for
          ps5169 redriver adb tuning.
```

## kernel_platform/msm-kernel/drivers/regulator/s2dos07/Kconfig
```kconfig
if REGULATOR

config REGULATOR_S2DOS07
	tristate "Samsung S2DOS07 regulator"
	depends on I2C
	help
	 This driver controls a Samsung S2DOS07 regulator
	 via I2C bus.

endif
```

## kernel_platform/msm-kernel/drivers/samsung/Kconfig
```kconfig
source "drivers/samsung/bsp/Kconfig"
source "drivers/samsung/debug/Kconfig"
source "drivers/samsung/knox/Kconfig"
source "drivers/samsung/power/Kconfig"
```

## kernel_platform/msm-kernel/drivers/samsung/bsp/of_kunit/Kconfig
```kconfig
config SEC_OF_KUNIT
	tristate "Samsung additional facilites for of / kunit testing"
	default y if OF=y && KUNIT=y
	default m if OF=y && KUNIT=m
	select OF_UNITTEST
	help
	  TODO: help is not ready.
```

## kernel_platform/msm-kernel/drivers/samsung/bsp/qcom/param/Kconfig
```kconfig
config SEC_QC_PARAM
	tristate "Samsung PARAM driver for RAW Partion & Qualcomm based devices"
	depends on SEC_PARAM
	help
	  TODO: help is not ready.
```

## kernel_platform/msm-kernel/drivers/samsung/bsp/reloc_gpio/Kconfig
```kconfig
config SEC_RELOC_GPIO
	tristate "Samsung Legacy-Style Relocated GPIO Interface for Factory Mode"
	default m if SEC_CLASS=m
	default y if SEC_CLASS=y
	depends on SEC_FACTORY
	help
	  TODO: help is not ready.
```

## kernel_platform/msm-kernel/drivers/samsung/bsp/sysup/Kconfig
```kconfig
config SEC_SYSUP
	tristate "Samsung System Update"
	default n
	help
	  Samsung system update Feature.
```

## kernel_platform/msm-kernel/drivers/samsung/debug/Kconfig
```kconfig
source "drivers/samsung/debug/common/Kconfig"
source "drivers/samsung/debug/boot_stat/Kconfig"
source "drivers/samsung/debug/log_buf/Kconfig"
source "drivers/samsung/debug/pmsg/Kconfig"
source "drivers/samsung/debug/reboot_cmd/Kconfig"
source "drivers/samsung/debug/upload_cause/Kconfig"
source "drivers/samsung/debug/crashkey/Kconfig"
source "drivers/samsung/debug/crashkey_long/Kconfig"
source "drivers/samsung/debug/debug_region/Kconfig"

source "drivers/samsung/debug/arm64/Kconfig"

source "drivers/samsung/debug/qcom/Kconfig"
```

## kernel_platform/msm-kernel/drivers/samsung/debug/boot_stat/Kconfig
```kconfig
config SEC_BOOT_STAT
	tristate "SEC Boot-stat driver"
	help
	  TODO: help is not ready.
```

## kernel_platform/msm-kernel/drivers/samsung/debug/common/Kconfig
```kconfig
menuconfig SEC_DEBUG
	tristate "SEC TN Debugging Features"
	help
	  TODO: help is not ready.

config SEC_FORCE_ERR
	bool "SEC Generating force errors"
	depends on SEC_DEBUG
	help
	  TODO: help is not ready.
```

## kernel_platform/msm-kernel/drivers/samsung/debug/crashkey/Kconfig
```kconfig
config SEC_CRASHKEY
	tristate "SEC Force key crash driver"
	depends on SEC_KEY_NOTIFIER || UML
	help
	  TODO: help is not ready.
```

## kernel_platform/msm-kernel/drivers/samsung/debug/crashkey_long/Kconfig
```kconfig
config SEC_CRASHKEY_LONG
	tristate "SEC Long key reset driver"
	depends on SEC_KEY_NOTIFIER
	help
	  TODO: help is not ready.
```

## kernel_platform/msm-kernel/drivers/samsung/debug/pmsg/Kconfig
```kconfig
config SEC_PMSG
	tristate "PSTORE backend for saving android platform log"
	help
	  TODO: help is not ready.
```
