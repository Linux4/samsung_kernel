// SPDX-License-Identifier: GPL-2.0
/*
 * COPYRIGHT(C) 2023 Samsung Electronics Co., Ltd. All Right Reserved.
 */

/dts-v1/;
/plugin/;

#include "khaje-sec.a05s.00.dtsi"

// TODO: DO NOT EDIT THIS FILE
