// SPDX-License-Identifier: GPL-2.0
/*
 * COPYRIGHT(C) 2023 Samsung Electronics Co., Ltd. All Right Reserved.
 */

#include "khaje-sec-a05s-common.dtsi"
#include "khaje-sec-a05s-pinctrl-r00.dtsi"

/ {
	model = "Samsung A05S PROJECT (board-id,00)";
	compatible = "qcom,khaje-idp", "qcom,khaje", "qcom,idp";
	qcom,msm-id = <562 0x10000>, <518 0x10000>;
	qcom,board-id = <0x10022 0>;
	qcom,pmic-id = <0x2D 0x0 0x0 0x0>;
};
