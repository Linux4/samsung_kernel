## kernel_platform/msm-kernel/drivers/gpio/gpio-pca953x/Kconfig
```kconfig
#
# PCA953X device
#

comment "PCA953X configs"

config GPIO_PCA953X_RESET
	bool "Using GPIO-PCA953X Reset"
	default n
	help
	  If you say yes here you will get support for
	  the GPIO-PCA953X reset.
```

## kernel_platform/msm-kernel/drivers/input/air/Kconfig
```kconfig
config SEC_AUTO_INPUT
        tristate "Samsung auto input"
        default n
        help
          Say Y here if you use auto input function.
	  If unsure, say N.
          To compile this driver as a module, choose M here: the
          module will be called autoinput.
```

## kernel_platform/msm-kernel/drivers/input/misc/hall/haechitech/Kconfig
```kconfig
config INPUT_DIGITAL_HALL_HAECHITECH
	tristate "Enable HAECHITECH DIGITAL HALL IC"
	depends on I2C
	help
	  Say Y to enable support of HAECHITECH digital hall ic.
	  To compile this driver as a module, choose M here: the
	  module will be called haechitech.
```

## kernel_platform/msm-kernel/drivers/input/sar/Kconfig
```kconfig
# M55 code for SR-QN6887A-01-458 by lichang at 20230911 start
config INPUT_SAR
    tristate "Support for sar"
    help
      Say Y here if you have sar driver.
# M55 code for SR-QN6887A-01-458 by lichang at 20230911 end

config SAR_SENSOR
    tristate "Support for sx933x sar"
    help
      Say Y here if you have sar driver.
```

## kernel_platform/msm-kernel/drivers/input/sec_input/stm_fst2ba61y_i2c/Kconfig
```kconfig
# SPDX-License-Identifier: GPL-2.0-only
#
# TOUCH driver configuration
#

config TOUCHSCREEN_STM_FST2BA61Y_I2C
	tristate "STM FST2BA61Y I2C Touchscreen"
	depends on I2C
	help
		Say Y here if you want support for STM I2C touchscreen controllers.
		If unsure, say N.

config TOUCHSCREEN_STM_SUB
	tristate "STM Touchscreen"
	depends on I2C
	help
		Say Y here if you want support for STM touchscreen controllers.
		If unsure, say N.
```

## kernel_platform/msm-kernel/drivers/input/sec_input/stm_fst2ca78y_i2c/Kconfig
```kconfig
# SPDX-License-Identifier: GPL-2.0-only
#
# TOUCH driver configuration
#

config TOUCHSCREEN_STM_FST2CA78Y_I2C
    tristate "STM FST2CA78Y I2C Touchscreen"
    depends on I2C
    help
      Say Y here if you want support for STM I2C touchscreen controllers.
      If unsure, say N.
```

## kernel_platform/msm-kernel/drivers/input/sec_input/stm_fst2ca78y_spi/Kconfig
```kconfig
# SPDX-License-Identifier: GPL-2.0-only
#
# STM TOUCH driver configuration
#

config TOUCHSCREEN_STM_FST2CA78Y_SPI
    tristate "STM FTS2CA78Y SPI Touchscreen"
    depends on SPI
    help
      Say Y here if you want support for STM SPI touchscreen controllers.
      If unsure, say N.
```

## kernel_platform/msm-kernel/drivers/input/sec_input/stm_fst3ca60y_i2c/Kconfig
```kconfig
# SPDX-License-Identifier: GPL-2.0-only
#
# TOUCH driver configuration
#

config TOUCHSCREEN_STM_FST3CA60Y_I2C
    tristate "STM FST3CA60Y I2C Touchscreen"
    depends on I2C
    help
      Say Y here if you want support for STM I2C touchscreen controllers.
      If unsure, say N.
```

## kernel_platform/msm-kernel/drivers/input/sec_input/synaptics_fold/Kconfig
```kconfig
# SPDX-License-Identifier: GPL-2.0-only
#
# SYNAPTICS TOUCH driver configuration
#

config TOUCHSCREEN_SYNAPTICS_SPI_FOLDABLE
    tristate "SYNAPTICS SPI Touchscreen for foldable"
    depends on SPI
    help
      Say Y here if you want support for SYNAPTICS SPI touchscreen for foldable controllers.
      If unsure, say N.

config TOUCHSCREEN_SYNAPTICS_I2C_FOLDABLE
    tristate "SYNAPTICS I2C Touchscreen for foldable"
    depends on I2C
    help
      Say Y here if you want support for SYNAPTICS I2C touchscreen for foldable controllers.
      If unsure, say N.
```

## kernel_platform/msm-kernel/drivers/input/touchscreen/novatek/nt36523_tablet_i2c/Kconfig
```kconfig
#
# Novatek NT36xxx touchscreen driver configuration
#

config TOUCHSCREEN_NOVATEK_NT36523_TABLET_I2C
	tristate "Novatek NT36523"
	depends on I2C
	help
	  Say Y here if you have a Novatek NT36523 touchscreen connected
	  to your system.

	  If unsure, say N.
```

## kernel_platform/msm-kernel/drivers/input/touchscreen/x55/focaltech_touch/Kconfig
```kconfig
#
# Focaltech Touchscreen driver configuration
#

config TOUCHSCREEN_FTS_I2C
    tristate "Focaltech Touchscreen"
    help
      Say Y here if you have Focaltech touch panel.
      If unsure, say N.

config FTS_I2C_TRUSTED_TOUCH
    bool "Focaltech Trusted Touch"
    depends on TOUCHSCREEN_FTS_I2C
    help
      Say Y here to enable Focaltech Trusted Touch.
      If unsure, say N.
```

## kernel_platform/msm-kernel/drivers/input/touchscreen/x55/goodix/Kconfig
```kconfig
#
# Goodix touchscreen driver configuration
#
menuconfig TOUCHSCREEN_GOODIX_BRL_I2C
    tristate "Goodix berlin touchscreen"
    help
      Say Y here if you have a Goodix berlin series touch controller
      to your system.

      If build module, say M.
      If unsure, say N.
```

## kernel_platform/msm-kernel/drivers/input/wacom/Kconfig
```kconfig
#
# Wacom configuration
#

config INPUT_WACOM
	tristate "Wacom penabled i2c touchscreen"
	depends on I2C
	help
	  Say Y here if you have an Wacom penabled i2c touchscreen
	  connected to your system.
	  If unsure, say N.
```
