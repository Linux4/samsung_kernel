## kernel_platform/msm-kernel/arch/arm64/configs/vendor/waipio_sec_defconfig
```kconfig
CONFIG_SOFT_WATCHDOG=m
CONFIG_SEC_KEY_NOTIFIER=m
CONFIG_SEC_CLASS=m
CONFIG_SEC_PARAM=m
CONFIG_SEC_SYSUP=m
CONFIG_SEC_DEBUG=m
CONFIG_SEC_LOG_BUF=m
CONFIG_SEC_LOG_LAST_KMSG=y
CONFIG_SEC_REBOOT_CMD=m
CONFIG_SEC_UPLOAD_CAUSE=m
CONFIG_SEC_CRASHKEY=m
CONFIG_SEC_CRASHKEY_LONG=m
CONFIG_SEC_DEBUG_REGION=m
CONFIG_SEC_PMSG=m
CONFIG_SEC_BOOT_STAT=m
CONFIG_SEC_ARM64_AP_CONTEXT=m
CONFIG_SEC_ARM64_FSIMD_DEBUG=m
CONFIG_SEC_QC_DEBUG=m
CONFIG_SEC_QC_PARAM=m
CONFIG_SEC_QC_LOGGER=m
CONFIG_SEC_QC_QCOM_WDT_CORE=m
CONFIG_SEC_QC_RBCMD=m
CONFIG_SEC_QC_QCOM_REBOOT_REASON=m
CONFIG_SEC_QC_UPLOAD_CAUSE=m
CONFIG_SEC_QC_DEBUG_PARTITION=m
CONFIG_SEC_QC_SUMMARY=m
CONFIG_SEC_QC_USER_RESET=m
CONFIG_SEC_QC_SMEM=m
CONFIG_SEC_QC_HW_PARAM=m
CONFIG_SEC_QC_RST_EXINFO=m
CONFIG_SEC_QC_RDX_BOOTDEV=m
CONFIG_SEC_QC_SOC_ID=m

CONFIG_LCD_CLASS_DEVICE=m

# Power
CONFIG_CPU_FREQ_LIMIT=m

# wlan
#CONFIG_BCM4375=m
CONFIG_BCM4389=m

# wlan for wcn6856
CONFIG_CLD_LL_CORE=y

CONFIG_WLAN=y
CONFIG_BROADCOM_WIFI=y
CONFIG_BCM_DHD_WLAN=y
CONFIG_BCMDHD_PCIE=y
CONFIG_WIFI_BROADCOM_COB=y

# Audio
CONFIG_SND_SOC_CIRRUS_AMP=m
CONFIG_SND_SOC_CS35L41=m
CONFIG_SND_SOC_CS35L41_I2C=m
CONFIG_SND_SOC_CS35L45=m
CONFIG_SND_SOC_CS35L45_I2C=m
CONFIG_SND_SOC_SAMSUNG_AUDIO=m

# BLUETOOTH
CONFIG_BT=y
CONFIG_RFKILL=y
CONFIG_BT_BCM4389=m
CONFIG_BT_BLUESLEEP=m
CONFIG_MSM_BT_POWER=m
CONFIG_BTFM_SLIM=m

# Sensors
CONFIG_ADSP_FACTORY=m
CONFIG_LSM6DSO_FACTORY=y
CONFIG_AK09918_FACTORY=y
CONFIG_LPS22HH_FACTORY=y
CONFIG_SENSORS=m
CONFIG_SEC_SENSORS_SSC=y
CONFIG_SUPPORT_SSC_SPU=y
CONFIG_SUPPORT_LIGHT_SEAMLESS=y

# Switch
CONFIG_SWITCH=m
CONFIG_SWITCH_GPIO=m

#USB
CONFIG_USB_NOTIFY_LAYER=m
CONFIG_USB_NOTIFY_PROC_LOG=y
CONFIG_USB_HOST_NOTIFY=y
CONFIG_USB_EXTERNAL_NOTIFY=y
CONFIG_USB_NOTIFIER=m
CONFIG_USB_HW_PARAM=y
CONFIG_USB_USBNET=y
CONFIG_USB_RTL8152=y
CONFIG_USB_RTL8150=y
CONFIG_USB_NET_AX8817X=m
CONFIG_USB_NET_AX88179_178A=m
CONFIG_USB_NET_SMSC75XX=y
CONFIG_USB_NET_SMSC95XX=y
CONFIG_USB_HOST_SAMSUNG_FEATURE=y
CONFIG_USB_ANNOUNCE_NEW_DEVICES=y
CONFIG_USB_DEBUG_DETAILED_LOG=y
CONFIG_USB_INTERFACE_LPM_LIST=y
CONFIG_SND_QC_USB_AUDIO_MODULE=m
CONFIG_SUPPORT_USB_TYPEC_OPS=y
CONFIG_USB_CONFIGFS_F_CONN_GADGET=m
CONFIG_USB_CONFIGFS_F_SS_MON_GADGET=m
CONFIG_USB_CONFIGFS_F_SS_ACM=m

# PM
CONFIG_SEC_PM=y
CONFIG_SEC_GPIO_DUMP=m
CONFIG_SEC_AP_PMIC=m
CONFIG_SEC_EXT_THERMAL_MONITOR=m
CONFIG_RTC_AUTO_PWRON=m
CONFIG_SEC_THERMAL_LOG=m

# AIR
CONFIG_SEC_AUTO_INPUT=m

# Touch
CONFIG_INPUT_SEC_NOTIFIER=m

# UFS
CONFIG_UFS_DBG=y
CONFIG_SEC_UFS_FEATURE=y
CONFIG_MQ_IOSCHED_SSG=m
CONFIG_BLK_SEC_STATS=m
CONFIG_MQ_IOSCHED_SSG_CGROUP=m

# MMC/SD
CONFIG_SEC_MMC_FEATURE=y

# PCIE
CONFIG_SEC_PCIE=y
CONFIG_SEC_PCIE_AER=y
CONFIG_SEC_PCIE_L1SS=y

# DM-Verity
CONFIG_DM_ANDROID_VERITY_AT_MOST_ONCE_DEFAULT_ENABLED=y

# SPU SGIN VERIFY
CONFIG_SPU_VERIFY=m

# PERFORMANCE
CONFIG_PERF_RESERVE=y

# ARGOS
CONFIG_ARGOS=m
CONFIG_ARGOS_VOTING_DDR=y

# Network
CONFIG_INET6_AH=y
CONFIG_IP_NF_MATCH_AH=y
CONFIG_IP_NF_MATCH_RPFILTER=y
CONFIG_TCP_CONG_ADVANCED=y
CONFIG_TCP_CONG_BIC=y
CONFIG_DEFAULT_BIC=y
CONFIG_DEFAULT_TCP_CONG="bic"

# Crypto
CONFIG_CRYPTO_SHA1_ARM64_CE=y
CONFIG_CRYPTO_AES_ARM64=y


CONFIG_SAMSUNG_PRODUCT_SHIP=y


# CONFIG_SEC_FACTORY is not set


# CONFIG_SEC_FACTORY_INTERPOSER is not set
```

## kernel_platform/msm-kernel/arch/arm64/configs/vendor/waipio_sec_eng_defconfig
```kconfig
# Battery driver
CONFIG_ENG_BATTERY_CONCEPT=y

CONFIG_USB_PHY_TUNING_QCOM=y
CONFIG_SEC_DISPLAYPORT_DBG=y
CONFIG_SEC_GPIO_DVS=m
CONFIG_SEC_PCIE_DEV=y
CONFIG_SEC_FORCE_ERR=y
# ABC driver bootc eng option
CONFIG_SEC_ABC_HUB_BOOTC_ENG=m
CONFIG_SEC_CDSP_NO_CRASH_FOR_ENG=y

CONFIG_I2C_CHARDEV=y
```

## kernel_platform/msm-kernel/arch/arm64/configs/vendor/waipio_sec_userdebug_defconfig
```kconfig
CONFIG_USB_PHY_TUNING_QCOM=y
CONFIG_SEC_GPIO_DVS=m
CONFIG_SEC_FORCE_ERR=y

# Battery driver
CONFIG_ENG_BATTERY_CONCEPT=y
```

## kernel_platform/msm-kernel/arch/arm64/configs/vendor/x55_sec_defconfig
```kconfig
#SEC_DEBUG
CONFIG_SOFT_WATCHDOG=m
CONFIG_SEC_KEY_NOTIFIER=m
CONFIG_SEC_CLASS=m
CONFIG_SEC_PARAM=m
CONFIG_SEC_SYSUP=m
CONFIG_SEC_DEBUG=m
CONFIG_SEC_LOG_BUF=m
CONFIG_SEC_REBOOT_CMD=m
CONFIG_SEC_UPLOAD_CAUSE=m
CONFIG_SEC_CRASHKEY=m
CONFIG_SEC_CRASHKEY_LONG=m
CONFIG_SEC_DEBUG_REGION=m
CONFIG_SEC_PMSG=m
CONFIG_SEC_BOOT_STAT=m
CONFIG_SEC_ARM64_AP_CONTEXT=m
CONFIG_SEC_ARM64_FSIMD_DEBUG=m
CONFIG_SEC_QC_DEBUG=m
CONFIG_SEC_QC_PARAM=m
CONFIG_SEC_QC_LOGGER=m
CONFIG_SEC_QC_QCOM_WDT_CORE=m
CONFIG_SEC_QC_RBCMD=m
CONFIG_SEC_QC_QCOM_REBOOT_REASON=m
CONFIG_SEC_QC_UPLOAD_CAUSE=m
CONFIG_SEC_QC_DEBUG_PARTITION=m
CONFIG_SEC_QC_SUMMARY=m
CONFIG_SEC_QC_USER_RESET=m
CONFIG_SEC_QC_SMEM=m
CONFIG_SEC_QC_HW_PARAM=m
CONFIG_SEC_QC_RST_EXINFO=m
CONFIG_SEC_QC_RDX_BOOTDEV=m
CONFIG_SEC_QC_SOC_ID=m

# UFS
CONFIG_SEC_UFS_FEATURE=y
# SD
CONFIG_SEC_MMC_FEATURE=y

# Fingerprint
CONFIG_SENSORS_FINGERPRINT=m
CONFIG_SENSORS_FINGERPRINT_QCOM=y
CONFIG_SENSORS_GW9558X=m
CONFIG_SENSORS_FINGERPRINT_MODULE=y
CONFIG_FINGERPRINT_SECURE=y
CONFIG_SENSORS_FINGERPRINT_NORMALSPI=y

# USB
CONFIG_USB_HOST_NOTIFY=y
CONFIG_USB_NOTIFY_LAYER=m
CONFIG_USB_NOTIFIER=m
CONFIG_USB_EXTERNAL_NOTIFY=y
CONFIG_USB_NOTIFY_EXTCON=y

CONFIG_USB_CONFIGFS_F_SS_MON_GADGET=m
CONFIG_USB_CONFIGFS_F_CONN_GADGET=m

# Block layer modules
CONFIG_MQ_IOSCHED_SSG=m
CONFIG_MQ_IOSCHED_SSG_CGROUP=m
CONFIG_BLK_SEC_STATS=m

#VOLD ASEC
CONFIG_CRYPTO_TWOFISH=m

# Power On Alarm
CONFIG_RTC_AUTO_PWRON=m


CONFIG_SAMSUNG_PRODUCT_SHIP=y


# CONFIG_SEC_FACTORY is not set


# CONFIG_SEC_FACTORY_INTERPOSER is not set
```

## kernel_platform/msm-kernel/drivers/adsp_factory/Kconfig
```kconfig
#
# factory sensor drivers configuration
#
config ADSP_FACTORY
	tristate "MSM ADSP factory driver"
	help
	  This driver communicate with SSC DAEMON.
	  register each sensor device.
	  send selftest request using netlink.
	  receive test result using netlink.

config LSM6DSO_FACTORY
	bool "factory test for SSC - LSM6DSO"
	depends on ADSP_FACTORY
	help
	  lsm6dso factory driver.
	  provide sysfs for factory test.
	  request selftest to adsp_factory.
	  receive test result from adsp_factory.

config LSM6DSL_FACTORY
	bool "factory test for SSC - LSM6DSL"
    depends on ADSP_FACTORY
	help
	  lsm6dsl factory driver.
	  provide sysfs for factory test.
	  request selftest to adsp_factory.
	  receive test result from adsp_factory.

config AK09918_FACTORY
	bool "factory test for SSC - ak09918"
    depends on ADSP_FACTORY
	help
	  ak09918 factory driver.
	  provide sysfs for factory test.
	  request selftest to adsp_factory.
	  receive test result from adsp_factory.

config SUPPORT_MAG_ABS_SUM
	tristate "mag abs sum for SSC"
	depends on AK09918_FACTORY
	help
	  Support the mag abs sum check
	  check the mag abs sum value.

config LPS22HH_FACTORY
	bool "factory test for SSC - lps22hh"
    depends on ADSP_FACTORY
	help
	  lps22hh factory driver.
	  provide sysfs for factory test.
	  request selftest to adsp_factory.
	  receive test result from adsp_factory.

config LIGHT_FACTORY
	bool "factory test for SSC - light"
    depends on ADSP_FACTORY
	help
	  light factory driver.
	  provide sysfs for factory test.
	  request selftest to adsp_factory.
	  receive test result from adsp_factory.

config LIGHT_SUB_FACTORY
	bool "factory test for SSC - light sub"
    depends on ADSP_FACTORY
	help
	  light sub factory driver.
	  provide sysfs for factory test.
	  request selftest to adsp_factory.
	  receive test result from adsp_factory.

config PROX_FACTORY
	bool "factory test for SSC - prox"
    depends on ADSP_FACTORY
	help
	  prox factory driver.
	  provide sysfs for factory test.
	  request selftest to adsp_factory.
	  receive test result from adsp_factory.

config STK33610_FACTORY
	bool "factory test for SSC - STK33610"
	depends on ADSP_FACTORY
	help
	  stk33610 factory driver.
	  provide sysfs for factory test.
	  request selftest through factory daemon to slpi.
	  receive test result through factory daemon from slpi.

config STK33610_SUB_FACTORY
	bool "factory test for SSC - STK33610"
	depends on ADSP_FACTORY
	help
	  stk33610 factory driver.
	  provide sysfs for factory test.
	  request selftest through factory daemon to slpi.
	  receive test result through factory daemon from slpi.

config SUPPORT_LIGHT_CALIBRATION
	bool "light cal for SSC"
    depends on ADSP_FACTORY
	help
	  light calibration feature.
	  provide sysfs for light calibration.
	  request light cal to adsp_factory.
	  receive cal value from adsp_factory.

config SUPPORT_PROX_CALIBRATION
	bool "prox cal for SSC"
    depends on ADSP_FACTORY
	help
	  prox calibration feature.
	  provide sysfs for prox calibration.
	  request prox cal to adsp_factory.
	  receive cal value from adsp_factory.

config SUPPORT_CONTROL_PROX_LED_GPIO
	bool "control prox led gpio for SSC"
	depends on ADSP_FACTORY
	help
	  Support to control prox led gpio.

config SUPPORT_PROX_POWER_ON_CAL
	bool "Sensors support proximity sensor power on cal"
    depends on ADSP_FACTORY
	help
	  Support power on calibration for proximity sensor
	  make calibration process done as the device power up.

config SUPPORT_BRIGHTNESS_NOTIFY_FOR_LIGHT_SENSOR
	bool "Sensors support brightness notify"
    depends on ADSP_FACTORY
	help
	  Support brightness notify for light sensor.
	  receive aor and brightness level from lcd driver.

config SUPPORT_PANEL_STATE_NOTIFY_FOR_LIGHT_SENSOR
	bool "Sensors support panel state notify"
    depends on ADSP_FACTORY
	help
	  Support panel state notify for light sensor.
	  receive  panel state from lcd driver.

config SUPPORT_DDI_COPR_FOR_LIGHT_SENSOR
	bool "Sensors support ddi copr"
    depends on ADSP_FACTORY
	help
	  Support ddi copr for light sensor.
	  provide copr sysfs for factory and afc service.
	  DDI must be connected with sensor core

config SUPPORT_FIFO_DEBUG_FOR_LIGHT_SENSOR
	bool "Sensors support fifo debug"
    depends on ADSP_FACTORY
	help
	  Support fifo debug for light sensor.
	  provide fifo debug msg for light sensor.
	  DDI must be connected with sensor core

config SUPPORT_DUAL_DDI_COPR_FOR_LIGHT_SENSOR
	bool "Sensors support dual ddi copr"
    depends on ADSP_FACTORY
	help
	  Support dual ddi copr for light sensor.
	  provide copr sysfs for factory and afc service.
	  DDI must be connected with sensor core

config SUPPORT_DUAL_6AXIS
	bool "Sensors support dual 6axis"
    depends on ADSP_FACTORY
	help
	  Support the dual accel and gyro function. 
	  provide sysfs for factory test.
	  request selftest to adsp_factory.
	  receive test result from adsp_factory.

config SUPPORT_DUAL_OPTIC
	bool "Sensors support dual optic"
    depends on ADSP_FACTORY
	help
	  Support the dual prox and light function. 
	  provide sysfs for factory test.
	  request selftest to adsp_factory.
	  receive test result from adsp_factory.

config SUPPORT_VIRTUAL_OPTIC
	bool "Sensors support virtual optic"
    depends on ADSP_FACTORY
	help
	  Support the virtual prox and light function. 
	  provide sysfs for factory test.
	  request selftest to adsp_factory.
	  receive test result from adsp_factory.

config SUPPORT_AK09973
	bool "Support ak09973"
    depends on ADSP_FACTORY
	help
	  Support ak09973.

config SUPPORT_DHALL_SWITCH
	bool "Support DHALL_SWITCH"
    depends on ADSP_FACTORY
	help
	  Support ak09973.

config SUPPORT_DEVICE_MODE
	bool "Support device mode"
    depends on ADSP_FACTORY
	help
	  Support device mode.

config SUPPORT_SENSOR_FOLD
	bool "Support fold state by sensor algorithm"
    depends on ADSP_FACTORY
	help
	  Support fold state by sensor algorithm.

config VEML3235_FACTORY
	bool "factory test for SSC - veml3235"
	depends on ADSP_FACTORY
	help
	  veml3235 factory driver.
	  provide sysfs for factory test.
	  request selftest to adsp_factory.
	  receive test result from adsp_factory.

config VEML3235_SUB_FACTORY
	bool "factory test for SSC - veml3235_sub"
	depends on ADSP_FACTORY
	help
	  veml3235_sub factory driver.
	  provide sysfs for factory test.
	  request selftest to adsp_factory.
	  receive test result from adsp_factory.

config VEML3328_FACTORY
	bool "factory test for SSC - veml3328"
	depends on ADSP_FACTORY
	help
	  veml3328 factory driver.
	  provide sysfs for factory test.
	  request selftest to adsp_factory.
	  receive test result from adsp_factory.

config VEML3328_SUB_FACTORY
	bool "factory test for SSC - veml3328_sub"
	depends on ADSP_FACTORY
	help
	  veml3328_sub factory driver.
	  provide sysfs for factory test.
	  request selftest to adsp_factory.
	  receive test result from adsp_factory.

config SUPPORT_LIGHT_SEAMLESS
	bool "Support Light seamless"
    depends on ADSP_FACTORY
	help
	  Support Light seamless.

config FLIP_COVER_DETECTOR_FACTORY
	bool "factory test for SSC - Flip Cover Detector"
	depends on ADSP_FACTORY
	help
	  flip_cover_detector factory driver.
	  provide sysfs for cover status by nfc

config FLIP_COVER_DETECTOR_NOTIFIER
	bool "flip cover detector notifier"
	depends on FLIP_COVER_DETECTOR_FACTORY
	default y
	help
	  Support notifier for flip cover attach/detach events

config SSC_WAKEUP_DEBUG
	bool "debug to ap wakeup due to SSC"
	depends on SENSORS_SSC
	help
	  debug to ap wakeup due to SSC event frequently

config SLPI_LOADING_FAILURE_DEBUG
	bool "debug to slpi loading fail"
	depends on SENSORS_SSC
	help
	  debug to to slpi loading fail
```

## kernel_platform/msm-kernel/drivers/battery/charger/max77705_charger/Kconfig
```kconfig
config CHARGER_DUMMY
	bool "dummy charger driver"
	default n
	depends on BATTERY_SAMSUNG
	help
	  Say Y here to enable
	  support for dummy charger driver.
	  This driver source code implemented
	  skeleton source code for charger functions.

config CHARGER_MAX77705
	tristate "MAX77705 battery charger support"
	depends on BATTERY_SAMSUNG
	help
	  Say Y or M here to enable
	  support for the MAX77705 charger.
	  This includes boost mode.
	  This is Switching Mode Charger.

config MAX77705_CHECK_B2SOVRC
	bool "enable for check B2SOVRC"
	default n
	depends on CHARGER_MAX77705
	help
	  Say Y here to enable
	  support for CHARGER_MAX77705 check B2SCOVRC.
	  MAX77705 onply supports this checking options.
	  this is for MAX77705 monitoring B2SCOVRC.
```

## kernel_platform/msm-kernel/drivers/battery/charger/sm5440_charger/Kconfig
```kconfig
config CHARGER_SM5440
	tristate "SM5440 direct charger support"
	depends on I2C
	help
	  Say Y here to enable support for the SM5440 direct charger.
	  SM5440 is a direct charging IC.
	  SM5440 is dependent on I2C
	  so it needs to be defined.
```

## kernel_platform/msm-kernel/drivers/battery/fuelgauge/max17333_fuelgauge/Kconfig
```kconfig
config FUELGAUGE_MAX17333
	tristate "MAX17333 fuel gauge driver"
	default n
	depends on BATTERY_SAMSUNG
	help
	 Say Y to include support
	 for MAXIM MAX17333 fuel gauge driver.
	 This fuel-gauge can be used in coulomb-counting mode.
```

## kernel_platform/msm-kernel/drivers/battery/limiter/Kconfig
```kconfig
config LIMITER_S2ASL01
	tristate "S2ASL01 limiter support"
	depends on I2C
	help
	  Say Y here to enable support for the S2ASL01 limiter support.
	  S2ASL01 is a limiter IC.
	  S2ASL01 is dependent on I2C
	  so it needs to be defined.
```

## kernel_platform/msm-kernel/drivers/battery/limiter/max17333_limiter/Kconfig
```kconfig
config LIMITER_MAX17333
	tristate "MAX17333 limiter support"
	depends on I2C
	help
	  Say Y here to enable support for the MAX17333 limiter support.
	  MAX17333 is a limiter IC.
	  MAX17333 is dependent on I2C
	  so it needs to be defined.
```

## kernel_platform/msm-kernel/drivers/battery/limiter/max77775_limiter/Kconfig
```kconfig
config LIMITER_MAX77775
	tristate "MAX77775 limiter support"
	depends on I2C
	help
	  Say Y here to enable support for the MAX77775 limiter support.
	  MAX77775 is a limiter IC.
	  MAX77775 is dependent on I2C
	  so it needs to be defined.

config IFPMIC_LIMITER
	bool "support for IFPMIC's limiter feature"
	default n
	depends on DUAL_BATTERY
	help
	  Say Y here to enable
	  support for IFPMIC's limiter feature.
```
