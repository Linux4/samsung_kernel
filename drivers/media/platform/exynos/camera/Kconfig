## drivers/media/platform/exynos/camera/Kconfig
```kconfig
config VIDEO_EXYNOS_PABLO_ISP
	tristate "Exynos Pablo Camera Driver"
	depends on VIDEO_EXYNOS
	default n
	help
	  This is a v4l2 driver for Exynos Pablo IS.

config DISABLE_CAMERA_MEM_ATTR
	bool "Disable memory attr change"
	depends on VIDEO_EXYNOS_PABLO_ISP
	default n

config DISABLE_CAMERA_SIMD
	bool "Disable simd ops"
	depends on VIDEO_EXYNOS_PABLO_ISP
	default n

config PABLO_OBTE_SUPPORT
	tristate "Enable obte driver for Pablo"
	depends on VIDEO_EXYNOS_PABLO_ISP
	default n
	help
	  Enable obte driver for Pablo.

# Chain driver
source "drivers/media/platform/exynos/camera/ischain/Kconfig"
source "drivers/media/platform/exynos/camera/hardware/Kconfig"
source "drivers/media/platform/exynos/camera/vendor/Kconfig"

# Sensor driver
source "drivers/media/platform/exynos/camera/sensor/Kconfig"

config EXYNOS_DEVICE_MIPI_CSIS_VER4
	bool "Use Sensor driver (Sensor Group)"
	depends on USE_SENSOR_GROUP
	depends on VIDEO_EXYNOS_PABLO_ISP
	default n
	help
	  Enable Device MIPI-CSIS S/W Version 4(Including WDMA and Sensor Group)

source "drivers/media/platform/exynos/camera/sensor/csi2/Kconfig"
```

## drivers/media/platform/exynos/camera/csi/Kconfig
```kconfig
config CSIS_V1_2
	bool "Use CSI H/W v1.2"
	depends on PABLO_V8_20_0
	help
	  csi version 1.2

config CSIS_V5_3
	bool "Use CSI H/W v5.3"
	depends on PABLO_V8_1_0 || PABLO_V8_10_0
	help
	  csi version 5.3

config CSIS_V5_4
	bool "Use CSI H/W v5.4"
	depends on PABLO_V9_1_0 || PABLO_V9_10_0 || PABLO_V10_20_0
	help
	  csi version 5.4

config CSIS_V5_4_8
	bool "Use CSI Link H/W v5.4 and DMA HW v8.0 and MCB HW v8.0"
	depends on PABLO_V11_30_0 || PABLO_V11_20_0
	help
	  csi version 5.4.8

config CSIS_V8_0
	bool "Use CSI H/W v8.0"
	depends on PABLO_V10_0_0 || PABLO_V10_1_0
	help
	  csi version 8.0

config CSIS_V8_1
	bool "Use CSI H/W v8.1"
	depends on PABLO_V11_0_0
	help
	  csi version 8.1

config CSIS_V6_0
	bool "Use CSI H/W v8.1"
	depends on PABLO_V12_0_0
	help
	  csi version 6.0
```

## drivers/media/platform/exynos/camera/hardware/Kconfig
```kconfig
config USE_SENSOR_GROUP
	bool "Use sensor group feature"
	depends on VIDEO_EXYNOS_PABLO_ISP
	default y
	help
	  Enalbe sensor group feature.

config CAMERA_PDP
	bool "Use PDP"
	depends on EXYNOS_DEVICE_CAMERA_MODULE
	depends on VIDEO_EXYNOS_PABLO_ISP
	default n
	help
	  Use to build PDP.

config PABLO_HW_HELPER_V1
	bool "HW HELPER V1"
	default n
	help
	  Use HW HELPER V1.

config PABLO_HW_HELPER_V2
	bool "HW HELPER V2"
	default n
	help
	  Use HW HELPER V2.

source "drivers/media/platform/exynos/camera/hardware/api/Kconfig"
```

## drivers/media/platform/exynos/camera/hardware/api/Kconfig
```kconfig
config VRA_V2_0
	bool "Use VRA H/W v2.0"
	depends on PABLO_V8_20_0
	default n
	help
	  use vra v2.0

config CSIS_PDP_TOP_API
	bool "Use CSIS_PDP_TOP H/W API"
	depends on VIDEO_EXYNOS_PABLO_ISP
	default n
	help
	  use CSIS_PDP_TOP H/W API

config CSIS_PDP_TOP_V5_0
        bool "Use CSIS_PDP_TOP H/W v5.0"
	depends on CSIS_PDP_TOP_API && PABLO_V11_0_0
        default n
        help
          use CSIS_PDP_TOP v5.0

config CSIS_PDP_TOP_V6_0
        bool "Use CSIS_PDP_TOP H/W v6.0"
	depends on CSIS_PDP_TOP_API && PABLO_V12_0_0
        default n
        help
          use CSIS_PDP_TOP v6.0

config PDP_V1_0_0
        bool "Use PDP H/W v1.0.0"
	depends on  PABLO_V8_1_0 || PABLO_V8_10_0
        default n
        help
          use PDP v1.0.0

config PDP_V3_1
        bool "Use PDP H/W v3.1"
	depends on PABLO_V9_1_0 || PABLO_V9_10_0 || PABLO_V10_20_0
        default n
        help
          use PDP v3.1

config PDP_V4_1
	bool "Use PDP H/W v4.1"
	depends on PABLO_V10_1_0
	default n
	help
	  use PDP v4.1

config PDP_V4_4
	bool "Use PDP H/W v4.4"
	depends on PABLO_V11_30_0 || PABLO_V11_20_0
	default n
	help
	  use PDP v4.4

config PDP_V5_0
	bool "Use PDP H/W v5.0"
	depends on PABLO_V11_0_0
	default n
	help
	  use PDP v5.0

config PDP_V6_0
	bool "Use PDP H/W v6.0"
	depends on PABLO_V12_0_0
	default n
	help
	  use PDP v6.0

config CSTAT_V1_1
	bool "Use CSTAT H/W v1.1"
	depends on PABLO_V10_1_0
	default n
	help
	 use CSTAT v1.1

config CSTAT_V2_0
	bool "Use CSTAT H/W v2.0"
	depends on PABLO_V11_0_0
	default n
	help
	 use CSTAT v2.0

config CSTAT_V1_20
	bool "Use CSTAT H/W v1.20"
	depends on PABLO_V11_20_0
	default n
	help
	 use CSTAT v1.20

config CSTAT_V1_40
	bool "Use CSTAT H/W v1.40"
	depends on PABLO_V11_30_0
	default n
	help
	 use CSTAT v1.40

config CSTAT_V3_0
	bool "Use CSTAT H/W v3.0"
	depends on PABLO_V12_0_0
	default n
	help
	 use CSTAT v3.0

config YUVPP_V2_1
        bool "Use YUVPP H/W v2.1"
	depends on PABLO_V9_1_0 || PABLO_V9_10_0 || PABLO_V10_20_0
        default n
	help
	  use YUVPP v2.1

config BYRP_V1_1
        bool "Use BYRP H/W v1.1"
	depends on PABLO_V10_1_0
        default n
        help
          use BYRP v1.1

config RGBP_V1_1
        bool "Use RGBP H/W v1.1"
	depends on PABLO_V10_1_0
        default n
        help
          use RGBP v1.1

config LME_V1_1
	bool "Use LME H/W v1.1"
	depends on PABLO_V9_1_0 || PABLO_V9_10_0
	default n
	help
	  use LME v1.1

config LME_V2_1
	bool "Use LME H/W v2.1"
	depends on PABLO_V10_1_0
	default n
	help
	  use LME v2.1

config LME_V2_20
	bool "Use LME H/W v2.20"
	depends on PABLO_V11_30_0 || PABLO_V11_20_0
	default n
	help
	  use LME v2.20

config LME_V3_0
	bool "Use LME H/W v3.0"
	depends on PABLO_V11_0_0 || PABLO_V12_0_0
	default n
	help
	  use LME v3.0

config COMMON_DMA_V1_0
	bool "Use Common DMA"
	depends on PABLO_V8_1_0 || PABLO_V8_10_0 || PABLO_V8_20_0 ||  PABLO_V9_1_0 || PABLO_V9_10_0 || PABLO_V10_1_0 || PABLO_V10_20_0 || PABLO_V11_20_0 || PABLO_V11_30_0
	default n
	help
	  use COMMON DMA

config COMMON_DMA_V2_0
	bool "Use Common DMA V2"
	depends on PABLO_V11_0_0 || PABLO_V12_0_0
	default n
	help
	  use COMMON DMA V2

config MCFP_V10_1
        bool "Use MCFP H/W v10.1"
	depends on PABLO_V10_1_0
        default n
        help
          use MCFP v10.1

config MCFP_V11_0
        bool "Use MCFP H/W v11.0"
	depends on PABLO_V11_0_0 || PABLO_V11_30_0
        default n
        help
          use MCFP v11.0

config MCFP_V11_20
        bool "Use MCFP H/W v11.20"
	depends on PABLO_V11_30_0 || PABLO_V11_20_0
        default n
        help
          use MCFP v11.20

config YUVP_V1_1
        bool "Use YUVP H/W v1.1"
	depends on PABLO_V10_1_0
        default n
        help
          use YUVP v1.1

config TAA_V9_20
        bool "Use TAA H/W v9.20"
	depends on PABLO_V10_20_0
        default n
        help
          use 3AA v9.20

config ORBMCH_V2_1
	bool "Use ORBMCH H/W v2.1"
	depends on PABLO_V10_20_0
	default n
	help
	  use ORBMCH v2.1

config DNS_V1_20
        bool "Use DNS H/W v1.20"
	depends on PABLO_V10_20_0
        default n
        help
          use DNS v1.20

config ITP_V1_20
        bool "Use ITP H/W v1.20"
	depends on PABLO_V10_20_0
        default n
        help
          use ITP v1.0

config MCFP_V10_20
	bool "Use MCFP H/W v10.20"
	depends on PABLO_V10_20_0
	default n
	help
	  use MCFP v10.20

config DLFE_API_V1_0
	bool "Use DLFE H/W API v1.0"
	depends on PABLO_DLFE
	default n
	help
	  use DLFE HW API v1.0
```

## drivers/media/platform/exynos/camera/icpu/Kconfig
```kconfig
config PABLO_ICPU
	tristate "Exynos Pablo ICPU Driver"
	default n
	help
	  This is a ICPU driver for Exynos Pablo IS.

config PABLO_ICPU_HW_V1_0
	tristate "Exynos Pablo ICPU HW V1_0"
	default n
	select PABLO_ICPU
	help
	  This is a hw variant of ICPU.

config PABLO_ICPU_HW_V2_0
	tristate "Exynos Pablo ICPU HW V2_0"
	default n
	select PABLO_ICPU
	help
	  This is a hw variant of ICPU.
```

## drivers/media/platform/exynos/camera/interface/Kconfig
```kconfig
config PABLO_ICPU_ADT_V2
	bool "Use icpu adt v2"
	default n
	help
	  Use icpu adt v2.

config PABLO_SENSOR_ADT
	bool "Use sensor adt"
	default n
	help
	  Use sensor adt.
```

## drivers/media/platform/exynos/camera/ischain/Kconfig
```kconfig
config EXYNOS_PABLO_ISP
	bool "Use Chain driver"
	depends on VIDEO_EXYNOS_PABLO_ISP
	default y
	help
	  This config abstracts driver source folder.

choice
	prompt "Select Pablo HW Version"
	depends on EXYNOS_PABLO_ISP
	help
	  Select Pablo ISP Version.

source "drivers/media/platform/exynos/camera/ischain/is-v7_0_0/Kconfig"
if SOC_EXYNOS9830_EVT0
source "drivers/media/platform/exynos/camera/ischain/is-v8_0_0/Kconfig"
endif
if SOC_EXYNOS9830
source "drivers/media/platform/exynos/camera/ischain/is-v8_1_0/Kconfig"
endif
source "drivers/media/platform/exynos/camera/ischain/is-v8_10_0/Kconfig"
source "drivers/media/platform/exynos/camera/ischain/is-v8_20_0/Kconfig"

endchoice
```

## drivers/media/platform/exynos/camera/lib/votf/Kconfig
```kconfig
menuconfig VIDEO_EXYNOS_PABLO_LIB_VOTF
	tristate "EXYNOS PABLO VOTF Driver"
	default n
	help
		This is a representative exynos camera VOTF device.

# TODO: deprecate CONFIG_VIDEO_EXYNOS_CAMERA_POSTPROCESS_VOTF
menuconfig VIDEO_EXYNOS_CAMERA_POSTPROCESS_VOTF
	tristate "EXYNOS PABLO VOTF Driver"
	default n
	help
		This is a representative exynos camera VOTF device.
```

## drivers/media/platform/exynos/camera/post/vra/Kconfig
```kconfig
menuconfig VIDEO_EXYNOS_CAMERA_POSTPROCESS_VRA
	tristate "EXYNOS CAMERA POSTPROCESS VRA Driver"
	depends on VIDEO_EXYNOS_CAMERA_POSTPROCESS
	default n
	help
		This is a representative exynos CAMERA-PP VRA device.

config CAMERA_PP_VRA_V6_0_0_OBJ
	tristate "use VGA v6.0.0"
	depends on VIDEO_EXYNOS_CAMERA_POSTPROCESS_VRA
	default n
	help
		Use to build VGA v6.0.0 driver
```

## drivers/media/platform/exynos/camera/sensor/Kconfig
```kconfig
config EXYNOS_DEVICE_MIPI_CSIS_VER4
	bool "Use Sensor driver (Sensor Group)"
	depends on USE_SENSOR_GROUP
	depends on VIDEO_EXYNOS_PABLO_ISP
	default n
	help
	  Enable Device MIPI-CSIS S/W Version 4(Including WDMA and Sensor Group)
choice
	prompt "Select CSIS Version"
	depends on EXYNOS_DEVICE_MIPI_CSIS_VER4
	help
	  Select CSIS Version.

	source "drivers/media/platform/exynos/camera/sensor/csi2/Kconfig"

endchoice

config EXYNOS_DEVICE_CAMERA_MODULE
	bool "Use Camera modules"
	depends on VIDEO_EXYNOS_PABLO_ISP
	default y
	help
	  Select camera module.

source "drivers/media/platform/exynos/camera/sensor/module_framework/Kconfig"
```
