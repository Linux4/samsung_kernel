## drivers/media/platform/exynos/camera/sensor/module_framework/cis/Kconfig
```kconfig
menuconfig CAMERA_CIS_SELECT
	bool "CIS select"
	depends on EXYNOS_DEVICE_CAMERA_MODULE
	help
	  Say Y here to enable support for platform-specific V4L drivers.

config CAMERA_CIS_6B2_OBJ
        bool "Use 6B2 camera cis"
	depends on CAMERA_CIS_SELECT
        default n
        help
          Use to build 6B2 camera sensor.

config CAMERA_CIS_5E2_OBJ
        bool "Use 5E2 camera cis"
	depends on CAMERA_CIS_SELECT
        default n
        help
          Use to build 5E2 camera sensor.

config CAMERA_CIS_5E3_OBJ
        bool "Use 5E3 camera cis"
	depends on CAMERA_CIS_SELECT
        default n
        help
          Use to build 5E3 camera sensor.

config CAMERA_CIS_4H5YC_OBJ
        bool "Use 4H5YC camera cis"
	depends on CAMERA_CIS_SELECT
        default n
        help
          Use to build 4H5YC camera sensor.

config CAMERA_CIS_4H5_OBJ
        bool "Use 4H5 camera cis"
	depends on CAMERA_CIS_SELECT
        default n
        help
          Use to build 4H5 camera sensor.

config CAMERA_CIS_2P2_OBJ
		bool "Use 2P2 camera cis"
	depends on CAMERA_CIS_SELECT
		default n
		help
		  Use to build 2P2 camera sensor.

config CAMERA_CIS_2P6_OBJ
		bool "Use 2P6 camera cis"
	depends on CAMERA_CIS_SELECT
		default n
		help
		  Use to build 2P6 camera sensor.

config CAMERA_CIS_2P8_OBJ
		bool "Use 2P8 camera cis"
	depends on CAMERA_CIS_SELECT
		default n
		help
		  Use to build 2P8 camera sensor.

config CAMERA_CIS_2X5_OBJ
	bool "Use 2X5 camera cis"
	depends on CAMERA_CIS_SELECT
	default n
	help
	  Use to build 2X5 camera sensor.

config CAMERA_CIS_3P3_OBJ
		bool "Use 3P3 camera cis"
	depends on CAMERA_CIS_SELECT
		default n
		help
		  Use to build 3P3 camera sensor.

config CAMERA_CIS_3L2_OBJ
		bool "Use 3L2 camera cis"
	depends on CAMERA_CIS_SELECT
		default n
		help
		  Use to build 3L2 camera sensor.

config CAMERA_CIS_3L6_OBJ
		bool "Use 3L6 camera cis"
	depends on CAMERA_CIS_SELECT
		default n
		help
		  Use to build 3L6 camera sensor.

config CAMERA_CIS_3H1_OBJ
		bool "Use 3H1 camera cis"
	depends on CAMERA_CIS_SELECT
		default n
		help
		  Use to build 3H1 camera sensor.

config CAMERA_CIS_3H1_C3_OBJ
		bool "Use 3H1 camera cis for companion"
	depends on CAMERA_CIS_SELECT
		default n
		help
		  Use to build 3H1 camera sensor.

config CAMERA_CIS_3J1_OBJ
		bool "Use 3J1 camera cis"
	depends on CAMERA_CIS_SELECT
		default n
		help
		  Use to build 3J1 camera sensor.

config CAMERA_CIS_4E6_OBJ
		bool "Use 4E6 camera cis"
	depends on CAMERA_CIS_SELECT
		default n
		help
		  Use to build 4E6 camera sensor.

config CAMERA_CIS_5E6_OBJ
		bool "Use 5E6 camera cis"
	depends on CAMERA_CIS_SELECT
		default n
		help
		  Use to build 5E6 camera sensor.

config CAMERA_CIS_5F1_OBJ
		bool "Use 5F1 camera cis"
	depends on CAMERA_CIS_SELECT
		default n
		help
		  Use to build 5F1 camera sensor.

config CAMERA_CIS_3M2_OBJ
		bool "Use 3M2 camera cis"
	depends on CAMERA_CIS_SELECT
		default n
		help
		  Use to build 3M2 camera sensor.

config CAMERA_CIS_3M3_OBJ
		bool "Use 3M3 camera cis"
	depends on CAMERA_CIS_SELECT
		default n
		help
		  Use to build 3M3 camera sensor.

config CAMERA_CIS_3M5_OBJ
		bool "Use 3M5 camera cis"
	depends on CAMERA_CIS_SELECT
		default n
		help
		  Use to build 3M5 camera sensor.

config CAMERA_CIS_GH1_OBJ
		bool "Use GH1 camera cis"
	depends on CAMERA_CIS_SELECT
		default n
		help
		  Use to build GH1 camera sensor.

config CAMERA_CIS_GW2_OBJ
		bool "Use GW2 camera cis"
	depends on CAMERA_CIS_SELECT
		default n
		help
		  Use to build GW2 camera sensor.

config CAMERA_CIS_2L1_OBJ
		bool "Use 2L1 camera cis"
	depends on CAMERA_CIS_SELECT
		default n
		help
		  Use to build 2L1 camera sensor.

config CAMERA_CIS_3P8_OBJ
		bool "Use 3P8 camera cis"
	depends on CAMERA_CIS_SELECT
		default n
		help
		  Use to build 3P8 camera sensor.

config CAMERA_CIS_3P9_OBJ
		bool "Use 3P9 camera cis"
	depends on CAMERA_CIS_SELECT
		default n
		help
		  Use to build 3P9 camera sensor.

config CAMERA_CIS_3P8SP_OBJ
		bool "Use 3P8SP camera cis"
	depends on CAMERA_CIS_SELECT
		default n
		help
		  Use to build 3P8SP camera sensor.

config CAMERA_CIS_2P7SX_OBJ
		bool "Use 2P7SX camera cis"
	depends on CAMERA_CIS_SELECT
		default n
		help
		  Use to build 2P7SX camera sensor.

config CAMERA_CIS_RPB_OBJ
		bool "Use RPB camera cis"
	depends on CAMERA_CIS_SELECT
		default n
		help
		  Use to build RPB camera sensor.

config CAMERA_CIS_2P7SQ_OBJ
		bool "Use 2P7SQ camera cis"
	depends on CAMERA_CIS_SELECT
		default n
		help
		  Use to build 2P7SQ camera sensor.

config CAMERA_CIS_2T7SX_OBJ
		bool "Use 2T7SX camera cis"
	depends on CAMERA_CIS_SELECT
		default n
		help
		  Use to build 2T7SX camera sensor.

config CAMERA_CIS_2L2_OBJ
		bool "Use 2L2 camera cis"
	depends on CAMERA_CIS_SELECT
		default n
		help
		  Use to build 2L2 camera sensor.

config CAMERA_CIS_2L3_OBJ
		bool "Use 2L3 camera cis"
	depends on CAMERA_CIS_SELECT
		default n
		help
		  Use to build 2L3 camera sensor.

config CAMERA_CIS_2L4_OBJ
		bool "Use 2L4 camera cis"
	depends on CAMERA_CIS_SELECT
		default n
		help
		  Use to build 2L4 camera sensor.

config CAMERA_CIS_2LA_OBJ
		bool "Use 2LA camera cis"
	depends on CAMERA_CIS_SELECT
		default n
		help
		  Use to build 2LA camera sensor.

config CAMERA_CIS_2LD_OBJ
		bool "Use 2LD camera cis"
	depends on CAMERA_CIS_SELECT
		default n
		help
		  Use to build 2LD camera sensor.

config CAMERA_CIS_HM1_OBJ
		bool "Use HM1 camera cis"
	depends on CAMERA_CIS_SELECT
		default n
		help
		  Use to build HM1 camera sensor.

config CAMERA_CIS_IMX260_OBJ
		bool "Use IMX260 camera cis"
	depends on CAMERA_CIS_SELECT
		default n
		help
		  Use to build IMX260 camera sensor.

config CAMERA_CIS_IMX333_OBJ
		bool "Use IMX333 camera cis"
	depends on CAMERA_CIS_SELECT
		default n
		help
		  Use to build IMX333 camera sensor.

config CAMERA_CIS_2L7_OBJ
		bool "Use 2L7 camera cis"
	depends on CAMERA_CIS_SELECT
		default n
		help
		  Use to build 2L7 camera sensor.

config CAMERA_CIS_IMX320_OBJ
		bool "Use IMX320 camera cis"
	depends on CAMERA_CIS_SELECT
		default n
		help
		  Use to build IMX320 camera sensor.

config CAMERA_CIS_IMX320_C3_OBJ
		bool "Use IMX320_C3 camera cis"
	depends on CAMERA_CIS_SELECT
		default n
		help
		  Use to build IMX320_C3 camera sensor.

config CAMERA_CIS_IMX219_OBJ
		bool "Use IMX219 camera cis"
	depends on CAMERA_CIS_SELECT
		default n
		help
		  Use to build IMX219 camera sensor.

config CAMERA_CIS_IMX258_OBJ
		bool "Use IMX258 camera cis"
	depends on CAMERA_CIS_SELECT
		default n
		help
		  Use to build IMX258 camera sensor.

config CAMERA_CIS_IMX241_OBJ
		bool "Use IMX241 camera cis"
	depends on CAMERA_CIS_SELECT
		default n
		help
		  Use to build IMX241 camera sensor.

config CAMERA_CIS_SR259_OBJ
		bool "Use SR259 camera cis"
	depends on CAMERA_CIS_SELECT
		default n
		help
		  Use to build SR259 camera sensor.

config CAMERA_CIS_4HA_OBJ
		bool "Use 4HA camera cis"
	depends on CAMERA_CIS_SELECT
		default n
		help
		  Use to build 4HA camera sensor.

config CAMERA_CIS_IMX576_OBJ
		bool "Use IMX576 camera cis"
	depends on CAMERA_CIS_SELECT
		default n
		help
		  Use to build IMX576 camera sensor.

config CAMERA_CIS_IMX316_OBJ
		bool "Use IMX316 camera cis"
	depends on CAMERA_CIS_SELECT
		default n
		help
		  Use to build IMX316 camera sensor.

config CAMERA_CIS_IMX516_OBJ
		bool "Use IMX516 camera cis"
	depends on CAMERA_CIS_SELECT
		default n
		help
		  Use to build IMX516 camera sensor.

config CAMERA_CIS_IMX518_OBJ
		bool "Use IMX518 camera cis"
	depends on CAMERA_CIS_SELECT
		default n
		help
		  Use to build IMX518 camera sensor.

config CAMERA_CIS_5E9_OBJ
		bool "Use S5K5E9 camera cis"
	depends on CAMERA_CIS_SELECT
		default n
		help
		  Use to build S5K5E9 camera sensor.

config CAMERA_CIS_GC5035_OBJ
	bool "Use GC5035 camera cis"
	depends on CAMERA_CIS_SELECT
	default n
	help
	  Use to build GC5035 camera sensor.


config CAMERA_CIS_GM1SP_OBJ
		bool "Use GM1SP camera cis"
	depends on CAMERA_CIS_SELECT
		default n
		help
		  Use to build GM1SP camera sensor.

config CAMERA_CIS_VIRTUAL_OBJ
		bool "Use VIRTUAL camera cis"
	depends on CAMERA_CIS_SELECT
		default n
		help
		  Use to build VIRTUAL camera sensor.

config CAMERA_CIS_IMX582_OBJ
	bool "Use IMX582 camera cis"
	depends on CAMERA_CIS_SELECT
	default n
	help
	  Use to build IMX582 camera sensor.

config CAMERA_CIS_IMX616_OBJ
	bool "Use IMX616 camera cis"
	depends on CAMERA_CIS_SELECT
	default n
	help
	  Use to build IMX616 camera sensor.

config CAMERA_CIS_IMX586_OBJ
	bool "Use IMX586 camera cis"
	depends on CAMERA_CIS_SELECT
	default n
	help
	  Use to build IMX586 camera sensor.

config CAMERA_CIS_GD1_OBJ
	bool "Use GD1 camera cis"
	depends on CAMERA_CIS_SELECT
	default n
	help
	  Use to build GD1 camera sensor.

config CAMERA_CIS_HI847_OBJ
	bool "Use HI847 camera cis"
	depends on CAMERA_CIS_SELECT
	default n
	help
	  Use to build HI847 camera sensor.
```

## drivers/media/platform/exynos/camera/sensor/module_framework/laser_af/Kconfig
```kconfig
config CAMERA_LASER_AF_VL53L5_OBJ
	bool "Use VL53L5"
	depends on EXYNOS_DEVICE_CAMERA_MODULE
	default n
	help
	  Use to build VL53L5 driver.
```

## drivers/media/platform/exynos/camera/vendor/Kconfig
```kconfig
#menu depth2
menu "Vendor Feature Setting"
	depends on EXYNOS_PABLO_ISP

choice
	prompt "Use vender features"
	depends on EXYNOS_PABLO_ISP
	default VENDER_DEFAULT
	help
	  Use the vender specific features.

config VENDER_DEFAULT
        bool "Default"
config VENDER_MCD
        bool "MCD"
config VENDER_MCD_V2
        bool "MCD_V2"
endchoice

source "drivers/media/platform/exynos/camera/vendor/default/Kconfig"
source "drivers/media/platform/exynos/camera/vendor/mcd/Kconfig"
source "drivers/media/platform/exynos/camera/vendor/mcd_v2/Kconfig"
endmenu
```

## drivers/media/platform/exynos/camera/vendor/mcd_v2/Kconfig
```kconfig
config CAMERA_EEPROM_SUPPORT_REAR
        tristate "Enable eeprom for rear cam"
        depends on CAMERA_VENDER_MCD_V2
        default n
        help
          Enable eeprom for rear cam.
config CAMERA_OTPROM_SUPPORT_REAR
        tristate "Enable otprom for rear cam"
        depends on CAMERA_VENDER_MCD_V2
        default n
        help
          Enable otprom for rear cam.
config SENSOR_RETENTION_USE
        bool "Use sensor retention"
        depends on CAMERA_VENDER_MCD_V2
        default n
        help
          Use sensor retention.
config OIS_USE
        bool "Use ois"
        depends on CAMERA_VENDER_MCD_V2
        default n
        help
          Use ois.
config OIS_FW_UPDATE_THREAD_USE
        bool "Enable ois fw update thread"
        depends on OIS_USE
        default n
        help
          Enable ois fw update thread.
config AF_HOST_CONTROL
        bool "Enable host af control"
        depends on CAMERA_VENDER_MCD_V2
        default n
        help
          Enable host af control.
config IS_DDK_DATA_LOAD
        bool "Enable signed binary processing."
        depends on CAMERA_VENDER_MCD_V2
        default n
        help
          Enable signed binary processing.
config TORCH_CURRENT_CHANGE_SUPPORT
        bool "Change torch current in recording mode"
        depends on CAMERA_VENDER_MCD_V2
        default n
        help
          Change torch current in recording mode.
config CAMERA_USE_INTERNAL_MCU
        bool "Use internal MCU for OIS"
        depends on CAMERA_VENDER_MCD_V2
        default n
        help
          Use internal MCU for OIS
config CAMERA_USE_MCU
        bool "Use Camera mcu"
        depends on CAMERA_VENDER_MCD_V2
        default n
        help
          Use Camera mcu
config CAMERA_AAW_A54X
        bool "This camera is aaw_v54x"
        depends on CAMERA_VENDER_MCD_V2
        default n
        help
         This camera is aaw_v54x
config CAMERA_AAX_A35X
        bool "This camera is aax_v35x"
        depends on CAMERA_VENDER_MCD_V2
        default n
        help
         This camera is aax_v35x
config CAMERA_MMW_M54X
        bool "This camera is mmw_v54x"
        depends on CAMERA_VENDER_MCD_V2
        default n
        help
         This camera is mmw_v54x
config CAMERA_STW_V60
        bool "This camera is stw_v60"
        depends on CAMERA_VENDER_MCD_V2
        default n
        help
         This camera is stw_v60
config CAMERA_STW_V50
        bool "This camera is stw_v50"
        depends on CAMERA_VENDER_MCD_V2
        default n
        help
         This camera is stw_v50
config CAMERA_ATW_V05
        bool "This camera is atw_v05"
        depends on CAMERA_VENDER_MCD_V2
        default n
        help
         This camera is atw_v05
config CAMERA_MMX_M35X
        bool "This camera is mmx_v35x"
        depends on CAMERA_VENDER_MCD_V2
        default n
        help
         This camera is mmx_v35x
```
