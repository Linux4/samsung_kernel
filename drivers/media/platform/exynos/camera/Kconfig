## drivers/media/platform/exynos/fimc-is/Kconfig
```kconfig
config VIDEO_EXYNOS_FIMC_IS
        bool "Exynos FIMC-IS (Image Subsystem) driver"
        depends on VIDEO_EXYNOS
        select MEDIA_EXYNOS
        select USE_VENDER_FEATURE
        default n
        help
          This is a v4l2 driver for exynos FIMC-IS device.
config CAMERA_EEPROM_SUPPORT_REAR
        bool "Enable eeprom for rear cam"
        depends on VIDEO_EXYNOS_FIMC_IS
        default n
        help
          Enable eeprom for rear cam.
config CAMERA_EEPROM_SUPPORT_FRONT
        bool "Enable eeprom for front cam"
        depends on VIDEO_EXYNOS_FIMC_IS
        default n
        help
          Enable eeprom for front cam.
config COMPANION_USE
        bool "Enable to companion"
        depends on VIDEO_EXYNOS_FIMC_IS
        default n
        help
          Enable to companion.
config OIS_USE
        bool "Enable to ois"
        depends on VIDEO_EXYNOS_FIMC_IS
        default n
        help
          Enable to ois.
config OIS_FW_UPDATE_THREAD_USE
        bool "Enable to ois fw update thread"
        depends on OIS_USE
        default n
        help
          Enable to ois fw update thread.
config AF_HOST_CONTROL
        bool "Enable to af control"
        depends on VIDEO_EXYNOS_FIMC_IS
        default n
        help
          Enable to af control.
config USE_VENDER_FEATURE
        bool "Use vendor specific features"
        depends on VIDEO_EXYNOS_FIMC_IS
        default n
        help
          Enable to use the vender.
config CAMERA_SENSOR_8B1
        bool "Use 8B1 camera sensor"
        depends on VIDEO_EXYNOS_FIMC_IS
        default n
        help
          Use 8B1 camera sensor.
config CAMERA_SENSOR_6D1
        bool "Use 6D1 camera sensor"
        depends on VIDEO_EXYNOS_FIMC_IS
        default n
        help
          Use 6D1 camera sensor.
config CAMERA_SENSOR_8B1_OBJ
        bool "Use 8B1 camera sensor"
        depends on VIDEO_EXYNOS_FIMC_IS
        default n
        help
          Use to build 8B1 camera sensor.
config CAMERA_SENSOR_6D1_OBJ
        bool "Use 6D1 camera sensor"
        depends on VIDEO_EXYNOS_FIMC_IS
        default n
        help
          Use to build 6D1 camera sensor.
config CAMERA_SENSOR_6B2_OBJ
        bool "Use 6B2 camera sensor"
        depends on VIDEO_EXYNOS_FIMC_IS
        default n
        help
          Use to build 6B2 camera sensor.
config CAMERA_SENSOR_6A3_OBJ
        bool "Use 6A3 camera sensor"
        depends on VIDEO_EXYNOS_FIMC_IS
        default n
        help
          Use to build 6A3 camera sensor.
config CAMERA_SENSOR_IMX135_OBJ
        bool "Use IMX135 camera sensor"
        depends on VIDEO_EXYNOS_FIMC_IS
        default n
        help
          Use to build IMX135 camera sensor.
config CAMERA_SENSOR_IMX134_OBJ
        bool "Use IMX134 camera sensor"
        depends on VIDEO_EXYNOS_FIMC_IS
        default n
        help
          Use to build IMX134 camera sensor.
config CAMERA_SENSOR_3L2_OBJ
        bool "Use 3L2 camera sensor"
        depends on VIDEO_EXYNOS_FIMC_IS
        default n
        help
          Use to build 3L2 camera sensor.
config CAMERA_SENSOR_2P2_OBJ
        bool "Use 2P2 camera sensor"
        depends on VIDEO_EXYNOS_FIMC_IS
        default n
        help
          Use to build 2P2 camera sensor.
config CAMERA_SENSOR_2P2_12M_OBJ
        bool "Use 2P2_12M camera sensor"
        depends on VIDEO_EXYNOS_FIMC_IS
        default n
        help
          Use to build 2P2_12M camera sensor.
config CAMERA_SENSOR_2P3_OBJ
        bool "Use 2P3 camera sensor"
        depends on VIDEO_EXYNOS_FIMC_IS
        default n
        help
          Use to build 2P3 camera sensor.
config CAMERA_SENSOR_3H5_OBJ
        bool "Use 3H5 camera sensor"
        depends on VIDEO_EXYNOS_FIMC_IS
        default n
        help
          Use to build 3H5 camera sensor.
config CAMERA_SENSOR_3H7_OBJ
        bool "Use 3H7 camera sensor"
        depends on VIDEO_EXYNOS_FIMC_IS
        default n
        help
          Use to build 3H7 camera sensor.
config CAMERA_SENSOR_3H7_SUNNY_OBJ
        bool "Use 3H7_SUNNY camera sensor"
        depends on VIDEO_EXYNOS_FIMC_IS
        default n
        help
          Use to build 3H7_SUNNY camera sensor.
config CAMERA_SENSOR_4E5_OBJ
        bool "Use 4E5 camera sensor"
        depends on VIDEO_EXYNOS_FIMC_IS
        default n
        help
          Use to build 4E5 camera sensor.
config CAMERA_SENSOR_IMX175_OBJ
        bool "Use IMX175 camera sensor"
        depends on VIDEO_EXYNOS_FIMC_IS
        default n
        help
          Use to build IMX175 camera sensor.
config CAMERA_SENSOR_IMX219_OBJ
        bool "Use IMX219 camera sensor"
        depends on VIDEO_EXYNOS_FIMC_IS
        default n
        help
          Use to build IMX219 camera sensor.
config CAMERA_SENSOR_IMX240_OBJ
        bool "Use IMX240 camera sensor"
        depends on VIDEO_EXYNOS_FIMC_IS
        default n
        help
          Use to build IMX240 camera sensor.
config CAMERA_SENSOR_4H5_OBJ
        bool "Use 4H5 camera sensor"
        depends on VIDEO_EXYNOS_FIMC_IS
        default n
        help
          Use to build 4H5 camera sensor.
config CAMERA_SENSOR_SR261_OBJ
        bool "Use SR261 camera sensor"
        depends on VIDEO_EXYNOS_FIMC_IS
        default n
        help
          Use to build SR261 camera sensor.
config CAMERA_SENSOR_TEMP
        bool "camera sensor temp"
        depends on VIDEO_EXYNOS_FIMC_IS
        default n
        help
          Use to build camera sensor temp.
config CAMERA_ONLY_SUPPORT_FRONT
        bool "Support only front camera temporarilly"
        depends on VIDEO_EXYNOS_FIMC_IS
        default n
        help
          Use to support only front camera temporarilly.
          This config should be removed after bring-up.
```

## drivers/media/platform/exynos/fimc-is/sensor/Kconfig
```kconfig
source "drivers/media/platform/exynos/fimc-is/sensor/module/Kconfig"
source "drivers/media/platform/exynos/fimc-is/sensor/csi/Kconfig"
```

## drivers/media/platform/exynos/fimc-is/vendor/Kconfig
```kconfig
config CAMERA_EEPROM_SUPPORT_REAR
        bool "Enable eeprom for rear cam"
        depends on VIDEO_EXYNOS_FIMC_IS
        default n
        help
          Enable eeprom for rear cam.
config CAMERA_EEPROM_SUPPORT_FRONT
        bool "Enable eeprom for front cam"
        depends on VIDEO_EXYNOS_FIMC_IS
        default n
        help
          Enable eeprom for front cam.
config COMPANION_USE
        bool "Use companion"
        depends on VIDEO_EXYNOS_FIMC_IS
        default n
        help
          Use companion.
 config COMPANION_C1_USE
        bool "Use companion C1"
        depends on COMPANION_USE
        default n
        help
          Use companion C1.
 config COMPANION_C2_USE
        bool "Use companion C2"
        depends on COMPANION_USE
        default n
        help
          Use companion C2.
config COMPANION_DCDC_USE
        bool "Use companion DCDC regulator"
        depends on COMPANION_USE
        default n
        help
          Use companion DCDC regulator.
config COMPANION_STANDBY_USE
        bool "Use companion standby"
        depends on COMPANION_USE
        default n
        help
          Use companion standby.
config OIS_USE
        bool "Use ois"
        depends on VIDEO_EXYNOS_FIMC_IS
        default n
        help
          Use ois.
config OIS_FW_UPDATE_THREAD_USE
        bool "Enable ois fw update thread"
        depends on OIS_USE
        default n
        help
          Enable ois fw update thread.
config AF_HOST_CONTROL
        bool "Enable host af control"
        depends on VIDEO_EXYNOS_FIMC_IS
        default n
        help
          Enable host af control.
config CAMERA_SYSFS_V2
        bool "Enable to sysfs v2"
        depends on VIDEO_EXYNOS_FIMC_IS
        default n
        help
          Enable to sysfs v2.
config CAMERA_ACTUATOR_DW9807
        bool "Use DW9807 camera actuator and eeprom"
        depends on VIDEO_EXYNOS_FIMC_IS
        default n
        help
          Use DW9807 camera actuator and eeprom.
config CAMERA_SENSOR_TEMP
        bool "camera sensor temp"
        depends on VIDEO_EXYNOS_FIMC_IS
        default n
        help
          Use to build camera sensor temp.
config CAMERA_ONLY_SUPPORT_FRONT
        bool "Support only front camera temporarilly"
        depends on VIDEO_EXYNOS_FIMC_IS
        default n
        help
          Use to support only front camera temporarilly.
          This config should be removed after bring-up.
config CAMERA_SENSOR_TIMEOUT_COUNT
        int "set camera sensor timeout count"
        depends on VIDEO_EXYNOS_FIMC_IS
        default 0
        help
          set camera sensor timeout count.
config CAMERA_SUPPORT_MULTI_EEPROM
        bool "Enable for support multi eeprom"
        depends on VIDEO_EXYNOS_FIMC_IS
        default n
        help
          Enable for support multi eeprom.
config CAMERA_VARIABLE_MIPI_LANES
        bool "Enable for support variable MIPI lanes"
        depends on VIDEO_EXYNOS_FIMC_IS
        default n
        help
          Enable for support variable MIPI lanes.
config CAMERA_TBE
        bool "This camera is TBE Project"
        depends on VIDEO_EXYNOS_FIMC_IS
        default n
        help
          This camera is TBE Project.
config CAMERA_TRE
        bool "This camera is TRE Project"
        depends on VIDEO_EXYNOS_FIMC_IS
        default n
        help
          This camera is TRE Project.
config CAMERA_TR
        bool "This camera is TR Project"
        depends on VIDEO_EXYNOS_FIMC_IS
        default n
        help
          This camera is TR Project.
config CAMERA_GTS2
        bool "This camera is GTS2 Project"
        depends on VIDEO_EXYNOS_FIMC_IS
        default n
        help
          This camera is GTS2 Project.
config CAMERA_ALPHA
        bool "This camera is ALPHA Project"
        depends on VIDEO_EXYNOS_FIMC_IS
        default n
        help
          This camera is ALPHA Project.
config CAMERA_CHAGALLHLTE
        bool "This camera is CHAGALLHLTE Project"
        depends on VIDEO_EXYNOS_FIMC_IS
        default n
        help
          This camera is CHAGALLHLTE Project.
config CAMERA_A7
        bool "This camera is A7 Project"
        depends on VIDEO_EXYNOS_FIMC_IS
        default n
        help
          This camera is A7 Project.
config CAMERA_A8
        bool "This camera is A8 Project"
        depends on VIDEO_EXYNOS_FIMC_IS
        default n
        help
          This camera is A8 Project.
```

## drivers/media/platform/exynos/fimc-is2/Kconfig
```kconfig
config VIDEO_EXYNOS_FIMC_IS
	bool "Exynos FIMC-IS2 (Image Subsystem) driver"
	depends on VIDEO_EXYNOS
	select MEDIA_EXYNOS
	select USE_VENDER_FEATURE if SEC_DEBUG
	default n
	help
	  This is a v4l2 driver for exynos FIMC-IS device.
config USE_VENDER_FEATURE
	bool "Use vendor specific features"
        depends on VIDEO_EXYNOS_FIMC_IS
	default n
	help
          Use the vender specfic features.

config ENABLE_HAL3_2_META_INTERFACE
	bool "Use HAL 3_2 Meta interface"
        depends on VIDEO_EXYNOS_FIMC_IS
	default n
	help
          Use the unified meta in 3.2 and 1.0 HAL.

config TORCH_CURRENT_CHANGE_SUPPORT
	bool "Change torch current in recording mode"
        depends on USE_VENDER_FEATURE
	default n
	help
          Change torch current in recording mode.

config INIT_TORCH_CURRENT_SUPPORT
	bool "Set Torch Current Value in init"
        depends on USE_VENDER_FEATURE
	default n
	help
          Set Torch Current Value in init.

source "drivers/media/platform/exynos/fimc-is2/sensor/Kconfig"
source "drivers/media/platform/exynos/fimc-is2/ischain/Kconfig"
source "drivers/media/platform/exynos/fimc-is2/vendor/Kconfig"
```

## drivers/media/platform/exynos/fimc-is2/ischain/Kconfig
```kconfig
source "drivers/media/platform/exynos/fimc-is2/ischain/fimc-is-v4_0_0/Kconfig"
source "drivers/media/platform/exynos/fimc-is2/ischain/fimc-is-v3_1_1/Kconfig"
source "drivers/media/platform/exynos/fimc-is2/ischain/fimc-is-v3_10_0/Kconfig"
```

## drivers/media/platform/exynos/fimc-is2/ischain/fimc-is-v3_10_0/Kconfig
```kconfig
config FIMC_IS_V3_10_0
	bool "Use fimc-is v3.10.0"
	depends on VIDEO_EXYNOS_FIMC_IS
	default n
	help
	  fimc-is version 3.10.0
```

## drivers/media/platform/exynos/fimc-is2/ischain/fimc-is-v4_3_0/Kconfig
```kconfig
config FIMC_IS_V4_3_0
	bool "Use fimc-is v4.3.0"
	depends on SOC_EXYNOS8890
	select EXYNOS_DEVICE_MIPI_CSIS_VER2
	select CSIS_V4_1
	select EXYNOS_FIMC_BNS
	select FIMC_BNS_V4_20_0
	select USE_HW_API_COMMON
	help
	  fimc-is version 4.3.0
```

## drivers/media/platform/exynos/fimc-is2/sensor/Kconfig
```kconfig
source "drivers/media/platform/exynos/fimc-is2/sensor/module/Kconfig"
source "drivers/media/platform/exynos/fimc-is2/sensor/csi/Kconfig"
source "drivers/media/platform/exynos/fimc-is2/sensor/module_framework/Kconfig"
source "drivers/media/platform/exynos/fimc-is2/sensor/module_framework/cis/Kconfig"
source "drivers/media/platform/exynos/fimc-is2/sensor/module_framework/actuator/Kconfig"
source "drivers/media/platform/exynos/fimc-is2/sensor/module_framework/flash/Kconfig"
source "drivers/media/platform/exynos/fimc-is2/sensor/module_framework/dphy/Kconfig"
```
