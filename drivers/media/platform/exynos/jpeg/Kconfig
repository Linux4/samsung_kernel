## drivers/media/platform/msm/camera_v2/Kconfig
```kconfig
config MSM_CAMERA_SENSOR
	    bool "Qualcomm MSM camera sensor support"
	    depends on MSMB_CAMERA
	    select NEW_LEDS
	    select LEDS_CLASS
        ---help---
          This flag enables support for Camera Sensor.
          The sensor driver is capable of providing real time
          data for camera support. The driver support V4L2
          subdev APIs.

config MSM_CPP
        bool "Qualcomm MSM Camera Post Processing Engine support"
        depends on MSMB_CAMERA
        ---help---
          Enable support for Camera Post-processing Engine
          The Post processing engine is capable of scaling
          and cropping image. The driver support V4L2 subdev
          APIs.

config MSM_CCI
        bool "Qualcomm MSM Camera Control Interface support"
        depends on MSMB_CAMERA
        ---help---
          Enable support for Camera Control Interface driver only
          for those platforms that have hardware support. This driver
          is responsible for handling I2C read and write on the I2C
          bus. It is also responsible for synchronization with
          GPIO and data frames.

config MSM_CSI20_HEADER
        bool "Qualcomm MSM CSI 2.0 Header"
        depends on MSMB_CAMERA
        ---help---
          Enable support for CSI drivers to include 2.0
          header. This header has register macros and its
          values and bit mask for register configuration bits
          This config macro is required targets based on 8960,
          8930 and 8064 platforms.

config MSM_CSI22_HEADER
        bool "Qualcomm MSM CSI 2.2 Header"
        depends on MSMB_CAMERA
        ---help---
          Enable support for CSI drivers to include 2.2
          header. This header has register macros and its
          values and bit mask for register configuration bits
          This config macro is required targets based on 8610
          platform.

config MSM_CSI30_HEADER
        bool "Qualcomm MSM CSI 3.0 Header"
        depends on MSMB_CAMERA
        ---help---
          Enable support for CSI drivers to include 3.0
          header. This header has register macros and its
          values and bit mask for register configuration bits
          This config macro is required for targets based on
          8064 platforms.

config MSM_CSI31_HEADER
        bool "Qualcomm MSM CSI 3.1 Header"
        depends on MSMB_CAMERA
        ---help---
          Enable support for CSI drivers to include 3.0
          header. This header has register macros and its
          values and bit mask for register configuration bits
          This config macro is required for targets based on
          APQ8084 platform.

config MSM_CSIPHY
        bool "Qualcomm MSM Camera Serial Interface Physical receiver support"
        depends on MSMB_CAMERA
        ---help---
          Enable support for Camera Serial Interface
          Physical receiver. It deserializes packets and
          supports detection of packet start and stop
          signalling.

config MSM_CSID
        bool "Qualcomm MSM Camera Serial Interface decoder support"
        depends on MSMB_CAMERA
        ---help---
          Enable support for Camera Serial Interface decoder.
          It supports lane merging and decoding of packets
          based on cid which is mapped to a virtual channel
          and datatype.

config MSM_EEPROM
        bool "Qualcomm MSM Camera ROM Interface for Calibration support"
        depends on MSMB_CAMERA
        ---help---
          Enable support for ROM Interface for Calibration
          Provides interface for reading the Claibration data.
          and also provides support for writing data in case of FLASH ROM.
	  Currently supports I2C, CCI and SPI protocol

config MSM_REAR_ROM_TYPE_EEPROM
        bool "Qualcomm MSM Camera ROM Interface for Calibration support"
        depends on MSMB_CAMERA
        ---help---
          Gives information whether calibration data is in FROM or EEPROM

config MSM_OTP
        bool "Qualcomm MSM Camera ROM Interface for Calibration support"
        depends on MSMB_CAMERA
        ---help---
          Enable support for ROM Interface for Calibration
          Provides interface for reading the Claibration data.
          and also provides support for writing data
	  

config MSM_ISPIF
        bool "Qualcomm MSM Image Signal Processing interface support"
        depends on MSMB_CAMERA
        ---help---
          Enable support for Image Signal Processing interface module.
          This module acts as a crossbar between CSID and VFE. Output
          of any CID of CSID can be routed to of of pixel or raw
          data interface in VFE.

config MSM_ISPIF_V1
        bool "Qualcomm MSM Image Signal Processing interface support"
        depends on MSMB_CAMERA
        ---help---
          Enable support for Image Signal Processing interface module.
          This module acts as a crossbar between CSID and VFE. Output
          of any CID of MSM_CSI22_HEADER can be routed to of pixel
          or raw data interface in VFE.

config MSM_ISPIF_V2
        bool "Qualcomm MSM Image Signal Processing interface support"
        depends on MSMB_CAMERA
        ---help---
          Enable support for Image Signal Processing interface module.
          This module acts as a crossbar between CSID and VFE. Output
          of any CID of CSID can be routed to of pixel
          or raw data interface in VFE.

config IMX134
	bool "Sensor IMX134 (BAYER 8M)"
	depends on MSMB_CAMERA
	---help---
		Sony 8 MP Bayer Sensor with auto focus, uses
		4 mipi lanes full resolution @30fps and
		HFR @60fps and @120fps,
		Video HDR support.

config IMX132
	bool "Sensor IMX132 (BAYER 2M)"
	depends on MSMB_CAMERA
	---help---
		Sony 2 MP Bayer Sensor with auto focus, uses
		2 mipi lanes, preview config = 1920 x 1080 at 30 fps,
		snapshot config = 1920 x 1080 at 30 fps,
		Video HDR support.

config OV9724
	bool "Sensor OV9724 (BAYER 2M)"
	depends on MSMB_CAMERA
	---help---
		OmniVision 2 MP Bayer Sensor, supports 2 mipi lanes,
		preview and snapshot config at 1280*720 at 30 fps,
		hfr video at 60, 90 and 120 fps. This sensor driver does
		not support auto focus.

config OV5648
	bool "Sensor OV5648 (BAYER 5M)"
	depends on MSMB_CAMERA
	---help---
		OmniVision 5 MP Bayer Sensor, only use 1 mipi lane,
		preview set to 1296*972 at 30 fps,
		snapshot set to 2592*1944 at 12 fps,
		This sensor driver does not support auto focus.

config GC0339
	bool "Sensor GC0339 (BAYER .3M)"
	depends on MSMB_CAMERA
	---help---
		gc0339 is a Galaxycore .3 MP Bayer Sensor.
		It supports 1 or 2 mipi lanes.
		Preview and snapshot resolution shall be 640*480 at 30 fps,
		It does not support auto focus.

config OV8825
	bool "OmniVision OV8825 (BAYER 8MP)"
	depends on MSMB_CAMERA
	---help---
		OmniVision 8 MP Bayer Sensor with auto focus.uses
		2 mipi lanes, preview config = 1632*1224 30 fps,
		snapshot config = 3264 * 2448 at 18 fps.
		2 lanes max fps is 18, 4 lanes max fps is 24.

config OV8865
	bool "OmniVision OV8865 (BAYER 8MP)"
	depends on MSMB_CAMERA
	---help---
		OmniVision 8 MP Bayer Sensor with auto focus.uses
		4 mipi lanes, preview config = 1632*1224 30 fps,
		snapshot config = 3264 * 2448 at 30 fps.
		Max fps is 30fps at 3264 * 2448, 60fps at 1632 * 1224

config s5k4e1
	bool "Sensor s5k4e1 (BAYER 5MP)"
	depends on MSMB_CAMERA
	---help---
		Samsung 5 MP Bayer Sensor. It uses 2 mipi lanes,
		supports 720P preview at 30 fps
		and QSXGA snapshot at 15 fps.
		This sensor driver does not support auto focus.

config OV12830
	bool "OmniVision OV12830 (BAYER 12MP)"
	depends on MSMB_CAMERA
	---help---
		OmniVision 12.8 MP Bayer Sensor with auto focus.uses
		4 mipi lanes, preview config = 2112 * 1500 at 30 fps,
		snapshot config = 4224 * 3000 at 15 fps.
		2 lanes max fps is 18, 4 lanes max fps is 24.

config MSM_V4L2_VIDEO_OVERLAY_DEVICE
	tristate "Qualcomm MSM V4l2 video overlay device"
	---help---
	  Enables support for the MSM V4L2 video
	  overlay driver. This allows video rendering
	  apps to render overlaid video using Video4Linux2
	  APIs, by using /dev/videoX device

config MSMB_JPEG
	tristate "Qualcomm MSM Jpeg Encoder Engine support"
        depends on MSMB_CAMERA && (ARCH_MSM8974 || ARCH_MSM8226 || ARCH_APQ8084 || ARCH_MSM8916 || ARCH_MSM)
	---help---
	  Enable support for Jpeg Encoder/Decoder
	  Engine for 8974.
	  This module serves as the common driver
	  for the JPEG 1.0 encoder and decoder.


config MSM_SEC_CCI_TA_NAME
       string "Name of TA to handle Secure CCI transactions"
       depends on MSM_CCI
       default "sec_iris"

config MSM_SEC_CCI_DEBUG
       bool "Qualcomm MSM Secure CCI Relay Debug"
       depends on MSM_CCI
       ---help---
         Enables simulation of secure camera for Secure CCI Realy
         debugging.

config MSM_GEMINI
	tristate "Qualcomm MSM Gemini JPEG engine support"
	depends on MSMB_CAMERA && (ARCH_MSM7X30 || ARCH_MSM8X60 || ARCH_MSM8960)
	---help---
	  Enables support for the Gemini JPEG encoder
	  Engine for 8x60, 7x30 and 8960.
	  This module serves as the driver
	  for JPEG encoding functionality.

config MSM_FD
	 tristate "Qualcomm MSM FD face detection engine support"
	 depends on MSMB_CAMERA
	 ---help---
	    Enables support for the MSM FD face detection engine.

config COMPANION2
        tristate "External companion support"
        depends on MSMB_CAMERA
        default n
        ---help---
          Enables support for external companion chip for 8992.

config COMPANION3
        tristate "External companion support"
        depends on MSMB_CAMERA
        default n
        ---help---
          Enables support for external companion chip for 8992.

config SAMSUNG_OIS
        tristate "External ois support"
	depends on MSMB_CAMERA
	default n
	---help---
	Enables support for external ois module.

config SENSOR_RETENTION
        tristate "Sensor retention mode support"
	depends on MSMB_CAMERA
	default n
	---help---
	Enables support for sensor retention mode.

config CAMERA_SYSFS_V2
	bool "CAMERA SYS"
	depends on MSMB_CAMERA
	---help---
		CAMERA SYS.

config MSM_FRONT_EEPROM
        bool "Qualcomm MSM Camera ROM Interface for Calibration support"
        depends on MSMB_CAMERA
        ---help---
        Enable support for ROM Interface for Calibration
        Provides interface for reading the Claibration data.
        and also provides support for writing data in case of FLASH ROM.
        Currently supports I2C, CCI and SPI protocol

config MSM_JPEGDMA
	tristate "Qualcomm Technologies Inc. MSM Jpeg dma"
        depends on MSMB_CAMERA
        select V4L2_MEM2MEM_DEV
	---help---
	  Enable support for Jpeg dma engine.

config FLASH_CURRENT_JAPAN
        tristate "Flash current for Japan project"
	depends on MSMB_CAMERA
	default n
	---help---
	Enables support for Japan flash current

config SAMSUNG_SECURE_CAMERA
        tristate "Flash for Secure camera"
        depends on MSMB_CAMERA
        default n
        ---help---
        Enables support for flash for secure camera

config S5K5E3YX
	bool "Sensor S5K5E3YX (BAYER 5MP)"
	depends on MSMB_CAMERA
	---help---
	Samsung 5 MP Bayer Sensor.
```

## drivers/media/radio/exynos/s621/Kconfig
```kconfig
#
# SAMSUNG's S621 FM driver based on SPEEDY driver.
#
menu "Samsung S621 FM driver (SPEEDY based)"
config RADIO_S621
	tristate "Samsung S621 FM Radio"
	depends on VIDEO_V4L2 && RADIO_S5E8835
	help
	Choose Y here if you have this FM radio chip.

endmenu
```

## drivers/media/radio/rtc6213n/Kconfig
```kconfig
config USB_RTC6213N
	tristate "Richwave RTC6213N FM Tuner support with USB"
	depends on USB && RADIO_RTC6213N
	---help---
	  This is a driver for USB devices with the Richwave RTC6213N chip.
	  Currently these devices are known to work:
	  - 10c4:818a: Richwave USB FM Radio Reference Design
	  - 06e1:a155: ADS/Tech FM Radio Receiver (formerly Instant FM Music)
	  - 1b80:d700: KWorld USB FM Radio SnapMusic Mobile 700 (FM700)
	  - 10c5:819a: Sanei Electric FM USB Radio (aka DealExtreme.com PCear)

	  Sound is provided by the ALSA USB Audio/MIDI driver. Therefore
	  if you don't want to use the device solely for RDS receiving,
	  it is recommended to also select SND_USB_AUDIO.

	  Please have a look at the documentation, especially on how
	  to redirect the audio stream from the radio to your sound device:
	  Documentation/video4linux/RTC6213N.txt

	  Say Y here if you want to connect this type of radio to your
	  computer's USB port.

	  To compile this driver as a module, choose M here: the
	  module will be called radio-usb-RTC6213N.

config I2C_RTC6213N
	tristate "Richwave RTC6213N FM Radio Receiver support with I2C"
	depends on I2C && RADIO_RTC6213N && !USB_RTC6213N
	---help---
	  This is a driver for I2C devices with the Richwave RTC6213N
	  chip.

	  Say Y here if you want to connect this type of radio to your
	  computer's I2C port.

	  To compile this driver as a module, choose M here: the
	  module will be called radio-i2c-RTC6213N.
```

## drivers/media/radio/s610/Kconfig
```kconfig
#
# SAMSUNG's S6XX FM driver based on SPEEDY driver.
#
menu "Samsung S6XX FM driver (SPEEDY based)"
config RADIO_S610
	tristate "Samsung S610 FM Radio"
	depends on VIDEO_V4L2 && (RADIO_S5E3830 || RADIO_S5E7885 || RADIO_S5E9610 || RADIO_S5E9630)
	help
	Choose Y here if you have this FM radio chip.

config RADIO_S621
	tristate "Samsung S621 FM Radio"
	depends on VIDEO_V4L2 && (RADIO_S5E3830 || RADIO_S5E7885 || RADIO_S5E9610 || RADIO_S5E9630)
	help
	Choose Y here if you have this FM radio chip.

endmenu
```

## drivers/media/radio/sprd2331/Kconfig
```kconfig
#
# Spreadtrum SC2331 FM drivers
#
menu "SPREADTRUM SC2331 FM driver"
config RADIO_SPRD2331
	tristate "SPRD 2331 FM Support"
	---help---
	  Say Y to enable built-in FM controller in the
	  Spreadtrum SC2331 based System-on-Chip devices.

endmenu
```

## drivers/media/sprd_dcam/Kconfig
```kconfig
if VIDEO_DCAM_SPRD
choice
	prompt "Camera resolution"
	default CAMERA_5M

config CAMERA_2M
	bool "2M pixels"

config CAMERA_3M
	bool "3M pixels"

config CAMERA_5M
	bool "5M pixels"

config CAMERA_8M
	bool "8M pixels"


endchoice

choice
	prompt "Camera capture mode"
	default CAMERA_NON_ZSL

config CAMERA_ZSL
	bool "zsl capture"

config CAMERA_NON_ZSL
	bool "non zsl capture"

endchoice

choice
	prompt "Sensor Output"
	default SENSOR_OUTPUT_YUV

config SENSOR_OUTPUT_RAW
	bool "sensor outputs raw"

config SENSOR_OUTPUT_YUV
	bool "sensor outputs yuv"

endchoice


endif
```

## drivers/media/sprd_gsp/Kconfig
```kconfig
config VIDEO_GSP_SPRD
	tristate "SPRD GSP driver"
	# depends on ARCH_SC8825
	# default m
	help
	  Support GSP for SPRD
```

## drivers/media/sprd_gspn/Kconfig
```kconfig
config VIDEO_GSPN_SPRD
	tristate "SPRD GSPN driver"
	# depends on ARCH_SC8825
	# default m
	help
	  Support GSPN for SPRD
```

## drivers/media/sprd_isp/Kconfig
```kconfig
menu "SoC Video for the SPREADTRUM SC88XX"

config SND_SC88XX_SOC_SPRDPHONE
	tristate "sprdphone -- SoC Audio for the SPREADTRUM SC88XX chips with intergrated VBC codec"
#   depends on ARCH_SC8800S
    select SND_PCM
    help
      Say Y if you want to built in to kernel, Say M for ko module.

endmenu
```

## drivers/media/sprd_rotation/Kconfig
```kconfig
config SPRD_ROT
	depends on ARCH_SCX35
	bool "Spreadtrum Rotation Driver"
	help
	  Say Y to support spreadtrum rotation device driver
```
