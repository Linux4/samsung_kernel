## drivers/media/video/cmmb/Kconfig
```kconfig
#
# innofidei cmmb driver configuration
#
#
#
menuconfig CMMB
	tristate "China Mobile Multimedia Broadcasting"
	help
	  CMMB is a mobile television and multimedia standard developed
	  and specified in China by the State Administration of Radio,
	  Film, and Television (SARFT).

if CMMB
menuconfig INNOCMMB
	tristate "Innofidei cmmb driver"
	help
	  Innofidei cmmb driver support spi/sdio mode transfer base on IF2xx.

if INNOCMMB
config INNOCMMB_DEBUG
	boolean "Debug support for Innofidei cmmb drivers"
	help
	  Say "yes" to enable debug messaging (like dev_dbg and pr_debug),
	  in innofidei cmmb drivers.

endif
endif
```

## drivers/media/video/ecs/Kconfig
```kconfig
config ECS_DRIVER
	bool
	depends on VIDEO_V4L2 && SOC_CAMERA
	default n
	help
	  Essential Camera Sensor(AKA: ECS) is a abstract description of
	  camera sensors. Can be used to creat a specific camera sensor
	  driver, like ov5640 driver.

config ECS_DRIVER_SUBDEV
	bool "Essential Camera Sensor V4L2-subdev interface"
	select ECS_DRIVER
	default n
	help
	  V4L2 subdev helper functions to implement subdev-like sensor
	  driver

config SOC_CAMERA_GC0328_ECS
	tristate "gc0328 support based on ECS driver"
	depends on ECS_DRIVER_SUBDEV
	default n
	help
	  Support for the GalaxyCore GC0328 VGA camera sensor.

config SOC_CAMERA_OV5640_ECS
	tristate "ov5640 support based on ECS"
	depends on ECS_DRIVER_SUBDEV && !SOC_CAMERA_OV5640
	default n
	help
	  Support for the OmniVision OV5640 5M camera sensor.

config SOC_CAMERA_GC2035_ECS
	tristate "gc2035 support based on ECS"
	depends on ECS_DRIVER_SUBDEV
	default n
	help
	  Support for the GC2035 3M camera sensor.
```

## drivers/media/video/exynos/fimc-is-w1/Kconfig
```kconfig
config VIDEO_EXYNOS_FIMC_IS
	bool "Exynos FIMC-IS (Image Subsystem) driver"
	depends on VIDEO_EXYNOS && !SOC_EXYNOS5410 && !SOC_EXYNOS5420
	select MEDIA_EXYNOS
	default n
	help
	  This is a v4l2 driver for exynos FIMC-IS device.
```

## drivers/media/video/exynos/fimc-is/Kconfig
```kconfig
config VIDEO_EXYNOS_FIMC_IS
	bool "Exynos FIMC-IS (Image Subsystem) driver"
	depends on VIDEO_EXYNOS && !SOC_EXYNOS5410 && !SOC_EXYNOS5420
	select MEDIA_EXYNOS
	select USE_VENDER_FEATURE
	default n
	help
	  This is a v4l2 driver for exynos FIMC-IS device.

config CAMERA_EEPROM_SUPPORT
	bool "Exynos FIMC-IS EEPROM SUPPORT"
	depends on VIDEO_EXYNOS_FIMC_IS
	default n
	help
	  This is a v4l2 driver for exynos FIMC-IS device.

config USE_VENDER_FEATURE
	bool "Use vender specific features"
	default n
	help
	  Enable to use the vender.
config CAMERA_SENSOR_SR261
        bool "Use SR261 camera sensor"
        depends on VIDEO_EXYNOS_FIMC_IS
        default n
        help
          Use SR261 camera sensor.
config CAMERA_SENSOR_8B1_OBJ
        bool "Use 8B1 camera sensor"
        depends on VIDEO_EXYNOS_FIMC_IS
        default n
        help
          Use to build 8B1 camera sensor.
config CAMERA_SENSOR_6B2_OBJ
        bool "Use 6B2 camera sensor"
        depends on VIDEO_EXYNOS_FIMC_IS
        default n
        help
          Use to build 6B2 camera sensor.
config CAMERA_SENSOR_6A3_OBJ
        bool "Use 6A3 camera sensor"
        depends on VIDEO_EXYNOS_FIMC_IS
        default n
        help
          Use to build 6A3 camera sensor.
config CAMERA_SENSOR_IMX135_OBJ
        bool "Use IMX135 camera sensor"
        depends on VIDEO_EXYNOS_FIMC_IS
        default n
        help
          Use to build IMX135 camera sensor.
config CAMERA_SENSOR_3L2_OBJ
        bool "Use 3L2 camera sensor"
        depends on VIDEO_EXYNOS_FIMC_IS
        default n
        help
          Use to build 3L2 camera sensor.
config CAMERA_SENSOR_2P2_OBJ
        bool "Use 2P2 camera sensor"
        depends on VIDEO_EXYNOS_FIMC_IS
        default n
        help
          Use to build 2P2 camera sensor.
config CAMERA_SENSOR_3H5_OBJ
        bool "Use 3H5 camera sensor"
        depends on VIDEO_EXYNOS_FIMC_IS
        default n
        help
          Use to build 3H5 camera sensor.
config CAMERA_SENSOR_3H7_OBJ
        bool "Use 3H7 camera sensor"
        depends on VIDEO_EXYNOS_FIMC_IS
        default n
        help
          Use to build 3H7 camera sensor.
config CAMERA_SENSOR_3H7_SUNNY_OBJ
        bool "Use 3H7_SUNNY camera sensor"
        depends on VIDEO_EXYNOS_FIMC_IS
        default n
        help
          Use to build 3H7_SUNNY camera sensor.
config CAMERA_SENSOR_4E5_OBJ
        bool "Use 4E5 camera sensor"
        depends on VIDEO_EXYNOS_FIMC_IS
        default n
        help
          Use to build 4E5 camera sensor.
config CAMERA_SENSOR_IMX175_OBJ
        bool "Use IMX175 camera sensor"
        depends on VIDEO_EXYNOS_FIMC_IS
        default n
        help
          Use to build IMX175 camera sensor.
config CAMERA_SENSOR_4H5_OBJ
        bool "Use 4H5 camera sensor"
        depends on VIDEO_EXYNOS_FIMC_IS
        default n
        help
          Use to build 4H5 camera sensor.
config CAMERA_SENSOR_SR261_OBJ
        bool "Use SR261 camera sensor"
        depends on VIDEO_EXYNOS_FIMC_IS
        default n
        help
          Use to build SR261 camera sensor.
```

## drivers/media/video/exynos/mipi-csis/Kconfig
```kconfig
config VIDEO_EXYNOS_MIPI_CSIS
	bool "Exynos MIPI-CSIS driver"
	depends on VIDEO_EXYNOS && VIDEO_EXYNOS_FIMC_LITE &&\
		(ARCH_EXYNOS4 || ARCH_EXYNOS5)
	select MEDIA_EXYNOS
	default n
	help
	  This is a v4l2 driver for exynos mipi-csis interface device.

config VIDEO_EXYNOS_MIPI_CSIS_IRQ_DEBUG
	bool "FIMC MIPI Error interrupt message"
	depends on VIDEO_EXYNOS_MIPI_CSIS
	default n
	help
	  This is for debugging mipi error interrupt.
```

## drivers/mfd/max77705/Kconfig
```kconfig
# SPDX-License-Identifier: GPL-2.0-only
#
# Multifunction miscellaneous devices
#

if HAS_IOMEM
menu "Multifunction device drivers"

config MFD_MAX77705
	tristate "Maxim Semiconductor MAX77705 PMIC Support"
	depends on I2C=y
	select MFD_CORE
	help
	  Say yes here to support for Maxim Semiconductor MAX77705.
	  This is a Power Management IC with Charger, safe LDOs, Flash, Haptic
	  and MUIC controls on chip.
	  This driver provides common support for accessing the device;
	  additional drivers

endmenu
endif
```

## drivers/mfd/samsung/pmic/Kconfig
```kconfig
# SPDX-License-Identifier: GPL-2.0-only
#
# Multifunction miscellaneous devices for samsung pmic
#

config MFD_SAMSUNG_PMIC
	tristate "SAMSUNG Electronics COMMON PMIC Series Support"
	depends on I2C=y
	select MFD_CORE
	select REGULATOR
	help
	  Support for the Samsung Electronics MFD series.
	  This driver provides common support for accessing the device,
	  additional drivers must be enabled in order to use the functionality
	  of the device

config MFD_S2MPS25
	tristate "SAMSUNG Electronics S2MPS25 PMIC Series Support"
	depends on I2C=y
	select MFD_CORE
	select REGULATOR
	help
	  Support for the Samsung Electronics MFD series.
	  This driver provides common support for accessing the device,
	  additional drivers must be enabled in order to use the functionality
	  of the device

config MFD_S2MPS26
	tristate "SAMSUNG Electronics S2MPS26 PMIC Series Support"
	depends on I2C=y
	select MFD_CORE
	select REGULATOR
	help
	  Support for the Samsung Electronics MFD series.
	  This driver provides common support for accessing the device,
	  additional drivers must be enabled in order to use the functionality
	  of the device

config MFD_S2MPM07
	tristate "SAMSUNG Electronics S2MPM07 PMIC Series Support"
	depends on I2C=y
	select MFD_CORE
	select REGULATOR
	help
	  Support for the Samsung Electronics MFD series.
	  This driver provides common support for accessing the device,
	  additional drivers must be enabled in order to use the functionality
	  of the device

config MFD_S2MPB02
	tristate "Samsung Semiconductor S2MPB02 PMIC Support"
	depends on I2C=y
	select MFD_CORE
	help
	  Say yes here to support for Samsung Semiconductor S2MPB02.
	  This is a Power Management IC with Flash on chip.
	  This driver provides common support for accessing the device;
	  additional drivers

config MFD_S2MPS25_9935
	tristate "SAMSUNG Electronics S2MPS25 PMIC Series Support for s5e9935"
	depends on I2C=y
	select MFD_CORE
	select REGULATOR
	help
	  Support for the Samsung Electronics MFD series.
	  This driver provides common support for accessing the device,
	  additional drivers must be enabled in order to use the functionality
	  of the device

config MFD_S2MPS26_9935
	tristate "SAMSUNG Electronics S2MPS26 PMIC Series Support for s5e9935"
	depends on I2C=y
	select MFD_CORE
	select REGULATOR
	help
	  Support for the Samsung Electronics MFD series.
	  This driver provides common support for accessing the device,
	  additional drivers must be enabled in order to use the functionality
	  of the device

config MFD_S2MPM07_9935
	tristate "SAMSUNG Electronics S2MPM07 PMIC Series Support for s5e9935"
	depends on I2C=y
	select MFD_CORE
	select REGULATOR
	help
	  Support for the Samsung Electronics MFD series.
	  This driver provides common support for accessing the device,
	  additional drivers must be enabled in order to use the functionality
	  of the device

config MFD_S2MPA05_9935
	tristate "SAMSUNG Electronics S2MPA05 PMIC Series Support for s5e9935"
	depends on I2C=y
	select MFD_CORE
	select REGULATOR
	help
	  Support for the Samsung Electronics MFD series.
	  This driver provides common support for accessing the device,
	  additional drivers must be enabled in order to use the functionality
	  of the device

config MFD_S2MPU15_8535
	tristate "SAMSUNG Electronics S2MPU15 PMIC Series Support for s5e8535"
	depends on I2C=y
	select MFD_CORE
	select REGULATOR
	help
	  Support for the Samsung Electronics MFD series.
	  This driver provides common support for accessing the device,
	  additional drivers must be enabled in order to use the functionality
	  of the device

config MFD_S2MPA05_8535
	tristate "SAMSUNG Electronics S2MPA05 PMIC Series Support for s5e8535"
	depends on I2C=y
	select MFD_CORE
	select REGULATOR
	help
	  Support for the Samsung Electronics MFD series.
	  This driver provides common support for accessing the device,
	  additional drivers must be enabled in order to use the functionality
	  of the device

config MFD_S2MPB06
	tristate "SAMSUNG Electronics S2MPB06 PMIC Support"
	depends on I2C=y
	select MFD_CORE
	select REGULATOR
	help
	  Support for the Samsung Electronics MFD series.
	  This driver provides common support for accessing the device,
	  additional drivers must be enabled in order to use the functionality
	  of the device

config MFD_S2MPU15_8835
	tristate "SAMSUNG Electronics S2MPU15 PMIC Series Support for s5e8835"
	depends on I2C=y
	select MFD_CORE
	select REGULATOR
	help
	  Support for the Samsung Electronics MFD series.
	  This driver provides common support for accessing the device,
	  additional drivers must be enabled in order to use the functionality
	  of the device

config MFD_S2MPU16_8835
	tristate "SAMSUNG Electronics S2MPU16 PMIC Series Support for s5e8835"
	depends on I2C=y
	select MFD_CORE
	select REGULATOR
	help
	  Support for the Samsung Electronics MFD series.
	  This driver provides common support for accessing the device,
	  additional drivers must be enabled in order to use the functionality
	  of the device
```

## drivers/mfd/slsi/s2mu005/Kconfig
```kconfig
config MFD_S2MU005
	bool "SAMSUNG Electronics IF PMIC S2MU005 Series Support"
	depends on I2C=y
	select MFD_CORE
	help
	 Support for the Samsung Electronics MFD series.
	 This driver provides common support for accessing the device,
	 additional drivers must be enabled in order to use the functionality
	 of the device

config S2MU005_SUPPORT_BC1P2_CERTI
	bool "S2MU005 Support BC 1.2 Certification"
	depends on I2C=y
	select MFD_S2MU005
	help
	 Support for the BC 1.2 Certification.
	 This driver provides common support for accessing the device,
	 additional drivers must be enabled in order to use the functionality
```

## drivers/mfd/slsi/s2mu107/Kconfig
```kconfig
config MFD_S2MU107
	bool "Samsung Electronics S2MU107 IF PMIC Series Support"
	depends on I2C=y
	select MFD_CORE
	help
	  Support for the Samsung Electronics MFD series.
	  This driver provides common support for accessing the device,
	  additional drivers must be enabled in order to use the functionality
	  of the device
```

## drivers/mhi/Kconfig
```kconfig
config MHI
	bool "MHI driver"

config MHI_RMNET_DUMP
	bool "MHI RMNET DUMP"
	default y

config DEBUG_PKTLOG
	bool "IPC pcap logging feature"
	default n
```

## drivers/misc/KnoxVault/Kconfig
```kconfig
config KNOXVAULT_POWER
    bool "regulatore control of KnoxVault2"
    default n
    help
      Say y here if you have a KnoxVault2.
      If unsure, say N.
```

## drivers/misc/KnoxVaultDev/Kconfig
```kconfig
config I2C_KNOXVAULTDEV
    bool "regulate control of I2C_KNOXVAULTDEV"
    default n
    help
      Say y here if you have a I2C_KNOXVAULTDEV.
      If unsure, say N.
```

## drivers/misc/benchmark/Kconfig
```kconfig
config BENCHMARK
    bool "enable benchmark proc"
    default n
    help
    enable benchmark proc
```
