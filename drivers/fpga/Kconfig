## drivers/fpga/Kconfig
```kconfig
#
# FPGA framework configuration
#

menu "FPGA Configuration Support"

config FPGA
	tristate "FPGA Configuration Framework"
	help
	  Say Y here if you want support for configuring FPGAs from the
	  kernel.  The FPGA framework adds a FPGA manager class and FPGA
	  manager drivers.

if FPGA

config FPGA_MGR_SOCFPGA
	tristate "Altera SOCFPGA FPGA Manager"
	depends on ARCH_SOCFPGA
	help
	  FPGA manager driver support for Altera SOCFPGA.

config FPGA_MGR_ZYNQ_FPGA
	tristate "Xilinx Zynq FPGA"
	help
	  FPGA manager driver support for Xilinx Zynq FPGAs.

endif # FPGA

config SPI_TO_I2C_FPGA
	tristate "spi to i2c fpga"
	help
	  FPGA manager driver support for spi to i2c fpga.

config POGO_FPGA
	tristate "fpga for pogo keyboard"
	help
	  FPGA manager driver support for pogo fpga.

config SEC_ICE40XX_IRIS
	tristate "this feature allows ICE40XX IRIS"
	default n
	help
	  This is a driver for IRIS LEd driver based on Lattice chip.
	  Lattice FPGA can support IRIS LED.
	  To compile this driver as a module, choose M here.
	  If unsure, say N.

endmenu
```

## drivers/gpu/arm/Kconfig
```kconfig
#
# (C) COPYRIGHT 2012 ARM Limited. All rights reserved.
#
# This program is free software and is provided to you under the terms of the GNU General Public License version 2
# as published by the Free Software Foundation, and any use by you of this program is subject to the terms of such GNU licence.
#
# A copy of the licence is included with the program, and can also be obtained from Free Software
# Foundation, Inc., 51 Franklin Street, Fifth Floor, Boston, MA  02110-1301, USA.
#
#
menu "ARM GPU Configuration"
menuconfig MALI_DDK_VERSION
	tristate "Mali support"
	default y
	help
	  Enable this option to build support for the ARM Mali-T7xx GPU.
	  To compile this driver as a module, choose M here:
	  this will generate a single module, called mali_kbase.
choice
	prompt "version Configuration"
	depends on MALI_DDK_VERSION
	default MALI_BIFROST_R38P1 if $(PLATFORM_VERSION) >= 13
	default MALI_BIFROST_R32P1 if $(PLATFORM_VERSION) = 12
	default MALI_BIFROST_R26P0 if $(PLATFORM_VERSION) = 11
	default MALI_BIFROST_R19P0 if $(PLATFORM_VERSION) < 11
	help
	  Select the gpu support version.
config MALI_BIFROST_R19P0
	depends on MALI_DDK_VERSION
	bool "Bifrost r19p0 driver"
config MALI_BIFROST_R26P0
	depends on MALI_DDK_VERSION
	bool "Bifrost r26p0 driver"
config MALI_BIFROST_R32P1
	depends on MALI_DDK_VERSION
	bool "Bifrost r32p1 driver"
config MALI_BIFROST_R38P1
	depends on MALI_DDK_VERSION
	bool "Bifrost r38p1 driver"

endchoice
if MALI_BIFROST_R19P0
source "drivers/gpu/arm/b_r19p0/Kconfig"
endif
if MALI_BIFROST_R26P0
source "drivers/gpu/arm/b_r26p0/Kconfig"
endif
if MALI_BIFROST_R32P1
source "drivers/gpu/arm/bv_r32p1/Kconfig"
endif
if MALI_BIFROST_R38P1
source "drivers/gpu/arm/bv_r38p1/Kconfig"
endif

endmenu
```

## drivers/gpu/arm/mali400/Kconfig
```kconfig
menuconfig MALI400
	tristate "Mali-400 support"
	depends on ARM
	default n
	select DMA_SHARED_BUFFER
	---help---
	  This enables support for the ARM Mali-400 GPU.

	  To compile this driver as a module, choose M here: the module will be
	  called mali.

choice
depends on MALI400
prompt "Select MALI VER"
default MALI_VER_R3P2_REL2

config MALI_VER_R3P2_REL2
	bool "Mali400 Version R3P2-REL2"
	help
	  Choose this option to select DDK version.

if MALI_VER_R3P2_REL2
source "drivers/gpu/arm/mali400/r3p2_rel2/Kconfig"
endif

config MALI_VER_R4P0_REL0
	bool "Mali400 Version R4P0-REL0"
	help
	  Choose this option to select DDK version.

if MALI_VER_R4P0_REL0
source "drivers/gpu/arm/mali400/r4p0_rel0/Kconfig"
endif

endchoice

config VIDEO_SAMSUNG
	bool "Samsung Multimedia Devices"
	depends on VIDEO_CAPTURE_DRIVERS && VIDEO_V4L2
	select VIDEO_FIXED_MINOR_RANGES
	default n
	help
	  This is a representative video4linux configuration for Samsung multimedia devices.

config VIDEO_SAMSUNG_V4L2
	bool "V4L2 API for digital camera to be contributed by samsung"
	depends on VIDEO_DEV && VIDEO_SAMSUNG
	default n
	help
	  This feature is for new V4L2 APIs all about digital camera
```

## drivers/gpu/arm/mali400/r3p2_rel2/Kconfig
```kconfig
config MALI400_DEBUG
	bool "Enable debug in Mali driver"
	depends on MALI400
	---help---
	  This enabled extra debug checks and messages in the Mali driver.

config MALI400_PROFILING
	bool "Enable Mali profiling"
	depends on MALI400
	select TRACEPOINTS
	default n
	---help---
	  This enables gator profiling of Mali GPU events.

config MALI400_INTERNAL_PROFILING
	bool "Enable internal Mali profiling API"
	depends on MALI400_PROFILING
	default n
	---help---
	  This enables the internal legacy Mali profiling API.

config MALI_DVFS
	bool "Enable mali DVFS"
	depends on MALI400 && PM_DEVFREQ
	default n
	---help---
		This enables Mali driver DVFS.

config MALI_DMA_BUF_MAP_ON_ATTACH
	bool "Map dma-buf attachments on attach"
	depends on MALI400 && DMA_SHARED_BUFFER
	default y
	---help---
	  This makes the Mali driver map dma-buf attachments after doing
	  attach. If this is not set the dma-buf attachments will be mapped for
	  every time the GPU need to access the buffer.

	  Mapping for each access can cause lower performance.

config MALI_SHARED_INTERRUPTS
	bool "Support for shared interrupts"
	depends on MALI400
	default n
	---help---
	  Adds functionality required to properly support shared interrupts.  Without this support,
	  the device driver will fail during insmod if it detects shared interrupts.  Works even if
	  the GPU is not using shared interrupts, but can cause lower performance.

config MALI400_UMP
    bool "Enable UMP support"
    depends on MALI400
    default n
    ---help---
      This enables support for the UMP memory sharing API in the Mali driver.

if MALI400_UMP
source "drivers/gpu/arm/mali400/ump_r3p2/Kconfig"
endif
```

## drivers/gpu/arm/t72x/Kconfig
```kconfig
#
# (C) COPYRIGHT 2012-2013 ARM Limited. All rights reserved.
#
# This program is free software and is provided to you under the terms of the
# GNU General Public License version 2 as published by the Free Software
# Foundation, and any use by you of this program is subject to the terms
# of such GNU licence.
#
# A copy of the licence is included with the program, and can also be obtained
# from Free Software Foundation, Inc., 51 Franklin Street, Fifth Floor,
# Boston, MA  02110-1301, USA.
#
#

menuconfig MALI_T72X
	tristate "Mali-T72X support"
	default n
	help
	  Enable this option to build support for the ARM Mali-T72x GPU.

	  To compile this driver as a module, choose M here:
	  this will generate a single module, called mali_kbase.

config DDK_VERSION_OS
	string "version"
	default ANDROID_MAJOR_VERSION

choice
	prompt "version Configuration"
	depends on MALI_T72X

	default MALI_R7P0_T72X if DDK_VERSION_OS = "m"
	default MALI_R15P0 if DDK_VERSION_OS = "n"
	default MALI_R22P0 if DDK_VERSION_OS = "o"
	default MALI_R28P0 if DDK_VERSION_OS = "p"
	help
	  Select the gpu support version.

config MALI_R7P0_T72X
	depends on MALI_T72X
	bool "r7p0 driver"

config MALI_R15P0
	depends on MALI_T72X
	bool "r15p0 driver"

config MALI_R21P0
	depends on MALI_T72X
	bool "r21p0 driver"

config MALI_R22P0
	depends on MALI_T72X
	bool "r22p0 driver"

config MALI_R28P0
	depends on MALI_T72X
	bool "r28p0 driver"
endchoice

if MALI_R7P0_T72X
source "drivers/gpu/arm/t72x/r7p0/Kconfig"
endif

if MALI_R15P0
source "drivers/gpu/arm/t72x/r15p0/Kconfig"
endif

if MALI_R21P0
source "drivers/gpu/arm/t72x/r21p0/Kconfig"
endif

if MALI_R22P0
source "drivers/gpu/arm/t72x/r22p0/Kconfig"
endif

if MALI_R28P0
source "drivers/gpu/arm/t72x/r28p0/Kconfig"
endif
```

## drivers/gpu/arm/t7xx/Kconfig
```kconfig
#
# (C) COPYRIGHT 2012-2013 ARM Limited. All rights reserved.
#
# This program is free software and is provided to you under the terms of the
# GNU General Public License version 2 as published by the Free Software
# Foundation, and any use by you of this program is subject to the terms
# of such GNU licence.
#
# A copy of the licence is included with the program, and can also be obtained
# from Free Software Foundation, Inc., 51 Franklin Street, Fifth Floor,
# Boston, MA  02110-1301, USA.
#
#


menuconfig MALI_T7XX
	tristate "Mali-T7XX support"
	default y
	help
	  Enable this option to build support for the ARM Mali-T7xx GPU.

	  To compile this driver as a module, choose M here:
	  this will generate a single module, called mali_kbase.

choice
	prompt "version Configuration"
	depends on MALI_T7XX
	default MALI_R15P0 if DDK_VERSION_OS = "n"
	help
	  Select the gpu support version.

config MALI_R12P0
	depends on MALI_T7XX
	bool "r12p0 driver"

config MALI_R15P0
	depends on MALI_T7XX
	bool "r15p0 driver"

endchoice

if MALI_R12P0
source "drivers/gpu/arm/t7xx/r12p0/Kconfig"
endif

if MALI_R15P0
source "drivers/gpu/arm/t7xx/r15p0/Kconfig"
endif
```

## drivers/gpu/arm/t83x/Kconfig
```kconfig
#
# (C) COPYRIGHT 2012-2013 ARM Limited. All rights reserved.
#
# This program is free software and is provided to you under the terms of the
# GNU General Public License version 2 as published by the Free Software
# Foundation, and any use by you of this program is subject to the terms
# of such GNU licence.
#
# A copy of the licence is included with the program, and can also be obtained
# from Free Software Foundation, Inc., 51 Franklin Street, Fifth Floor,
# Boston, MA  02110-1301, USA.
#
#


menuconfig MALI_T83X
	tristate "Mali-T83X support"
	default n
	help
	  Enable this option to build support for the ARM Mali-T83X GPU.
	  To compile this driver as a module, choose M here:
	  this will generate a single module, called mali_kbase.

choice
	prompt "version Configuration"
	depends on MALI_T83X
	default MALI_R7P0_T83X
	help
	  Select the gpu support version.

config MALI_R7P0_T83X
	depends on MALI_T83X
	bool "r7p0 driver"

if MALI_R7P0_T83X
source "drivers/gpu/arm/t83x/r7p0/Kconfig"
endif

endchoice
```

## drivers/gpu/drm/msm/samsung/Kconfig
```kconfig
config SAMSUNG_DEBUG_DISPLAY
	bool "Add Samsung Debugging code"
	default n

config DISPLAY_SAMSUNG
	depends on DRM_MSM
	bool "mdss config for samsung product"
	default n
	---help---
	Mdss config signature for samsung product

#
#	PANEL UNIQUE FEATURE
#
config DUAL_PANEL
	depends on DISPLAY_SAMSUNG
	bool "dual paneloperation"
	default n
	---help---
	dual panel operation support

config PARTIAL_UPDATE
	depends on DISPLAY_SAMSUNG
	bool "partial update operation"
	default n
	---help---
	partial update operation support

config CABC_FUNCTION
	depends on DISPLAY_SAMSUNG
	bool "DDI cabc operation"
	default n
	---help---
	DDI cabc operation support

config SUPPORT_POC_FLASH
	depends on DISPLAY_SAMSUNG
	bool "SUPPORT POC FLASH"
	default n
	---help---
	SUPPORT_POC_FLASH FOR DREAM2 ONLY

#
#	HOW TO MAKE DEF-CONFIG NAME FOR PANEL
#
#	PANEL_DDI-model_PANEL-model_RESOLUTION
#	PANEL_S6E3FA2    _AMS510CV01_FHD
#	PANEL_S6E3FA2_AMS510CV01_FHD
#

config PANEL_S6E3HA6_AMB632NF01_WQHD
	depends on DISPLAY_SAMSUNG
	bool "LSI S6E3HA6 LDI"
	default n
	---help---
	LSI S6E3HA6 LDI 1440_2560 GREAT DSC


config PANEL_S6E3HA6_AMS622MR01_WQHD
	depends on DISPLAY_SAMSUNG
	bool "LSI S6E3HA6 LDI"
	default n
	---help---
	LSI S6E3HA6 LDI 1440_2560 DREAM2 DSC

config PANEL_S6E3HA8_AMB622NP01_WQHD
	depends on DISPLAY_SAMSUNG
	bool "LSI S6E3HA8 LDI"
	default n
	---help---
	LSI S6E3HA8 LDI 1440_2560 STAR2 DSC

config PANEL_S6E3HA8_AMB638RD01_WQHD
	depends on DISPLAY_SAMSUNG
	bool "LSI S6E3HA8 LDI"
	default n
	---help---
	LSI S6E3HA8 LDI 1440_2560 BEYOND DSC

config PANEL_S6E3HA9_AMB611WE01_WQHD
	depends on DISPLAY_SAMSUNG
	bool "LSI S6E3HA9 LDI"
	default n
	---help---
	LSI S6E3HA9 LDI 1440_3040 BEYOND1 L-Cut DSC

config PANEL_S6E3HA9_AMB611WE01_FHD
	depends on DISPLAY_SAMSUNG
	bool "LSI S6E3HA9 LDI"
	default n
	---help---
	LSI S6E3HA9 LDI 1080_2280 BLOOM rev00 DSC

config PANEL_S6E3HA9_AMF670UH01_FHD
	depends on DISPLAY_SAMSUNG
	bool "LSI S6E3HA9 LDI"
	default n
	---help---
	LSI S6E3HA9 LDI 1080_2640 BLOOM rev01 DSC

config PANEL_S6E3HA9_AMB644WF01_WQHD
	depends on DISPLAY_SAMSUNG
	bool "LSI S6E3HA9 LDI"
	default n
	---help---
	LSI S6E3HA9 LDI 1440_3040 BEYOND2 L-Cut DSC

config PANEL_S6E3HA9_AMB666WS04_WQHD
	depends on DISPLAY_SAMSUNG
	bool "LSI S6E3HA9 LDI"
	default n
	---help---
	LSI S6E3HA9 LDI 1440_3040 BEYONDX P-Hole DSC

config PANEL_S6E3HA9_AMB597RT01_WQHD
	depends on DISPLAY_SAMSUNG
	bool "LSI S6E3HA9 LDI"
	default n
	---help---
	LSI S6E3HA9 LDI 1440_2960 CROWN DSC

config PANEL_S6E3XA0_AMB729WA01_QXGA
	depends on DISPLAY_SAMSUNG
	bool "LSI S6E3XA0 LDI"
	default n
	---help---
	LSI S6E3XA0 LDI 2152_1536 WINNER main panel

config PANEL_S6E3FA7_AMB458WJ01_HD
	depends on DISPLAY_SAMSUNG
	bool "LSI S6E3FA7 LDI"
	default n
	---help---
	LSI S6E3FA7 LDI 720_1680 WINNER SUB

config PANEL_S6E3FA7_AMS628RF01_FHD
	depends on DISPLAY_SAMSUNG
	bool "LSI S6E3FA7 LDI"
	default n
	---help---
	LSI S6E3FA7 LDI 1080_2220 ASTAR

config PANEL_S6E3FA7_AMS559NK01_FHD
	depends on DISPLAY_SAMSUNG
	bool "LSI S6E3FA7 LDI"
	default n
	---help---
	LSI S6E3FA7 LDI 1080_2220 JACKPOT

config PANEL_S6E3FA7_AMB575WD01_FHD
	depends on DISPLAY_SAMSUNG
	bool "LSI S6E3FA7 LDI"
	default n
	---help---
	LSI S6E3FA7 LDI 1080_2280 BEYOND0

config PANEL_ANA38401_AMSA05RB06_WQXGA
	depends on DISPLAY_SAMSUNG
	bool "LSI ANA38401 LDI"
	default n
	---help---
	LSI ANA38401 LDI 2560_1600 TAB S5

config PANEL_S6E3FA7_AMB628TR01_FHD
	depends on DISPLAY_SAMSUNG
	bool "LSI S6E3FA7 LDI"
	default n
	---help---
	LSI S6E3FA7 LDI 1080_2280 DAVINCI1

config PANEL_S6E3HA9_AMB675TG01_WQHD
	depends on DISPLAY_SAMSUNG
	bool "LSI S6E3HA9 LDI"
	default n
	---help---
	LSI S6E3HA9 LDI 1440_3040 DAVINCI2 P HOLE DSC

config PANEL_S6E36W3_AMB114EU09
	depends on DISPLAY_SAMSUNG
	bool "LSI S6E36W3 LDI"
	default n
	---help---
	LSI S6E36W3 LDI 120_300 BLOOM SUB

config PANEL_S6E3FC2_AMS670TA01_FHD
	depends on DISPLAY_SAMSUNG
	bool "LSI S6E3FC2 LDI"
	default n
	---help---
	LSI S6E3FC2 LDI 1080_2400 R3

config PANEL_S6E3FA9_AMB667UM01_FHD
	depends on DISPLAY_SAMSUNG
	bool "LSI S6E3FA9 LDI"
	default n
	---help---
	LSI S6E3FA9 LDI 1080_2400 R5

config PANEL_S6E3HAB_AMB677TY01_WQHD
	depends on DISPLAY_SAMSUNG
	bool "LSI S6E3HAB LDI"
	default n
	---help---
	LSI S6E3HAB LDI 1440_3200 A82 From HUBBLE Y2 DSC
```

## drivers/gpu/drm/msm/samsung_lego/Kconfig
```kconfig
config SAMSUNG_DEBUG_DISPLAY
	bool "Add Samsung Debugging code"
	default n

config DISPLAY_SAMSUNG_LEGO
	bool "mdss config for samsung product"
	default n
	---help---
	Mdss config signature for samsung product

#
#	PANEL UNIQUE FEATURE
#
config DUAL_PANEL
	depends on DISPLAY_SAMSUNG
	bool "dual paneloperation"
	default n
	---help---
	dual panel operation support

config PARTIAL_UPDATE
	depends on DISPLAY_SAMSUNG
	bool "partial update operation"
	default n
	---help---
	partial update operation support

config CABC_FUNCTION
	depends on DISPLAY_SAMSUNG
	bool "DDI cabc operation"
	default n
	---help---
	DDI cabc operation support

config SUPPORT_POC_FLASH
	depends on DISPLAY_SAMSUNG
	bool "SUPPORT POC FLASH"
	default n
	---help---
	SUPPORT_POC_FLASH FOR DREAM2 ONLY

#
#	HOW TO MAKE DEF-CONFIG NAME FOR PANEL
#
#	PANEL_DDI-model_PANEL-model_RESOLUTION
#	PANEL_S6E3FA2_AMS510CV01_FHD
#	PANEL_S6E3FA2_AMS510CV01_FHD
#

config PANEL_S6E3HAB_AMB677TY01_WQHD
	depends on DISPLAY_SAMSUNG || DISPLAY_SAMSUNG_LEGO
	bool "LSI S6E3HAB LDI"
	default n
	---help---
	LSI S6E3HAB LDI 1440_3200 A82 From HUBBLE Y2 DSC
```

## drivers/gpu/drm/panel/smcdsd_panel/Kconfig
```kconfig
if DRM_MEDIATEK && !MTK_FB

config SMCDSD_PANEL
	bool "Samsung Mobile Communication Division System Display"
	default n

endif # DRM_MEDIATEK && !MTK_FB

source "drivers/gpu/drm/panel/smcdsd_panel/panels/Kconfig"
```
