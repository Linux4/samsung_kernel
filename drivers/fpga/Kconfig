## drivers/gpu/drm/panel/smcdsd_panel/panels/Kconfig
```kconfig
if DRM_MEDIATEK && !MTK_FB && SMCDSD_PANEL

config SMCDSD_LCD_DEBUG
	bool "Support LCD_DEBUG"
	depends on DEBUG_FS
	default n

config SMCDSD_DPUI
	bool "Support DPUI"
	default n

config SMCDSD_MDNIE
	bool "Support MDNIE"
	default n

config SMCDSD_DOZE
	bool "Support DOZE"
	default n

config SMCDSD_MASK_LAYER
	bool "Support mask layer"
	default n

config SMCDSD_DYNAMIC_MIPI
	bool "Support dynamic mipi"
	default n

config SMCDSD_PANEL_M53X
	bool "Support SMCDSD_PANEL_M53X driver"
	default n

config SMCDSD_PANEL_A32X
	bool "Support SMCDSD_PANEL_A32X driver"
	default n

config SMCDSD_PANEL_A32XU
	bool "Support SMCDSD_PANEL_A32XU driver"
	default n

config SMCDSD_PANEL_A22EX
	bool "Support SMCDSD_PANEL_A22EX driver"
	default n

config SMCDSD_PANEL_A13X
	bool "Support SMCDSD_PANEL_A13X driver"
	default n

config SMCDSD_PANEL_A13XU
	bool "Support SMCDSD_PANEL_A13XU driver"
	default n

endif # DRM_MEDIATEK && !MTK_FB && SMCDSD_PANEL
```

## drivers/gpu/drm/samsung/dpu/Kconfig
```kconfig
config DRM_SAMSUNG_DPU
	tristate "DRM Support for Samsung EXYNOS Series"
	depends on OF && DRM && (SOC_S5E8825 || SOC_S5E9925 || SOC_S5E9935 || SOC_S5E8535 || SOC_S5E8835)
	select DRM_KMS_HELPER
	select VIDEOMODE_HELPERS
	help
	  Choose this option if you have a Samsung EXYNOS SoC chipset.
	  If M is selected the module will be called exynosdrm. It will
	  control various panel drivers and display hardware on Samsung
	  Exynos SoC chipset.

if DRM_SAMSUNG_DPU

config DRM_SAMSUNG_DPP
	bool "DPP on Exynos"
	default DRM_SAMSUNG_DPU
	depends on DRM_SAMSUNG_DPU
	help
	  This enables support for DPP(Display Pre Processor) device on
	  Samsung Exynos SoC. It will support scaling, rotation, compression
	  and so on.

comment "CRTCs"

config DRM_SAMSUNG_DECON
	bool "DECON on Exynos"
	depends on !FB_S3C && !DRM_EXYNOS
	default DRM_SAMSUNG_DPU
	help
	  Choose this option if you want to use Exynos DECON for DRM. It
	  will control DECON hardware. It can blend all windows connected
	  to DPP.

comment "Encoders and Bridges"

config DRM_SAMSUNG_DSI
	bool "MIPI-DSI host"
	depends on DRM_SAMSUNG_DECON
	select DRM_MIPI_DSI
	select DRM_PANEL
	default DRM_SAMSUNG_DPU
	help
	  This enables support for Exynos MIPI-DSI device. It will encode
	  data as mipi standard and transfer to the mipi panel. It also
	  supports to read and write mipi command to and from the mipi panel.
	  So, this driver can use various panel feature.

config DRM_SAMSUNG_WB
	bool "WB on Exynos"
	depends on DRM_SAMSUNG_DECON
	default DRM_SAMSUNG_DPU
	help
	  This enables support for Exynos Concurrent Writeback device.
	  It can be attached writeback at runtime. It will dump blended
	  output buffer which is displaying on LCD.
	  This means that both writeback and LCD display can be operated
	  simultaneously.

config DRM_SAMSUNG_DP
	bool "DP on Exynos"
	depends on DRM_SAMSUNG_DECON
	default n
	help
	  This enables support for Exynos DisplayPort device. It will encode
	  data as DP standard and transfer to the DP Dongle(USB type C to DP) or monitor.

config DRM_SAMSUNG_HIBERNATION
	bool "Support Display Hibernation"
	depends on DRM_SAMSUNG_DECON
	default DRM_SAMSUNG_DPU
	help
	  This enables support for Exynos Display Hibernation

config DRM_SAMSUNG_HIBERNATION_EARLY_WAKEUP
	bool "Support Hibernation Early Wakeup"
	depends on DRM_SAMSUNG_DECON && DRM_SAMSUNG_HIBERNATION
	default n
	help
	  This enables support for Exynos Hibernation Early Wakeup.
	  Hibernation Early Wakeup will be performed through sysfs.

config DRM_SAMSUNG_EWR
    bool "Support early wake up"
	depends on DRM_SAMSUNG_DECON
	default DRM_SAMSUNG_DPU

config EXYNOS_DMA_DSIMFC
    bool "Support DSIM Fast Command"
	depends on DRM_SAMSUNG_DECON
	default n

config EXYNOS_DMA_RCD
    bool "Support Rounded Corner Display"
	depends on DRM_SAMSUNG_DECON
	default n

config DRM_SAMSUNG_DOZE
	bool "Support Doze, Doze_suspend"
	depends on DRM_SAMSUNG_DECON
	default n
	help
	  This enables support for Exynos Display Doze

config EXYNOS_PLL_SLEEP
	bool "Support DPHY PLL Sleep"
	depends on DRM_SAMSUNG_DECON
	default n

config EXYNOS_CMD_SVSYNC
	bool "Support Command Mode Samsung Variable Sync"
	depends on DRM_SAMSUNG_DECON
	default n

config EXYNOS_CMD_SVSYNC_ONOFF
	bool "Support Command Mode Samsung Variable Sync On/Off"
	depends on DRM_SAMSUNG_DECON
	default n

config EXYNOS_DRM_BUFFER_SANITY_CHECK
	bool "Support DMA Buffer Sanity Check for Debugging"
        depends on DRM_SAMSUNG_DECON
        default n

config BOARD_EMULATOR
	bool "Support Emulator Display"
	depends on DRM_SAMSUNG_DECON
	default n

config EXYNOS_UEVENT_RECOVERY_SOLUTION
	bool "Support Recovery solution"
	depends on DRM_SAMSUNG_DECON
	default n
	help
	  If this menu is enabled, you can detect panel dead.

config EXYNOS_FREQ_HOP
    tristate "Support DPHY PLL Frequency Hopping"
	depends on DRM_SAMSUNG_DECON
	default n

source "drivers/gpu/drm/samsung/dpu/panel/Kconfig"
source "drivers/gpu/drm/samsung/dpu/mcd_cal/Kconfig"
endif
```

## drivers/gpu/drm/samsung/dpu/kunit_test/Kconfig
```kconfig
config EXYNOS_DRM_DECON_TEST
	bool "KUnit test for exynos_drm_decon_test"
	depends on SEC_KUNIT
	help
	  TODO: Describe config fully.


config EXYNOS_DRM_DSIM_TEST
	bool "KUnit test for exynos_drm_dsim_test"
	depends on SEC_KUNIT
	help
	  TODO: Describe config fully.


config EXYNOS_DRM_BTS_TEST
	bool "KUnit test for exynos_drm_bts_test"
	depends on SEC_KUNIT
	help
	  TODO: Describe config fully.


config EXYNOS_DRM_CONNECTOR_TEST
	bool "KUnit test for exynos_drm_connector_test"
	depends on SEC_KUNIT
	help
	  TODO: Describe config fully.


config EXYNOS_DRM_CRTC_TEST
	bool "KUnit test for exynos_drm_crtc_test"
	depends on SEC_KUNIT
	help
	  TODO: Describe config fully.


config EXYNOS_DRM_DEBUG_TEST
	bool "KUnit test for exynos_drm_debug_test"
	depends on SEC_KUNIT
	help
	  TODO: Describe config fully.


config EXYNOS_DRM_DPP_TEST
	bool "KUnit test for exynos_drm_dpp_test"
	depends on SEC_KUNIT
	help
	  TODO: Describe config fully.


config EXYNOS_DRM_DQE_TEST
	bool "KUnit test for exynos_drm_dqe_test"
	depends on SEC_KUNIT
	help
	  TODO: Describe config fully.


config EXYNOS_DRM_DRV_TEST
	bool "KUnit test for exynos_drm_drv_test"
	depends on SEC_KUNIT
	help
	  TODO: Describe config fully.


config EXYNOS_DRM_FB_TEST
	bool "KUnit test for exynos_drm_fb_test"
	depends on SEC_KUNIT
	help
	  TODO: Describe config fully.


config EXYNOS_DRM_FBDEV_TEST
	bool "KUnit test for exynos_drm_fbdev_test"
	depends on SEC_KUNIT
	help
	  TODO: Describe config fully.


config EXYNOS_DRM_FORMAT_TEST
	bool "KUnit test for exynos_drm_format_test"
	depends on SEC_KUNIT
	help
	  TODO: Describe config fully.


config EXYNOS_DRM_GEM_TEST
	bool "KUnit test for exynos_drm_gem_test"
	depends on SEC_KUNIT
	help
	  TODO: Describe config fully.


config EXYNOS_DRM_HIBERNATION_TEST
	bool "KUnit test for exynos_drm_hibernation_test"
	depends on SEC_KUNIT
	help
	  TODO: Describe config fully.


config EXYNOS_DRM_MIGOV_TEST
	bool "KUnit test for exynos_drm_migov_test"
	depends on SEC_KUNIT
	help
	  TODO: Describe config fully.


config EXYNOS_DRM_PLANE_TEST
	bool "KUnit test for exynos_drm_plane_test"
	depends on SEC_KUNIT
	help
	  TODO: Describe config fully.


config EXYNOS_DRM_WRITEBACK_TEST
	bool "KUnit test for exynos_drm_writeback_test"
	depends on SEC_KUNIT
	help
	  TODO: Describe config fully.
```

## drivers/gpu/drm/samsung/panel/ana6710/Kconfig
```kconfig
menuconfig USDM_PANEL_ANA6710
	tristate "ANA6710 DDI Panel Driver"
	depends on USDM_PANEL
	depends on USDM_PANEL_OLED_COMMON
	default n
	help
		This enables ANA6710 DDI dependent panel drivers of
		common panel driver. say Y, if you have a panel based on
		the ANA6710 DDI.
```

## drivers/gpu/drm/samsung/panel/s6e3fac/Kconfig
```kconfig
menuconfig EXYNOS_DECON_LCD_S6E3FAC
	tristate "S6E3FAC DDI Panel Driver"
	depends on MCD_PANEL
	default n
	help
		This enables S6E3FAC DDI dependent panel drivers of
		common panel driver. say Y, if you have a panel based on
		the S6E3FAC DDI.
```

## drivers/gpu/drm/samsung/panel/s6e3fc5/Kconfig
```kconfig
menuconfig USDM_PANEL_S6E3FC5
	tristate "S6E3FC5 DDI Panel Driver"
	depends on USDM_PANEL
	depends on USDM_PANEL_OLED_COMMON
	default n
	help
		This enables S6E3FC5 DDI dependent panel drivers of
		common panel driver. say Y, if you have a panel based on
		the S6E3FC5 DDI.
```

## drivers/gpu/drm/samsung/panel/s6e3hae/Kconfig
```kconfig
menuconfig EXYNOS_DECON_LCD_S6E3HAE
	tristate "S6E3HAE DDI Panel Driver"
	depends on MCD_PANEL
	default n
	help
		This enables S6E3HAE DDI dependent panel drivers of
		common panel driver. say Y, if you have a panel based on
		the S6E3HAE DDI.
```

## drivers/gpu/drm/samsung/panel/sw83109/Kconfig
```kconfig
menuconfig USDM_PANEL_SW83109
	tristate "SW83109 DDI Panel Driver"
	depends on USDM_PANEL
	depends on USDM_PANEL_OLED_COMMON
	default n
	help
		This enables SW83109 DDI dependent panel drivers of
		common panel driver. say Y, if you have a panel based on
		the SW83109 DDI.
```

## drivers/gpu/drm/samsung/panel/sw83109c/Kconfig
```kconfig
menuconfig USDM_PANEL_SW83109C
	tristate "SW83109C DDI Panel Driver"
	depends on USDM_PANEL
	depends on USDM_PANEL_OLED_COMMON
	default n
	help
		This enables SW83109C DDI dependent panel drivers of
		common panel driver. say Y, if you have a panel based on
		the SW83109C DDI.
```

## drivers/gpu/drm/samsung/panel/tft_common/Kconfig
```kconfig
menuconfig USDM_PANEL_TFT_COMMON
	tristate "TFT_COMMON DDI Panel Driver"
	depends on USDM_PANEL
	default n
	help
		This enables TFT_COMMON DDI dependent panel drivers of
		common panel driver. say Y, if you have a panel based on
		the TFT_COMMON DDI.


########## FOR KUNIT ##########

config TFT_COMMON_TEST
	bool "KUnit test for tft_common ddi driver"
	depends on SEC_KUNIT
	help
	  TODO: Describe config fully.

menuconfig USDM_PANEL_HX83122A_GTS9FEP_CSOT
	tristate "HX83122A_GTS9FEP_CSOT DDI Panel Driver"
	depends on USDM_PANEL_TFT_COMMON
	default n
	help
		This enables HX83122A_GTS9FEP_CSOT DDI dependent panel drivers of
		common panel driver. say Y, if you have a panel based on
		the HX83122A_GTS9FEP_CSOT DDI.

########## FOR KUNIT ##########

config HX83122A_GTS9FEP_CSOT_TEST
	bool "KUnit test for tft_common ddi driver"
	depends on SEC_KUNIT
	help
	  TODO: Describe config fully.

menuconfig USDM_PANEL_HX83122A_GTS9FEP_BOE
	tristate "HX83122A_GTS9FEP_BOE DDI Panel Driver"
	depends on USDM_PANEL_TFT_COMMON
	default n
	help
		This enables HX83122A_GTS9FEP_BOE DDI dependent panel drivers of
		common panel driver. say Y, if you have a panel based on
		the HX83122A_GTS9FEP_BOE DDI.

########## FOR KUNIT ##########

config HX83122A_GTS9FEP_BOE_TEST
	bool "KUnit test for tft_common ddi driver"
	depends on SEC_KUNIT
	help
	  TODO: Describe config fully.
```

## drivers/gpu/drm/samsung/sgpu/Kconfig
```kconfig
# SPDX-License-Identifier: MIT
config DRM_SGPU
	tristate "Samsung GPU"
	depends on DRM && MMU
	select FW_LOADER
	select DRM_KMS_HELPER
	select DRM_SCHED
	select DRM_TTM
	select DRM_TTM_HELPER
	select POWER_SUPPLY
	select HWMON
	select BACKLIGHT_CLASS_DEVICE
	select INTERVAL_TREE
	select CHASH
	select TRACE_GPU_MEM
	help
	  Choose this option if you have a recent SGPU.

	  If M is selected, the module will be called sgpu.

config DRM_SGPU_BUILTIN_FIRMWARE
	bool "Enable use of built-in firmware"
	depends on DRM_SGPU
	default y
	help
	  Selecting this option enables linking firmware binaries into the driver.

config DRM_SGPU_EXYNOS
	bool "Enable Exynos related code"
	depends on DRM_SGPU
	default n
	help
	  This option is for SGPU in Eynos.

config DRM_AMDGPU_SI
	bool "Enable amdgpu support for SI parts"
	depends on DRM_SGPU
	help
	  Choose this option if you want to enable experimental support
	  for SI asics.

	  SI is already supported in radeon. Experimental support for SI
	  in amdgpu will be disabled by default and is still provided by
	  radeon. Use module options to override this:

	  radeon.si_support=0 amdgpu.si_support=1

config DRM_AMDGPU_CIK
	bool "Enable amdgpu support for CIK parts"
	depends on DRM_SGPU
	help
	  Choose this option if you want to enable support for CIK asics.

	  CIK is already supported in radeon. Support for CIK in amdgpu
	  will be disabled by default and is still provided by radeon.
	  Use module options to override this:

	  radeon.cik_support=0 amdgpu.cik_support=1

config DRM_AMDGPU_USERPTR
	bool "Always enable userptr write support"
	depends on DRM_SGPU
	depends on MMU
	select HMM_MIRROR
	select MMU_NOTIFIER
	help
	  This option selects CONFIG_HMM and CONFIG_HMM_MIRROR if it
	  isn't already selected to enabled full userptr support.

config DRM_AMDGPU_DUMP
	bool "Enable AMDGPU GPU dump upon GPU hang"
	depends on DRM_AMDGPU
	depends on DRM_DUMP
	default y
	help
	  Selecting this option enables support for persisting AMDGPU's
	  different blocks register status upon GPU hang.

config DRM_AMDGPU_GMC_DUMP
	bool "Persist GMC block's status"
	depends on DRM_AMDGPU_DUMP
	default y
	help
	  Selecting this option enables support for persisting
	  AMDGPU's GMC block register status upon GPU hang.

config DRM_AMDGPU_GFX_DUMP
	bool "Persist GFX block's status"
	depends on DRM_AMDGPU_DUMP
	default y
	help
	  Selecting this option enables support for persisting
	  AMDGPU's GFX block register status upon GPU hang.

config DRM_AMDGPU_COMPUTE_DUMP
	bool "Persist COMPUTE block's status"
	depends on DRM_AMDGPU_DUMP
	default y
	help
	  Selecting this option enables support for persisting
	  AMDGPU's COMPUTE block register status upon GPU hang.

config DRM_AMDGPU_SDMA_DUMP
	bool "Persist SDMA block's status"
	depends on DRM_AMDGPU_DUMP
	default y
	help
	  Selecting this option enables support for persisting
	  AMDGPU's SDMA block register status upon GPU hang.

source "drivers/gpu/drm/amd/acp/Kconfig"
source "drivers/gpu/drm/amd/display/Kconfig"
source "drivers/gpu/drm/amd/amdkfd/Kconfig"
```

## drivers/gpu/drm/sprd/gsp/Kconfig
```kconfig
config DRM_SPRD_GSP
	bool "SPRD DRM GSP driver"
	depends on ARCH_SPRD
	depends on (ION_SPRD_STAGING || ION_SPRD)
	depends on DRM_SPRD
	---help---
	  GSP is hardware which not only can compose multiple layers
	  but also can transform and scale layers.

config DRM_SPRD_GSP_IPC_TRUSTY
	bool "SPRD DRM GSP widevine driver"
	depends on DRM_SPRD_GSP
	depends on TRUSTY_VIRTIO_IPC
	---help---
	  This function is to support the widevine function.

config DRM_SPRD_GSP_DVFS
	bool "SPRD DRM GSP dvfs driver"
	depends on DRM_SPRD_GSP
	depends on SPRD_APSYS_DVFS_DEVFREQ
	---help---
	  This function is to support the dvfs function.
```

## drivers/gpu/sprd_iommu/Kconfig
```kconfig
config SPRD_IOMMU
	bool "SPRD IOMMU Module"
	help
	  Chose this option to enable the SPRD IOMMU.
```

## drivers/gud/Kconfig
```kconfig
#
# Mobicore Configuration
#
if SOC_EXYNOS9820
source "drivers/gud/gud-exynos9820/Kconfig"
endif
if SOC_EXYNOS9830
source "drivers/gud/gud-exynos9830/Kconfig"
endif
if SOC_EXYNOS9630
source "drivers/gud/gud-exynos9630/Kconfig"
endif
if SOC_EXYNOS3830
source "drivers/gud/gud-exynos3830/Kconfig"
endif
```
