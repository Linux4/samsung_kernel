/* Copyright (c) 2016, The Linux Foundation. All rights reserved.
 *
 * This program is free software; you can redistribute it and/or modify
 * it under the terms of the GNU General Public License version 2 and
 * only version 2 as published by the Free Software Foundation.
 *
 * This program is distributed in the hope that it will be useful,
 * but WITHOUT ANY WARRANTY; without even the implied warranty of
 * MERCHANTABILITY or FITNESS FOR A PARTICULAR PURPOSE.  See the
 * GNU General Public License for more details.
 * 
 */

/*
 * As a general rule, only motor tuning property overrides should be placed
 * inside this file.
 */

&soc {
	samsung,vibrator {
		samsung,support_multi_freq = <1>;
		samsung,freq_0 = <3 137>;	// m n
		samsung,freq_low = <3 137>;
		samsung,freq_mid = <3 137>;
		samsung,freq_high = <3 137>;
		samsung,freq_alert = <3 137>;
		samsung,strength_od = <70>;
		samsung,strength_default = <47>;
		samsung,vib_type = "LINEAR_0832RC";	// MD05(PWM) + RC0832
	};
};
