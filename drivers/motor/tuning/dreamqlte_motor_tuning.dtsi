/* Copyright (c) 2016, The Linux Foundation. All rights reserved.                 
 *                                                                                
 * This program is free software; you can redistribute it and/or modify           
 * it under the terms of the GNU General Public License version 2 and             
 * only version 2 as published by the Free Software Foundation.                   
 *                                                                                
 * This program is distributed in the hope that it will be useful,                
 * but WITHOUT ANY WARRANTY; without even the implied warranty of                 
 * MERCHANTABILITY or FITNESS FOR A PARTICULAR PURPOSE.  See the                  
 * GNU General Public License for more details.                                   
 */                                                                               

/*                                                                                
 * As a general rule, only motor tuning property overrides should be placed   
 * inside this file.                                                              
 */                                                                               

&soc {
	samsung,vibrator {
		samsung,freq_0 = <2 104>;    // m n
		samsung,freq_low = <2 156>;
		samsung,freq_mid = <2 125>;
		samsung,freq_high = <3 140>;
		samsung,freq_alert = <2 119>;
		samsung,strength_od = <70>;
		samsung,strength_default = <35>;
	};
};

&i2c_6 {
	drv2624@5A {
		overdrive_rtp_input_limit = <88>;
		rtp_input_limit = <56>;
		frequency = <158>;
		support_multi_freq = <1>;
		multi_freq_support_num = <5>;
		/* frequency   alert low  mid  high  0 */
		multi_freq = <158 120 150 200 180>;
		multi_freq1 = <0x01 0x01 0x01 0x00 0x00>;
		multi_freq2 = <0x04 0x55 0x12 0xce 0xe4>;
	};
};
