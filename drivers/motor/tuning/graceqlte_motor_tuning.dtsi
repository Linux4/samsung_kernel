/* Copyright (c) 2016, The Linux Foundation. All rights reserved.                 
 *                                                                                
 * This program is free software; you can redistribute it and/or modify           
 * it under the terms of the GNU General Public License version 2 and             
 * only version 2 as published by the Free Software Foundation.                   
 *                                                                                
 * This program is distributed in the hope that it will be useful,                
 * but WITHOUT ANY WARRANTY; without even the implied warranty of                 
 * MERCHANTABILITY or FITNESS FOR A PARTICULAR PURPOSE.  See the                  
 * GNU General Public License for more details.                                   
 */                                                                               

/*                                                                                
 * As a general rule, only motor tuning property overrides should be placed   
 * inside this file.                                                              
 */                                                                               

&soc {
	samsung,vibrator {
		samsung,freq_0 = <2 104 94>;    // m n str
		samsung,freq_low = <2 156 94>;
		samsung,freq_mid = <2 125 94>;
		samsung,freq_high = <3 140 94>;
		samsung,freq_alert = <2 119 94>;
	};
};
