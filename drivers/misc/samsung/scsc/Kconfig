## drivers/misc/samsung/scsc/Kconfig
```kconfig
config SCSC_CORE_CM
	tristate "Samsung SCSC Maxwell driver Core Module"
	depends on SCSC_CORE

config SCSC_CORE
	tristate "Samsung SCSC Maxwell driver"
	select SCSC_CORE_CM

config SCSC_CORE_FW_LOCATION
	string "SCSC FW location"
	default "/system/etc/wifi"
	---help---
	  Select the FW location.

config SCSC_PCIE
	tristate "Samsung SCSC MIF PCIE implementation"
	depends on SCSC_CORE
	depends on PCI

config SCSC_PLATFORM
	tristate "Samsung SCSC MIF Platform driver implementation"
	depends on SCSC_CORE

config SCSC_CM_MX_CLIENT_TEST
	tristate "Samsung SCSC Test Client"
	depends on SCSC_CORE

config SCSC_MX_ALWAYS_ON
	tristate "Samsung SCSC MX140 always booted"
	depends on SCSC_CM_MX_CLIENT_TEST

config SCSC_CLK20MHZ
	tristate "Samsung SCSC USB 20MHz Clock"
	depends on SCSC_CORE

config SCSC_CLK20MHZ_TEST
	tristate "Samsung SCSC USB 20MHz Clock Test"
	depends on SCSC_CLK20MHZ

config SCSC_MMAP
	tristate "Samsung SCSC MMAP/GDB User space interface"
	depends on SCSC_CORE

config SCSC_DBG_SAMPLER
	tristate "Samsung SCSC Debug Sampler Service"
	depends on SCSC_CORE

config SCSC_DEBUG
	tristate "Samsung SCSC Logging"
	depends on SCSC_CORE
	default n

config SCSC_DEBUG_COMPATIBILITY
	bool "Samsung SCSC Logging mode"
	depends on SCSC_DEBUG
	default y

config SCSC_STATIC_RING
	tristate "Samsung SCSC Logging use static ring"
	depends on SCSC_CORE
	default n

config SCSC_STATIC_RING_SIZE
	int "Size of the static ring"
	depends on SCSC_CORE && SCSC_STATIC_RING
	default "1048576"
	range 1024 4194304

config SCSC_CHV_SUPPORT
	bool "Samsung CHV f/w support"
	depends on SCSC_CORE
	default n

config SCSC_GPR4_CON_DEBUG
	bool "GPR4 PIO muxes switching to the Maxwell Subsystem"
	depends on SCSC_PLATFORM
	default n
```

## drivers/misc/samsung/scsc_bt/Kconfig
```kconfig
config SCSC_BT
        tristate "SCSC MX BT support"
        depends on SCSC_CORE
```

## drivers/misc/samsung/slsi_bt/Kconfig
```kconfig
config SLSI_BT
	tristate "SLSI MX BT support"
	depends on (SCSC_CORE || KUNIT_SLSI_BT_TEST)

choice
	prompt "Data transport interface"
	depends on SLSI_BT
		default SLSI_BT_USE_UART_INTERFACE
config SLSI_BT_USE_UART_INTERFACE
		bool "UART interface"
config SLSI_BT_USE_MIF_INTERFACE
		bool "MIF interface"
endchoice

config SLSI_BT_TTY_DEVICE_NAME
	string "TTY device filename"
	default "ttySAC1"
	depends on SLSI_BT_USE_UART_INTERFACE
	help
	  Select the tty device file.

config SLSI_BT_TTY_BAUD
	int "Baud rate"
	default 4800000
	depends on SLSI_BT_USE_UART_INTERFACE
	help
	  Select baud rate for serial interface.

config SLSI_BT_H4
	default N
	tristate "Enable Part D. Uart Transport Layer Protocol(H4) driver"
	depends on SLSI_BT
	help
	  Select the SLSI BT UTLP (H4) driver.

config SLSI_BT_BCSP
	default N
	tristate "Enable BCSP driver"
	depends on SLSI_BT
	help
	  Select the SLSI BT BCSP driver.

config SLSI_BT_3WUTL
	default N
	tristate "Enable 3-Wire Uart Trasnport Layer driver instead of BCSP"
	depends on SLSI_BT_BCSP
	help
	  Select the SLSI BT 3WUTL driver.

config SLSI_BT_ADDRESS_IN_FILE
	default N
	tristate "SCSC MX BT support"
	depends on SCSC_CORE
	help
	  Allow BT address to be read from a file

config SLSI_BT_ADDRESS_FILENAME
	string "BT address filename"
	depends on SCSC_CORE
	default "/mnt/vendor/efs/bluetooth/bt_addr"
	help
	  Select the named BT address override file.
```

## drivers/misc/sar/hx9031/Kconfig
```kconfig
#
# Input misc drivers configuration
#
menuconfig INPUT_MISC
	bool "Miscellaneous devices"
	help
	  Say Y here, and a list of miscellaneous input drivers will be displayed.
	  Everything that didn't fit into the other categories is here. This option
	  doesn't affect the kernel.

	  If unsure, say Y.

if INPUT_MISC

config INPUT_HX9031A
	tristate "NanJingTianYiHeXin HX9031A or HX9023E SAR SENSOR"
	depends on I2C
	default n

endif

config SENSORS
	bool "Sensors Class Support"
	help
	  This option enables the sensor sysfs class in /sys/class/sensors.
	  You'll need this to do anything useful with sensorss. If unsure, say N.
```

## drivers/misc/sdiodev/Kconfig
```kconfig
menu "SDIODEV modules"

config SDIODEV
	tristate "SPRD SDIO DEV SUPPORT"	
	---help---
	  PLEASE INSMOD THIS MODULE BEFORE OTHER SDIO DEV MODULES

config SDIODEV_TEST
	bool "SDIO DEV TEST"
	default n
	depends on SDIODEV
	help
	  FOR RUN SDIODEV TEST CASE,DO NOT OPEN IT IN NORMAL MODE

config MARLIN_CALI_READY_94
	bool "Marlin cali ready 94"
	default n
	help
	  FOR marlin cali ready 94

config MARLIN_CALI_READY_131
        bool "Marlin cali ready 131"
        default n
        help
          FOR marlin cali ready 131

endmenu
```

## drivers/misc/sprd_apdu/Kconfig
```kconfig
menuconfig SPRD_APDU_DRIVERS
	bool "SPRD APDU drivers"
	help
	  Say Y to enable Spreadtrum application protocol data unit driver Support.
	  If unused, say N.

if SPRD_APDU_DRIVERS

config SPRD_APDU
	tristate "Spreadtrum APDU driver"
	default n
	help
	  Spreadtrum application protocol data unit driver Support.
	  If unused, say N.

config SPRD_APDU_R3P0
	tristate "Spreadtrum APDU R3P0 driver"
	default n
	help
	  Spreadtrum application protocol data unit driver R3P0 Support.
	  If unused, say N.

endif # SPRD_APDU_DRIVERS
```

## drivers/misc/sprd_audio/Kconfig
```kconfig
menu "Spreadtrum Audio Assistant Modules"
config SPRD_AUDIO_AGDSP_ACCESS
	tristate "Sprd audio agdsp access"
	depends on SPRD_MAILBOX
	help
	  This module is used to enable the access
	  of agdsp registers.
	  If audio use audio cp, this config should be selected.
	  If r3p0 vbc is used, this must be set to Y.

config SPRD_AUDIO_MEMORY_MANAGER
	tristate "Sprd audio memory manager"
	help
	  This module is used to manager memories that needed by offlad play(mp3 play),
	  music data buffer used by dma, audio sipc and share memory.
	  If r3p0 vbc is used, this must be set to Y.
	  Say Y if you support audio memory manager.

config SPRD_AUDIO_DSP_DUMP
	tristate "Sprd audio dsp dump"
	depends on SPRD_SIPC
	help
		This module is used to dump dsp log,
		memory and pcm data.
		The main purpers is support debug information.
		Say Y if you support dsp dump.

config SPRD_AUDIO_SIPC
	tristate "Sprd audio sipc"
	depends on SPRD_MAILBOX && SPRD_AUDIO_MEMORY_MANAGER
	help
		This module is used to communication with
		other processor(e.g. agdsp).
		It depends on mailbox and audio memeroy manager.
		Say Y if you support sipc.

config SPRD_AUDIO_SAUDIO
	tristate "Sprd saudio driver in call mode based on sipc"
	depends on SPRD_SIPC
	default N
	help
	  Say Y if you want to built in to kernel, Say M for ko module.
	  SAudio is a bridge to connect AP and CP system.

config SPRD_AUDIO_MCDT
	bool "Spreadtrum MCDT support"
	default n
	help
	  MCDT(Multi-Channel Data Transfer) is a Hardware module
	  that can be used to transfer data between AP and DSP,
	  normally we use it transfer audio data.
	  Say Y if your platform supports hardware MCDT.

config SPRD_AUDIO_MCDT_R2P0
	bool "Spreadtrum MCDT_R2P0 support"
	default n
	help
	  MCDT_r2p0(Multi-Channel Data Transfer) is a Hardware module
	  that can be used to transfer data between AP and DSP,
	  normally we use it transfer audio data.
	  Say Y if your platform supports hardware MCDT_r2p0.

config SPRD_HW_DEVICE_DVFS_AGCP
	tristate "Spreadtrum AGCP dvfs driver"
	depends on SPRD_MAILBOX && SPRD_AUDIO_MEMORY_MANAGER
	help
	   This driver supports dvfs interfaces for PUBCP DVFS and WTLCP DVFS at user specidied.

config SPRD_AUDIO_CPBOOT
	tristate "Spreadtrum AGCP boot driver"
	depends on SPRD_AUDIO_MEMORY_MANAGER
	help
	  Audio cp boot driver is used for reboot audio cp in kernel.
	  It support interface for userspace to stop audio cp, download dsp bin and
	  start audio cp.

config SPRD_AUDIO_VOICE_TRIGGER
	bool "Sprd audio voice trigger"
	default n
	help
		This module is used to create a file node for voice trigger,
		it will be used by audio HAL.
		Say Y if you support voice trigger.

config SND_SOC_XS200X
	tristate "XS200X Voice Trigger"
	default n
	help
		XS200X Voice Trigger driver

config SND_SOC_AK4377_HIFI
	tristate "AK4377_HIFI"
	default n
	help
		AK4377_HIFI
endmenu
```

## drivers/misc/sprd_coda7l/Kconfig
```kconfig
# to add sprd vsp configs in the future
config SPRD_CODA7L
	bool "sprd coda7l driver"
	help
	"enable coda7l device driver"
```

## drivers/misc/sprd_dwnload/Kconfig
```kconfig
config SPRD_DOWNLOAD_IMG
	tristate "SPRD Marlin Download img"
	default n
	help
	  If you say yes here you can use the fdl and img for marlin.
config SPRD_DOWNLOAD_POWER_CTL
	bool "SPRD Marlin Power control"
	default n
	help
	  If you say yes here you can use the marlin chip.
```

## drivers/misc/sprd_jpg/Kconfig
```kconfig
# to add sprd jpg configs in the future
config SPRD_JPG
	tristate "SPRD jpg driver"
	depends on ARCH_SCX35
	default y
```

## drivers/misc/sprd_otp/Kconfig
```kconfig
menuconfig OTP_SPRD

    bool "Spreadtrum OTP Efuse"
    depends on ARCH_SCX30G || ARCH_SCX35L
    default y
    help
      Spreadtrum OTP Efuse Support.

if OTP_SPRD

config OTP_SPRD_EFUSE
    tristate "Spreadtrum D-die AON Efuse driver (since from r3p0)"
    depends on ARCH_SCX30G || ARCH_SCX35L
    default y
    help
      Say Y here to support spreadtrum ddie efuse for ip r3p0 version.

config OTP_SPRD_ADIE_EFUSE
    tristate "Spreadtrum A-die eFuse/eMemory driver"
    depends on ADIE_SC2723 || ADIE_SC2723S
    default y
    help
      Say Y here to support spreadtrum adie efuse.

config OTP_SPRD_LASER_FUSE
    tristate "Spreadtrum A-die laser fuse driver (no longer recommended)"
    depends on ADIE_SC2713 || ADIE_SC2713S
    default y
    help
      Say Y here to support spreadtrum adie laser fuse.

endif
```

## drivers/misc/sprd_simdet/Kconfig
```kconfig
config SPRD_SIMDET
	tristate "SPRD SIM CARD DETECT Driver"
	default n
config SPRD_SIMDET_IOCTL
	bool "SPRD SIM CARD DETECT Driver IOCTL support"
	depends on SPRD_SIMDET
	default n
	
```

## drivers/misc/sprd_vpp/sprd_deint/Kconfig
```kconfig
# to add sprd vsp configs in the future
config SPRD_VPP
	bool "SPRD VPP driver"
	help
	"enable vpp device driver"
```

## drivers/misc/sprd_vpu/Kconfig
```kconfig
# to add sprd vsp configs in the future
config SPRD_VPU
	tristate "SPRD vpu driver"
	depends on ARCH_SPRD
---help---
Say Y here if you want to build a driver for vpu device for qogirn6pro; otherwise, N.
```

## drivers/misc/sprd_vsp/Kconfig
```kconfig
# to add sprd vsp configs in the future
config SPRD_VSP
	tristate "SPRD vsp driver"
	depends on ARCH_SC8810 || ARCH_SC8825 || ARCH_SCX35
	default y
```

## drivers/misc/sprd_wcn_n6pro/Kconfig
```kconfig
#
# Misc wcn bsp devices
#

source "drivers/misc/sprd_wcn_n6pro/wcn_bsp_sdio/Kconfig"
source "drivers/misc/sprd_wcn_n6pro/wcn_bsp_pcie/Kconfig"
```

## drivers/misc/sprd_wcn_n6pro/wcn_bsp_pcie/Kconfig
```kconfig
#
# Spreadtrum WCN PCIE device (NEW )configuration
#
menu "Spreadtrum WCN PCIE Device Drivers"
config WCN_BSP_PCIE
	tristate "WCN_BSP_PCIE"
	help
	  This is support wcn chip for spreadtrum.
	  if you want to use PCIE series wcn chip of spreadtrum.
	  please say "m".

config SC2355_P
	tristate "SC2355 chip Support"
	default n
	help
	  This is support wcn chip for spreadtrum.
	  If you want to use sc2355 chip of spreadtrum.
	  Please say "y".

endmenu
```

## drivers/misc/sprd_wcn_n6pro/wcn_bsp_sdio/Kconfig
```kconfig
#
# Spreadtrum WCN SDIO device (NEW )configuration
#
menu "Spreadtrum WCN SDIO Device Drivers"
config WCN_BSP_SDIO
	tristate "WCN_BSP_SDIO"
	help
	  This is support wcn chip for spreadtrum.
	  if you want to use SDIO series wcn chip of spreadtrum.
	  please say "m".

config UMW2652_S
	tristate "UMW2652_S chip Support"
	default n
	help
	  This is support wcn chip for spreadtrum.
	  If you want to use umw2652 chip of spreadtrum.
	  Please say "y".

endmenu
```

## drivers/misc/sprdwcn/Kconfig
```kconfig
#
# Spreadtrum WCN device (NEW )configuration
#
menu "Spreadtrum WCN Device Drivers"
config SC23XX
	bool "SC23XX chip Support"
	#depends on MMC
	default n
	help
	  This is support wcn chip for spreadtrum.
	  if you want to use 23xx series wcn chip of spreadtrum.
	  please say "y".

config WCN_INTEG
	tristate "WCN Integrated chip Support"
	depends on SC23XX
	default n
	help
	  This is support wcn chip for spreadtrum.
	  If you want to use WCN integrated chip of spreadtrum.
	  Please say "y".

config SC2355
	tristate "SC2355 chip Support"
	depends on SC23XX
	default n
	help
	  This is support wcn chip for spreadtrum.
	  If you want to use sc2355 chip of spreadtrum.
	  Please say "y".

config UMW2652
	tristate "UMW2652 chip Support"
	depends on SC23XX
	default n
	help
	  This is support wcn chip for spreadtrum.
	  If you want to use umw2652 chip of spreadtrum.
	  Please say "y".

config UMW2653
	tristate "UMW2653 chip Support"
	depends on SC23XX
	default n
	help
	  This is support wcn chip for spreadtrum.
	  If you want to use umw2653 chip of spreadtrum.
	  Please say "y".

config SC2342_I
	tristate "SC2342 integrated chip Support"
	depends on WCN_INTEG
	default n
	help
	  This is support wcn sc2342 integrated chip unique config for spreadtrum.
	  use it distinguish with other integrated chip.
	  If you want to use sc2342 integrated chip of spreadtrum.
	  Please say "y".

config UMW2631_I
	tristate "UMW2631 integrated chip Support"
	depends on WCN_INTEG
	default n
	help
	  This is support wcn umw2631 integrated chip unique config for unisoc.
	  If you want to use umw2631 integrated chip of unisoc.
	  Please say "y".

# sprd's SDIO device driver based on SC2355...,etc
source "drivers/misc/sprdwcn/sdio/Kconfig"

# sprd's SIPC device driver based on WCN_INTEG...,etc
source "drivers/misc/sprdwcn/sipc/Kconfig"

# sprd's sleep device driver based on SC2355...,etc
source "drivers/misc/sprdwcn/sleep/Kconfig"

# sprd's PCIe device driver based on SC2355...,etc
source "drivers/misc/sprdwcn/pcie/Kconfig"

# sprd's wcn platform driver based on SC2355/SC2342...,etc
source "drivers/misc/sprdwcn/platform/Kconfig"

endmenu
```

## drivers/misc/thin_modem/Kconfig
```kconfig
menuconfig THIN_MODEM
	bool "HSIC I/F for Ericsson, Samsung"
	default n

if THIN_MODEM

config SEC_MODEM_ERICSSON
	bool "ERICSSON HSIC feature"
	default n
	select LTE_MODEM_M74XX
	select LINK_DEVICE_HSIC

comment "Select Link Devices"

config LTE_MODEM_M74XX
	bool "modem chip : ERICSSON M74XX"
	default n

config LINK_DEVICE_HSIC
	bool "modem driver link device HSIC"
	default n

endif

if LINK_DEVICE_HSIC
config EHCI_MODEM_PORTNUM
	int "EHCI port number for modem connection"
	default 2
endif
```

## drivers/misc/trout_fm/Kconfig
```kconfig
config TROUT_FM
	tristate "SPRD Trout FM Support"
	depends on SPRD_2351
	---help---
	  Say Y to enable built-in wireless MAC controller in the
	  Spreadtrum SC88xx based System-on-Chip devices.

config FM_SEEK_STEP_50KHZ
	tristate "Trout FM Seek Step 50KHz Support "
	default n
	help
	  If you say yes here you can support Step 50KHz for Trout FM.

if TROUT_FM
choice
	prompt "TROUT INTERFACE"
	default INTERFACE_ONCHIP
#use shared interface
config INTERFACE_SHARED
	depends on TROUT_FM
	bool "Use Shared Interface"
	help
	  Public interface for trout FM BT and WIFI.

config INTERFACE_ONCHIP
	depends on TROUT_FM
	bool "Use Onchip interface."
	help
	  Directly access to the trout configure address.

endchoice

choice
	prompt "TROUT RF"
	default RF_SHARK

#use rf 55
config RF_55
	depends on TROUT_FM
	bool "RF 55"
	help
	  MXD RF.

#use rf 2829
config RF_2829
	depends on TROUT_FM
	bool "RF 2829"
	help
	  SPRD RF.

config RF_SHARK
	depends on TROUT_FM
	bool "RF SHARK"
	help
	  SPRD RF.

endchoice

endif
```
