## drivers/misc/mediatek/typec/tcpc/Kconfig
```kconfig
#
# TypeC Port Controller Device Configuration
#

config TCPC_CLASS
	bool "TypeC Port Controller Device Class"
	select MTK_USB_TYPEC
	select TYPEC
	help
	  Say Y to enable
	  Typec Port
	  Controller Device
	  Class

config TCPC_RT1711H
	bool "Richtek RT1711H TypeC port Controller Driver"
	depends on TCPC_CLASS
	default n
	help
	  Say Y to enable
	  Richtek RT1711H
	  TypeC port Controller
	  Driver

config TCPC_RT5081
	bool "Richtek RT5081 TypeC port Controller Driver"
	depends on TCPC_CLASS
	default n
	help
	  Say Y to enable Richtek RT5081
	  TypeC port Controller
	  Also Support Power Delivery
	  Say N to disable

config TCPC_MT6360
	bool "MediaTek MT6360 TypeC port Controller Driver"
	depends on TCPC_CLASS
	help
	  Say Y to enable MediaTek MT6370
	  TypeC port Controller
	  Also Support Power Delivery
	  Say N to disable

config TCPC_MT6362
	tristate "MT6362 SPMI TCPC driver"
	depends on TCPC_CLASS
	depends on MFD_MT6362
	help
	  Say yes here to have support for the MT6362 TCPC
	  Support TypeC port Controller and Power Delivery

	  The driver can also be build as a module.
	  If so, the module will be called tcpci_mt6362

config TCPC_MT6370
	bool "MediaTek MT6370 TypeC port Controller Driver"
	depends on TCPC_CLASS
	default n
	help
	  Say Y to enable MediaTek MT6370
	  TypeC port Controller
	  Also Support Power Delivery
	  Say N to disable

config PD_DBG_INFO
	bool "TCPC power delivery debug information"
	depends on TCPC_CLASS
	default y
	help
	  Say Y to enable
	  power delivery
	  debug information
	  Say N to disable

config USB_POWER_DELIVERY
	bool "Support USB power delivery Function"
	depends on TCPC_CLASS
	default n
	help
	  Say Y to enable
	  USB
	  Power Delivery
	  support

config USB_PD_VBUS_STABLE_TOUT
	int "PD VBUS Stable Timeout"
	depends on USB_POWER_DELIVERY
	range 0 1000                       # >= 0,  <= 1000
	default 125
	help
	  Setup a timeout value (ms)
	  for
	  VBUS change
	  stable

config MTK_TYPEC_WATER_DETECT
	bool "Water detection function for type-c connector"
	depends on TCPC_CLASS
	help
	  Say Yes to enable water detection on type-c connector.
	  If water is detected on the connector, it will show
	  warning to notify end user.
	  If unsure, say N.

config MTK_TYPEC_WATER_DETECT_BY_PCB
	bool "Let PCB decides enabling water detection or not"
	depends on MTK_TYPEC_WATER_DETECT
	help
	  Query GPIO on PCB to judge whether type-c water detection
	  need to be enabled.
	  Say Yes to let PCB decides enabling water detection or not.
	  If unsure, say N.

# HS03s for SR-AL5625-01-515 by wangzikang at 21210610 start
config TCPC_WUSB3801
	bool "IGC WUSB3801X Configuration Channel Controller for USB Type-C"
	depends on USB || I2C
	default n
	help
	  Enable this to support WUSB3801X CC Controller for USB Type C.

config TYPEC_SGM7220
	tristate "SG-Micro SGM7220 Type-C chip driver"
	depends on I2C
	help
	  The SG-Micro SGM7220 Type-C chip driver that works with
	  Type-C Port Controller Manager to provide USB Type-C
	  functionalities.
# HS03s for SR-AL5625-01-515 by wangzikang at 21210610 end

#HS03s for SR-AL5625-01-541 by wangzikang at 20210614 start
config FUSB301A
	tristate "fusb301 driver"
	depends on I2C
	default n
	help
	  Say Y here to enable support for type-c CC and SBU protection
	  IC FUSB301.
#HS03s for SR-AL5625-01-541 by wangzikang at 20210614 end

# AL6528A code for SR-AL6528A-01-307 by wenyaqi at 2022/08/30 start
config TCPC_HUSB311
	bool "Hynetek HUSB311 TypeC port Controller Driver"
	depends on TCPC_CLASS
	default n
	help
	  Say Y to enable
	  Hynetek HUSB311
	  TypeC port Controller
	  Driver

config HUSB_REGMAP
	tristate "regmap"
	default n
	help
	  Say Y to enable HUSB_REGMAP
	  information
	  Say N to disable
# AL6528A code for SR-AL6528A-01-307 by wenyaqi at 2022/08/30 end

# hs14 code for SR-AL6528A-01-309 by wenyaqi at 2022/09/11 start
config TCPC_ET7304
	bool "ETEK ET7304 TypeC port Controller Driver"
	depends on TCPC_CLASS
	default n
	help
	  Say Y to enable
	  ETEK ET7304
	  TypeC port Controller
	  Driver
config ET_REGMAP
	tristate "regmap"
	default n
	help
	  Say Y to enable ET_REGMAP
	  information
	  Say N to disable
# hs14 code for SR-AL6528A-01-309 by wenyaqi at 2022/09/11 start

# hs14 code for SR-AL6528A-01-308 by wenyaqi at 2022/09/09 start
config FUSB302_EXT
	tristate "ONSAIMEI USB Power Delivery controller driver"
	depends on I2C
	default n
	help
	  Say Y or M here if your system has ONSAIMEI USB Power
	  Delivery controller.

source "drivers/misc/mediatek/typec/tcpc/tcpc_fusb302b/Kconfig"
# hs14 code for SR-AL6528A-01-308 by wenyaqi at 2022/09/09 end
```

## drivers/misc/mediatek/typec/tcpc/tcpc_if/Kconfig
```kconfig
# A06 code for SR-AL7160A-01-347 by shixuanxuan at 20240323 start
config TCPC_UPM6922
	bool "TCPC_UPM6922 TypeC port Controller Driver"
	depends on TCPC_CLASS
	default n
	help
	  Say Y to enable
	  TCPC_UPM6922
	  TypeC port Controller
	  Driver
# A06 code for SR-AL7160A-01-347 by shixuanxuan at 20240323 end

# A06 code for SR-AL7160A-01-275 by shixuanxuan at 20240325 start
config TCPC_UPM7610
	bool "TCPC_UPM7610 TypeC port Controller Driver"
	depends on TCPC_CLASS
	default n
	help
	  Say Y to enable
	  TCPC_UPM7610
	  TypeC port Controller
	  Driver
# A06 code for SR-AL7160A-01-275 by shixuanxuan at 20240325 end

# A06 code for SR-AL7160A-01-274 by shixuanxuan at 20240326 start
config TCPC_CPS8851
	bool "TCPC_CPS8851 TypeC port Controller Driver"
	depends on TCPC_CLASS
	default n
	help
	  Say Y to enable
	  TCPC_CPS8851
	  TypeC port Controller
	  Driver
# A06 code for SR-AL7160A-01-274 by shixuanxuan at 20240326 end

# A06 code for SR-AL7160A-01-291 by zhangziyi at 20240327 start
config TCPC_WUSB3812
	tristate "Willsemi WUSB3812 TypeC port Controller Driver"
	depends on TCPC_CLASS
	default n
	help
	  Say Y to enable Willsemi WUSB3812
	  TypeC port Controller Driver
	  Say N to disable
# A06 code for SR-AL7160A-01-291 by zhangziyi at 20240327 end
```

## drivers/misc/mipi-lli/Kconfig
```kconfig
#
# MIPI LLI
#

menuconfig MIPI_LLI
	tristate "MIPI LLI"
	default n
	help
	  It is for supporting MIPI LLI driver.

if MIPI_LLI
config EXYNOS_MIPI_LLI
	bool "Enable Exynos MIPI LLI"
	default y
	help
	  Enable MIPI LLI via Shared Memory.

config EXYNOS_MIPI_LLI_MPHY
	bool "Enable Exynos MIPI LLI MPHY"
	default y
	depends on EXYNOS_MIPI_LLI
	help
	  Enable M-PHY for MIPI-LLI

config EXYNOS_MIPI_LLI_GPIO_SIDEBAND
	bool "Enable Exynos MIPI LLI GPIO SIDEBAND SIGNAL"
	default y
	depends on SOC_EXYNOS5433 || (SOC_EXYNOS5430 && LTE_MODEM_XMM7260)
	help
	  Prevent bug-hang issue by gpio instead of sideband signal

endif # MIPI_LLI
```

## drivers/misc/modem_v1/Kconfig
```kconfig
comment "Samsung Mobile Modem Driver (SVNET2) V1 for Memory-type Interface"
menuconfig SEC_MODEM_V1
	bool "Samsung Mobile Modem Driver (SVNET2) V1 for Memory-type Interface"
	depends on SEC_MODEM
	default n
	---help---
	  Samsung Modem Interface Driver

config UMTS_MODEM_SS222
	bool "Samsung SS222 modem"
	depends on SEC_MODEM_V1
	default n

config UMTS_MODEM_SH222AP
	bool "Samsung SH222AP (one-chip) modem"
	depends on SEC_MODEM_V1
	default n

config LINK_DEVICE_MEMORY
	bool "Memory-type (i.e. shared memory) interface medium"
	depends on SEC_MODEM_V1
	default n

config LINK_POWER_MANAGEMENT
	bool "Power management (PM) for a link device"
	depends on SEC_MODEM_V1
	default n

config LINK_DEVICE_C2C
	bool "Pseudo shared-memory with chip-to-chip (C2C) interface"
	depends on SEC_MODEM_V1
	select LINK_DEVICE_MEMORY
	select LINK_POWER_MANAGEMENT
	default n

config LINK_DEVICE_SHMEM
	bool "Real system-level shared-memory on a system bus"
	depends on SEC_MODEM_V1
	select LINK_DEVICE_MEMORY
	default n

choice
	prompt "SEC MODEM CONFIG"
	depends on SEC_MODEM_V1
	default MODEM_SET_SH222AP

config MODEM_SET_SS222
	bool "Samsung SS222 (single modem configuration)"
	select UMTS_MODEM_SS222
	select LINK_DEVICE_C2C

config MODEM_SET_SH222AP
	bool "Samsung SH222AP (single modem configuration)"
	select UMTS_MODEM_SH222AP
	select LINK_DEVICE_SHMEM

endchoice
```

## drivers/misc/modem_v2/Kconfig
```kconfig
menuconfig SEC_MODEM_V2
	bool "Samsung Mobile Modem Interface"
	default n
	---help---
	  Samsung Modem Interface Drivers for
	  SAMSUNG IPC models
	  And you can select the modem chipset
	  and interface link type.

config UMTS_MODEM_XMM6262
	bool "modem chip : IMC XMM6262"
	depends on SEC_MODEM_V2
	default n

config UMTS_MODEM_XMM6360
	bool "modem chip : IMC XMM6360"
	depends on SEC_MODEM_V2
	default n

config CDMA_MODEM_MDM6600
	bool "modem chip : QC MDM6600"
	depends on SEC_MODEM_V2
	default n

config GSM_MODEM_ESC6270
	bool "modem chip : QC ESC6270"
	depends on SEC_MODEM_V2
	default n

config LTE_MODEM_XMM7160
	bool "modem chip : IMC XMM7160"
	depends on SEC_MODEM_V2
	default n

config LTE_MODEM_XMM7260
	bool "modem chip : IMC XMM7260"
	depends on SEC_MODEM_V2
	default n

config LTE_MODEM_SHANNON
	bool "modem chip : SEC SHANNON"
	depends on SEC_MODEM_V2
	default n

config LTE_MODEM_M74XX
	bool "modem chip : ERICSSON M74XX"
	depends on SEC_MODEM_V2
	default n

config LINK_DEVICE_HSIC
	bool "modem driver link device HSIC"
	depends on SEC_MODEM_V2
	default n

config LINK_DEVICE_MIPI_EDLP
	bool "modem driver link device MIPI-HSI eDLP"
	depends on SEC_MODEM_V2
	depends on HSI
	default n

config LINK_DEVICE_PLD
	bool "modem driver link device PLD"
	depends on SEC_MODEM_V2
	default n

config LINK_DEVICE_SPI
	bool "modem driver link device SPI"
	depends on SEC_MODEM_V2
	default n

config LINK_ETHERNET
	bool "SIPC USB raw ehternet patcket"
	depends on SEC_MODEM_V2
	select MII
	default n

config SIM_SLOT_SWITCH
	bool "SIM_SLOT_SWITCH"
	depends on SEC_MODEM_V2
	default n

config ERICSSON_MODEM_CLK_RESET
	bool "Reset USB PHY when PHY_CLK_USERMUX is on changing"
	depends on SEC_MODEM_V2
	default n

choice
	prompt "SEC MODEM CONFIG"
	depends on SEC_MODEM_V2
	default SEC_MODEM_XMM6360

config SEC_MODEM_XMM6360
	bool "IMC XMM6360 feature"
	select UMTS_MODEM_XMM6360
	select LINK_DEVICE_HSIC

config SEC_MODEM_XMM6262
	bool "IMC XMM6262 feature"
	select UMTS_MODEM_XMM6262
	select LINK_DEVICE_HSIC

config SEC_MODEM_XMM7260
	bool "IMC XMM7260 feature"
	select LTE_MODEM_XMM7260
	select LINK_DEVICE_HSIC

config SEC_MODEM_SHANNON
	bool "Shannon HSIC feature"
	select LTE_MODEM_SHANNON
	select LINK_DEVICE_HSIC
	select LINK_DEVICE_SPI

config SEC_MODEM_M74XX
	bool "ERICSSON HSIC feature"
	select LTE_MODEM_M74XX
	select LINK_DEVICE_HSIC
endchoice

if LINK_DEVICE_HSIC
config EHCI_MODEM_PORTNUM
	int "EHCI port number of modem connection"
	default 2
endif
```

## drivers/misc/projector/Kconfig
```kconfig
#
# Mobile Projector driver configuration
#
config USE_DPP2601
	tristate "TI DPP2601 projector"
	default n
	help
	This option enables TI DPP2601 projector driver
	select Y to build it into the kernel
	select N to disable it
```

## drivers/misc/quicklogic/Kconfig
```kconfig
#
# Mobile Quick logic bridge configuration
config QUICKLOGIC_BRIDGE
	boolean "QUICKLOGIC BRIDGE chip"
	depends on I2C && I2C_PXA
	default n
	help
	  If you say yes here, you support for it.

	  This driver can NOT be built as a module.
```

## drivers/misc/rmnet_argos/Kconfig
```kconfig
# SPDX-License-Identifier: GPL-2.0-only
#

config RMNET_ARGOS
	bool "RmNet Argos extension"
	default n
```

## drivers/misc/samsung/Kconfig
```kconfig
#
# SAMSUNG device dedicated drivers
#

config DRV_SAMSUNG
	bool "samsung device dedicated drivers option"
	default y
	help
	  This is driver option for samsung sec_class
	  Say y here to enable samsung classes for drivers
	  Provide option of enabling sec class
	  Supports sec drivers key, touch, sec_debug etc
#HS60 code for P191001-06405 by zhanghao at 2019/11/15 start
config FB_MSM_MDSS_32BIT
       depends on FB_MSM_MDSS
       bool "mdss config for 32bit Platform"
       default n
       help
       Mdss config signature for 32bit Platform
#HS60 code for P191001-06405 by zhanghao at 2019/11/15 end
```
