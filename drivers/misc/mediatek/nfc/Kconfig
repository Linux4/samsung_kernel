## drivers/misc/mediatek/nfc/Kconfig
```kconfig
config NFC_CHIP_SUPPORT
	tristate "NFC driver solution - NFC Controller Driver"
	default n
	help
	  Near Field Communication controller support. If configures to be y,
	  means devices supports NFC functionality.
	  If configures to be n, means devices doesn't support NFC
	  functionality.
```

## drivers/misc/mediatek/power/Kconfig
```kconfig
# Power Related
config MTK_PMIC
	bool "MediaTek PMIC driver"
	default y
	---help---
	Mediatek PMIC driver
	Set y to support this driver.
	Set n to not support this driver.
	MediaTek PMIC driver

config MTK_BQ25896_SUPPORT
	bool "MTK_BQ25896_SUPPORT"
	select MTK_SWITCH_INPUT_OUTPUT_CURRENT_SUPPORT
	default n
	---help---
	Mediatek TI BQ25896 driver.
	Set y to support this driver.
	Set n and choose other chargers.
	This driver uses I2c bus.

config MTK_SWITCH_INPUT_OUTPUT_CURRENT_SUPPORT
	bool "MTK_SWITCH_INPUT_OUTPUT_CURRENT_SUPPORT"
	default n
	---help---
	Mediatek switch charger input output current.
	Set y to support.
	Set n to disable.
	switch charger often supports this feature.

config MTK_BIF_SUPPORT
	bool "MTK_BIF_SUPPORT"
	select MTK_DYNAMIC_BAT_CV_SUPPORT
	default n
	---help---
	Mediatek smart battery BIF feature.
	BIF feature provides battery information
	to AP and no need to use AuxADC
	to get battery information.

config MTK_DYNAMIC_BAT_CV_SUPPORT
	bool "MTK_DYNAMIC_BAT_CV_SUPPORT"
	default n
	---help---
	Mediatek dynamic CV support with BIF battery
	BIF feature provides battery information
	to AP and no need to use AuxADC
	to get battery voltage.

config PMIC_OVP_DISABLE
	bool "PMIC_OVP_DISABLE"
	default n
	---help---
	Mediatek Over Voltage Protection function.
	Set y to disable OVP.
	Set n to not disable OVP.
	OVP default is enabled in PMIC hardware.

config PMIC_BATTERY_THERMAL_DISABLE
	bool "PMIC_BATTERY_THERMAL_DISABLE"
	default n
	---help---
	Mediatek Battery Thermal function.
	Set y to disable battery thermal.
	Set n to not disable battery thermal.
	Battery Thermal default is enabled in PMIC hardware.
```

## drivers/misc/mediatek/rtc/Kconfig
```kconfig
# RTC Related
config MTK_RTC
	bool "MediaTek Real Time Clock Support"
	default n
	help
	  A real-time clock (RTC) is a computer
	  clock (most often in the form of an
	  integrated circuit) that keeps track
	  of the current time.
config RTC_AUTO_PWRON
        bool "RTC Auto Power On Alarm by PMICs"
        default n
        help
          Support for the auto power on alarm on alarm booting supporting PMICs.
          Say Y if you want to enable this feature.
```

## drivers/misc/mediatek/scp/Kconfig
```kconfig
config MTK_TINYSYS_SCP_SUPPORT
	tristate "Specify Interface Support SCP"
	default n
	select MFD_SYSCON
	help
	  SCP is a MediaTek in-house DSP which can receive
	  command from IPI interface.
	  Set Y to enable this feature.
	  If unsure,
	  Set N to stay with legacy feature.

config MTK_TINYSYS_SCP_CM4_SUPPORT
	tristate "Specify micro processor CM4 supported by SCP"
	depends on MTK_TINYSYS_SCP_SUPPORT
	default n
	help
	  CM4 is one uP supported by SCP which designed by ARM corp.
	  Set Y to enable this feature.
	  If unsure,
	  Set N to stay with legacy feature.

config MTK_TINYSYS_SCP_LOGGER_SUPPORT
	bool "SCP Logger support"
	depends on MTK_TINYSYS_SCP_SUPPORT
	default y
	help
	  This is debug feature: SCP logger on/off option.
	  Set Y to enable this feature.
	  Set N to disable this feature.
	  If unsure, Set Y to have debug log.

config MTK_TINYSYS_SCP_RV_SUPPORT
	tristate "Specify micro processor RV supported by SCP"
	depends on MTK_TINYSYS_SCP_SUPPORT
	default n
	help
	  MTK_TINYSYS_SCP_VERSION define which scp version will be used

config SHUB_DUMP_NOTI
	tristate "Specify dump notifier by SHUB"
	depends on MTK_TINYSYS_SCP_SUPPORT
	default n
	help
	  This is notifier to give a reset information at scp reset.
	  Set y enable notifier call at scp reset.
	  Set n disable notifier call at scp reset.
```

## drivers/misc/mediatek/sensors-1.0/Kconfig
```kconfig
source "drivers/misc/mediatek/sensors-1.0/accelerometer/Kconfig"
source "drivers/misc/mediatek/sensors-1.0/alsps/Kconfig"
source "drivers/misc/mediatek/sensors-1.0/gyroscope/Kconfig"
source "drivers/misc/mediatek/sensors-1.0/magnetometer/Kconfig"
source "drivers/misc/mediatek/sensors-1.0/hwmon/Kconfig"
source "drivers/misc/mediatek/sensors-1.0/barometer/Kconfig"
source "drivers/misc/mediatek/sensors-1.0/step_counter/Kconfig"
source "drivers/misc/mediatek/sensors-1.0/situation/Kconfig"
source "drivers/misc/mediatek/sensors-1.0/sensorHub/Kconfig"
source "drivers/misc/mediatek/sensors-1.0/sensorfusion/Kconfig"
#TabA7 Lite code for SR-AX3565-01-101 by Hujincan at 20201123 start
# hs03s code for SR-AL5625-01-168 by xiongxiaoliang at 2021/06/09 start
source "drivers/misc/mediatek/sensors-1.0/sar/Kconfig"
# hs03s code for SR-AL5625-01-168 by xiongxiaoliang at 2021/06/09 end
#hs14 code for SR-AL6528A-01-376 by xiongxiaoliang at 2022/09/02 start
source "drivers/misc/mediatek/sensors-1.0/o22_sar/Kconfig"
#hs14 code for SR-AL6528A-01-376 by xiongxiaoliang at 2022/09/02 end
#o8 code for SR-AL7160A-01-171 by jiashixian at 2024/03/21 start
source "drivers/misc/mediatek/sensors-1.0/o8_sar/Kconfig"
#o8 code for SR-AL7160A-01-171 by jiashixian at 2022/03/21 end
#TabA7 Lite code for SR-AX3565-01-101 by Hujincan at 20201123 end
```

## drivers/misc/mediatek/sensors-1.0/o22_sar/Kconfig
```kconfig
config CUSTOM_KERNEL_SAR_SENSOR
    bool "CUSTOM KERNEL sar Config"
    help
      If the platform is supported for sar, this
      configuration should be configured, and the sar
      driver configuration should be configured as well.

config SENSORS
    bool "Sensors Class Support"
    help
      This option enables the sensor sysfs class in /sys/class/sensors.
      You'll need this to do anything useful with sensorss. If unsure, say N.

source "drivers/misc/mediatek/sensors-1.0/o22_sar/sx9338/Kconfig"
```

## drivers/misc/mediatek/sensors-1.0/o22_sar/sx9338/Kconfig
```kconfig
#
# Input misc drivers configuration
#
menuconfig INPUT_MISC
    bool "Miscellaneous devices"
    help
      Say Y here, and a list of miscellaneous input drivers will be displayed.
      Everything that didn't fit into the other categories is here. This option
      doesn't affect the kernel.

      If unsure, say Y.

config SENSORS
    bool "Sensors Class Support"
    help
      This option enables the sensor sysfs class in /sys/class/sensors.
      You'll need this to do anything useful with sensorss. If unsure, say N.

if INPUT_MISC

config INPUT_SX933x
    tristate "SX933x_SAR_sensor"
    depends on I2C
    default n
    help
      Say Y to enable the SAR detection application, if N here not to use the
      this SAR sensor

endif
```

## drivers/misc/mediatek/sensors-1.0/o8_sar/Kconfig
```kconfig
config CUSTOM_KERNEL_SAR_SENSOR
    bool "CUSTOM KERNEL sar Config"
    help
      If the platform is supported for sar, this
      configuration should be configured, and the sar
      driver configuration should be configured as well.

source "drivers/misc/mediatek/sensors-1.0/o8_sar/sx9338/Kconfig"
source "drivers/misc/mediatek/sensors-1.0/o8_sar/hx9031as/Kconfig"
```

## drivers/misc/mediatek/sensors-1.0/o8_sar/hx9031as/Kconfig
```kconfig
#
# Input misc drivers configuration
#

config INPUT_HX9031AS
    tristate "hx9031as sar sensor"
    depends on I2C
    default n
    help
      Say Y to enable the SAR hx9031as detection application, if N here not to use the
      this SAR sensor
```

## drivers/misc/mediatek/sensors-1.0/sar/Kconfig
```kconfig
config CUSTOM_KERNEL_SAR_SENSOR
    bool "CUSTOM KERNEL sar Config"
    help
      If the platform is supported for sar, this
      configuration should be configured, and the sar
      driver configuration should be configured as well.

config SENSORS
    bool "Sensors Class Support"
    help
      This option enables the sensor sysfs class in /sys/class/sensors.
      You'll need this to do anything useful with sensorss. If unsure, say N.
```

## drivers/misc/mediatek/sensors-1.0/situation/Kconfig
```kconfig
config CUSTOM_KERNEL_SITUATION
	bool "mediatek situation sensor tag"
	help
	  Kernel space support situation sensor driver.
	  If the platform is supported for gesture, this
	  configuration should be configured, and the situation
	  driver configuration should be configured as well.

source "drivers/misc/mediatek/sensors-1.0/situation/stationary/Kconfig"
source "drivers/misc/mediatek/sensors-1.0/situation/inpocket/Kconfig"
source "drivers/misc/mediatek/sensors-1.0/situation/wake_gesture/Kconfig"
source "drivers/misc/mediatek/sensors-1.0/situation/glance_gesture/Kconfig"
source "drivers/misc/mediatek/sensors-1.0/situation/answercall/Kconfig"
source "drivers/misc/mediatek/sensors-1.0/situation/pickup_gesture/Kconfig"
source "drivers/misc/mediatek/sensors-1.0/situation/device_orientation/Kconfig"
source "drivers/misc/mediatek/sensors-1.0/situation/motion_detect/Kconfig"
source "drivers/misc/mediatek/sensors-1.0/situation/tilt_detector/Kconfig"
source "drivers/misc/mediatek/sensors-1.0/situation/flat/Kconfig"
source "drivers/misc/mediatek/sensors-1.0/situation/sar/Kconfig"
#hs14 code for SR-AL6528A-01-779 by xiongxiaoliang at 2022/11/23 start
source "drivers/misc/mediatek/sensors-1.0/situation/wakeup_motion/Kconfig"
#hs14 code for SR-AL6528A-01-779 by xiongxiaoliang at 2022/11/23 end
#hs14 code for SR-AL6528A-01-778 by xiongxiaoliang at 2022/11/26 start
source "drivers/misc/mediatek/sensors-1.0/situation/smart_alert/Kconfig"
#hs14 code for SR-AL6528A-01-778 by xiongxiaoliang at 2022/11/26 end
```

## drivers/misc/mediatek/sensors-1.0/situation/lift_to_wake/Kconfig
```kconfig
config N28_LIFT_TO_WAKE
    bool "lift to wake for ss"
    help
        A wake is a device,
        usually portable and electronic
        or electromechanical,
        that detect device is picked up with 35 degree.
```

## drivers/misc/mediatek/sensors-1.0/situation/smart_alert/Kconfig
```kconfig
config N28_SMART_ALERT_HUB
	bool "smart_alert_hub for MediaTek package"
	help
	  smart_alert is a device,
	  usually portable and electronic
	  or electromechanical,
	  that detect device is picked up with 35 degree.
```

## drivers/misc/mediatek/sensors-1.0/situation/wakeup_motion/Kconfig
```kconfig
config MTK_WAKE_UP_MOTION
    bool "wakeup motion for MediaTek package"
    help
      A lift detect is a device,
      usually portable and electronic
      or electromechanical,
      that detect device is picked up with 35 degree.
```

## drivers/misc/mediatek/thermal/Kconfig
```kconfig
config MTK_LEGACY_THERMAL
	bool "Use MTK legacy thermal code"
	help
	  Upstream thermal code and legacy thermal
	  code are not compatiable. As a result,
	  add a new switch MTK_LEGACY_THERMAL to replace
	  CONFIG_THERMAL for MTK legacy thermal code.

config MTK_THERMAL_PA_VIA_ATCMD
	bool "Thermal switch for query modem RF temp"
	depends on MTK_LEGACY_THERMAL
	help
	  Internal switch for thermal management
	  to query modem RF temperature
	  via AT command.
	  (RIL sockets)

config MTK_LEGACY_THERMAL_PLATFORM
	string "MTK legacy thermal platform name"
	depends on MTK_LEGACY_THERMAL
	help
	  To separate platform codes for legacy thermal
	  drivers. Config platform name for your
	  selection. It's used for legacy thermal
	  drivers only.

# TabA7 Lite code for SR-AX3565-01-55 remove pa thermal in wifi-only by wenyaqi at 20201225 start
config NO_PA_NTC
	bool "Remove PA NTC"
	default n
	help
	  If NO_PA_NTC is true, it means there is no PA
	  NTC, and the temp of PA will set to 25 degree.
# TabA7 Lite code for SR-AX3565-01-55 remove pa thermal in wifi-only by wenyaqi at 20201225 end
```

## drivers/misc/mediatek/tui/Kconfig
```kconfig
config BLOWFISH_TUI_SUPPORT
	bool "TUI HW Handler"
	default n
	help
	  Provide methods for TUI such as acquisition of buffer
	  to be used as secure frame buffer in Secure World and
	  synchronization of display and touch device between
	  Normal World and Secure World.
```
