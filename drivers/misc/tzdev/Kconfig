## drivers/net/wireless/synaptics/bcmdhd_101_10/Kconfig
```kconfig
#
# Copyright (C) 2022, Broadcom.
#
#      Unless you and Broadcom execute a separate written software license
# agreement governing use of this software, this software is licensed to you
# under the terms of the GNU General Public License version 2 (the "GPL"),
# available at http://www.broadcom.com/licenses/GPLv2.php, with the
# following added to such license:
#
#      As a special exception, the copyright holders of this software give you
# permission to link this software with independent modules, and to copy and
# distribute the resulting executable under terms of your choice, provided that
# you also meet, for each linked independent module, the terms and conditions of
# the license of that module.  An independent module is a module which is not
# derived from this software.  The special exception does not apply to any
# modifications of the software.
#
#
# <<Broadcom-WL-IPTag/Open:>>
#

config BCMDHD
	tristate "Broadcom FullMAC wireless cards support"
	default n
	help
	  This module adds support for wireless adapters based on
	  Broadcom FullMAC chipset.

	  If you choose to build a module, it'll be called dhd. Say M if
	  unsure.

config BCMDHD_SDIO
	bool "SDIO bus interface support"
	depends on BCMDHD && MMC
	default n

config BCMDHD_PCIE
	bool "PCIe bus interface support"
	default n
	depends on BCMDHD && PCI && !BCMDHD_SDIO

config BCM4354
	bool "BCM4354 support"
	depends on BCMDHD
	default n

config BCM4356
	bool "BCM4356 support"
	depends on BCMDHD
	default n

config BCM4358
	bool "BCM4358 support"
	depends on BCMDHD
	default n

config BCM4359
	bool "BCM4359 support"
	depends on BCMDHD
	default n

config BCM4361
	bool "BCM4361 support"
	depends on BCMDHD
	default n

config BCM4362
	bool "BCM4362 support"
	depends on BCMDHD
	default n

config BCM4375
	bool "BCM4375 support"
	depends on BCMDHD
	default n

config BCM43752
	bool "BCM43752 support"
	depends on BCMDHD
	default n

config BCM43456
	bool "Broadcom 43456 wireless cards support"
	depends on BCMDHD
	default n
	help
	  This module adds support for wireless adapters based on
	  Broadcom 43456 chipset.

config DHD_OF_SUPPORT
	bool "Use in-drive platform device"
	depends on BCMDHD
	default n

config BCMDHD_FW_PATH
	depends on BCMDHD
	string "Firmware path"
	default "bcmdhd_sta.bin"
	help
	  Path to the firmware file.

config BCMDHD_NVRAM_PATH
	depends on BCMDHD
	string "NVRAM path"
	default "nvram_net.txt"
	help
	  Path to the calibration file.

config BCMDHD_CLM_PATH
	depends on BCMDHD
	string "CLM path"
	default "bcmdhd_clm.blob"
	help
	  Path to the clm file.

config BCMDHD_CONFIG_PATH
	depends on BCMDHD
	string "CONFIG path"
	default "wlan_config.ini"
	help
	  Path to the config file.

config BROADCOM_WIFI_RESERVED_MEM
	bool "BROADCOM Reserved memory for wifi device"
	depends on BCMDHD
	default n
	help
	  This is a configuration for Broadcom WLAN driver.

config WIFI_BROADCOM_COB
        bool "BROADCOM WIFI COB"
        depends on (BCM43456 || BCM43455 || BCM4343 || BCM43436 || BCM43454 || BCM43012)
        help
          This is a configuration for Broadcom WIFI COB Type.

config BCMDHD_WEXT
	bool "Enable WEXT support"
	depends on BCMDHD && CFG80211 = n
	select WIRELESS_EXT
	select WEXT_PRIV
	help
	  Enables WEXT support

config DHD_USE_STATIC_BUF
	bool "Enable memory preallocation"
	depends on BCMDHD
	default n
	help
	  Use memory preallocated in platform

config DHD_USE_SCHED_SCAN
	bool "Use CFG80211 sched scan"
	depends on BCMDHD && CFG80211
	default n
	help
	  Use CFG80211 sched scan

config DHD_SET_RANDOM_MAC_VAL
	hex "Vendor OUI"
	depends on BCMDHD
	default 0x001A11
	help
	  Set vendor OUI for SoftAP

config WLAN_REGION_CODE
	int "---Region codes for Broadcom WiFi Driver"
	depends on BCMDHD
	default 100
	help
		This is a region code for Broadcom Wi-Fi featured functions.
		- 100 : EUR OPEN
		- 101 : EUR ORG
		- 200 : KOR OPEN
		- 201 : KOR SKT
		- 202 : KOR KTT
		- 203 : KOR LGT
		- 300 : CHN OPEN

config WLAIBSS
	bool "Advanced IBSS mode"
	depends on (BCM4335 || BCM4339 || BCM4354 || BCM4358 || BCM4359 || BCM4361 || BCM4362)
	default n
	help
	  This is a configuration for Oxygen Network.

config WL_RELMCAST
	bool "Reliable Multicast Support"
	depends on (BCM4335 || BCM4339 || BCM4354 || BCM4358 || BCM4359 || BCM4361 || BCM4362)
	default n
	help
	  This is a configuration for RMC.

config WL_NAN
	bool "NAN Feature"
	depends on BCMDHD
	default n
	help
	  This is a configuration for NAN Feature.

config BCMDHD_PREALLOC_PKTIDMAP
	bool "BROADCOM PCIE specific memory reserved for PKTIDMAP"
	depends on BROADCOM_WIFI_RESERVED_MEM && BCMDHD_PCIE
	help
	  Preallocated memory support for PCIE interface in Broadcom
	  WLAN driver.

config BCMDHD_PREALLOC_MEMDUMP
	bool "BROADCOM PCIE specific memory reserved for MEMDUMP"
	depends on BROADCOM_WIFI_RESERVED_MEM
	default n
	help
	  Preallocated memory support for dongle memory dump

config BCMDHD_OOB_HOST_WAKE
        bool "Use the external WLAN_HOST_WAKE pin"
        depends on BCMDHD
	default n
        help
          Use the external GPIO pin to wake up host

config SPLIT_ARGOS_SET
	bool "Support argos table"
	depends on BCMDHD
	help
	To support SPLIT_ARGOS_SET

config WLAN_VHTDISABLE
	bool "WLAN Disable 11ac"
	depends on BCM43456
	default n
	help
	This is a configuration to disable 11ac.

config WLAN_TSQ_MULTIPLIER
	bool "Enable TCP TSQ_MULTIPLIER"
	depends on BCMDHD
	default n
	help
	This is configuration for TCP TSQ_MULTIPLIER

config WLAN_VENDOR_DUMP_ENABLE
	bool "Enable dump policy as Android Global DE Policy"
	depends on BCMDHD
	default n
	help
	Change WLAN Debug dump policy as Global DE policy

config BCMDHD_GET_OOB_STATE
        bool "Support WLAN_HOST_WAKE pin level information"
        depends on BCMDHD_OOB_HOST_WAKE
        default n
        help
          Support WLAN_HOST_WAKE pin level information

config WLAN_HOMECONTROL
	bool "HOMECONTROL"
	depends on BCM43456
	default n
	help
	Support HOMECONTROL
```

## drivers/nfc/Kconfig
```kconfig
#
# Near Field Communication (NFC) devices
#

config SAMSUNG_NFC
	bool "Samsung NFC driver"
	default n
	help
		Say Y here if you want to build support for NFC (Near field
		communication) devices.
		To compile this support as a module, choose M here: the module will
		be called nfc.

config SEC_NFC
	bool "S.LSI NFC driver"
	default n
	help
	  S.LSI NFC Driver.
	  This driver provides support for S.LSI NFC products.
	  You should select your NFC product and interface.

	  Say Y here to compile support for S.LSI NFC driver into the
	  kernel.

config ESE_P3_LSI
	bool "Oberthur ese driver"
	depends on SPI
	default n
	help
	  Oberthur Driver.
	  This driver provides support for LSI NXP combined ESE products.
	  You should select your NFC product and interface.

config ESE_FACTORY_ONLY
	bool "Oberthur ese driver factory"
	depends on SPI
	default n
	help
	  Oberthur Driver.
	  This driver provides support for LSI NXP combined ESE products.
	  You should select your NFC product and interface.
```
