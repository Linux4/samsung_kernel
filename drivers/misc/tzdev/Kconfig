## drivers/muic/universal/Kconfig
```kconfig
#
# MUIC devices
#

comment "MUIC configs"

config MUIC_UNIVERSAL
  bool "UNIVERSAL MUIC"
	depends on USE_MUIC
	default n
	help
	  If you say yes here you will get support for various MUIC chips.

config MUIC_UNIVERSAL_SM5703
  bool "SM5703 MUIC"
	depends on USE_MUIC
	default n
	help
	  If you say yes here you will get support for the SM5703 MUIC chip.

config MUIC_UNIVERSAL_SM5705
	bool "SM5705 MUIC"
	depends on USE_MUIC
	default n
	help
	  If you say yes here you will get support for the SM5705 MUIC chip.

config MUIC_UNIVERSAL_SM5705_AFC
	bool "SM5705 MUIC AFC"
	depends on USE_MUIC
	default n
	help
	  If you say yes here you will get support for the SM5705 MUIC
	  AFC feature.

config MUIC_UNIVERSAL_SM5504
  bool "SM5504 MUIC"
	depends on USE_MUIC
	default n
	help
	  If you say yes here you will get support for the SM5504 MUIC chip.

config MUIC_PINCTRL
  bool "MUIC PINCTRL"
	depends on USE_MUIC
	default n
	help
	  If you say yes here you will get support for the Pinctrl in MUIC driver.

config MUIC_SUPPORT_RUSTPROOF
	bool "MUIC Disable UART"
	depends on !SEC_FACTORY
	default n
	help
	 This option will disable the UART to prevent the rusting of the
	 IF Connector in the case of Kmini Devices.

config SM5705_SUPPORT_LANHUB
	bool "LANHUB Support for SM5705 MUIC"
	depends on MUIC_UNIVERSAL_SM5705
	default n
	help
	 This option will provide USB LANHUB support to SM5705 MUIC based
	 devices.

config MUIC_SUPPORT_GAMEPAD
	bool "GAMEPAD Support for MUIC"
	depends on MUIC_UNIVERSAL
	default n
	help
	 This option will provide GAMEPAD support to MUIC based
	 devices.
```

## drivers/muic_s2m/Kconfig
```kconfig
#
# MUIC devices
#

comment "MUIC configs"

source "drivers/muic_s2m/common/Kconfig"

config USE_S2M_MUIC
	tristate "Using S2M MUIC device driver"
	depends on I2C
	default n
	help
	  If you say yes here you will get support for
	  the MUIC device driver.

config MUIC_SUPPORT_CCIC
	bool "MUIC supports CCIC chip interface"
	depends on USE_S2M_MUIC
	default n
	help
	  If you say yes here you will get support for the CCIC chip.

config MUIC_SYSFS
	bool "Using muic sysfs Features"
	depends on USE_S2M_MUIC
	default n
	help
	  If you say yes here you will get support for the muic sysfs.

config MUIC_SUPPORT_PRSWAP
	bool "MUIC supports power role swap"
	depends on USE_S2M_MUIC
	default n
	help
	  If you say yes here you will get support for the power role swap.

config MUIC_S2MU106
	tristate "Using S2MU106 MUIC"
	depends on USE_S2M_MUIC# && MFD_S2MU106
	default n
	help
	  If you say yes here you will get support for the S2MU106 MUIC chip.

config MUIC_S2MU106_RID
	bool "Using S2MU106 MUIC RID"
	depends on MUIC_S2MU106
	default n
	help
	  If you say yes here you will get support for the S2MU106 MUIC RID functions.

config S2MU106_MUIC_STABLE_RESET
	bool "Using S2MU106 MUIC rescan when booting"
	depends on MUIC_S2MU106
	default n
	help
	  If you say yes here you will get support for the S2MU106 muic booting rescan

config MUIC_S2MF301
	tristate "Using S2MF301 MUIC"
	depends on USE_S2M_MUIC# && MFD_S2MF301
	default n
	help
	  If you say yes here you will get support for the S2MF301 MUIC chip.

config MUIC_S2MF301_RID
	bool "Using S2MF301 MUIC RID"
	depends on MUIC_S2MF301
	default n
	help
	  If you say yes here you will get support for the S2MF301 MUIC RID functions.

config S2MF301_MUIC_STABLE_RESET
	bool "Using S2MF301 MUIC rescan when booting"
	depends on MUIC_S2MF301
	default n
	help
	  If you say yes here you will get support for the S2MF301 muic booting rescan

config S2MF301_MUIC_SDP_OVP_OFF
	bool "Using S2MF301 MUIC support fs usb"
	depends on USE_S2M_MUIC
	default n
	help
	  If you say yes here you will get support for the S2MF301 MUIC chip.
```

## drivers/muic_s2m/common/Kconfig
```kconfig
#
# MUIC devices
#

comment "MUIC configs"

config MUIC_MANAGER
	bool "MUIC Manager supports PDIC chip interface"
	depends on USE_S2M_MUIC
	default n
	help
	  If you say yes here you will get support manager for the PDIC chip.

config MUIC_CORE
	bool "Supports MUIC Core"
	depends on USE_S2M_MUIC
	default n
	help
	  If you say yes here you will get support for the MUIC Core functionalities
```

## drivers/net/bih/Kconfig
```kconfig
config BIH 
        tristate "Bump-in-the-stack"
        depends on NET || IPV6 || IPV4
        help
        This driver supports BIH based on Copyright 2010, 2011 China 
          Mobile Communications Corporation, Inc. ("CMCC")

        To compile this driver as a module, choose M here.  The module
          will be called sfc.
```

## drivers/net/dropdump/Kconfig
```kconfig
#
# net: logging dropped skb
#

comment "Enable Dropdump to logging dropped network packet"

config SUPPORT_DROPDUMP
	tristate "Network packet drop logging service for tcpdump"
	---help---
	This feature just provide an /proc/sys/net/core/support_dropdump node,
	whether this kernel supports 'dropdump' which is used at libpcap.
	If node exist, then it supports.
	If node doesn't exist, then it doesn't support.
```

## drivers/net/ethernet/sprd/Kconfig
```kconfig
#
# Spreadtrum virtual Ethernet configuration
#

config SPRD_VETH
	tristate "SPRD Virtual Ethernet on MUX"
	default n
	#depends on MUX
	---help---
		It supports Spreadtrum virtual Ethernet device on MUX.
```

## drivers/net/wireless/sc2331/Kconfig
```kconfig
config SC2331
	tristate "SPRDWL Wireless Network Support"
	depends on CFG80211
	---help---
	  Say Y to enable built-in wireless MAC controller in the
	  Spreadtrum SC88xx based System-on-Chip devices.
```

## drivers/net/wireless/scsc/Kconfig
```kconfig
config SCSC_WLAN
	tristate "Driver for Samsung SCSC Maxwell Wifi"
	depends on SCSC_CORE
	depends on CFG80211

if SCSC_WLAN != n
config SCSC_WLAN_KEY_MGMT_OFFLOAD
        bool "Enable roam offload for SCSC WLAN"
        default y
        ---help---
          This option enables roam offload for SCSC WLAN.

config SCSC_WLAN_HIP4_PROFILING
	bool "Enable HIP4 profiling"
        default y
	depends on SCSC_WLAN
	---help---
	  This option enables HIP4 profiling

config SCSC_WLAN_DEBUG
	bool "Enable debug output from the SCSC Wifi driver"
	depends on SCSC_WLAN
	select SCSC_WLAN_HIP4_PROFILING
	---help---
	  This option enables debug support for the SCSC wifi chipset.

config SCSC_WLAN_SG
	bool "Enable SCSC WLAN Scatter-gather and GSO support"
	depends on SCSC_WLAN
        default y
	---help---
	  This option enables scatter-gather and GSO feature

config SCSC_WLAN_SKB_TRACKING
	bool "Enable debug memory tracking of skb data in the driver"
	---help---
	  This option enables tracking of all skb data in the driver..
	  This will affect the performance!

config SCSC_WLAN_RX_NAPI
	bool "Enable use of net device napi rx polling api"
	default y
	---help---
	  This option enables the drivers use of the napi api

config SCSC_WLAN_RX_NAPI_GRO
	bool "Enable use of net device napi rx GRO"
	depends on SCSC_WLAN_RX_NAPI
	default y
	---help---
	  This option enables the drivers use of the napi Generic Receive Offload

config SCSC_WLAN_ANDROID
	bool "Android specific support"
	default y
	---help---
	  Enable support for Android specific aspects of the driver.

config SCSC_WLAN_STA_ONLY
	bool "Support WLAN STA only (no P2P/AP/IBSS)"
	default n
	---help---
	  Enable only basic STA mode for debugging purposes

config SCSC_WLAN_KIC_OPS
	bool "Wi-Fi service driver provides OPS for KIC to use for various tasks"
	depends on SAMSUNG_KIC
	default y
	---help---
	  Provide Wi-Fi service driver OPS, which KIC can use for triggering Wi-Fi related events.

config SCSC_WLAN_GSCAN_ENABLE
	bool "Enable GSCAN in SCSC wlan driver"
	default y
	---help---
	  This option enables GSCAN in SCSC wlan driver.

config SCSC_WLAN_WES_NCHO
	bool "Enable NCHO/WES feature"
	default y
	---help---
	  This option enables the NCHO/WES feature

config SCSC_WLAN_MUTEX_DEBUG
	bool "Enable Mutex debugging mechanism in slsi wlan driver"
	default y
	---help---
	  This option enables the Mutex debug reports in slsi wlan driver.

config CONFIG_SCSC_WLAN_BLOCK_IPV6
	bool "Block IPv6"
	default n
	---help---
	  This option blocks IPv6 packets.

config CONFIG_SCSC_WLAN_DISABLE_NAT_KA
	bool "Disable NAT"
	default n
	---help---
	  This option disables NAT.

config SCSC_WLAN_HANG_TEST
	bool "Test HANG Event"
	default y
	---help---
	   This option facilitates triggering of HANG Event
	   to reset WLAN.

config SCSC_WLAN_NAT_KEEPALIVE_DISABLE
	bool "Disable NAT KeepAlive"
	default n
	---help---
	  This option disables the NAT KeepAlive
	  Offload Feature.

config SCSC_WLAN_ENHANCED_LOGGING
	bool "Enable Enhanced Logging"
	depends on SCSC_WIFILOGGER
	default y
	---help---
	  This option enables the Enhanced Logging
	  Feature.

config SCSC_WLAN_ACM_API
	bool "Provide TSF read API"
	default n
	---help---
	  This option provides API to read TSF.

endif

config SCSC_WLAN_MAC_ADDRESS_FILENAME
	string "MAC address filename"
	default "/efs/wifi/.mac.info"
	---help---
	  Select the programmed MAC address file.

config SCSC_WLAN_MAX_INTERFACES
        int "Max number of virtual interfaces supported"
        range 1 12
        default 3
        ---help---
          The driver structures are sized to support this
          number of interfaces.

config SCSC_WLAN_AP_INFO_FILE
        bool "Create .softap.info file"
        default n
        ---help---
          The option enables the driver to create .softap.info
          file in user space and fill information in it.

config SCSC_WLAN_WIFI_SHARING
	bool "Wifi Sharing Support"
	default n
	---help---
	  This option tells if wifi sharing is supported or not.

config SCSC_WLAN_SAE_CONFIG
        bool "Wpa3 Support"
        default n
        ---help---
          This option tells if wpa3  is supported or not.

config SCSC_WLAN_ENABLE_MAC_RANDOMISATION
        bool "Wifi Mac Randomization Support"
        default n
        ---help---
          This option tells if mac randomization is supported or not.

config SCSC_WLAN_SINGLE_ANTENNA
	depends on SCSC_WLAN_WIFI_SHARING
	bool "Single Antenna Supported"
	default y
	---help---
	  This option tells if there is support for single
	  antenna or dual antenna.

config SCSC_WLAN_ACS_ENABLE
        bool "ACS Support"
        default y
        ---help---
          This option tells if automatic channel selection is
	  supported or not.

config SCSC_AP_INTERFACE_NAME
        string "AP net device interface name"
        default "wlan1"
        ---help---
          AP net device interface name.

config SCSC_WLAN_MHS_STATIC_INTERFACE
        bool "Static AP Interface Support"
        default n
        ---help---
          This option tells if AP interface has been created
          statically or dynamically.
          is enabled or not.

config SCSC_WLAN_PRIORITISE_IMP_FRAMES
        bool "Change priority of important frames such as DNS, MDNS, TCP SYN"
        default y
        ---help---
          The option enables the driver to prioritise important frames
          (such as DNS, MDNS, TCP SYN) so that they are sent ahead of others.

config SCSC_WIFI_NAN_ENABLE
        bool "Enable WiFi NAN"
        default n
        ---help---
          This option tells whether WiFi NAN is enabled or not.

config SCSC_WLAN_ENHANCED_PKT_FILTER
        bool "Enable enhanced packet filtering in suspend"
        default n
        ---help---
          This option tells if UDP packet filtering in suspend is
          supported or not.

config SCSC_WLAN_SET_NUM_ANTENNAS
        bool "Enable configuring of number of antennas"
        default n
        ---help---
          This option tells whether configuring of number of antennas is enabled or not.

config SCSC_ENHANCED_PACKET_STATS
        bool "Enable enhanced packet stats"
        default n
        ---help---
          This option tells whether enhanced packet stats collection
          is enabled or not.

config SCSC_WLAN_LOW_LATENCY_MODE
        bool "Support enabling/disabling roaming as per latency mode"
        default n
        ---help---
          This option tells whether support is provided for enabling
          or disabling roaming as per the latency mode.

config SCSC_WLAN_SET_PREFERRED_ANTENNA
        bool "Enable the driver to set preferred antenna"
        default y
        ---help---
          This option enables the driver to set the preferred antenna.

config SLSI_WLAN_STA_FWD_BEACON
        bool "Forwarding beacon support"
        default n
        ---help---
          This option tells if beacon forwarding in STA mode is enabled or not.
          When it is enabled, Driver deliver beacon info of connected AP to Supplicant.

config SCSC_WLAN_STA_ENHANCED_ARP_DETECT
        bool "Enable enhanced arp detection"
        default n
        ---help---
          This option tells whether enhanced arp detection
          is enabled or not.

config SCSC_WLAN_SILENT_RECOVERY
	bool "Enable silent recovery"
	default n
	---help---
	This option tells if silent recovery is enabled or not.

config SCSC_WLAN_DUAL_STATION
        bool "Enable dual station"
        default n
        ---help---
        This option tells if dual station feature is supported or not.

config SCSC_WLAN_MAX_LINK_SPEED
        bool "Enable max link speed calculation"
        default n
        ---help---
        This option tells if max linkspeed calculation is enabled or not.
```

## drivers/net/wireless/sprdwl/Kconfig
```kconfig
config SPRDWL
	tristate "SPRD Wireless LAN Support"
	depends on CFG80211 && SIPC
	---help---
	  Say Y to enable built-in wireless MAC controller in the
	  Spreadtrum SC88xx based System-on-Chip devices.

config SPRDWL_FW_ZEROCOPY
	depends on SPRDWL
	bool "Enable WLAN zerocopy"
	default n
	help
	  Say Y to enable WLAN zerocopy.

config SPRDWL_WIFI_DIRECT
	depends on SPRDWL && PM
	bool "Wi-Fi Direct"
	help
	  Say Y to enable Wi-Fi Direct.

config SPRDWL_ENHANCED_PM
	depends on SPRDWL && HAS_EARLYSUSPEND
	bool "Enhanced Power Management"
	default y if HAS_EARLYSUSPEND=y
	help
	  Say Y to enable enhanced power management. This feature
	  will put a limit on downloading when screen goes off, and
	  will restore when screen goes on.
```

## drivers/net/wireless/sprdwl_ng/Kconfig
```kconfig
config SPRDWL_NG
	tristate "SPRD Next Generation Wireless LAN Support"
	depends on CFG80211
	help
	  This is a driver for the Spreadtrum IEEE802.11 WLAN devices.

	  When compiled as a module, this driver will be called sprdwl_ng.

choice
	prompt  "Select H/W interface"
	depends on SPRDWL_NG
	default SPRDWL_NG_SDIO_BA

config SPRDWL_NG_SDIO
	bool "SDIO (pack/unpack)"
	depends on SDIOM && MARLIN2
	help
	  Select this to enable support for the Spreadtrum SC2332
	  chipsets running over SDIO(pack/unpack).

config SPRDWL_NG_SDIO_BA
	bool "SDIO"
	depends on SDIODEV
	help
	  Select this to enable support for the Spreadtrum SC2331
	  chipsets running over SDIO.

endchoice
```

## drivers/net/wireless/synaptics/Kconfig
```kconfig
config WLAN_VENDOR_SYNAPTICS
	bool "Synaptics devices"
	default n
	---help---
	  If you have a wireless card belonging to this class, say Y.

	  Note that the answer to this question doesn't directly affect the
	  kernel: saying N will just cause the configurator to skip all the
	  questions about these cards. If you say Y, you will be asked for
	  your specific card in the following questions.

if WLAN_VENDOR_SYNAPTICS

source "drivers/net/wireless/synaptics/bcmdhd_101_10/Kconfig"

endif # WLAN_VENDOR_SYNAPTICS
```
