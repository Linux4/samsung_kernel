## drivers/misc/tzdev/Kconfig
```kconfig
config TZDEV
	bool "Samsung TZ Based Secure OS Support"
	default n
	depends on ARM || ARM64
	help
	  Samsung TZ Based Secure OS interface driver

config QCOM_SCM_ARMV8
	bool "QC ARM8 scm call"
	depends on TZDEV
	default n
	help
	  Use scm_call2() to send SMC commands to BF

config TZDEV_SK_PFNS_64BIT
	bool "Secure kernel works with 64-bit PFNs"
	depends on TZDEV
	default n
	help
	  Enables passing of PFNs into secure kernel as 64-bit values. Should
	  correspond to similar config in SK.

config TZDEV_USE_ARM_CALLING_CONVENTION
	bool "Comply to ARM calling convention"
	depends on TZDEV
	default y
	help
	  Comply to ARM calling convention. New software architectures use
	  EL3 code comply to this convention compared to old architectures
	  when Secure kernel contains non-compatible commands handler

config TZDEV_CMA
	bool "Allocate TrustZone environment CMA region"
	depends on TZDEV && (CMA || DMA_CMA) && !ARCH_MSM
	default n
	help
	  Use CMA region to allocate TrustZone environment memory

config TZDEV_MEMRESSZ
	hex "TrustZone environment memory reservation size"
	depends on TZDEV_CMA
	default 0x01000000
	help
	  Provide reservation of memory for usage in secure world - allocation size.

config TZDEV_MEMRESSZPROT
	hex "TrustZone environment memory reservation size - protected"
	depends on TZDEV_CMA
	help
	  Provide reservation of memory for usage in secure world - bootloader-protected size.

config TZDEV_MEMRESADDR
	hex "TrustZone environment memory reservation address"
	depends on TZDEV_CMA
	help
	  Provide reservation of memory for usage in secure world - allocation address.

config TZDEV_IWI_EVENT
	int "IWI_EVENT interrupt number"
	depends on TZDEV
	default 280 if ARCH_MSM
	default 125 if ARCH_EXYNOS3
	default 113 if ARCH_EXYNOS4
	default 501 if ARCH_EXYNOS5
	default 446 if ARCH_EXYNOS7

config TZDEV_IWI_PANIC
	int "IWI_PANIC interrupt number"
	depends on TZDEV
	default 0 if ARCH_MSM
	default 126 if ARCH_EXYNOS3
	default 114 if ARCH_EXYNOS4
	default 502 if ARCH_EXYNOS5
	default 447 if ARCH_EXYNOS7

config TZDEV_SWD_PANIC_IS_CRITICAL
	bool "Panic NWd if secure world panics"
	depends on TZDEV
	default n
	help
	  Enable support of NWd panic generation in tzdev when secure world panics

config CONFIG_TZDEV_NWD_PANIC_ON_CLOSE
	bool "Panic NWd if tzdev is closed"
	depends on TZDEV
	default n
	help
	  Panic system on crash/close of NWd components

config TZ_IW_CIRCULAR_BUFFER
	bool
	depends on TZDEV

config TZLOG
	bool "TZDEV LOGGER support"
	select TZ_IW_CIRCULAR_BUFFER
	depends on TZDEV
	default n
	help
	  Enable support for Samsung Secure OS Logger

config TZLOG_POLLING
	bool "TZDEV LOGGER polling"
	depends on TZLOG
	default n
	help
	  Enable periodic logs polling by TZDEV

config TZLOG_POLLING_PERIOD
	int "TZDEV LOGGER polling period (in ms)"
	depends on TZLOG_POLLING
	default 100
	help
	  Define logs polling period in milliseconds. The resolution is 1/Hz ms
	  rounded down (e.g. for Hz = 100, value 117 would mean 110 ms period)

config TZLOG_PG_CNT
	int "TZDEV LOGGER per-CPU buffer size (in pages)"
	depends on TZLOG
	default 1
	help
	  Select TZDEV logger buffer size in pages per CPU.

config TZPROFILER
	bool "TZDEV PROFILING support"
	depends on TZDEV
	default n
	help
	  Enable support for secure kernel and userspace profiling.

config TZPROFILER_BUF_PG_CNT
	int "TZDEV PROFILER buffer size (in pages)"
	depends on TZPROFILER
	default 10
	help
	  Select TZDEV profiler buffer size in pages. Profiler uses pool
	  of buffers. This is size of each buffer. Minimum size is a 1 page.
	  Select the sufficient size for profiling of the target.

config TZPROFILER_BUFS_CNT
	int "TZDEV PROFILER buffers quantity"
	depends on TZPROFILER
	default 20
	help
	  Select the sufficient pool size for profiling of the target.
	  Profiler uses two mechanisms for profiler data transferring.
	  1. Circular buffer.
	  2. Buffer replacing if according to the point 1 NWd had no time for
	     cleaning the previous buffer.
	  The profiler stops working if there are no free buffers in pool.

config TZDEV_SK_MULTICORE
	bool "TZDEV SK multicore"
	depends on TZDEV
	default n
	help
	  Define if secure kernel can work in multicore mode.

config TZDEV_MSM_CRYPTO_WORKAROUND
	bool
	default n

config TZDEV_QC_CRYPTO_CLOCKS_MANAGEMENT
	bool "TZDEV crypto clock management"
	depends on TZDEV && QCOM_SCM_ARMV8
	default n
	help
	  Enable QC HW crypto clock management.

config TZDEV_QC_CRYPTO_CLOCKS_USR_MNG
	bool "User crypto clock management"
	depends on TZDEV && QCOM_SCM_ARMV8 && TZDEV_QC_CRYPTO_CLOCKS_MANAGEMENT
	default n
	help
	  Enable QC HW crypto clock management from User space. If disabled,
	  QC HW clock disable/enable is done in TZDEV.

config TZASC_TEST
	tristate "TZASC test helper module"
	depends on TZDEV
	default n
	help
	Provide the way to allocate a region of DRAM suitable for protection by
	a TZASC, get its physical address, and mmap it into userspace.

config TZASC_TEST_PAGE_ORDER
	int "TZASC test page allocation order"
	depends on TZASC_TEST
	help
	  Select TZASC test buffer page allocation order.

config TZPC_TEST
	tristate "TZPC test helper module"
	depends on TZDEV
	default n
	help
	Provide the way to try access to SSS device.

config TZ_MEMDUMP_TEST
	tristate "TZ memdump test helper module"
	default n
	help
	Provide the way to try to memdump from physical location.

config TZ_MMAP_TEST
	bool "TZ mmap test helper module"
	default n
	help
	Provide the way to get physical address of a location with known
	contents.

config TZ_CMA_TEST
	tristate "TZ CMA migration test helper module"
	depends on CMA
	default n
	help
	  Provide ioctl to calculate number of MIGRATE_CMA type pages

config EFUSE_TEST
	tristate "efuse test Kernel Module"
	default n
	help
	  Say Y to enable efuse test kernel modules.

config ION_FD2PHYS
	tristate "ION FD to physical address converter"
	depends on ION && (ARCH_EXYNOS || ARCH_MSM || ARCH_WHALE || ARCH_MT6755 || ARCH_MT6735)
	default y
	help
	Provide a method for userspace to get physical address from ION buffer
	descriptor

config TZIRS
	bool "Integrity reporting system"
	depends on TZDEV
	default n
	help
	  Enable Integrity reporintg system for Samsung Secure OS

config TZTUI
	bool "Trusted user interface"
	depends on TZDEV
	default n
	help
	  Enable Trusted user interface support for Samsung Secure OS

config TZ_CORE_MIGRATION
	bool "Core migration"
	depends on TZDEV
	default n
	help
	  Enable Core migration functionality for Samsung Secure OS

config TZDEV_PAGE_MIGRATION
	bool "Page migration"
	depends on TZDEV && MIGRATION && CMA
	default n
	help
	  Enable Page migration functionality for CMA Migration

config TZ_TRANSPORT
	bool "Telemetry module"
	select TZ_IW_CIRCULAR_BUFFER
	depends on TZDEV
	default n
	help
	  Enable Transport module. It is used for transfering data from SK to NWd.

config TZ_TRANSPORT_PG_CNT
	int "TZDEV transport module per-CPU buffer size (in pages)"
	depends on TZ_TRANSPORT
	default 1
	help
	  Select TZDEV transport buffer size in pages per CPU.

config TZ_TELEMETRY
	bool "Telemetry module"
	select TZ_TRANSPORT
	depends on TZDEV
	default n
	help
	  Enable Telemetry module. It is used for collecting runtime information
	  about Secure OS state.

config TZDEV_HOTPLUG
	bool "Core hotplug"
	depends on TZDEV
	default n
	help
	  Enable CPU Cores requested by Samsung Secure OS

config TZ_CHTEST
	bool "Custom handler test Kernel Module"
	depends on TZDEV
	default n
	help
	  Provide ioctl to test custom handler functionality from NWd

config TZDEV_BOOST
	bool "TZ booster"
	depends on TZDEV_HOTPLUG && ARCH_EXYNOS
	default n
	help
	  Switch high performance cluster to maximum frequency by NWd client
	  request.
```

## drivers/mmc/Kconfig
```kconfig
# SPDX-License-Identifier: GPL-2.0-only
#
# MMC subsystem configuration
#

menuconfig MMC
	tristate "MMC/SD/SDIO card support"
	depends on HAS_IOMEM
	help
	  This selects MultiMediaCard, Secure Digital and Secure
	  Digital I/O support.

	  If you want MMC/SD/SDIO support, you should say Y here and
	  also to your specific host controller driver.

config MMC_SUPPORT_STLOG
	bool "Enable storage log"
	depends on MMC && PROC_STLOG
	default y

config MMC_TEST_MODE
	bool "Samsung MMC TEST feature"
	depends on MMC
	help
	  This selects support for test mode for debugging.
	  Select this option if this feature is needed on working.

if MMC

source "drivers/mmc/core/Kconfig"

source "drivers/mmc/host/Kconfig"

endif # MMC
```

## drivers/motor/Kconfig
```kconfig
# Kconfig for the motor
#
# vibrator controlled by PMIC regualtor configuration
#

menuconfig VIBETONZ
	tristate "Vibetonz"
	default n
	help
	Say Y to enable Vibetonz support.
	-------------
	-------------
	-------------

config TACTILE_ASSIST
	tristate "Auto Haptic"
	default n
	depends on VIBETONZ

menuconfig MSM_VIBRATOR
        tristate "MSM_VIBRATOR"
        default n
        help
          Say Y to enable MSM_VIBRATOR support.
```

## drivers/motor_msm8930/Kconfig
```kconfig
#
# Immersion TouchSense Player driver configuration
#
menuconfig VIBETONZ
	tristate "Vibetonz"
	default n
	help
	Say Y to enable Vibetonz support.

config MOTOR_DRV_MAX77693
	tristate "Maxim MAX77693 motor"
	default n

	depends on MFD_MAX77693
#
# vibrator controlled by PMIC regualtor configuration
#
menuconfig MSM_VIBRATOR
        tristate "MSM_VIBRATOR"
        default n
        help
          Say Y to enable MSM_VIBRATOR support.
```

## drivers/muic-mcd/Kconfig
```kconfig
#
# MUIC devices
#

menu "Samsung MUIC device drivers"

config USE_MUIC
	bool "Using MUIC device driver"
	depends on I2C
	default n
	help
	  If you say yes here you will get support for
	  the MUIC device driver.

config USE_SAFEOUT
	bool "Using SAFEOUT device driver"
	depends on I2C
	default n
	help
	  If you say yes here you will get support for
	  the SAFEOUT device driver.

config MUIC_NOTIFIER
	bool "MUIC notifier support"
	depends on USE_MUIC
	default n
	help
	  If you say yes here you will get support for
	  the MUIC attached device status change notification.
	  
config MUIC_NOTIFIER_MODULE
	tristate "MUIC notifier module"
	default n
	help
	 this feature is for module build
	 If this feature is "m", KO object will be make
	 need modprobe for loading
	 It is made by samsung

config MUIC_SUPPORT_CCIC
	bool "MUIC supports CCIC chip interface"
	depends on USE_MUIC
	default n
	help
	  If you say yes here you will get support for the CCIC chip.

config HICCUP_CHARGER
	bool "Using HICCUP charger"
	depends on USE_MUIC
	default n
	help
	  If you say yes here you will get support for for the hiccup charger feature.
	  
endmenu
source "drivers/muic-mcd/common/Kconfig"
source "drivers/muic-mcd/sm/sm5714/Kconfig"
```

## drivers/muic/Kconfig
```kconfig
#
# MUIC devices
#

comment "MUIC configs"

config USE_MUIC
	bool "Using MUIC device driver"
	depends on I2C
	default n
	help
	  If you say yes here you will get support for
	  the MUIC device driver.

config MUIC_NOTIFIER
	bool "MUIC notifier support"
	depends on USE_MUIC
	default n
	help
	  If you say yes here you will get support for
	  the MUIC attached device status change notification.

config MUIC_S2MM001
	bool "Using S2MM001 MUIC"
	depends on USE_MUIC
	default n
	help
	  If you say yes here you will get support for
	  for the S2MM001 MUIC chip.

config MUIC_S2MU005
	bool "Using S2MU005 MUIC"
	depends on USE_MUIC
	default n
	help
	  If you say yes here you will get support for
	  for the S2MU005 MUIC chip.

config MUIC_SM5703
	bool "SM5703 MUIC"
	depends on USE_MUIC
	default n
	help
	  If you say yes here you will get support for the SM5703 MUIC chip.

config MUIC_UART_SWITCH
	bool "Using Exynos ModAP UART"
	depends on USE_MUIC
	default n
	help
	  If you say yes here you will get support for
	  for the Exynos ModAP chip.

config MUIC_UNIVERSAL
  	bool "UNIVERSAL MUIC"
	depends on USE_MUIC
	default n
	help
	  If you say yes here you will get support for various MUIC chips.

config MUIC_UNIVERSAL_SM5703
  	bool "SM5703 MUIC"
	depends on USE_MUIC
	default n
	help
	  If you say yes here you will get support for the SM5703 MUIC chip.

config MUIC_SUPPORT_VZW_ACC
	bool "MUIC supports VZW ACC"
	depends on MUIC_UNIVERSAL
	default n
	help
	 If you say yes here you will get support for the VZW Accessory & Incompatible.
```

## drivers/muic/afc_gpio/Kconfig
```kconfig
config AFC_CHARGER
	tristate "Using AFC charger driver"
	default n
	help
	  If you say yes here you will get support for
	  the AFC charger driver.
```

## drivers/muic/common/vt_muic/Kconfig
```kconfig
config VIRTUAL_MUIC
	tristate "Virtual MUIC support"
	depends on MUIC_NOTIFIER
	default n
	help
	  If you say yes here you will get support for
	  virtual MUIC device driver.
```

## drivers/muic/slsi/s2mu005/Kconfig
```kconfig
config MUIC_S2MU005
	bool "Using S2MU005 MUIC"
	depends on USE_MUIC && MFD_S2MU005
	default n
	help
	  If you say yes here you will get support for
	  for the S2MU005 MUIC chip.

config MUIC_S2MU005_ENABLE_AUTOSW
	bool "Using S2MU005 MUIC ENABLE AUTOSW"
	depends on MUIC_S2MU005
	default n
	help
	  If you say yes here you will get support for
	  for the S2MU005 MUIC chip ENABLE AUTOSW feature.

config MUIC_S2MU005_DISCHARGING_WA
	bool "Using S2MU005 MUIC DISCHARGING WORKAROUND"
	depends on MUIC_S2MU005
	default n
	help
		If you say yes here you will get support for
		for the S2MU005 MUIC chip DISCHARGING WA feature.
```

## drivers/muic/slsi/s2mu106/Kconfig
```kconfig
config MUIC_S2MU106
	bool "Using S2MU106 MUIC"
	depends on USE_MUIC && MFD_S2MU106
	default n
	help
	  If you say yes here you will get support for the S2MU106 MUIC chip.

config HV_MUIC_S2MU106_AFC
	bool "Using S2MU106 MUIC AFC"
	depends on MUIC_HV && MUIC_S2MU106
	default n
	help
	  If you say yes here you will get support for the AFC.

config MUIC_S2MU106_RID
	bool "Using S2MU106 MUIC RID"
	depends on MUIC_S2MU106
	default n
	help
	  If you say yes here you will get support for the S2MU106 MUIC RID functions.

config S2MU106_TYPEC_WATER
	bool "Using S2MU106 Type-C Water Detection"
	depends on MUIC_S2MU106_RID
	default n
	help
	  If you say yes here you will get support for
	  the S2MU106 Type-C Water functions.
```

## drivers/muic/slsi/s2mu107/Kconfig
```kconfig
config MUIC_S2MU107
	bool "Using S2MU107 MUIC"
	depends on USE_MUIC && MFD_S2MU107
	default n
	help
	  If you say yes here you will get support for the S2MU107 MUIC chip.

config HV_MUIC_S2MU107_AFC
	bool "Using S2MU107 MUIC AFC"
	depends on MUIC_HV && MUIC_S2MU107
	default n
	help
	  If you say yes here you will get support for the AFC.

config MUIC_S2MU107_RID
	bool "Using S2MU107 MUIC RID"
	depends on MUIC_S2MU107
	default n
	help
	  If you say yes here you will get support for the S2MU107 MUIC RID functions.

config S2MU107_TYPEC_WATER
	bool "Using S2MU107 Type-C Water Detection"
	depends on MUIC_S2MU107_RID
	default n
	help
	  If you say yes here you will get support for
	  the S2MU107 Type-C Water functions.
```
