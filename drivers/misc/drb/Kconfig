## drivers/misc/drb/Kconfig
```kconfig
#
# Dev-Ril-Bridge driver
#

config DEV_RIL_BRIDGE
	bool "Support a bridge between device and RIL"
	default n
```

## drivers/misc/fm_2351/Kconfig
```kconfig
config SR2351_FM
	tristate "SPRD 2351 FM Support"
	---help---
	  Say Y to enable built-in wireless MAC controller in the
	  Spreadtrum SC88xx based System-on-Chip devices.

config FM_SEEK_STEP_50KHZ
	tristate "Trout FM Seek Step 50KHz Support "
	default n
	help
	  If you say yes here you can support Step 50KHz for Trout FM.
```

## drivers/misc/gpsip/Kconfig
```kconfig
config CGX
	bool "Sprd gps"
	default n
	help
	  GPS can locate you position

config CGX_DRIVER
	tristate "Sprd gps driver"
	depends on CGX
	help
	  GPS can locate you position

config CGX_VIRTUALCOM
	tristate "Sprd gps virtual com"
	depends on CGX
	help
	  GPS can locate you position

config CGX_GE_GPS
	tristate "Sprd greeneye gps use spi interface"
	depends on CGX
	help
	  GPS can locate you position
```

## drivers/misc/grdm/Kconfig
```kconfig
config GRDM_POWER
	bool "regulatore control of grdm"
	default y
	help
	  Say Y here if you have a grdm.

	  If unsure, say N.
```

## drivers/misc/hall/Kconfig
```kconfig
config INPUT_HALL
    tristate "hall_sensor"
    default y
    help
      Say Y to enable the HALL detection application, if N here not to use the
      this HALL sensor
```

## drivers/misc/huaqin/Kconfig
```kconfig
#
# for huaqin mis info
#

# HS03 code for SR-SL6215-01-233 by sunxunou at 2021/08/02 start
config HQ_SIM_TRAY_CHECK
	bool "check sim stry status"
        default y
	help
	  this will create a node to show sim tray status.

	  If unsure, say N.
# HS03 code for SR-SL6215-01-233 by sunxunou at 2021/08/02 end
```

## drivers/misc/hwconfig_check/Kconfig
```kconfig
config SPRD_HWCONFIG_CHECK
    bool "enable hardware configuration check funtion"
    default n
    help
    enable hardware configuration check
```

## drivers/misc/mcu/Kconfig
```kconfig
#
# Kconfig for MCU
#

config EXYNOS7580_MCU_IPC
     bool "Exynos 7580 MCU IPC Support"
     default n
	 help
	   This enables MCU_IPC driver to control the MCU_IPC Device.

	   MCU_IPC is the Mailbox which has 16 interrupts for TX/RX each
	   and 256 bytes memory for communicating messages.
	   AP and CP can share the messages through this device.

config EXYNOS7580_SHM_IPC
    bool "Shared Memory for IPC support"
    default n
        help
	  This enables SHM_IPC driver to control the Shared memory
	  for AP-CP Interface.

config EXYNOS7580_PMU_CP
     bool "Exynos 7580 Modem PMU Driver"
     default n
	 help
	   This enables Exynos 7580 Modem PMU Driver driver to control
	   the PMU_CP Device.

	   PMU_CP controls CP power on/off/reset
```

## drivers/misc/mcu_ipc/Kconfig
```kconfig
#
# MCU_IPC Device Driver
#

config MCU_IPC
	bool "MCU_IPC Support"
	depends on SOC_EXYNOS4270 || SOC_EXYNOS3470
	default y
	help
	  This enables MCU_IPC driver to control the MCU_IPC Device.

	  MCU_IPC is the Mailbox which has 16 interrupts for TX/RX each
	  and 256 bytes memory for communicating messages.
	  AP and CP can share the messages through this device.
```

## drivers/misc/mdbg/Kconfig
```kconfig
menu "MARLIN DEBUG modules"
config MDBG_SDIO
	bool "MDBG SDIO INTERFACE"
	default y
	help
	  FOR MDBG SDIO INTERFACE

config MDBG_RING
	bool "MDBG RING BUFFER"
	default y
	help
	  FOR MDBG RING BUFFER

config MDBG
	tristate "MDBG"
	depends on SDIODEV
	depends on MDBG_RING
	help
	  DEBUG SYSTEM FOR MARLIN.
	  If unsure, say N.


endmenu
```

## drivers/misc/mediatek/accdet/Kconfig
```kconfig
config MTK_ACCDET
	bool "MediaTek ACCDET driver"
	help
	  ACCDET driver is for headset detect and support for MediaTek SOC
	  If you want to use MediaTek ACCDET driver,
	  say Y.
	  If unsure, say N.

config ACCDET_EINT_IRQ
	bool "MediaTek ACCDET PMIC EINT"
	help
	  ACCDET Internal EINT(PMIC) support for MediaTek SOC
	  If you want to use MediaTek ACCDET EINT from PMIC,
	  say Y.
	  If unsure, say N.

config ACCDET_SUPPORT_EINT0
	bool "MediaTek ACCDET PMIC EINT0"
	help
	  ACCDET use Internal EINT0(PMIC) support for MediaTek SOC
	  If you just want to use MediaTek PMIC ACCDET EINT0,
	  say Y.
	  If unsure, say N.

config FOUR_KEY_HEADSET
	bool "MediaTek four key headset"
	help
	  FOUR_KEY_HEADSET support for MediaTek SOC
	  If you want to use MediaTek ACCDET four key headset,
	  say Y.
	  If unsure, say N.

# +Req S96818AA1-1936 shenwenlei.wt 20230525  audio bringup
config WT_PROJECT_HEADPHONE_NODE
        default y
        tristate
# -Req S96818AA1-1936 shenwenlei.wt 20230525  audio bringup
```

## drivers/misc/mediatek/base/power/Kconfig
```kconfig
config MTK_CLKMGR
	bool "Mediatek proprietary clock management"
	default n
	---help---
	  Mediatek proprietary clock management is used to operate
          the clocks. The clocks are composed of CG, MUX, PLL,
          non-MTCMOS. The operations of clocks are enabling,
          disabling, and querying status. If this config is not set,
          system will use COMMON_CLK instead.

config SODI_ON
	bool "Enable SODI"
	depends on (ARCH_MT6735 || ARCH_MT6735M || ARCH_MT6753)
	default n
	help
	  Select if you want to enable Screen ON DeepIdle (SODI).

config MTK_CPU_HOTPLUG_DEBUG_0
	bool "MediaTek CPU Hotplug DEBUG 0"
	default y
	help
	  This kernel config can be used to enable log message in cpu notify
	  callback function in register_cpu_notifier. This is useful for CPU
	  hotplug debug.
	  If unsure, say Y.

config MTK_CPU_HOTPLUG_DEBUG_1
	bool "MediaTek CPU Hotplug DEBUG 1"
	default n
	help
	  This kernel config can be used to enable log message in cpu notify
	  callback function in notifier_call_chain. This is useful for CPU
	  hotplug debug but the performance will be drop down.
	  If unsure, say N.

config MTK_CPU_HOTPLUG_DEBUG_2
	bool "MediaTek CPU Hotplug DEBUG 2"
	default y
	help
	  This kernel config can be used to enable aee to log cpu notify
	  callback in notifier_call_chain. This is useful for CPU hotplug
	  debug.
	  If unsure, say Y.

config SYSTEM_BOOTUP_CPU_BOOST
	bool "Boost CPU performance to enhance boot speed"
	default n
	help
	  SYSTEM_BOOTUP_CPU_BOOST is to boost CPU performance to enhance boot
	  speed and save time cost during system booting. This mechanism
	  will recover DVFS/hotplug after system boot up done.

config CPU_DVFS_SYSTEM_BOOTUP_BOOST
	bool "cpu dvfs system bootup boost"
	default n 
	help
		CPU_DVFS_SYSTEM_BOOTUP_BOOST is used to enhance system bootup time by fixing
		CPU at max CPU frequency before bootup procedure finished. Say y here to enable
		it and say n to disable it.

config DISABLE_SCREEN_OFF_DVFS_ENHANCEMENT
	bool "Disable DVFS enhancement feature for screen off scenario"
	default n
	help
	  Select this option if you want to disable CPU DVFS enhancemnet
	  and let it free-run for screen off scenario.
```

## drivers/misc/mediatek/cam_cal/Kconfig
```kconfig
config MTK_CAM_CAL
  bool CONFIG_MTK_CAM_CAL
  default n
  help
    CONFIG_MTK_CAM_CAL define if the camera cal driver should be built in or not

config CUSTOM_KERNEL_CAM_CAL_DRV
        string "CUSTOM_KERNEL_CAM_CAL_DRV"
        help
          Kernel space camera cal driver. You can use this driver
          choose camera cal type.
```

## drivers/misc/mediatek/cam_ois/Kconfig
```kconfig
config CAMERA_OIS
	bool "camera OIS driver"
	default n
	help
	  CONFIG_CAMEAR_OIS define if the camera OIS driver should be
	  built in or not. If you want to use OIS for sensor. You have
	  enable CONFIG_CAMERA_OIS on general_variant. The kernel space for
	  OIS will be build. It may be like as "/dev/CAM_OIS_DRV".
	  Use space code will control the driver by open and ioctrl this one.
config CAMERA_OIS_LIST
	string "Camera ois driver list"
	help
	  Kernel space camera OIS driver list.
```

## drivers/misc/mediatek/imgsensor/Kconfig
```kconfig
config MTK_IMGSENSOR
  bool CONFIG_MTK_IMGSENSOR
  default n
  help
    CONFIG_MTK_IMGSENSOR

config CAMERA_HW_BIG_DATA
  bool CONFIG_CAMERA_HW_BIG_DATA
  default y
  help
    CONFIG_CAMERA_HW_BIG_DATA
source "drivers/misc/mediatek/imgsensor/src/Kconfig"  
```

## drivers/misc/mediatek/imgsensor/src/Kconfig
```kconfig
config SPECIFY_IMGSENSOR
	bool SPECIFY_IMGSENSOR
	depends on MTK_IMGSENSOR
	help
	  Specify name of each sensor to prevent obtaining wrong sensor driver with same sensor ID.
	  For example, imx258_mipi_raw and imx258_mipi_mono are of same sensor ID. If not specifying
	  sensor, imx258_mipi_mono may be recognized as imx258_mipi_raw.

config IMGSENSOR_MAIN
	string "Custom main image sensor"
	depends on SPECIFY_IMGSENSOR
	help
	  Specify main sensor.

config IMGSENSOR_MAIN2
	string "Custom main2 image sensor"
	depends on SPECIFY_IMGSENSOR
	help
	  Specify main2 sensor.

config IMGSENSOR_SUB
	string "Custom sub image sensor"
	depends on SPECIFY_IMGSENSOR
	help
	  Specify sub sensor.

config IMGSENSOR_SUB2
	string "Custom sub2 image sensor"
	depends on SPECIFY_IMGSENSOR
	help
	  Specify sub2 sensor.

config IMGSENSOR_MAIN3
	string "Custom main3 image sensor"
	depends on SPECIFY_IMGSENSOR
	help
	  Specify main3 sensor.

config IMGSENSOR_CUSTOM_CAMERA
	bool "Use custom camera set"
	help
		Use custom camera set

if IMGSENSOR_CUSTOM_CAMERA
choice IMGSENSOR_CAMERA_SET_CHOICE
	prompt "Choose the proper camera set"
config CAMERA_AAT_V12
	bool CAMERA_AAT_V12
	help
		For AAT V12 camera set
config CAMERA_MMV_V53X
	bool CAMERA_MMV_V53X
	help
		For MMV V53X camera set
config CAMERA_AAV_V13VE
	bool CAMERA_AAV_V13VE
	help
		For AAV V13VE camera set
config CAMERA_AAV_V23EX
	bool CAMERA_AAV_V23EX
	help
		For AAV V23EX camera set
config CAMERA_AAW_V34X
	bool CAMERA_AAW_V34X
	help
		For AAW V34X camera set
config CAMERA_BTW_V00
	bool CAMERA_BTW_V00
	help
		For BTW V00 camera set
endchoice

config CAMERA_SAMSUNG_MODEL_NAME
	string CAMERA_SAMSUNG_MODEL_NAME
	help
		Current model name. Set string by IMGSENSOR_CAMERA_SET_CHOICE.

config CAMERA_SENSOR0
	string "Camera Sensor 0"
	help
		Camera image sensor 0
config CAMERA_SENSOR1
	string "Camera Sensor 1"
	help
		Camera image sensor 1
config CAMERA_SENSOR2
	string "Camera Sensor 2"
	help
		Camera image sensor 2
config CAMERA_SENSOR3
	string "Camera Sensor 3"
	help
		Camera image sensor 3
config CAMERA_SENSOR4
	string "Camera Sensor 4"
	help
		Camera image sensor 4
config CAMERA_SENSOR5
	string "Camera Sensor 5"
	help
		Camera image sensor 5
config CAMERA_SENSOR0_2
	string "Camera Sensor 0_2"
	help
		Camera image sensor 0_2
config CAMERA_SENSOR1_2
	string "Camera Sensor 1_2"
	help
		Camera image sensor 1_2
config CAMERA_SENSOR2_2
	string "Camera Sensor 2_2"
	help
		Camera image sensor 2_2
config CAMERA_SENSOR3_2
	string "Camera Sensor 3_2"
	help
		Camera image sensor 3_2
config CAMERA_SENSOR4_2
	string "Camera Sensor 4_2"
	help
		Camera image sensor 4_2
config CAMERA_SENSOR5_2
	string "Camera Sensor 5_2"
	help
		Camera image sensor 5_2
endif

config CAMERA_ADAPTIVE_MIPI
	bool CAMERA_ADAPTIVE_MIPI
	depends on MTK_IMGSENSOR
	help
	  for using Adaptive MIPI.
	  use CONFIG_CAMERA_ADAPTIVE_MIPI

source "drivers/misc/mediatek/imgsensor/src/common/sysfs/Kconfig"
```

## drivers/misc/mediatek/imgsensor/src/common/sysfs/Kconfig
```kconfig
config IMGSENSOR_SYSFS
	bool CONFIG_IMGSENSOR_SYSFS
	default n
	help
	  If CONFIG_IMGSENSOR_SYSFS is y, then "imgsensor/src/common/sysfs/" is built.
	  This is for camera bringup without sysfs implementation.
	  Set this config to n, while bringup the camera.
```

## drivers/misc/mediatek/lcm/Kconfig
```kconfig
config MTK_LCM
	bool "Enble LCM driver"
	default n
	help
	  define LCM driver config to enable LCM driver.
	  To set LCM driver which you choose avoid cannot driver LCM.
	  Please make sure CONFIG_MTK_LCM in xxxxxx_defconfig.mk.
	  And also make sure true on in ProjectConfig.mk

config CUSTOM_LCM_USE_PMIC_VRF18_2
	bool "pmic vrf18_2 for lcm"
	default n
	help
	  this config is used to control lcm power
	  if lcm 1.8V control by pmic vrf18_2,please set it true.
	  Please make sure CUSTOM_LCM_USE_PMIC_VRF18_2 in xxxxx_defconfig.mk.
	  And also make sure true on in ProjectConfig.mk

config CUSTOM_KERNEL_LCM
	string "define mediatek kernel LCM driver"
	help
	  To choose kernel LCM driver name.
	  This config is to select which LCM driver you want to use.
	  Please make sure CUSTOME_KERNEL_LCM in xxxxx_defconfig.mk.
	  And also make sure turn on in ProjectConfig.mk

config MTK_LCM_DEVICE_TREE_SUPPORT
	bool "support LCM device tree connect with display drivers"
	help
	  Decide whether to support LCM device tree based configuration.
	  This feature requires the connection between display driver and LCM devices.
	  Please also turn on MTK_LCM_DEVICE_TREE_SUPPORT in ProjectConfig.mk.
	  If not define MTK_LCM_DEVICE_TREE_SUPPORT
	  there will not connect between display driver and LCM devices.

config LCD_GENERIC
	bool "GENERIC PANEL support"
	help
		Enable this to be able to choose the drivers for controlling the 
		TFT-LCD and AMOLED on some platforms. This driver adds support for 
		easy control of lcd, backlight, mdnie and tuning thru device tree.

if CUSTOM_KERNEL_LCM="sec_panel"
source "drivers/misc/mediatek/lcm/sec_panel/Kconfig"
endif

if LCD_GENERIC
source "drivers/misc/mediatek/lcm/mtk_gen_panel/Kconfig"
endif
```

## drivers/misc/mediatek/lcm/mtk_gen_panel/Kconfig
```kconfig
#
# GENERIC PANEL
#
# Enable this to be able to choose the drivers for controlling the 
# TFT-LCD and AMOLED on some platforms. This driver adds support for 
# easy control of lcd, backlight, mdnie and tuning thru device tree.

if LCD_GENERIC
source "drivers/misc/mediatek/lcm/mtk_gen_panel/gen_panel/Kconfig"
endif
```

## drivers/misc/mediatek/lcm/sec_panel/Kconfig
```kconfig
config SEC_PANEL
	tristate "Support SEC PANEL"
	default y

source "drivers/misc/mediatek/lcm/sec_panel/panels/Kconfig"
```

## drivers/misc/mediatek/lcm/sec_panel/panels/Kconfig
```kconfig
config DISPLAY_USE_INFO
	tristate "Support display use info logging"
	default n

config SEC_PANEL_DOZE_MODE
	tristate "Support DOZE MODE"
	default n

config SEC_PANEL_MDNIE_LITE
	tristate "Support MDNIE LITE"
	default n

config SEC_PANEL_S6E3FA3_AMS549KU2X
	tristate "S6E3FA3 AMS549KU2X AMOLED driver"
	default n
```

## drivers/misc/mediatek/lcm/smcdsd_panel/Kconfig
```kconfig
config SMCDSD_PANEL
	tristate "Samsung Mobile Communication Division System Display"
	default y

source "drivers/misc/mediatek/lcm/smcdsd_panel/panels/Kconfig"
```

## drivers/misc/mediatek/lcm/smcdsd_panel/panels/Kconfig
```kconfig
config SMCDSD_ENG
	bool "Support ENG"
	default n

config SMCDSD_DPUI
	bool "Support DPUI"
	default n

config SMCDSD_MDNIE
	bool "Support MDNIE"
	default n

config SMCDSD_DOZE
	bool "Support DOZE"
	default n

config SMCDSD_MASK_LAYER
	bool "Support mask layer"
	default n

config SMCDSD_DYNAMIC_MIPI
	bool "Support dynamic mipi"
	default n

config SMCDSD_EA8076_A31
	bool "EA8076_A31 driver"
	default n

config SMCDSD_EA8076_A41
	bool "EA8076_A41 driver"
	default n

config SMCDSD_EA8076_A41_JPN
	bool "EA8076_A41 JPN driver"
	default n
```

## drivers/misc/mediatek/lens/cam_ois/Kconfig
```kconfig
config CAMERA_OIS
	tristate "CAMERA_OIS"
	help
	  This is OIS driver for camera
	  Set as y if the driver is used in this project
	  use CONFIG_CAMERA_OIS
```

## drivers/misc/mediatek/mstdrv/Kconfig
```kconfig
config NFC_MST_ZF115
    bool "Samsung MST ZF115 dirver"
    help
      nfc pay function
```
