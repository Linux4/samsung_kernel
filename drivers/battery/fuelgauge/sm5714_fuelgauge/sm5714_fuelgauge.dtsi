/*
 * sm5714 battery device tree common
 *
 * Copyright (c) 2021 Samsung Electronics Co., Ltd.
 *		http://www.samsung.com
 *
 * This program is free software; you can redistribute it and/or modify
 * it under the terms of the GNU General Public License version 2 as
 * published by the Free Software Foundation.
 */

&smd {
	sm5714_fuelgauge: sm5714-fuelgauge {
		status = "okay";
		fuelgauge,fuel_alert_soc = <1>;
		fuelgauge,capacity_max = <1000>;
		fuelgauge,capacity_max_margin = <300>;
		fuelgauge,capacity_min = <0>;
		fuelgauge,capacity_calculation_type = <0x1F>;
		fuelgauge,using_temp_compensation;
		fuelgauge,low_temp_limit = <100>;
		fuelgauge,using_hw_vempty;
		fuelgauge,sw_v_empty_voltage = <3200>;
		fuelgauge,sw_v_empty_voltage_cisd = <3100>;
		fuelgauge,sw_v_empty_recover_voltage = <3480>;
		fuelgauge,capacity = <4000>;
#if 0
		fuelgauge,bat_id_gpio = <
				SEC_GPIO_REF(${bat_id_single_gpio}) 0  /* BAT_ID_1 */
				>;
#elif 1
		fuelgauge,bat_id_gpio = <
				SEC_GPIO_REF(PM,s2mpu16_gpio,gpio_s,5) 0  /* BAT_ID_2 */
				SEC_GPIO_REF(PM,s2mpu16_gpio,gpio_s,4) 0  /* BAT_ID_1 */
				>;
#endif

	};
};


&smd {
	battery {
		battery,fgsrc_switch_name = "sm5714-fuelgauge";
	};
};

/* /home/dpi/qb5_8814/workspace/P4_1716/android/kernel/kmodule/battery/suwon/fuelgauge/sm5714/sm5714_fuelgauge.gts9fe(wifi).dtsi */
/*
 * Gts9fe battery device tree common
 *
 * Copyright (c) 2023 Samsung Electronics Co., Ltd.
 *		http://www.samsung.com
 *
 * This program is free software; you can redistribute it and/or modify
 * it under the terms of the GNU General Public License version 2 as
 * published by the Free Software Foundation.
 */

&smd {
	sm5714-fuelgauge {
		status = "okay";
		fuelgauge,fuel_alert_soc = <1>;
		fuelgauge,capacity_max = <1000>;
		fuelgauge,capacity_max_margin = <300>;
		fuelgauge,capacity_min = <0>;
		fuelgauge,capacity_calculation_type = <0x1F>;
		fuelgauge,using_temp_compensation;
		fuelgauge,low_temp_limit = <100>;
		fuelgauge,using_hw_vempty;
		fuelgauge,sw_v_empty_voltage = <3200>;
		fuelgauge,sw_v_empty_voltage_cisd = <3100>;
		fuelgauge,sw_v_empty_recover_voltage = <3480>;
		fuelgauge,capacity = <10090>;
		battery_params {
			battery,id = <0>;
			battery0,battery_type = <4400 0x3B66>; /* batt_v_max, cap */
			battery0,battery_table0 = <
				0x1400 0x1A0B 0x1AE4 0x1BE1 0x1C81 0x1CF8 0x1D52 0x1D79
				0x1D87 0x1D9B 0x1DE2 0x1E3C 0x1E61 0x1E92 0x1ED5 0x1F12
				0x1F43 0x1F91 0x200F 0x20A1 0x210E 0x2182 0x22CD 0x2400
				>;
			battery0,battery_table1 = <
				0x0000 0x0019 0x0099 0x0199 0x02B3 0x03B3 0x04CC 0x05CC
				0x07E6 0x0C99 0x11CC 0x1C4C 0x2180 0x2966 0x3133 0x3680
				0x3919 0x3BB3 0x4399 0x4B66 0x5099 0x55E6 0x6400 0x64E6
				>;
			battery0,battery_table2 = <
				0x4366 0x3036 0x292C 0x2225 0x1F21 0x1D1E 0x1C1D 0x1B1B
				0x4366 0x3036 0x292C 0x2225 0x1F21 0x1D1E 0x1C1D 0x1B1B
				>;
			/*spare min max factor chg_factor dischg_factor manvalue*/
			battery0,rs_value = <0x003D 0x003D 0x3800 0x010A 0x0599 0x0599 0x0045>;
			battery0,v_alarm = <3100 200>;
			battery0,topoff = <775>;
			battery0,i_cal = <1 0x0 0x0800 0x0800 0 0x0 0x07A4 0x0820>;
			battery0,v_cal = <1 0 0 1 0 0 0>;
			battery0,temp_std = <25>;
			battery0,tem_poff = <3450 50 3450 50>;
			battery0,aux_ctrl = <0x322 0x5800>;
			battery0,data_ver = <4>;
			battery0,v_max_table = <0x22CD 0x22A4 0x227B 0x2252 0x2201>;
			battery0,q_max_table = <0x3B66 0x3B20 0x3ADA 0x3A94 0x35E6>;
		};
	};
};


&smd {
		battery {
			battery,fuelgauge_name = "sm5714-fuelgauge";
			battery,fgsrc_switch_name = "sm5714-fuelgauge";
		};
};
