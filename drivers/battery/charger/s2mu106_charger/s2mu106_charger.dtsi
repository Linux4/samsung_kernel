
&smd {
	s2mu106_charger: s2mu106-charger {
		status = "disable";
		compatible = "samsung,s2mu106-charger";
	};
};


/* /home/dpi/qb5_8815/workspace/P4_1716/android/kernel/kmodule/battery/stable/xcover5/charger/s2mu106_charger/s2mu106_charger.xcover5.dtsi */

&s2mu106_charger {
		charger,mrstbtmr_factory = <1>;
};
