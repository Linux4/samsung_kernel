&i2c10 {
	status = "okay";

	sm5451_charger: sm5451@63 {
		compatible = "siliconmitus,sm5451";
		reg = <0x63>;
	};
};

/* /home/dpi/qb5_8814/workspace/P4_1716/android/kernel/kmodule/battery/suwon/charger/sm5451/sm5451_charger.a34x.dtsi */
&sm5451_charger {
	sm5451,freq_byp = <0x1>; /* 375kHz */
	sm5451,freq = <2>; /* 500kHz */
	sm5451,r_ttl = <520000>;
	sm5451,topoff = <380>;
	sm5451,en_vbatreg = <1>;
};
