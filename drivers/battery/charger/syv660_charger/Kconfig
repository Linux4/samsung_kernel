## drivers/clk/mmp/Kconfig
```kconfig
menuconfig MRVL_MMP_CLK_FULL_FEAT
	bool "Marvell MMP Clock Full features"
	depends on ARCH_MMP && COMMON_CLK
	default n
	---help---
	  Enable full features of clock for Marvell MMP architecture.
	  Now DVFS (DVC) and MAX_VOLTAGE debug features are included.
	  And it could be expanded in the future.

if MRVL_MMP_CLK_FULL_FEAT
config PXA_DVFS
	tristate "Enable DVFS feature"
	depends on ARCH_MMP && COMMON_CLK
	default y
	---help---
	  Enable Dynamic Voltage & Frequency Scaling feature.
	  Multi-clients (clock nodes) could register to dvfs framework.
	  Then it will dynamically change voltage according to the
	  frequencies of all the clients.

config PXA_DEBUG_MAX_VOLTAGE
	bool "Enable Max Voltage Setting for Debug"
	depends on PXA_DVFS
	default n
	---help---
	  Use max voltage as vcc_main for debug popurse.
	  It is only a debug feature. When it is enabled, max voltage
	  will be set to vcc_main by default.

config VOLDC_STAT
	tristate "Enable voltage stat feature"
	depends on ARCH_MMP && PXA_DVFS
	default y
	---help---
	  Enable Dynamic Voltage state feature.

config PXA1936_CLK
	tristate "Enable pxa1936 clock"
	depends on ARCH_MMP && COMMON_CLK
	default n
	---help---
	  Enable clock driver for pxa1936. Though pxa1936 belongs to
	  Helanx series, it has some difference due to the big.LITTLE
	  architecture especially some PMU registers are totally
	  different from those on previous platforms such as pxa1088,
	  pxa1U88 and pxa1908.

endif
```

## drivers/cpuhotplug/Kconfig
```kconfig
#
# Generic cpuhotplug and touchboost drivers configuration
#

menu "CPU Hotplug and touchboost scaling"

config SPRD_CPU_HOTPLUG_GOV
	bool "SPRD CPU hotplug policy"
	depends on HOTPLUG_CPU
        help
          SPRD CPU hotplug policy.
	  And this driver change core number
	  on the basis of load on cpus.

	  Note that this driver will change the num of
	  CPU cores.

	  If in doubt, say N.

config SPRD_CPU_HOTPLUG_WORKAROUND
        bool "Pike2 CPU HOTPLUG WORKAROUND"
	depends on HOTPLUG_CPU
	help
	  Pike2 CPU HOTPLUG WORKAROUND
endmenu
```

## drivers/cpuidle/Kconfig.arm64
```kconfig
#
# ARM64 CPU Idle drivers
#

config ARM64_CPUIDLE
	bool "Generic ARM64 CPU idle Driver"
	select ARM64_CPU_SUSPEND
	help
	  Select this to enable generic cpuidle driver for ARM v8.
	  It provides a driver for testing purpose on ARM v8 models based
	  on cpu_suspend API for entering power down modes.

config CPU_IDLE_MMP_V8
	bool "CPU Idle Driver for MMP processors (ARMv8)"
	select ARM64_CPU_SUSPEND
	depends on ARM64 && ARCH_MMP
        default y
	help
	  Select this to enable cpuidle on MMP processors (ARMv8).

config PXA1936_LPM
	bool "LPM support for PXA1936"
	default n
	help
	  Enable the PXA1936 dual cluster LPM support.
	  This changes the behavior of the MCPM platform code.
```

## drivers/crypto/fmp/Kconfig
```kconfig
#
# FMP controller drivers
#
config EXYNOS_FMP
	tristate "Samsung EXYNOS FMP driver"
	help
	  Say yes here to build support for FMP (Flash Memory Protector)
	  If unsure, say N.

	  To compile this driver as a module, choose M here

config EXYNOS_FMP_FIPS
	bool "Samsung EXYNOS FMP Driver for FIPS"
	depends on EXYNOS_FMP
	default y
	help
	  Say yes here to build support for FMP (Flash Memory Protector)
	  FIPS validation driver for functional test.
	  If unsure, say N.
```

## drivers/debug/Kconfig
```kconfig
# When adding new entries keep the list in alphabetical order

source "drivers/debug/user_reset/Kconfig"
```

## drivers/devfreq/Kconfig
```kconfig
menuconfig PM_DEVFREQ
	bool "Generic Dynamic Voltage and Frequency Scaling (DVFS) support"
	help
	  A device may have a list of frequencies and voltages available.
	  devfreq, a generic DVFS framework can be registered for a device
	  in order to let the governor provided to devfreq choose an
	  operating frequency based on the device driver's policy.

	  Each device may have its own governor and policy. Devfreq can
	  reevaluate the device state periodically and/or based on the
	  notification to "nb", a notifier block, of devfreq.

	  Like some CPUs with CPUfreq, a device may have multiple clocks.
	  However, because the clock frequencies of a single device are
	  determined by the single device's state, an instance of devfreq
	  is attached to a single device and returns a "representative"
	  clock frequency of the device, which is also attached
	  to a device by 1-to-1. The device registering devfreq takes the
	  responsiblity to "interpret" the representative frequency and
	  to set its every clock accordingly with the "target" callback
	  given to devfreq.

	  When OPP is used with the devfreq device, it is recommended to
	  register devfreq's nb to the OPP's notifier head.  If OPP is
	  used with the devfreq device, you may use OPP helper
	  functions defined in devfreq.h.

if PM_DEVFREQ

comment "DEVFREQ Governors"

config DEVFREQ_GOV_SIMPLE_ONDEMAND
	bool "Simple Ondemand"
	help
	  Chooses frequency based on the recent load on the device. Works
	  similar as ONDEMAND governor of CPUFREQ does. A device with
	  Simple-Ondemand should be able to provide busy/total counter
	  values that imply the usage rate. A device may provide tuned
	  values to the governor with data field at devfreq_add_device().

config DEVFREQ_GOV_PERFORMANCE
	bool "Performance"
	help
	  Sets the frequency at the maximum available frequency.
	  This governor always returns UINT_MAX as frequency so that
	  the DEVFREQ framework returns the highest frequency available
	  at any time.

config DEVFREQ_GOV_POWERSAVE
	bool "Powersave"
	help
	  Sets the frequency at the minimum available frequency.
	  This governor always returns 0 as frequency so that
	  the DEVFREQ framework returns the lowest frequency available
	  at any time.

config DEVFREQ_GOV_USERSPACE
	bool "Userspace"
	help
	  Sets the frequency at the user specified one.
	  This governor returns the user configured frequency if there
	  has been an input to /sys/devices/.../power/devfreq_set_freq.
	  Otherwise, the governor does not change the frequnecy
	  given at the initialization.

config DEVFREQ_GOV_THROUGHPUT
        bool "Throughput"
        help
	  Set frequency based on recent throughput (e.g. how many MB/s).
	  A device with throughput governor should provide current throughput
	  value and available freq table. The throughput governor will choose
	  a proper frequency according to current throughput. A device may
	  provide tuned values to the governor with data field at
	  devfreq_add_device().

comment "DEVFREQ Drivers"

config ARM_EXYNOS4_BUS_DEVFREQ
	bool "ARM Exynos4210/4212/4412 Memory Bus DEVFREQ Driver"
	depends on CPU_EXYNOS4210 || CPU_EXYNOS4212 || CPU_EXYNOS4412
	select ARCH_HAS_OPP
	select DEVFREQ_GOV_SIMPLE_ONDEMAND
	help
	  This adds the DEVFREQ driver for Exynos4210 memory bus (vdd_int)
	  and Exynos4212/4412 memory interface and bus (vdd_mif + vdd_int).
	  It reads PPMU counters of memory controllers and adjusts
	  the operating frequencies and voltages with OPP support.
	  To operate with optimal voltages, ASV support is required
	  (CONFIG_EXYNOS_ASV).

config VPU_DEVFREQ
	bool "Marvell Soc's VPU devfreq driver"
	select DEVFREQ_GOV_USERSPACE
	help
	  This adds the DEVFREQ driver for Marvell Soc's VPU.
	  Use the DEVFreq governor 'userspace' as default. This allows
	  userspace to set the vpu frequency to dedicate frequency.

config DDR_DEVFREQ
	bool "DDR devfreq driver support"
	help
	  This adds the mck4 devfreq driver support.

if DDR_DEVFREQ
choice
	bool "DDR devfreq default governor"
	default DDR_DEVFREQ_GOV_THROUGHPUT
	help
	  this selects the default governor of DDR devfreq driver

config DDR_DEVFREQ_GOV_THROUGHPUT
	bool "Throughput"
	select DEVFREQ_GOV_THROUGHPUT
	help
	  Use the DEVFreq governor 'Throughput' as default. This allows
	  you to get a full dynamic frequency capable system by simply
	  loading your devfreq low-level hardware driver.
	  Be aware that not all devfreq drivers support the throughput
	  governor.

config DDR_DEVFREQ_GOV_ONDEMAND
	bool "Simple Ondemand"
	select DEVFREQ_GOV_SIMPLE_ONDEMAND
	help
	  Use the DEVFreq governor 'Simple Ondemand' as default. This allows
	  you to get a full dynamic frequency capable system by simply
	  loading your devfreq low-level hardware driver.
	  Be aware that not all devfreq drivers support the simple ondemand
	  governor.

config DDR_DEVFREQ_GOV_USERSPACE
	bool "Userspace"
	select DEVFREQ_GOV_USERSPACE
	help
	  Use the DEVFreq governor 'Userspace' as default. This allows
	  you to set the ddr frequency manually or when a userspace
	  program shall be able to set the ddr dynamically without having
	  to enable the userspace governor manually.
endchoice

endif # DDR_DEVFREQ

endif # PM_DEVFREQ
```

## drivers/extcon/Kconfig
```kconfig
menuconfig EXTCON
	tristate "External Connector Class (extcon) support"
	help
	  Say Y here to enable external connector class (extcon) support.
	  This allows monitoring external connectors by userspace
	  via sysfs and uevent and supports external connectors with
	  multiple states; i.e., an extcon that may have multiple
	  cables attached. For example, an external connector of a device
	  may be used to connect an HDMI cable and a AC adaptor, and to
	  host USB ports. Many of 30-pin connectors including PDMI are
	  also good examples.

if EXTCON

comment "Extcon Device Drivers"

config EXTCON_GPIO
	tristate "GPIO extcon support"
	depends on GENERIC_GPIO
	help
	  Say Y here to enable GPIO based extcon support. Note that GPIO
	  extcon supports single state per extcon instance.

config EXTCON_ADC_JACK
	tristate "ADC Jack extcon support"
	depends on IIO
	help
	  Say Y here to enable extcon device driver based on ADC values.

config EXTCON_MAX77693
	tristate "MAX77693 EXTCON Support"
	depends on MFD_MAX77693
	select IRQ_DOMAIN
	select REGMAP_I2C
	help
	  If you say yes here you get support for the MUIC device of
	  Maxim MAX77693 PMIC. The MAX77693 MUIC is a USB port accessory
	  detector and switch.

config EXTCON_FSA9485
	tristate "FSA9485 EXTCON Support"
	depends on I2C
	help
	  If you say yes here you get support for the MUIC device of
	  Fairchild FSA9485. The FSA9485 MUIC is a USB port accessory
	  detector and switch.

config EXTCON_TSU6721
	tristate "TSU6721 EXTCON Support"
	depends on I2C
	help
	  If you say yes here you get support for the MUIC device of
	  Texas Instrument TSU6721. The TSU6721 MUIC is a USB port accessory
	  detector and switch.

config EXTCON_MAX77803
	tristate "MAX77803 EXTCON Support"
	depends on MFD_MAX77803
	help
	  If you say yes here you get support for the MUIC device of
	  Maxim MAX77803 PMIC.
	  The MAX77803 MUIC is a USB port accessory detector and switch.

config EXTCON_MAX77804K
	tristate "MAX77804K EXTCON Support"
	depends on MFD_MAX77804K
	help
	  If you say yes here you get support for the MUIC device of
	  Maxim MAX77804K PMIC.
	  The MAX77804K MUIC is a USB port accessory detector and switch.

config EXTCON_MAX77828
	tristate "MAX77828 EXTCON Support"
	depends on MFD_MAX77828
	help
	  If you say yes here you get support for the MUIC device of
	  Maxim MAX77828 PMIC.
	  The MAX77828 MUIC is a USB port accessory detector and switch.

config EXTCON_MAX77843
	tristate "MAX77843 EXTCON Support"
	depends on MFD_MAX77843
	help
	  If you say yes here you get support for the MUIC device of
	  Maxim MAX77843 PMIC.
	  The MAX77843 MUIC is a USB port accessory detector and switch.

config ADC_ONESHOT
	bool "MAX77828 ADC ONESHOT MODE Support"
	depends on !SEC_FACTORY
	default y
	help
	  say yes here to enable ADC ONESHOT MODE when detecting ID Value

config MUIC_SUPPORT_HMT_DETECTION
	bool "support HMT Accessary"
	default n
	help
	  If you say yes here you will get support for the hmt accessary.

config MUIC_SUPPORT_AUDIO_DOCK
	bool "MUIC_SUPPORT_AUDIO_DOCK"
	default n
	help
	  If you say yes here you will get support for the audio dock.

config MUIC_SUPPORT_DESK_DOCK
	bool "MUIC_SUPPORT_DESK_DOCK"
	default n
	help
	  If you say yes here you will get support for the audio dock.

config MUIC_SUPPORT_SMART_DOCK
	bool "MUIC_SUPPORT_SMART_DOCK"
	default n
	help
	  If you say yes here you will get support for the audio dock.

config MUIC_SUPPORT_MULTIMEDIA_DOCK
	bool "MUIC_SUPPORT_MULTIMEDIA_DOCK"
	default n
	help
	  If you say yes here you will get support for the multimedia dock.

config MUIC_SUPPORT_INCOMPATIBLE_CHARGER
	bool "MUIC_SUPPORT_INCOMPATIBLE_CHARGER"
	default n
	help
	  If you say yes here you will get support for the audio dock.

config MUIC_SUPPORT_QC_CHARGER
	bool "MUIC_SUPPORT_QC_CHARGER"
	default n
	help
	  If you say yes here you will get support for the qc charger.

config EXTCON_ARIZONA
	tristate "Wolfson Arizona EXTCON support"
	depends on MFD_ARIZONA && INPUT
	help
	  Say Y here to enable support for external accessory detection
	  with Wolfson Arizona devices. These are audio CODECs with
	  advanced audio accessory detection support.

config MUIC_SUPPORT_RUSTPROOF
	bool "MUIC Disable UART"
	depends on !SEC_FACTORY
	default n
	help
	 This option will disable the UART to prevent the rusting of the
	 IF Connector in the case of Devices.

config MUIC_SUPPORT_WATERRESISTANCE
	bool "Feature for WATER Resistance mode"
	default n
	help
	 This option will disable the UART to prevent the rusting of the
	 IF Connector in the case of Devices.

endif # MULTISTATE_SWITCH
```

## drivers/fingerprint/Kconfig
```kconfig
config FINGERPRINT
	default y
tristate "samsung Fingerprint driver support"

source "drivers/fingerprint/silead/Kconfig"
source "drivers/fingerprint/gf_3258/Kconfig"
```

## drivers/fingerprint/fpsensor_tee/Kconfig
```kconfig
config FNGAP_FINGERPRINT
        tristate "Chipone Finger Print Driver"
        help
          Chipone Finger Print Supported
```

## drivers/fingerprint/gf_3258/Kconfig
```kconfig
config FINGGERPRINT_GF_3258
	tristate "generic goodix fingerprint driver"
	default n
	help
	add support for goodix fingerprint driver.
```

## drivers/five/five_tee_driver/Kconfig
```kconfig
#
# TEE Driver configuration
#

config FIVE_TEE_DRIVER
    bool "Integrity TEE Driver"
    depends on FIVE && QSEECOM
    default y
    help
      Enable Integrity Trusted Execution Environment support

config TEE_DRIVER_DEBUG
    bool "Integrity TEE Driver Debug mode"
    depends on FIVE_TEE_DRIVER
    default n
    help
      Enable Debug mode in TEE Driver

config FIVE_EARLY_LOAD_TRUSTED_APP
    bool "Load trusted application in early boot"
    depends on FIVE_TEE_DRIVER
    default y
    help
      Enable the load of trusted application on during initialization of driver

config FIVE_SIGN_TA
    bool "Sign FIVE TA during build"
    depends on FIVE_TEE_DRIVER
    default n
    help
      FIVE TA will be signed during build. Otherwise pre-signed TA will be used.

config FIVE_SIGNCLIENT_PATH
    string "Path to signclient.jar"
    depends on FIVE_SIGN_TA
    help
      Path to signclient.jar for signing FIVE TA

config FIVE_PILSPLITTER_PATH
    string "Path to pil_splitter.py"
    depends on FIVE_SIGN_TA
    help
      Path to pil_splitter.py for preparaing TA to signing
```
