## drivers/battery/charger/syv660_charger/Kconfig
```kconfig
config CHARGER_SYV660
	tristate "SYV660 charger driver"
	default n
	depends on BATTERY_SAMSUNG
	help
	  Say Y here to enable support for the SYV660 charger
	  support for the SYV660 charger.
	  This includes boost mode.
	  This is Switching Mode Charger.

config BC12_DEVICE
    bool "support for bc12 device"
    default n
    help
	  Say Y here to enable
	  support for bc12 device
	  If this is N in models,
	  not support to bc12 device.
```

## drivers/battery/common/Kconfig
```kconfig
# Samsung battery configuration
#

menu "Samsung battery support"

config BATTERY_SAMSUNG
	tristate "samsung battery driver"
	help
	  Say Y to include support for samsung battery driver
	  This battery driver integrated all battery-related functions
	  To see battery-related functions,
	  refer to sec_charging_common.h

if BATTERY_SAMSUNG

config BATTERY_SAMSUNG_LEGO_STYLE
	tristate "samsung battery driver (lego style)"
	default n
	depends on BATTERY_SAMSUNG
	help
	 Say Y to include support for samsung battery driver
	 This battery driver integrated all battery-related functions
	 To see battery-related functions,
	 refer to sec_charging_common.h

config BATTERY_SAMSUNG_MHS
	tristate "samsung battery driver for mhs model"
	default n
	depends on BATTERY_SAMSUNG_V2
	help
	 Say Y to include support for samsung battery driver
	 This battery driver integrated all battery-related functions
	 To see battery-related functions,
	 refer to sec_charging_common.h

config CHARGING_VZWCONCEPT
	tristate "VZW concept about the charging"
	default n
	depends on BATTERY_SAMSUNG
	help
	 Say Y to include support for the VZW concepts.

config MULTI_CHARGING
	bool "support for multi charger ICs"
	help
	 Say Y to include support for multi charger ICs

config STEP_CHARGING
	bool "support for step charging"
	help
	 Say Y to include support for step charging

config ENABLE_FULL_BY_SOC
	bool "make full by soc 100%"
	help
	default n
	 Say Y to include support to make full by soc 100%

config UPDATE_BATTERY_DATA
	bool "support for updating battery data"
	default n
	depends on BATTERY_SAMSUNG && OF
	help
	 Say Y to include support for step charging

config AFC_CURR_CONTROL_BY_TEMP
	tristate "fast charging current control by temp"
	default n
	depends on BATTERY_SAMSUNG
	help
	 Say Y to set afc current control by temp

config BATTERY_CISD
	 bool "support for cisd"
	 help
	 Say Y to include support for cisd
	 cisd means cell internal short detection

config PREVENT_SOC_JUMP
	tristate "prevent soc jump at full-charged"
	default n
	depends on BATTERY_SAMSUNG
	help
		Say Y to prevent soc jump

config CS100_JPNCONCEPT
	tristate "cs100 command support"
	depends on BATTERY_SAMSUNG && I2C
	help
	 Say Y here to support for CS100 command to stop when full-charged
	 on wireless charging for JPN models

config AFC_CHARGER_MODE
	bool "afc charging support in sec battery driver"
	default n
	help
	  Say Y to include support for sec afc charging support

config SAMSUNG_LPM_MODE
	bool "Off charging mode support in sec battery driver"
	default n
	help
	  Say Y to include support for sec off charging support
	  This value defined at bootloader.
	  Before enable this feature,
	  implemet power off charging in the bootloader.

config SAMSUNG_BATTERY_ENG_TEST
	bool "enable ENG mode for battery test"
	default n
	help
	  Say Y to include support for battery test
	  enable this feature only ENG mode
	  this featuren must disabled user binary
	  stability test etc..

config SAMSUNG_BATTERY_FACTORY
	bool "enable for factory test"
	default n
	help
	  Say Y to include support for factory test
	  enable this feature only factory mode
	  this featuren must disabled user binary
	  stability test etc..

config SAMSUNG_BATTERY_DISALLOW_DEEP_SLEEP
	bool "Disallow deep sleep during charging"
	default n
	depends on BATTERY_SAMSUNG && (ARCH_MSM8974 || ARCH_APQ8084)
	help
	  Say Y to include support
	  Disallow deep sleep during charging for stablity.

config DISABLE_SAVE_CAPACITY_MAX
	bool "Disable to save capacity max in efs"
	default n
	depends on BATTERY_SAMSUNG
	help
		Say Y to include support to disable it
		capacity_max is saved in /efs/Battery/batt_capacity_max
		capacity_max is restored after boot up
		You can find the code in healthd

config EN_OOPS
	bool "enable oops filter"
	default n
	help
	  Say Y to enable oops filter

config USE_POGO
	bool "enable pogo charging"
	default n
	help
	  Say Y to enable CONFIG_USE_POGO

config DISCRETE_CHARGER
	bool "enable discrete charger"
	default n
	help
	  Say Y to enable CONFIG_USE_CHARGER
	  This feature is used for models that have a
	  dedicated charger IC or in-PMIC charger.
	  It is needed to separate concepts in the battery driver.

config MACH_KOR_EARJACK_WR
	bool "enable earjack-noise workaround"
	default n
	depends on BATTERY_SAMSUNG
	help
	  Say Y to enable earjack-noise workaround at charging

config STORE_MODE
	bool "enable store mode"
	default n
	help
	  Say Y to enable CONFIG_STORE_MODE

config SW_SELF_DISCHARGING
	bool "enable sw_self_discharging"
	default n
	help
	  Say Y to enable CONFIG_SW_SELF_DISCHARGING

config BATTERY_AGE_FORECAST
	tristate "battery age forecast"
	default n
	help
	  Say Y to use calc time to full function.

config BATTERY_AGE_FORECAST_DETACHABLE
	tristate "battery age forecast for detachable"
	default n
	select BATTERY_AGE_FORECAST
	help
	Say Y to use battery age forecast for detachable

config BATTERY_AGE_FORECAST_B2B
	tristate "battery age forecast for B2B"
	default n
	select BATTERY_AGE_FORECAST
	help
	Say Y to use battery age forecast for B2B

config BATTERY_LOGGING
	tristate "battery logging"
	default n
	depends on BATTERY_SAMSUNG
	help
	Say Y to use update battery logging

config ENG_BATTERY_CONCEPT
       bool "enable temp block"
       default n
       help
	 Say Y to enable CONFIG_ENG_BATTERY_CONCEPT

config USB_FACTORY_MODE
	bool "enable USB factory mode"
	default n
	help
	  Say Y to enable CONFIG_USB_FACTORY_MODE
	  This feature is used for models that support
	  factory mode using USB cable instead of Anyway JIG.
	  Code for this is added in charger and battery driver.

config QH_ALGORITHM
	bool "enable QH algorithm"
	default n
	help
		Say Y to enable CONFIG_QH_ALGORITHM to measure leakges of the battery
		using raw coulomb count generated by the device

config BATTERY_NOTIFIER
	bool "battery notifier"
	default n
	help
	  Say Y to enable battery notifier

config LIMIT_CHARGING_DURING_CALL
	bool "limit charging during call"
	default n
	help
	  Say Y to limit charging during call

config TABLET_MODEL_CONCEPT
	bool "tablet model concept"
	default n
	help
	  Say Y to enable tablet model concept

config OTG_OVERCURRENT_BY_CHGIN
	bool "enable otg overcurrent detection by chgin workaround"
	default n
	help
	  Say Y to enable otg overcurrent detection by chgin workaround
	  for charger ICs have otg retrying issues from OVP IC specification

config SWITCHING_S2ASL01
    tristate "S2ASL01 SWITCHING IC support"
    depends on I2C
    help
	  Say Y here to enable support for S2ASL01 switching driver.

config DUAL_BATTERY
    tristate "DUAL BATTERY support"
    depends on I2C
    help
	  Say Y here to enable support for dual battery

config ISDB_CHARGING_CONTROL
    tristate "ISDB CHARGING CONTROL support"
    depends on I2C
    help
	  Say Y here to enable support for isdb

config PREVENT_USB_CONN_OVERHEAT
    bool "enable prevent usb conn overheat"
    default n
    help
	  Say Y to enable CONFIG_PREVENT_USB_CONN_OVERHEAT

endif

config SUPPORT_HV_CTRL
    bool "support for controlling voltage"
    default n
    help
	  Say Y to include support for controlling voltage

config SUPPORT_WAKEUP_REGISTER
    bool "support for wakeup register api based on kernel version"
    default n
    help
	  Say Y to enable CONFIG_SUPPORT_WAKEUP_REGISTER
	  This feature is used for kernel wakeup api and
	  old kernel version do not support wakeup register api.
	  Please check pm_wakeup header in your kernel before enable this.

config SEC_BATTERY_TEST
	bool "KUnit test for sec_battery_test"
	depends on SEC_KUNIT
	help
	  TODO: Describe config fully.

config SEC_BATTERY_THERMAL_TEST
	bool "KUnit test for sec_battery_thermal_test"
	depends on SEC_KUNIT
	help
	  TODO: Describe config fully.

config SEC_BATTERY_VOTE_TEST
	bool "KUnit test for sec_battery_vote_test"
	depends on SEC_KUNIT
	help
	  TODO: Describe config fully.

config SEC_CISD_TEST
	bool "KUnit test for sec_cisd_test"
	depends on SEC_KUNIT
	help
	  TODO: Describe config fully.

config SEC_ADC_TEST
	bool "KUnit test for sec_adc_test"
	depends on SEC_KUNIT
	help
	  TODO: Describe config fully.

config SEC_BATTERY_SYSFS_TEST
	bool "KUnit test for sec_battery_sysfs_test"
	depends on SEC_KUNIT
	help
	  TODO: Describe config fully.

config SEC_BATTERY_TTF_TEST
	bool "KUnit test for sec_battery_ttf_test"
	depends on SEC_KUNIT
	help
	  TODO: Describe config fully.

config SEC_STEP_CHARGING_TEST
	bool "KUnit test for sec_step_charging_test"
	depends on SEC_KUNIT
	help
	  TODO: Describe config fully.

config SEC_PD_TEST
	bool "KUnit test for sec_pd_test"
	depends on SEC_KUNIT
	help
	  TODO: Describe config fully.
endmenu
```

## drivers/battery/fuelgauge/Kconfig
```kconfig
config FUELGAUGE_DUMMY
	tristate "dummy fuel gauge driver"
	default n
	depends on BATTERY_SAMSUNG
	help
	 Say Y to include support
	 for dummy fuel gauge driver.
	 This driver source code implemented
	 skeleton source code for fuel gauge functions.

config FUELGAUGE_SM5714
	tristate "Siliconmitus SM5714 Fuel Gauge"
	default n
	depends on I2C
	help
	  SM5714 is fuel-gauge systems for lithium-ion (Li+) batteries
	  in handheld and portable equipment. The SM5714 is configured
	  to operate with a single lithium cell
```

## drivers/battery/fuelgauge/max1726x_fuelgauge/Kconfig
```kconfig
config FUELGAUGE_MAX1726X
	tristate "MAX1726X fuel gauge driver"
	default n
	depends on BATTERY_SAMSUNG
	help
	 Say Y to include support
	 for MAXIM MAX1726X fuel gauge driver.
	 This fuel-gauge can be used in coulomb-counting mode.
```

## drivers/battery/fuelgauge/mtk_fuelgauge/Kconfig
```kconfig
config FUELGAUGE_MTK
	tristate "MTK fuel gauge battery driver"
	default n
	help
	 Say Y to include support
	 for MTK in-PMIC fuelgauge driver
	 Ths is an empty driver file and only
	 acts as a connector to mtk_fg_battery
	 which has all the in-PMIC FG functionalities.
```

## drivers/battery/fuelgauge/s2mf301_fuelgauge/Kconfig
```kconfig
config FUELGAUGE_S2MF301
	tristate "S2MF301 fuel gauge driver"
	default n
	depends on (MFD_S2MF301) && I2C
	help
	 Say Y to include support
	 for S.LSI S2MF301 fuel gauge driver.
	 Ths fuel-gauge supports current tracking and
	 voltage tracking to model the battery SOC.
```

## drivers/battery/fuelgauge/s2mu005_fuelgauge/Kconfig
```kconfig
config FUELGAUGE_S2MU005
	tristate "S2MU005 fuel gauge driver"
	default n
	depends on BATTERY_SAMSUNG
	help
	 Say Y to include support
	 for S.LSI S2MU005 fuel gauge driver.
	 Ths fuel-gauge supports current tracking and
	 voltage tracking to model the battery SOC.

config S2MU005_VOLT_MODE_TUNING
	bool "enable s2mu005 volt mode tuning"
	default n
	help
	 Say Y to include support
	 for S.LSI S2MU005 fuel gauge driver.
	 Ths fuel-gauge supports
	 s2mu005 volt mode tuning
```

## drivers/battery/fuelgauge/s2mu106_fuelgauge/Kconfig
```kconfig
config FUELGAUGE_S2MU106
	tristate "S2MU106 fuel gauge driver"
	default n
	depends on (MFD_S2MU106) && I2C
	help
	 Say Y to include support
	 for S.LSI S2MU106 fuel gauge driver.
	 Ths fuel-gauge supports current tracking and
	 voltage tracking to model the battery SOC.

config FUELGAUGE_S2MU106_USE_5MILLIOHM
	tristate "S2MU106 fuel gauge with 5mohm resistor"
	default n
	depends on (FUELGAUGE_S2MU106) && I2C
	help
	 Say Y to use 5mohm current sensing resistor
	 instead of 10mohm for S.LSI S2MU106 fuel gauge.
```

## drivers/battery/fuelgauge/s2mu107_fuelgauge/Kconfig
```kconfig
config FUELGAUGE_S2MU107
	tristate "S2MU107 fuel gauge driver"
	default n
	depends on I2C
	help
	 Say Y to include support
	 for S.LSI S2MU107 fuel gauge driver.
	 Ths fuel-gauge supports current tracking and
	 voltage tracking to model the battery SOC.

config FUELGAUGE_S2MU107_TEMP_COMPEN
	tristate "S2MU107 fuel gauge temperature compensation"
	default n
	depends on (FUELGAUGE_S2MU107) && I2C
	help
	 Say Y to enable temperature compensation
	 for S.LSI S2MU107 fuel gauge driver.

config FUELGAUGE_S2MU107_BATCAP_LRN
	tristate "S2MU107 fuel gauge battery capacity learning"
	default n
	depends on (FUELGAUGE_S2MU107) && I2C
	help
	 Say Y to enable battery capacity learning
	 for S.LSI S2MU107 fuel gauge driver.

config FUELGAUGE_S2MU107_USE_10MILLIOHM
	tristate "S2MU107 fuel gauge with 10mohm resistor"
	default n
	depends on (FUELGAUGE_S2MU107) && I2C
	help
	 Say Y to use 10mohm current sensing resistor
	 instead of 5mohm for S.LSI S2MU107 fuel gauge.
```

## drivers/battery/fuelgauge/sm5714_fuelgauge/Kconfig
```kconfig
config FUELGAUGE_SM5714
	tristate "Siliconmitus SM5714 Fuel Gauge"
	default n
	depends on I2C
	help
	  SM5714 is fuel-gauge systems for lithium-ion (Li+) batteries
	  in handheld and portable equipment. The SM5714 is configured
	  to operate with a single lithium cell
```

## drivers/battery_qc/Kconfig
```kconfig
config BATTERY_SAMSUNG
	tristate "samsung battery driver"
	help
	 Say Y to include support for samsung battery driver
	 This battery driver integrated all battery-related functions
	 To see battery-related functions,
	 refer to sec_charging_common.h

config BATTERY_SAMSUNG_USING_QC
	tristate "samsung battery driver for model that uses qc charger"
	default n
	depends on BATTERY_SAMSUNG
	help
	 Say Y to include support for samsung battery driver
	 This battery driver integrated all battery-related functions
	 To see battery-related functions,
	 refer to sec_charging_common.h

 config BATTERY_CISD
	 bool "support for cisd"
	 help
	 Say Y to include support for cisd
	 cisd means cell internal short detection

config DIRECT_CHARGING
	bool "support for direct charging"
	help
	 Say Y to include support for direct charging

config CALC_TIME_TO_FULL
	tristate "calculate time to full"
	default n
	depends on BATTERY_SAMSUNG
	help
	 Say Y to use calc time to full function.
```

## drivers/bts/Kconfig
```kconfig
#
# BTS device driver Kernel Configuration
#

menuconfig EXYNOS_BTS
	bool "BTS device driver support"
	help
	  Enables BTS(Bus Traffic Shaper) device driver support
	  BTS device driver will set BTS and request DVFS for
	  controlling system bus traffic. Default setting of BTS
	  should be different to chipset because of hardware characteristics.

if EXYNOS_BTS

config EXYNOS9630_BTS
        bool "Bus traffic shaper support for exynos9630"
        default y
        depends on SOC_EXYNOS9630
        help
          Enable BTS (Bus traffic shaper) support for exynos9630

endif
```

## drivers/ccic/Kconfig
```kconfig
#
# Ccic strange devices
#

comment "Pdic samsung features"
config SEC_SVDM
	boolean "USB CCIC Notifier using QC PMIC"
	depends on USB_NOTIFY_LAYER
	default n
	help
	  Enable driver for samsung UVDM

config CCIC_ALTERNATE_MODE
	bool "support CCIC alternate mode"
	depends on USB_NOTIFY_LAYER
	default n
	help
	  If you say yes here you will get support for
	  alternate mode
```

## drivers/char/maxscend/Kconfig
```kconfig
#
# maxscend cmmb driver configuration
#
#

menuconfig MXDCMMB
	tristate "Maxscend cmmb driver"

help
	Maxdscend cmmb driver support spi/sdio mode transfer base on mxd0265.

if MXDCMMB
	config MXDCMMB_DEBUG
		boolean "Debug support for mxd cmmb drivers"
	help
		Say "yes" to enable debug messaging (like dev_dbg and pr_debug),
		in mxd cmmb drivers.
endif
```
