&hsi2c_26 {
	status = "okay";

	nu2111a_charger: nu2111a@6e {
		compatible = "nuvolta,nu2111a";
		reg = <0x6e>;

		nu2111a,vbat-reg = <4450000>;
		nu2111a,input-current-limit = <3000000>; /* 3.0A */
		nu2111a,charging-current = <6000000>; /* 6.0A */
		nu2111a,topoff-current = <400000>; /* 400mA */
		nu2111a,chg-mode = <1>; /* 2:1 direct charging mode */
		nu2111a,cv-polling = <2000>; /* 2000ms */
		nu2111a,step1-cv=<4200000>; /* 4200mV */
		nu2111a,wd-tmr=<0x04>; /* 5s */
		/* WDT enabled */
		//nu2111a,wd-dis;
	};
};
