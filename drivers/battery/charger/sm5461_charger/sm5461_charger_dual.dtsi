&hsi2c_9 {
	status = "okay";

	sm5461_charger: sm5461@63 {
		compatible = "siliconmitus,sm5461";
		reg = <0x63>;

		sm5461,freq = <2>; /* 500kHz */
		sm5461,r_ttl = <520000>;
		sm5461,topoff = <380>;
		sm5461,en_vbatreg = <1>;
		sm5461,single_mode = <0>;
	};
};

&${sub_direct_charger_i2c} {
	status = "okay";

	sm5461_charger_sub: sm5461@64 {
		compatible = "siliconmitus,sm5461-sub";
		reg = <0x64>;

		sm5461,freq = <2>; /* 500kHz */
		sm5461,r_ttl = <520000>;
		sm5461,topoff = <380>;
	};
};
