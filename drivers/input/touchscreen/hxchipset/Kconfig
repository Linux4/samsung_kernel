## drivers/input/touchscreen/hxchipset/Kconfig
```kconfig
#
# Himax Touchscreen driver configuration
#

config TOUCHSCREEN_HIMAX_COMMON
        tristate "HIMAX chipset i2c touchscreen"
		depends on TOUCHSCREEN_HIMAX_CHIPSET
		help
		This enables support for HIMAX CHIPSET over I2C based touchscreens.

choice
	prompt "HIMAX touch IC types"
	depends on TOUCHSCREEN_HIMAX_COMMON
	default TOUCHSCREEN_HIMAX_INCELL

config TOUCHSCREEN_HIMAX_ONCELL
        bool "HIMAX chipset on-cell function"
		depends on TOUCHSCREEN_HIMAX_COMMON
		help
		This enables support for HIMAX CHIPSET of on-cell function.

config TOUCHSCREEN_HIMAX_INCELL
        bool "HIMAX chipset in-cell function"
		depends on TOUCHSCREEN_HIMAX_COMMON
		help
		This enables support for HIMAX CHIPSET of in-cell function.

endchoice

# ***************** In-cell Start *****************
config TOUCHSCREEN_HIMAX_IC_HX83112
        tristate "HIMAX chipset HX83112 function"
		depends on TOUCHSCREEN_HIMAX_INCELL
		help
		This enables support for HIMAX CHIPSET of HX83112.
# ***************** In-cell End *******************

config TOUCHSCREEN_HIMAX_DEBUG
        bool "HIMAX debug function"
		depends on TOUCHSCREEN_HIMAX_INCELL || TOUCHSCREEN_HIMAX_ONCELL
		help
		This enables support for HIMAX debug function.
config TOUCHSCREEN_HIMAX_INSPECT
        bool "HIMAX inspect function"
		depends on TOUCHSCREEN_HIMAX_INCELL || TOUCHSCREEN_HIMAX_ONCELL
		help
		This enables support for HIMAX debug function.

config TOUCHSCREEN_HIMAX_EMBEDDED_FIRMWARE
	bool "HIMAX embedded firmware function"
		depends on TOUCHSCREEN_HIMAX_INCELL || TOUCHSCREEN_HIMAX_ONCELL
		help
		This enables built-in FW inside kernel as binary array

config HMX_DB
	bool "HIMAX driver test over Dragon Board"
	depends on TOUCHSCREEN_HIMAX_COMMON
	help
	  This enables support for HIMAX driver test over Dragon Board.
```

## drivers/input/touchscreen/ili9881h/Kconfig
```kconfig
#
# ilitek Touchscreen driver configuration
#

config TOUCHSCREEN_ILI9881H
    depends on SPI
    help
      Say Y here if you have ilitek touch panel.
      If unsure, say N.
      

    
```

## drivers/input/touchscreen/ili9881x/Kconfig
```kconfig
#
# Ilitek ili9881x touchscreen driver configuration
#
config TOUCHSCREEN_ILITEK_ILI9881X
	bool "Ilitek ili9881x touchscreen"
	default n
	help
	  Say Y here if you have a Synaptics TCM touchscreen connected
	  to your system.

config TOUCHSCREEN_ILITEK_ILI9881X_SPI
	bool "SPI"
	depends on SPI_MASTER
```

## drivers/input/touchscreen/ili9882n/Kconfig
```kconfig
#
# ilitek Touchscreen driver configuration
#

config TOUCHSCREEN_ILI9882N
    depends on SPI
    help
      Say Y here if you have ilitek touch panel.
      If unsure, say N.
      

    
```

## drivers/input/touchscreen/ilitek/ili9881x/Kconfig
```kconfig
#
# Ilitek ili9881x touchscreen driver configuration
#

config TOUCHSCREEN_ILITEK_ILI9881X_SPI
	tristate "Ilitek ili9881x SPI driver"
	default y
	help
	  Say Y here if you have a Ilitek ili9881x no flash touchscreen connected
	  to your system by SPI bus.

	  If unsure, say N.
```

## drivers/input/touchscreen/imagis_30xxh/Kconfig
```kconfig
#
# Imagis IST30XXC Touchscreen driver
#

config TOUCHSCREEN_IST30XXC
  tristate "IST30XXC I2C Touchscreen"
	depends on I2C
	help
	  Say Y here if you have the Imagis IST30XXC I2C touchscreen
	  connected to your system.

config TOUCHSCREEN_IST3038H
  tristate "IST3038H I2C Touchscreen"
	depends on I2C
	help
	  Say Y here if you have the Imagis IST3038H I2C touchscreen
	  connected to your system.
```

## drivers/input/touchscreen/imagis_ist30xxb/Kconfig
```kconfig
# Imagis Touchscreen driver configuration
#

config TOUCHSCREEN_IST30XXB
	tristate "IMAGIS touchscreen driver"
	depends on I2C
```

## drivers/input/touchscreen/imagis_o1/Kconfig
```kconfig
#
# Goodix IST30XX Touchscreen driver
#

config TOUCHSCREEN_IST30XX_O1
  tristate "IST30XX I2C Touchscreen"
	depends on I2C
	help
	  Say Y here if you have the Imagis IST30XX I2C touchscreen
	  connected to your system.
```

## drivers/input/touchscreen/lxsemicon/lx891rs/Kconfig
```kconfig
#
# LXS LX891RS touchscreen driver configuration
#
config TOUCHSCREEN_LXS_LX891RS
	tristate "LXS LX891RS ROM-less SPI driver"
	depends on SPI
	help
	  Say Y here if you have a LXS LX891RS ROM-less touchscreen connected
	  to your system by SPI bus.

	  If unsure, say N.
```

## drivers/input/touchscreen/mediatek/Kconfig
```kconfig
config TOUCHSCREEN_MTK
	bool "MediaTek Touch Panel Driver"
	help
	  Say Y here if you have MediaTek touch panel.

	  If unsure, say N.

	  To compile this dirver as a module, choose M here: the
	  module will be called.

config TOUCHSCREEN_HIMAX_CHIPSET
        bool "Himax touchpanel CHIPSET"
        depends on I2C
        help
          Say Y here if you have a Himax CHIPSET touchscreen.
          HIMAX controllers are multi touch controllers which can
          report 10 touches at a time.

          If unsure, say N.
source "drivers/input/touchscreen/mediatek/hxchipset/Kconfig"
source "drivers/input/touchscreen/mediatek/focaltech_touch_ax3565/Kconfig"
source "drivers/input/touchscreen/mediatek/novatek_touch/Kconfig"
source "drivers/input/touchscreen/mediatek/ilitek_touch/Kconfig"
```

## drivers/input/touchscreen/mediatek/M04/chipone/Kconfig
```kconfig
config TOUCHSCREEN_CHIPONE_CHIPSET_M04
        tristate "Chipone TDDI touchscreen for Mediatek package"
        depends on SPI
        default n
        help
          Say y here if you have chipone TDDI touch panel.

          If unsure, say N.

          To compile this driver as a module, choose M here: the
          module will be called chipone-tddi.
```

## drivers/input/touchscreen/mediatek/O22/jdchipset/Kconfig
```kconfig
#
# Jadard Touchscreen driver configuration
#

config TOUCHSCREEN_JADARD_MODULE
    tristate "Jadard chipset module fuction"
    depends on TOUCHSCREEN_JADARD_CHIPSET_O22
    help
      This switch whether to compile into a kernel module.

config TOUCHSCREEN_JADARD_IC_JD9522T
    tristate "Jadard chipset of JD9522T"
    depends on TOUCHSCREEN_JADARD_MODULE
    help
      This enables support for Jadard chipset of JD9522T.

config JD_FB
    tristate "Jadard driver suspend/resume event by system FB"
    depends on TOUCHSCREEN_JADARD_COMMON
    help
      This enables support for Jadard driver suspend/resume event by system FB.

config TOUCHSCREEN_JADARD_COMMON
    tristate "Jadard chipset common fuction"
    depends on TOUCHSCREEN_JADARD_CHIPSET_O22
    help
      This enables support for Jadard chipset common function.

config TOUCHSCREEN_JADARD_DEBUG
    tristate "Jadard chipset debug function"
    depends on TOUCHSCREEN_JADARD_COMMON
    help
      This enables support for Jadard chipset debug function.

config TOUCHSCREEN_JADARD_SORTING
    tristate "Jadard chipset sorting function"
    depends on TOUCHSCREEN_JADARD_COMMON
    help
      This enables support for Jadard chipset sorting function.

# hs14 code for SR-AL6528A-01-482 by hehaoran5 at 20220910 start
config TOUCHSCREEN_JADARD_SEC
    tristate "Jadard chipset sec function"
    depends on TOUCHSCREEN_JADARD_COMMON
    help
      This enables support for Jadard chipset sec function.
# hs14 code for SR-AL6528A-01-482 by hehaoran5 at 20220910 end
```

## drivers/input/touchscreen/mediatek/O22/omnivision_tcm/Kconfig
```kconfig
#
# Omnivision TCM touchscreen driver configuration
#
menuconfig TOUCHSCREEN_OMNIVISION_TCM_O22
    bool "Omnivision TCM touchscreen"
    default n
    help
      Say Y here if you have a Omnivision TCM touchscreen connected
      to your system.

      If unsure, say N.

if TOUCHSCREEN_OMNIVISION_TCM_O22

choice
    default TOUCHSCREEN_OMNIVISION_TCM_SPI
    prompt "Omnivision TCM bus module"
config TOUCHSCREEN_OMNIVISION_TCM_SPI
    bool "SPI"
    depends on SPI
config TOUCHSCREEN_OMNIVISION_TCM_I2C
    bool "I2C"
    depends on I2C
endchoice

config TOUCHSCREEN_OMNIVISION_TCM_CORE
    tristate "Omnivision TCM core module"
    depends on I2C || SPI
    help
      Say Y here to enable core functionality.

      If unsure, say N.

      To compile this driver as a module, choose M here: the
      module will be called omnivision_tcm_core.

config TOUCHSCREEN_OMNIVISION_TCM_TOUCH
    tristate "Omnivision TCM touch module"
    depends on TOUCHSCREEN_OMNIVISION_TCM_CORE
    help
      Say Y here to enable support for touch reporting.

      If unsure, say N.

      To compile this driver as a module, choose M here: the
      module will be called omnivision_tcm_touch.

config TOUCHSCREEN_OMNIVISION_TCM_DEVICE
    tristate "Omnivision TCM device module"
    depends on TOUCHSCREEN_OMNIVISION_TCM_CORE
    help
      Say Y here to enable support for TCM device functionality.

      If unsure, say N.

      To compile this driver as a module, choose M here: the
      module will be called omnivision_tcm_device.

config TOUCHSCREEN_OMNIVISION_TCM_TESTING
    tristate "Omnivision TCM testing module"
    depends on TOUCHSCREEN_OMNIVISION_TCM_CORE
    help
      Say Y here to enable support for testing functionality.

      If unsure, say N.

      To compile this driver as a module, choose M here: the
      module will be called omnivision_tcm_testing.

config TOUCHSCREEN_OMNIVISION_TCM_REFLASH
    tristate "Omnivision TCM reflash module"
    depends on TOUCHSCREEN_OMNIVISION_TCM_CORE
    help
      Say Y here to enable support for reflash functionality.

      If unsure, say N.

      To compile this driver as a module, choose M here: the
      module will be called omnivision_tcm_reflash.

config TOUCHSCREEN_OMNIVISION_TCM_RECOVERY
    tristate "Omnivision TCM recovery module"
    depends on TOUCHSCREEN_OMNIVISION_TCM_CORE
    help
      Say Y here to enable support for recovery functionality.

      If unsure, say N.

      To compile this driver as a module, choose M here: the
      module will be called omnivision_tcm_recovery.

config TOUCHSCREEN_OMNIVISION_TCM_ZEROFLASH
    tristate "Omnivision TCM zeroflash module"
    depends on TOUCHSCREEN_OMNIVISION_TCM_CORE
    help
      Say Y here to enable support for ZeroFlash functionality.

      If unsure, say N.

      To compile this driver as a module, choose M here: the
      module will be called omnivision_tcm_zeroflash.

config TOUCHSCREEN_OMNIVISION_TCM_DIAGNOSTICS
    tristate "Omnivision TCM diagnostics module"
    depends on TOUCHSCREEN_OMNIVISION_TCM_CORE
    help
      Say Y here to enable support for diagnostics functionality.

      If unsure, say N.

      To compile this driver as a module, choose M here: the
      module will be called omnivision_tcm_diagnostics.
# hs14 code for AL6528A-13 by hehaoran5 at 20220901 start
config TOUCHSCREEN_OMNIVISION_TCM_SEC
    tristate "Omnivision TCM sec module"
    depends on TOUCHSCREEN_OMNIVISION_TCM_CORE
    help
      Say Y here to enable support for sec functionality.

      If unsure, say N.

      To compile this driver as a module, choose M here: the
      module will be called omnivision_tcm_sec.
# hs14 code for AL6528A-13 by hehaoran5 at 20220901 end
endif
```

## drivers/input/touchscreen/mediatek/O8/focaltech_touch_ft8057p/Kconfig
```kconfig
#
# Focaltech Touchscreen driver configuration
#

config TOUCHSCREEN_FT8057P_O8
    tristate "Focaltech Touchscreen"
    default m
    help
      Say Y here if you have Focaltech touch panel.
      If unsure, say N.
```

## drivers/input/touchscreen/mediatek/O8/galaxycore/Kconfig
```kconfig
config TOUCHSCREEN_GALAXYCORE_IC_GC7272
    tristate "For GALAXYCORE TOUCH"
    default n
    help
        Say Y here if you have GCORE touch panel

        If unsure, say N.
```

## drivers/input/touchscreen/mediatek/O8/hxchipset_hx83108b/Kconfig
```kconfig
#
# Himax Touchscreen driver configuration
#

config TOUCHSCREEN_HX83108B_CHIPSET_O8
    bool "Himax touchpanel CHIPSET"
    depends on SPI
    help
        Say Y here if you have a Himax CHIPSET touchscreen.
        HIMAX controllers are multi touch controllers which can
        report 10 touches at a time.
        If unsure, say N.

config TOUCHSCREEN_HIMAX_COMMON
        tristate "HIMAX chipset i2c touchscreen"
        depends on TOUCHSCREEN_HX83108B_CHIPSET_O8
        help
        This enables support for HIMAX CHIPSET touchscreens.

+config TOUCHSCREEN_HIMAX_IC_HX83108A
        tristate "HIMAX chipset HX83108A function"
        depends on TOUCHSCREEN_HX83108B_CHIPSET_O8
        help
        This enables support for HIMAX CHIPSET of HX83108A.

+config TOUCHSCREEN_HIMAX_IC_HX83102J
        tristate "HIMAX chipset HX83102J function"
        depends on TOUCHSCREEN_HX83108B_CHIPSET_O8
        help
        This enables support for HIMAX CHIPSET of HX83102J.

+config TOUCHSCREEN_HIMAX_IC_HX83112F
        tristate "HIMAX chipset HX83112f function"
        depends on TOUCHSCREEN_HX83108B_CHIPSET_O8
        help
        This enables support for HIMAX CHIPSET of HX83112F.

+config TOUCHSCREEN_HIMAX_IC_HX83121A
        tristate "HIMAX chipset HX83121A function"
        depends on TOUCHSCREEN_HX83108B_CHIPSET_O8
        help
        This enables support for HIMAX CHIPSET of HX83121A.

+config TOUCHSCREEN_HIMAX_IC_HX83122A
        tristate "HIMAX chipset HX83122A function"
        depends on TOUCHSCREEN_HX83108B_CHIPSET_O8
        help
        This enables support for HIMAX CHIPSET of HX83122A.

+config TOUCHSCREEN_HIMAX_IC_HX85200A
        tristate "HIMAX chipset HX85200A function"
        depends on TOUCHSCREEN_HX83108B_CHIPSET_O8
        help
        This enables support for HIMAX CHIPSET of HX85200A.

+config TOUCHSCREEN_HIMAX_IC_HX83132A
        tristate "HIMAX chipset HX83132A function"
        depends on TOUCHSCREEN_HX83108B_CHIPSET_O8
        help
        This enables support for HIMAX CHIPSET of HX83132A.

+config TOUCHSCREEN_HIMAX_DEBUG
        bool "HIMAX debug function"
        depends on TOUCHSCREEN_HX83108B_CHIPSET_O8
        help
        This enables support for HIMAX debug function.
+config TOUCHSCREEN_HIMAX_INSPECT
        bool "HIMAX inspect function"
        depends on TOUCHSCREEN_HX83108B_CHIPSET_O8
        help
        This enables support for HIMAX inspect function.

+config TOUCHSCREEN_HIMAX_EMBEDDED_FIRMWARE
    bool "HIMAX embedded firmware function"
        depends on TOUCHSCREEN_HX83108B_CHIPSET_O8
        help
        This enables built-in FW inside kernel as binary array

+config HMX_DB
    bool "HIMAX driver test over Dragon Board"
    depends on TOUCHSCREEN_HX83108B_CHIPSET_O8
    help
      This enables support for HIMAX driver test over Dragon Board.

+config HIMAX_SUPPORT_KERNEL_419
        bool "HIMAX support kernel 4.19"
        depends on TOUCHSCREEN_HX83108B_CHIPSET_O8
        help
        This enables support for support kernel 4.19.
```

## drivers/input/touchscreen/mediatek/O8/touch_common/Kconfig
```kconfig
config ODM_SEC_COMMON
    bool "add touch common sec"
    help
        this will add touch common sec.

        If unsure, say N.
```

## drivers/input/touchscreen/mediatek/chipone/Kconfig
```kconfig
config TOUCHSCREEN_CHIPONE
	tristate "Chipone TDDI touchscreen for Mediatek package"
	depends on I2C
	default n
	help
	  Say y here if you have chipone TDDI touch panel.

	  If unsure, say N.

	  To compile this driver as a module, choose M here: the
	  module will be called chipone-tddi.
```

## drivers/input/touchscreen/mediatek/ilitek_tddi_touch/Kconfig
```kconfig
#
# ILITEK Touchscreen driver configuration
#

config TOUCHSCREEN_MTK_ILITEK_TS
    bool "ILITEK Touchscreen"
    depends on SPI
    default n
    help
      Say Y here if you have ILITEK touch panel.
      If unsure, say N.
      
```

## drivers/input/touchscreen/mediatek/ilitek_touch/Kconfig
```kconfig
#
# ILI7806S touchscreen driver configuration
#
config TOUCHSCREEN_ILI7806S_TOUCH
	bool "ILI9881 for Mediatek package"
	default n
	help
	  Say Y here if you have a Novatek NT36xxx no flash touchscreen connected
	  to your system by SPI bus.

	  If unsure, say N.
```
