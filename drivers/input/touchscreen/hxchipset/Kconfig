## drivers/input/touchscreen/mediatek/jdchipset/Kconfig
```kconfig
#
# Jadard Touchscreen driver configuration
#

config TOUCHSCREEN_JADARD_MODULE
	tristate "Jadard chipset module fuction"
	depends on TOUCHSCREEN_JADARD_CHIPSET
	help
	  This enables support for Jadard chipset module function.

config TOUCHSCREEN_JADARD_IC_JD9365T
	tristate "Jadard chipset of JD9365T"
	depends on TOUCHSCREEN_JADARD_MODULE
	help
	  This enables support for Jadard chipset of JD9365T.

config TOUCHSCREEN_JADARD_COMMON
	tristate "Jadard chipset common fuction"
	depends on TOUCHSCREEN_JADARD_CHIPSET
	help
	  This enables support for Jadard chipset common function.

config TOUCHSCREEN_JADARD_DEBUG
	tristate "Jadard chipset debug function"
	depends on TOUCHSCREEN_JADARD_COMMON
	help
	  This enables support for Jadard chipset debug function.

config TOUCHSCREEN_JADARD_SORTING
	tristate "Jadard chipset sorting function"
	depends on TOUCHSCREEN_JADARD_COMMON
	help
	  This enables support for Jadard chipset sorting function.

config JD_DB
	tristate "Jadard driver test over Dragon Board"
	depends on TOUCHSCREEN_JADARD_COMMON
	help
	  This enables support for Jadard driver test over Dragon Board.

# HS03SD code added for SR-AL5625-01-305 by yuanliding at 20210521 start
config TOUCHSCREEN_JADARD_SEC
	tristate "Jadard chipset sec node"
	depends on TOUCHSCREEN_JADARD_COMMON
	help
	  This build sec node.
# HS03SD code added for SR-AL5625-01-305 by yuanliding at 20210521 end
```

## drivers/input/touchscreen/melfas_mip4/Kconfig
```kconfig
#
# Kconfig for MELFAS MIP4 Touchscreen Driver
#

if INPUT_TOUCHSCREEN

config TOUCHSCREEN_MELFAS_MIP4
	tristate "MELFAS MIP4 Touchscreen"
	depends on I2C
	help
	  Say Y here if you have a MELFAS MIP4 touchscreen device in your system.

	  If unsure, say N.

	  To compile this driver as a module, choose M here: the module will be called melfas_mip4_ts.

config TOUCHSCREEN_MELFAS_MMS427
	tristate "MELFAS MMS427 Touchscreen"
	depends on I2C
	help
	  Say Y here if you have a MELFAS MMS427 touchscreen device in your system.

	  If unsure, say N.

	  To compile this driver as a module, choose M here: the module will be called melfas_mip4_ts.

config TOUCHSCREEN_MELFAS_MMS438
	tristate "MELFAS MMS438 Touchscreen"
	depends on I2C
	help
	  Say Y here if you have a MELFAS MMS438 touchscreen device in your system.

	  If unsure, say N.

	  To compile this driver as a module, choose M here: the module will be called melfas_mip4_ts.

config TOUCHSCREEN_MELFAS_MMS438S
	tristate "MELFAS MMS438S Touchscreen"
	depends on I2C
	help
	  Say Y here if you have a MELFAS MMS438S touchscreen device in your system.

	  If unsure, say N.

	  To compile this driver as a module, choose M here: the module will be called melfas_mip4_ts.

config TOUCHSCREEN_MELFAS_MMS449
	tristate "MELFAS MMS449 Touchscreen"
	depends on I2C
	help
	  Say Y here if you have a MELFAS MMS449 touchscreen device in your system.

	  If unsure, say N.

	  To compile this driver as a module, choose M here: the module will be called melfas_mip4_ts.

config TOUCHSCREEN_MELFAS_MMS449S
	tristate "MELFAS MMS449S Touchscreen"
	depends on I2C
	help
	  Say Y here if you have a MELFAS MMS449S touchscreen device in your system.

	  If unsure, say N.

	  To compile this driver as a module, choose M here: the module will be called melfas_mip4_ts.

config TOUCHSCREEN_MELFAS_MMS458
	tristate "MELFAS MMS458 Touchscreen"
	depends on I2C
	help
	  Say Y here if you have a MELFAS MMS458 touchscreen device in your system.

	  If unsure, say N.

	  To compile this driver as a module, choose M here: the module will be called melfas_mip4_ts.

config TOUCHSCREEN_MELFAS_MMS500
	tristate "MELFAS MMS500 Touchscreen"
	depends on I2C
	help
	  Say Y here if you have a MELFAS MMS500 touchscreen device in your system.

	  If unsure, say N.

	  To compile this driver as a module, choose M here: the module will be called melfas_mip4_ts.

config TOUCHSCREEN_MELFAS_MMS600
	tristate "MELFAS MMS600 Touchscreen"
	depends on I2C
	help
	  Say Y here if you have a MELFAS MMS600 touchscreen device in your system.

	  If unsure, say N.

	  To compile this driver as a module, choose M here: the module will be called melfas_mip4_ts.

config TOUCHSCREEN_MELFAS_MCS8040L
	tristate "MELFAS MCS8040L Touchscreen"
	depends on I2C
	help
	  Say Y here if you have a MELFAS MCS8040L touchscreen device in your system.

	  If unsure, say N.

	  To compile this driver as a module, choose M here: the module will be called melfas_mip4_ts.

config TOUCHSCREEN_MELFAS_MFS10
	tristate "MELFAS MFS10 Touchscreen"
	depends on I2C
	help
	  Say Y here if you have a MELFAS MFS10 touchscreen device in your system.

	  If unsure, say N.

	  To compile this driver as a module, choose M here: the module will be called melfas_mip4_ts.

config TOUCHSCREEN_MELFAS_MOS50
	tristate "MELFAS MOS50 Touchscreen"
	depends on I2C
	help
	  Say Y here if you have a MELFAS MOS50 touchscreen device in your system.

	  If unsure, say N.

	  To compile this driver as a module, choose M here: the module will be called melfas_mip4_ts.

config TOUCHSCREEN_MELFAS_MAT100
	tristate "MELFAS MAT100 Touchscreen"
	depends on I2C
	help
	  Say Y here if you have a MELFAS MAT100 touchscreen device in your system.

	  If unsure, say N.

	  To compile this driver as a module, choose M here: the module will be called melfas_mip4_ts.

config TOUCHSCREEN_MELFAS_MSS100
	tristate "MELFAS MSS100 Touchscreen"
	depends on I2C
	help
	  Say Y here if you have a MELFAS MSS100 touchscreen device in your system.

	  If unsure, say N.

	  To compile this driver as a module, choose M here: the module will be called melfas_mip4_ts.

config TOUCHSCREEN_MELFAS_MIT400
	tristate "MELFAS MIT400 Touchscreen"
	depends on I2C
	help
	  Say Y here if you have a MELFAS MIT400 touchscreen device in your system.

	  If unsure, say N.

	  To compile this driver as a module, choose M here: the module will be called melfas_mip4_ts.

config TOUCHSCREEN_MELFAS_MIT401
	tristate "MELFAS MIT401 Touchscreen"
	depends on I2C
	help
	  Say Y here if you have a MELFAS MIT401 touchscreen device in your system.

	  If unsure, say N.

	  To compile this driver as a module, choose M here: the module will be called melfas_mip4_ts.

config TOUCHSCREEN_MELFAS_MIT410
	tristate "MELFAS MIT410 Touchscreen"
	depends on I2C
	help
	  Say Y here if you have a MELFAS MIT410 touchscreen device in your system.

	  If unsure, say N.

	  To compile this driver as a module, choose M here: the module will be called melfas_mip4_ts.

endif
```

## drivers/input/touchscreen/new_tddi_9881x/Kconfig
```kconfig
#
# Synaptics TCM touchscreen driver configuration
#
menuconfig TOUCHSCREEN_ILI9882N
	bool "ILITECK touchscreen"
	default n
	help
	  Say Y here if you have a Ilitek touchscreen connected
	  to your system.

	  If unsure, say N.
```

## drivers/input/touchscreen/novatek/nt36672/Kconfig
```kconfig
#
# Novatek NT36xxx touchscreen driver configuration
#
config TOUCHSCREEN_NOVATEK_NT36672
	bool "Novatek NT36672"
	depends on I2C
	help
	  Say Y here if you have a Novatek NT36672 touchscreen connected
	  to your system.

	  If unsure, say N.
```

## drivers/input/touchscreen/ovt/td4150_spi/Kconfig
```kconfig
#
# Omnivision TCM touchscreen driver configuration
#

config TOUCHSCREEN_OVT_TD4150_SPI
	tristate "Omnivision chipset tcm spi touchscreen"
	help
		This enables support for td4150_spi based touchscreens.

config TOUCHSCREEN_OVT_TCM_CORE
	tristate "Omnivision TCM core module"
	depends on TOUCHSCREEN_OVT_TD4150_SPI
	default y
	help
	  Say Y here to enable core functionality.
	  If unsure, say N.
	  To compile this driver as a module, choose M here: the
	  module will be called Omnivision_tcm_core.

config TOUCHSCREEN_OVT_TCM_DEVICE
	tristate "Omnivision TCM device module"
	depends on TOUCHSCREEN_OVT_TD4150_SPI
	default y
	help
	  Say Y here to enable support for TCM device functionality.
	  If unsure, say N.
	  To compile this driver as a module, choose M here: the
	  module will be called Omnivision_tcm_device.

config TOUCHSCREEN_OVT_TCM_ZEROFLASH
	tristate "Omnivision TCM zeroflash module"
	depends on TOUCHSCREEN_OVT_TD4150_SPI
	default y
	help
	  Say Y here to enable support for ZeroFlash functionality.
	  If unsure, say N.
	  To compile this driver as a module, choose M here: the
	  module will be called Omnivision_tcm_zeroflash.


config TOUCHSCREEN_OVT_TCM_TESTING
	tristate "Omnivision TCM testing module"
	depends on TOUCHSCREEN_OVT_TD4150_SPI
	help
	  Say Y here to enable support for testing functionality.
	  If unsure, say N.
	  To compile this driver as a module, choose M here: the
	  module will be called Omnivision_tcm_testing.

config TOUCHSCREEN_OVT_TCM_REFLASH
	tristate "Omnivision TCM reflash module"
	depends on TOUCHSCREEN_OVT_TD4150_SPI
	help
	  Say Y here to enable support for reflash functionality.
	  If unsure, say N.
	  To compile this driver as a module, choose M here: the
	  module will be called Omnivision_tcm_reflash.

config TOUCHSCREEN_OVT_TCM_RECOVERY
	tristate "Omnivision TCM recovery module"
	depends on TOUCHSCREEN_OVT_TD4150_SPI
	help
	  Say Y here to enable support for recovery functionality.
	  If unsure, say N.
	  To compile this driver as a module, choose M here: the
	  module will be called Omnivision_tcm_recovery.


config TOUCHSCREEN_OVT_TCM_DIAGNOSTICS
	tristate "Omnivision TCM diagnostics module"
	depends on TOUCHSCREEN_OVT_TD4150_SPI
	help
	  Say Y here to enable support for diagnostics functionality.
	  If unsure, say N.
	  To compile this driver as a module, choose M here: the
	  module will be called Omnivision_tcm_diagnostics.
```
