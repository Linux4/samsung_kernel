## drivers/input/touchscreen/sec_ts/Kconfig
```kconfig
#
# Samsung Electronics TOUCH driver configuration
#

if INPUT_TOUCHSCREEN

config TOUCHSCREEN_SEC_TS
        tristate "Samsung Electronics Touchscreen"
        depends on I2C

config TOUCHSCREEN_SEC_TS_GLOVEMODE
        tristate "Samsung Electronics Touchscreen"
        depends on I2C

endif
```

## drivers/input/touchscreen/sec_ts_dual/Kconfig
```kconfig
#
# Samsung Electronics TOUCH driver configuration
#

config TOUCHSCREEN_SEC_TS_DUAL
        tristate "Samsung Electronics Touchscreen"
        depends on I2C
        help
          Say Y here if you want support for SEC touchscreen controllers.
          If unsure, say N.

          To compile this driver as a module, choose M here: the
          module will be called sec_ts.

config TOUCHSCREEN_SEC_TS_GLOVEMODE
        tristate "Samsung Electronics Touchscreen"
        depends on I2C
        help
          Say Y here if you have a Samsung Electronics Touchscreen and want to enable
          support for the built-in touchscreen.

          If unsure, say N.

config TOUCHSCREEN_DUMP_MODE
	bool "tsp dump mode"
	depends on I2C

config TRUSTONIC_TRUSTED_UI
		bool "tbase tui"
		default n
		help
          Say Y here if you have a TBASE TUI and want to enable
```

## drivers/input/touchscreen/sec_ts_y661/Kconfig
```kconfig
#
# s6sy661 Electronics TOUCH driver configuration
#

if INPUT_TOUCHSCREEN

config TOUCHSCREEN_SEC_TS_Y661
        bool "s6sy661 Electronics Touchscreen"
        depends on I2C
		default n
        help
          Say Y here if you want support for SEC touchscreen controllers.

config TOUCHSCREEN_SEC_TS_GLOVEMODE
        bool "s6sy661 Electronics Touchscreen"
        depends on I2C
		default n
        help
          Say Y here if you have a s6sy661 Electronics Touchscreen and want to enable
          support for the built-in touchscreen.

endif
```

## drivers/input/touchscreen/stm/Kconfig
```kconfig
#
# STMicroelectronics TOUCHSCREEN driver configuration
#
config TOUCHSCREEN_STM
	tristate "STMicroelectronics i2c multitouch touchscreen with FingerTipS"
	depends on I2C
	help
	  Say Y here to enable STMicroelectronics touchscreen support.
	  If unsure, say N.
	  To compile this driver as a module, choose M here: the
	  module will be called STM_ts.

config TOUCHSCREEN_DUMP_MODE
	bool "tsp dump mode"
	depends on I2C
```

## drivers/input/touchscreen/stm/fts9cu80f_spi/Kconfig
```kconfig
#
# STMicroelectronics TOUCH driver configuration
#

config TOUCHSCREEN_FTS9CU80F_SPI
	tristate "STMicroelectronics spi multitouch touchscreen with FingerTipS"
	depends on SPI
	help
		Say Y here to enable STMicroelectronics touchscreen support.
		If unsure, say N.
		To compile this driver as a module, choose M here: the
		module will be called STM_ts.
```

## drivers/input/touchscreen/synaptics_ts/td4300/Kconfig
```kconfig
#
# SYNAPTICS TOUCH driver configuration
#

config TOUCHSCREEN_SYNAPTICS_TS_TD4300
	tristate "Synaptics TD4300 i2c touchscreen base on bootloader Ver7"
	depends on I2C
	help
	  This enables support for Synaptics TD4300 over I2C based touchscreens.
```

## drivers/input/touchscreen/zinitix/Kconfig
```kconfig
#
# Zinitix Touchscreen driver configuration
#

config TOUCHSCREEN_ZINITIX_BT532
	bool "ZINITIX BT532 touchscreen driver"
	depends on I2C
	default n
	help
	  Say Y here if you have a ZINITIX BT532 touchscreen.
	  If unsure, say N.

  config TOUCHSCREEN_ZINITIX_ZT75XX
	bool "ZINITIX ZT75XX touchscreen driver"
	depends on I2C
	default n
	help
	  Say Y here if you have a ZINITIX ZT75XX touchscreen.
	  If unsure, say N.
```

## drivers/input/touchscreen/zinitix/zt75xx/Kconfig
```kconfig
#
# Zinitix Touchscreen driver configuration
#

config TOUCHSCREEN_ZINITIX_ZT75XX_TCLM
	bool "ZINITIX ZTW522 touchscreen driver"
	depends on I2C
	default n
	help
	  Say Y here if you have a ZINITIX ZT75XX touchscreen.
	  If unsure, say N.
```

## drivers/input/touchscreen/zinitix/ztw522/Kconfig
```kconfig
#
# Zinitix Touchscreen driver configuration
#

config TOUCHSCREEN_ZINITIX_ZTW522
	tristate "ZINITIX ZTW522 touchscreen driver"
	depends on I2C
	default n
	help
	  Say Y here if you have a ZINITIX ZTW522 touchscreen.
	  If unsure, say N.
```

## drivers/irda/Kconfig
```kconfig
#
# IR_LED
#
menu "IRDA devices"

config IR_REMOCON_MC96
	bool "Micom(ABOV)-based IR LED driver"
	depends on I2C
	default n
	help
	  Say Y here to enable the I2C based IRDA of LT01 Model

endmenu
```

## drivers/irled/Kconfig
```kconfig
#
# IRLED
#

comment "IRLED configs"

config IRLED
	bool "Using IRLED driver"
	default n
	help
	  If you say yes here you will get support for
	  the IRLED driver.

config IRLED_ICE5LP
	tristate "ICE5LP FPGA chip for IRDA control"
	depends on IRLED
	default n
	help
	  Lattice FPGA can support IRDA controller.
	  The configuration will enable IRDA feature.
	  To compile this driver as a module, choose M here.
	  If unsure, say N.

config IRLED_PEEL
	bool "Using PEEL IRLED driver"
	depends on IRLED
	default n
	help
	  If you say yes here you will get support for
	  the PEEL IRLED driver (no chip IR).

config IRLED_WATCHON
	bool "Using WatchON IRLED driver"
	depends on IRLED
	default n
	help
	  If you say yes here you will get support for
	  the WatchOn IRLED driver (no chip IR).
```

## drivers/irqchip/exynos/Kconfig
```kconfig
# SPDX-License-Identifier: GPL-2.0-only

config ARM_GIC_V3_VENDORHOOK
	tristate "Vendor hook for ARM GIC V3"
	depends on ARM_GIC_V3 && EXYNOS_GIC
	help
	  Support GIC V3 Vendor hook for multitarget irq action
	  Exynos SOC with GIC-600 device can support multi-target irqaction
	  with VendorHook implementation.

config ARM_GIC_VENDORHOOK
	tristate "Vendor hook for ARM GIC"
	depends on ARM_GIC
	help
	  Support GIC 400 vendor hook for multitarget irq action
	  This is not agreed by Kernel gic mainltainer.
	  He recommend to assign only one CPU, not to multi CPU.
	  If not unsure, say N
```

## drivers/kperfmon/Kconfig
```kconfig
# drivers/kperfmon/Kconfig
#
# Copyright (c) 2010-2011 Samsung Electronics Co., Ltd.
#		http://www.samsung.com/
#
# Licensed under GPLv2

config KPERFMON
	bool "Enable performance log"
	default y
	help
	  Samsung performance log(OLOG).
```

## drivers/kunit/Kconfig
```kconfig
#
# KUnit base configuration
#

menu "KUnit support"

config SEC_KUNIT
	bool "Enable support for unit tests (KUnit)"
	select HAS_IOMEM
	help
	  Enables support for kernel unit tests (KUnit), a lightweight unit
	  testing and mocking framework for the Linux kernel. These tests are
	  able to be run locally on a developer's workstation without a VM or
	  special hardware. For more information, please see Documentation/test/

if SEC_KUNIT

config SEC_KUNIT_TEST
	bool "KUnit test for KUnit"
	depends on SEC_KUNIT
	help
	  Enables KUnit test to test KUnit.

config SEC_KUNIT_DEATH_TEST
	bool "(Expert) KUnit death test for KUnit"
	depends on SEC_KUNIT
	help
	  Enables KUnit test to test KUnit death test feature. This test is not
	  hermetic and can cause other tests to misbehave.

config SEC_KUNIT_EXAMPLE_TEST
	bool "Example test for KUnit"
	depends on SEC_KUNIT
	help
	  Enables example KUnit test to demo features of KUnit.

config PLATFORM_MOCK
	bool "KUnit Platform Mocking"
	depends on SEC_KUNIT
	help
	  Enables example KUnit test to demo features of KUnit.

config SEC_KUNIT_MANAGER
	bool "Manager for KUnit"
	depends on SEC_KUNIT
	help
	  Enables KUnit Manager.

endif # SEC_KUNIT

endmenu
```

## drivers/ledmatrix/Kconfig
```kconfig
#
# ICE5_FPGA_LED_MATRIX
#
menu "LED MATRIX FPGA"

config ICE5_FPGA_LED_MATRIX
	tristate "ICE5 FPGA chip for LED MATRIX control"
	default n
	help
	  Lattice FPGA can support LED MATRIX controller.
	  The configuration will enable LED MATRIX feature.
	  To compile this driver as a module, choose M here.
	  If unsure, say N.
endmenu
```

## drivers/leds/samsung/Kconfig
```kconfig
# SPDX-License-Identifier: GPL-2.0-only

config FLED_SAMSUNG_IFPMIC
	tristate "common FLASH LED support"
	depends on I2C
	help
	  If you say yes here you will get support for
	  the common led chip.

config LEDS_S2MU106_FLASH
	tristate "FLASH LED support for the S2MU106"
	depends on (MFD_S2MU106) && I2C
	help
	  If you say yes here you will get support for
	  the LEDS_S2MU106_FLASH led chip.

config LEDS_S2MF301_FLASH
	tristate "FLASH LED support for the S2MF301"
	depends on (MFD_S2MF301) && I2C
	help
	  If you say yes here you will get support for
	  the LEDS_S2MF301_FLASH led chip.
```

## drivers/marvell/Kconfig
```kconfig
menuconfig MARVELL_DRIVERS
	bool "Marvell kernel module drivers"
	---help---
	  marvell kernel module drivers

if MARVELL_DRIVERS

config MRVL_WIRELESS
	bool "marvell wireless driver"
	---help---
	This enables the marvell wireless driver for application processor

choice
	depends on MRVL_WIRELESS
	bool "Choose the chip for marvell wireless"
	default MRVL_WL_SD8777

config MRVL_WL_SD8777
	bool "SD8777"
	---help---
	Marvell NIC driver: SD8777 chip

config MRVL_WL_SD8787
	bool "SD8787"
	---help---
	Marvell NIC driver: SD8787 chip

config MRVL_WL_SD8887
	bool "SD8887"
	---help---
	Marvell NIC driver: SD8887 chip

config MRVL_WL_SD8897
	bool "SD8897"
	---help---
	Temporarily maintain SD8897 specifically, this item will be
	removed when Marvell combo driver support SD8897

config MRVL_WL_SD8XXX
	bool "SD8787/SD8777/SD8801/SD8887"
	---help---
	Marvell combo driver support: SD8787/SD8777/SD8801/SD8887 chips

endchoice

config MRVL_WL_BUILD_TYPE
	depends on MRVL_WL_SD8777 || MRVL_WL_SD8787 || MRVL_WL_SD8887 || MRVL_WL_SD8897 || (MRVL_WL_SD8XXX && m)
	tristate "Build type of the driver for MARVELL wireless"
	default m
	---help---
	Choose <m> if you want to build the driver as module;
	<y> to build-in kernel; <n> if you do not want to build.

config MRVL_DEBUG
	tristate "Support Marvell debug features"
	default y
	---help---
	  This will enable Marvell debug features.

config MRVL_LOG
	tristate "Support Marvell non-cacheable buffer"
	default y
	---help---
	  This will enable Marvell non-cacheable buffer shared between kernel and bootloader.

config MRVL_TZDD
	tristate "Marvell Trust Zone Device Driver"
	default n
	help
	  Marvell Trust Execution Environment (TEE) Solution in non-trusted world

config MRVL_SW_JTAG
	tristate "Marvell software jtag driver"
	default n
	help
	  Marvell software jtag driver to simulate jtag access

config MRVL_PANIC_FLUSH
        bool "cache flush when panic"
        depends on KEXEC
        help
          Enable support for flush all cache during panic

config PXA_RAMDUMP
        bool "marvell ramdump driver"
        help
          marvell ramdump driver

config MRVL_SKMALLOC
	tristate "Marvell Supper Kmalloc Driver"
	default y
	---help---
	Create skmalloc-xxx like as kmalloc-xxx.
	Driver or module can use these skmalloc caches which will
	be different with kmalloc-xxx.
	Use this method will be helpful for kmalloc issue debugging.

config SKMALLOC_REBOOT_NOTIFY
	tristate "support changing skm_dbg_level by reboot cmd"
	depends on MRVL_SKMALLOC && KEXEC
	default y
	---help---
	If you want, you can change skm_dbg_level by reboot cmd,
	like "reboot skm_dbg_level=2". Set this value to 0 will disable skmalloc;
	set to 1, will create skmalloc-xxx with kernel default debug flags;
	set to 2, which force enable all the debug flags for the skmalloc-xxx.

config MRVL_SKMALLOC_WIRELESS_EN
	tristate "marvell wireless driver use skmalloc"
	depends on MRVL_SKMALLOC && MRVL_WIRELESS
	default y
	---help---
	Whether marvell wireless driver uses Supper Kmalloc or not.
	After enable this config, all the kmalloc used in marvell wireless
	driver will use skmalloc-xxx instead of kmalloc-xxx.

config MRVL_MMP_MODEM
	tristate "Marvell mmp modem driver"
	depends on PXA9XX_ACIPC
	default n
	help
	  Marvell MMP modem driver for communication processor

config SSIPC_SUPPORT
	bool "SSIPC feature"
	depends on MRVL_MMP_MODEM
	default n
	help
	  support SSIPC feature

config MRVL_MMP_CM3
	tristate "Marvell CM3 resource manager driver"
	depends on MRVL_MMP_MODEM && PXA9XX_AMIPC
	default n
	help
	  Marvell CM3 resource manager driver for PXA1U88

config MRVL_RSV_PAGE
	tristate "Marvell emmc reserve page"
	default y
	---help---
	Reserve some range both in eMMC and DDR memory.
	With the help of bootloader, Driver or module can use
	the data before eMMC is ready. It is something like DTB.

config TEE_RES_CFG_8M
	bool "Marvell TrustZone/TEE Resource Configuration (8M)"
	default n
	help
		Marvell TrustZone/TEE Resource Configuration (8M)
		
config TEE_RES_CFG_16M
	bool "Marvell TrustZone/TEE Resource Configuration (16M)"
	default n
	help
		Marvell TrustZone/TEE Resource Configuration (16M)

config TEE_RES_CFG_24M
	bool "Marvell TrustZone/TEE Resource Configuration (24M)"
	default n
	help
		Marvell TrustZone/TEE Resource Configuration (24M)

endif

config MRVL_GPU_GALCORE
        tristate "Marvell Graphics Kernel Mode Driver"
        default m
        help
          If you say Y here, graphics kernel mode driver named galcore
          will be built into uImage.
          To compile this driver as a module, choose M here: the driver
          will be compiled into a separate module galcore.ko.
          If you want to disable GPU hardware totally, just select N here.
```

## drivers/marvell/sd8787/Kconfig
```kconfig
menuconfig MRVL_SD87XX
	tristate "Marvell sd87XX Driver"
	default n

config MRVL_SD87XX_WIFI
	tristate "Marvell sd87XX_WIFI Driver"
	depends on MRVL_SD87XX
	default n
	---help---
	  Marvell sd87XX wifi driver.

config MRVL_SD87XX_BT
	tristate "Marvell sd87XX_BT Driver"
	depends on MRVL_SD87XX
	default n
	---help---
	  Marvell sd87XX bt driver.
```

## drivers/mcdt/Kconfig
```kconfig
menuconfig MCDT
	bool "MCDT Hardware Support"
	help
	  MCDT is a Hardware module that can be used to transfer data between AP
	  and DSP, normally we use it transfer audio data.
	  Say Y if your platform supports hardware MCDT.

if MCDT
config MCDT_DRV
	bool "MCDT driver"
	help
	  MCDT_DRV is the driver of MCDT.
	  Say Y if you want support this driver.
endif
```
