## drivers/media/i2c/b52_camera/Kconfig
```kconfig
comment "b52_camera sensor drivers"

config B52_CAMERA_OV13850
	tristate "OV13850 sensor support"
	depends on VIDEO_MMPISP_B52SENSOR && I2C
	help
	  This is a V4L2 camera driver for the ov13850 sensor.

config B52_CAMERA_OV13850_13M
	tristate "OV13850 13M size support"
	depends on VIDEO_MMPISP_B52SENSOR && I2C && B52_CAMERA_OV13850
	help
	  This is a V4L2 camera driver for the ov13850 13M setting.

config B52_CAMERA_OV13850R2A
	tristate "OV13850R2A sensor support"
	depends on VIDEO_MMPISP_B52SENSOR && I2C && B52_CAMERA_OV13850
	help
	  This is a V4L2 camera driver for the ov13850R2A 13M setting.

config B52_CAMERA_IMX219
	tristate "imx219 sensor support"
	depends on VIDEO_MMPISP_B52SENSOR && I2C
	help
	  This is a V4L2 camera driver for the imx219 sensor.

config B52_CAMERA_OV5648
       tristate "OV5648 camera support"
       depends on VIDEO_MMPISP_B52 && I2C
       help
        This is a V4L2 camera driver for the ov5648 sensor

config B52_CAMERA_OV2680
       tristate "OV2680 camera support"
       depends on VIDEO_MMPISP_B52 && I2C
       help
        This is a V4L2 camera driver for the ov2680 sensor

config B52_CAMERA_OV8858
       tristate "OV8858 camera support"
       depends on VIDEO_MMPISP_B52 && I2C
       help
	This is a V4L2 camera driver for the ov8858 sensor

config B52_CAMERA_SR544
       tristate "SR544 camera support"
       depends on VIDEO_MMPISP_B52 && I2C
       help
	This is a V4L2 camera driver for the sr544 sensor

config B52_CAMERA_HI551
       tristate "HI551 camera support"
       depends on VIDEO_MMPISP_B52 && I2C
       help
	This is a V4L2 camera driver for the hi551 sensor

config B52_CAMERA_S5K5E3
       tristate "S5K5E3 camera support"
       depends on VIDEO_MMPISP_B52 && I2C
       help
       This is a V4L2 camera driver for the s5k5e3 sensor

config B52_CAMERA_OV5670
       tristate "OV5670 camera support"
       depends on VIDEO_MMPISP_B52 && I2C
       help
       This is a V4L2 camera driver for the ov5670 sensor

config B52_CAMERA_S5K3L2
       tristate "S5K3L2 camera support"
       depends on VIDEO_MMPISP_B52 && I2C
       help
       This is a V4L2 camera driver for the s5k3l2 sensor

config B52_CAMERA_S5K4H5
       tristate "S5K4H5 camera support"
       depends on VIDEO_MMPISP_B52 && I2C
       help
       This is a V4L2 camera driver for the s5k4h5 sensor
```

## drivers/media/i2c/ecs/Kconfig
```kconfig
config ECS_DRIVER
	bool "Essential Camera Sensor driver"
	depends on VIDEO_V4L2 && SOC_CAMERA
	default y
	help
	  Essential Camera Sensor(AKA: ECS) is a abstract description of
	  camera sensors. Can be used to creat a specific camera sensor
	  driver, like ov5640 driver.

config ECS_DRIVER_SUBDEV
	bool "Essential Camera Sensor V4L2-subdev interface"
	select ECS_DRIVER
	default y
	help
	  V4L2 subdev helper functions to implement subdev-like sensor
	  driver

config SOC_CAMERA_OV5640_ECS
	tristate "ov5640 support based on ECS"
	depends on ECS_DRIVER_SUBDEV
	default n
	help
		Support for the OmniVision OV5640 5M camera sensor.

config SOC_CAMERA_SP0A20_ECS
	tristate "sp0a20 support based on ECS"
	depends on ECS_DRIVER_SUBDEV
	default y
	help
		Support for the sp0a20 0.3M camera sensor.
```

## drivers/media/isdbt/Kconfig
```kconfig
config ISDBT
	bool "isdbt"
	default n

choice
	depends on ISDBT
	prompt "isdbt driver"
	default ISDBT_FC8150

	config ISDBT_FC8150
		bool "ISDBT_FC8150"

	config ISDBT_FC8300
		bool "ISDBT_FC8300"
endchoice

config ISDBT_SPMI
	bool "isdbt spmi"
	default n

config ISDBT_ANT_DET
	bool "isdbt antenna detection"
	default n
```

## drivers/media/platform/Kconfig
```kconfig
#
# Platform drivers
#	All drivers here are currently for webcam support

menuconfig V4L_PLATFORM_DRIVERS
	bool "V4L platform devices"
	depends on MEDIA_CAMERA_SUPPORT
	default n
	---help---
	  Say Y here to enable support for platform-specific V4L drivers.

if V4L_PLATFORM_DRIVERS

source "drivers/media/platform/marvell-ccic/Kconfig"

config VIDEO_VIA_CAMERA
	tristate "VIAFB camera controller support"
	depends on FB_VIA
	select VIDEOBUF_DMA_SG
	select VIDEO_OV7670
	help
	   Driver support for the integrated camera controller in VIA
	   Chrome9 chipsets.  Currently only tested on OLPC xo-1.5 systems
	   with ov7670 sensors.

#
# Platform multimedia device configuration
#

source "drivers/media/platform/davinci/Kconfig"

source "drivers/media/platform/omap/Kconfig"

source "drivers/media/platform/blackfin/Kconfig"

config VIDEO_SH_VOU
	tristate "SuperH VOU video output driver"
	depends on MEDIA_CAMERA_SUPPORT
	depends on VIDEO_DEV && I2C
	depends on ARCH_SHMOBILE || COMPILE_TEST
	select VIDEOBUF_DMA_CONTIG
	help
	  Support for the Video Output Unit (VOU) on SuperH SoCs.

config VIDEO_VIU
	tristate "Freescale VIU Video Driver"
	depends on VIDEO_V4L2 && PPC_MPC512x
	select VIDEOBUF_DMA_CONTIG
	default y
	---help---
	  Support for Freescale VIU video driver. This device captures
	  video data, or overlays video on DIU frame buffer.

	  Say Y here if you want to enable VIU device on MPC5121e Rev2+.
	  In doubt, say N.

config VIDEO_TIMBERDALE
	tristate "Support for timberdale Video In/LogiWIN"
	depends on VIDEO_V4L2 && I2C && DMADEVICES
	select DMA_ENGINE
	select TIMB_DMA
	select VIDEO_ADV7180
	select VIDEOBUF_DMA_CONTIG
	---help---
	  Add support for the Video In peripherial of the timberdale FPGA.

config VIDEO_VINO
	tristate "SGI Vino Video For Linux"
	depends on I2C && SGI_IP22 && VIDEO_V4L2
	select VIDEO_SAA7191 if MEDIA_SUBDRV_AUTOSELECT
	help
	  Say Y here to build in support for the Vino video input system found
	  on SGI Indy machines.

config VIDEO_M32R_AR
	tristate "AR devices"
	depends on M32R && VIDEO_V4L2
	---help---
	  This is a video4linux driver for the Renesas AR (Artificial Retina)
	  camera module.

config VIDEO_M32R_AR_M64278
	tristate "AR device with color module M64278(VGA)"
	depends on PLAT_M32700UT
	select VIDEO_M32R_AR
	---help---
	  This is a video4linux driver for the Renesas AR (Artificial
	  Retina) with M64278E-800 camera module.
	  This module supports VGA(640x480 pixels) resolutions.

	  To compile this driver as a module, choose M here: the
	  module will be called arv.

config VIDEO_OMAP3
	tristate "OMAP 3 Camera support"
	depends on OMAP_IOVMM && VIDEO_V4L2 && I2C && VIDEO_V4L2_SUBDEV_API && ARCH_OMAP3
	---help---
	  Driver for an OMAP 3 camera controller.

config VIDEO_OMAP3_DEBUG
	bool "OMAP 3 Camera debug messages"
	depends on VIDEO_OMAP3
	---help---
	  Enable debug messages on OMAP 3 camera controller driver.

config VIDEO_S3C_CAMIF
	tristate "Samsung S3C24XX/S3C64XX SoC Camera Interface driver"
	depends on VIDEO_V4L2 && I2C && VIDEO_V4L2_SUBDEV_API
	depends on (ARCH_S3C64XX || PLAT_S3C24XX) && PM_RUNTIME
	select VIDEOBUF2_DMA_CONTIG
	---help---
	  This is a v4l2 driver for s3c24xx and s3c64xx SoC series camera
	  host interface (CAMIF).

	  To compile this driver as a module, choose M here: the module
	  will be called s3c-camif.

config VIDEO_MMPISP
	bool "Marvell MMP ISP framework support"
	select VIDEOBUF2_DMA_CONTIG
	depends on VIDEO_V4L2 && VIDEO_V4L2_SUBDEV_API && ARCH_MMP
	select DMA_SHARED_BUFFER
	default n
	---help---
	  Driver framework for Marvell MMP serial SoC ISP.
	  Say Y here to enable the ISP driver framework, and then ISP driver
	  must be enabled too.
	  This framework will support AREA51 and B52 ISP project

config VIDEO_MMPISP_B52SENSOR
	bool "B52ISP common camera sensor support"
	depends on VIDEO_MMPISP_B52 && I2C
	default n
	---help---
	  Say Y here to enable b52 common sensor driver.
	  The framework implements the v4l2 interface.
	  Each sensor mainly provides the setting to the
	  framework. The framework will handle the setting.

config VIDEO_MMPISP_B52
	bool "MMP serial SoC B52 ISP support"
	depends on VIDEO_MMPISP
	default n
	---help---
	  Say Y here to enable MMP serial SoC B52 ISP driver.
	  B52 ISP can support both dual pipeline and single
	  pipeline. The dual pipeline and single pipeline have
	  different number of MAC.

config VIDEO_MMPISP_CCICV2
	bool "MMP serial SoC CCIC version 2 support"
	depends on VIDEO_MMPISP
	select VIDEO_MV_SC2_CCIC
	default n
	---help---
	  Say Y here to enable MMP serial SoC CCICv2 driver.
	  SoC CCICv2 driver shares the functions with VIDEO_MV_SC2_CCIC.
	  CCICv2 provides the media control interfaces.
	  CCICv2 includes csi-ctrl and csi-dma.

config VIDEO_MMPISP_PLATFORM
	bool "Marvell Platform Camera support"
	depends on VIDEO_MMPISP
	select VIDEO_MMPISP_B52
	select VIDEO_MMPISP_CCICV2
	default n
	---help---
	  Say Y here to enable Camera driver.
	  The platform has the overall view of the ISP topology.
	  It provides the interface to find other linked subdev.
	  It also detects sensor during the probe.

config VIDEO_MV_SC2_MMU
	tristate "Marvell SC2 mmu driver"
	depends on VIDEO_DEV
	select VIDEOBUF2_DMA_SG
	---help---
	  This is a v4l2 driver for the Marvell sc2 MMU
	  To compile this driver as a module, choose M here: the module will
	  be called mv_sc2_mmu.
	  In new Marvell architecture, CCIC/ISP drivers depend on
	  this driver.

config ISP_USE_TWSI3
	tristate "Marvell b52 isp use twsi3 as i2c"
	depends on VIDEO_MMPISP
	default n
	---help---
	  This is a new feture for the Marvell B52 ISP
	  To compile this driver as a module, choose M here: the module will
	  be called system i2c module.
	  In new Marvell SOC architecture, ISP drivers can use it access sensor

config VIDEO_MV_SC2_CCIC
	tristate "Marvell SC2 ccic driver"
	select VIDEOBUF2_DMA_SG
	select VIDEOBUF2_DMA_CONTIG
	---help---
	  This is a v4l2 driver for the Marvell sc2 CCIC
	  To compile this driver as a module, choose M here: the module will
	  be called mv_sc2_ccic.

config HOST_SUBDEV
	bool "host v4l2 subdev support"
	depends on VIDEO_V4L2
	default n
	---help---
	  Host v4l2 subdev provide a container of v4l2 subdevs, it's a way to
	  map a group of v4l2_subdevs to one v4l2 subdev. This is very usefull
	  if driver choose to expose a unified interface to user space for
	  a raw camera sensor and its accessories(like VCM, OTP, etc).

config SUBDEV_VCM
	bool "v4l2 subdev vcm support"
	depends on VIDEO_V4L2
	default n
	---help---
	  v4l2 subdev vcm is the subdev of the "host guest" framework, it's a way to
	  control the vcm throgh the host handler.

config SUBDEV_FLASH
	bool "v4l2 subdev flash support"
	depends on VIDEO_V4L2
	default n
	---help---
	  v4l2 subdev flash is the subdev of the "host guest" framework, it's a way to
	  control the flash throgh the host handler.

source "drivers/media/platform/soc_camera/Kconfig"
source "drivers/media/platform/exynos4-is/Kconfig"
source "drivers/media/platform/s5p-tv/Kconfig"

endif # V4L_PLATFORM_DRIVERS

menuconfig V4L_MEM2MEM_DRIVERS
	bool "Memory-to-memory multimedia devices"
	depends on VIDEO_V4L2
	depends on MEDIA_CAMERA_SUPPORT
	default n
	---help---
	  Say Y here to enable selecting drivers for V4L devices that
	  use system memory for both source and destination buffers, as opposed
	  to capture and output drivers, which use memory buffers for just
	  one of those.

if V4L_MEM2MEM_DRIVERS

config VIDEO_CODA
	tristate "Chips&Media Coda multi-standard codec IP"
	depends on VIDEO_DEV && VIDEO_V4L2 && ARCH_MXC
	select SRAM
	select VIDEOBUF2_DMA_CONTIG
	select V4L2_MEM2MEM_DEV
	---help---
	   Coda is a range of video codec IPs that supports
	   H.264, MPEG-4, and other video formats.

config VIDEO_MEM2MEM_DEINTERLACE
	tristate "Deinterlace support"
	depends on VIDEO_DEV && VIDEO_V4L2 && DMA_ENGINE
	select VIDEOBUF2_DMA_CONTIG
	select V4L2_MEM2MEM_DEV
	help
	    Generic deinterlacing V4L2 driver.

config VIDEO_SAMSUNG_S5P_G2D
	tristate "Samsung S5P and EXYNOS4 G2D 2d graphics accelerator driver"
	depends on VIDEO_DEV && VIDEO_V4L2 && (PLAT_S5P || ARCH_EXYNOS)
	select VIDEOBUF2_DMA_CONTIG
	select V4L2_MEM2MEM_DEV
	default n
	---help---
	  This is a v4l2 driver for Samsung S5P and EXYNOS4 G2D
	  2d graphics accelerator.

config VIDEO_SAMSUNG_S5P_JPEG
	tristate "Samsung S5P/Exynos4 JPEG codec driver"
	depends on VIDEO_DEV && VIDEO_V4L2 && (PLAT_S5P || ARCH_EXYNOS)
	select VIDEOBUF2_DMA_CONTIG
	select V4L2_MEM2MEM_DEV
	---help---
	  This is a v4l2 driver for Samsung S5P and EXYNOS4 JPEG codec

config VIDEO_SAMSUNG_S5P_MFC
	tristate "Samsung S5P MFC Video Codec"
	depends on VIDEO_DEV && VIDEO_V4L2 && (PLAT_S5P || ARCH_EXYNOS)
	select VIDEOBUF2_DMA_CONTIG
	default n
	help
	    MFC 5.1 and 6.x driver for V4L2

config VIDEO_MX2_EMMAPRP
	tristate "MX2 eMMa-PrP support"
	depends on VIDEO_DEV && VIDEO_V4L2 && SOC_IMX27
	select VIDEOBUF2_DMA_CONTIG
	select V4L2_MEM2MEM_DEV
	help
	    MX2X chips have a PrP that can be used to process buffers from
	    memory to memory. Operations include resizing and format
	    conversion.

config VIDEO_SAMSUNG_EXYNOS_GSC
	tristate "Samsung Exynos G-Scaler driver"
	depends on VIDEO_DEV && VIDEO_V4L2 && ARCH_EXYNOS5
	select VIDEOBUF2_DMA_CONTIG
	select V4L2_MEM2MEM_DEV
	help
	  This is a v4l2 driver for Samsung EXYNOS5 SoC G-Scaler.

config VIDEO_SH_VEU
	tristate "SuperH VEU mem2mem video processing driver"
	depends on VIDEO_DEV && VIDEO_V4L2 && HAS_DMA
	select VIDEOBUF2_DMA_CONTIG
	select V4L2_MEM2MEM_DEV
	help
	    Support for the Video Engine Unit (VEU) on SuperH and
	    SH-Mobile SoCs.

config VIDEO_RENESAS_VSP1
	tristate "Renesas VSP1 Video Processing Engine"
	depends on VIDEO_V4L2 && VIDEO_V4L2_SUBDEV_API && HAS_DMA
	select VIDEOBUF2_DMA_CONTIG
	---help---
	  This is a V4L2 driver for the Renesas VSP1 video processing engine.

	  To compile this driver as a module, choose M here: the module
	  will be called vsp1.

config VIDEO_TI_VPE
	tristate "TI VPE (Video Processing Engine) driver"
	depends on VIDEO_DEV && VIDEO_V4L2 && SOC_DRA7XX
	select VIDEOBUF2_DMA_CONTIG
	select V4L2_MEM2MEM_DEV
	default n
	---help---
	  Support for the TI VPE(Video Processing Engine) block
	  found on DRA7XX SoC.

config VIDEO_TI_VPE_DEBUG
	bool "VPE debug messages"
	depends on VIDEO_TI_VPE
	---help---
	  Enable debug messages on VPE driver.

endif # V4L_MEM2MEM_DRIVERS

menuconfig V4L_TEST_DRIVERS
	bool "Media test drivers"
	depends on MEDIA_CAMERA_SUPPORT

if V4L_TEST_DRIVERS
config VIDEO_VIVI
	tristate "Virtual Video Driver"
	depends on VIDEO_DEV && VIDEO_V4L2 && !SPARC32 && !SPARC64
	select FONT_SUPPORT
	select FONT_8x16
	select VIDEOBUF2_VMALLOC
	default n
	---help---
	  Enables a virtual video driver. This device shows a color bar
	  and a timestamp, as a real device would generate by using V4L2
	  api.
	  Say Y here if you want to test video apps or debug V4L devices.
	  In doubt, say N.

config VIDEO_MEM2MEM_TESTDEV
	tristate "Virtual test device for mem2mem framework"
	depends on VIDEO_DEV && VIDEO_V4L2
	select VIDEOBUF2_VMALLOC
	select V4L2_MEM2MEM_DEV
	default n
	---help---
	  This is a virtual test device for the memory-to-memory driver
	  framework.
endif #V4L_TEST_DRIVERS
```

## drivers/media/platform/exynos/Kconfig
```kconfig
#
# Exynos multimedia device drivers
#
config VIDEO_EXYNOS
        bool "Exynos Multimedia Devices"
        default y
        help
          This is a representative exynos multimedia device.

if VIDEO_EXYNOS
        source "drivers/media/platform/exynos/mfc/Kconfig"

source "drivers/media/platform/exynos/camera/Kconfig"
source "drivers/media/platform/exynos/camera-pp/Kconfig"
endif
```

## drivers/media/platform/exynos/camera-pp/votf/Kconfig
```kconfig
menuconfig VIDEO_EXYNOS_CAMERA_POSTPROCESS_VOTF
	bool "EXYNOS CAMERA POSTPROCESS VOTF Driver"
	depends on VIDEO_EXYNOS_CAMERA_POSTPROCESS
	default y
	help
		This is a representative exynos CAMERA-PP VOTF device.
```
