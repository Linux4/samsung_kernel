## drivers/input/rfcable_detect/Kconfig
```kconfig
config SWTP_INT_INPUT_DEV
	bool "swtp interrupt pin register an input device"
	default n
	help
		To support register an input device in swtp function.
		if yes, then it is supported,
		if no, it is disabled.
		The option default enabled.
```

## drivers/input/sar_mode_detect/Kconfig
```kconfig
config SAR_MODE_DETECT
    bool "sar mode detect interrupt pin register an input device"
    default y
    help
        To support register an input device in sar model detect function.
        if yes, then it is supported,
        if no, it is disabled.
        The option default enabled.
```

## drivers/input/sec_input/Kconfig
```kconfig
#
# Sec_Input device configuration
#

config SEC_DEBUG_TSP_LOG_LEGO
	bool "SEC_DEBUG_TSP_LOG_LEGO"
	help
		Say Y here if you have a SEC_DEBUG_TSP_LOG_LEGO.
		If unsure, say N.
		
config INPUT_TOUCHSCREEN_TCLMV2_LEGO
	bool "INPUT_TOUCHSCREEN_TCLMV2_LEGO"
	help
		Say Y here if you have a INPUT_TOUCHSCREEN_TCLMV2_LEGO.
		If unsure, say N.

config INPUT_SEC_SECURE_TOUCH_LEGO
	bool "INPUT_SEC_SECURE_TOUCH_LEGO"
	help
		Say Y here if you have a INPUT_SEC_SECURE_TOUCH_LEGO.
		If unsure, say N.

config TOUCHSCREEN_DUMP_MODE_LEGO
	bool "TOUCHSCREEN_DUMP_MODE_LEGO"
	help
		Say Y here if you have a TOUCHSCREEN_DUMP_MODE_LEGO.
		If unsure, say N.

config INPUT_SEC_NOTIFIER_LEGO
	bool "INPUT_SEC_NOTIFIER_LEGO"
	help
		Say Y here if you have a INPUT_SEC_NOTIFIER_LEGO.
		If unsure, say N.

config TOUCHSCREEN_DUAL_FOLDABLE_LEGO
	bool "TOUCHSCREEN_DUAL_FOLDABLE_LEGO"
	help
		Say Y here if you have a TOUCHSCREEN_DUAL_FOLDABLE_LEGO.
		If unsure, say N.

config INPUT_SEC_INPUT_LEGO
	bool "INPUT_SEC_INPUT_LEGO"
	help
		Say Y here if you have a INPUT_SEC_INPUT_LEGO.
		If unsure, say N.
```

## drivers/input/sec_input/nvt_spi/Kconfig
```kconfig
# SPDX-License-Identifier: GPL-2.0-only
#
# SLSI TOUCH driver configuration
#

config TOUCHSCREEN_NVT_SPI_ZERO
    tristate "NVT SPI ZERO Touchscreen"
    depends on SPI
    help
      Say Y here if you want support for NVT SPI ZERO touchscreen controllers.
      If unsure, say N.
```

## drivers/input/sec_input/stm_fold/Kconfig
```kconfig
# SPDX-License-Identifier: GPL-2.0-only
#
# STM TOUCH driver configuration
#

config TOUCHSCREEN_STM
	tristate "STM Touchscreen"
	depends on I2C
    help
      Say Y here if you want support for STM touchscreen controllers.
      If unsure, say N.

config TOUCHSCREEN_STM_SUB
	tristate "STM Touchscreen"
	depends on I2C
    help
      Say Y here if you want support for STM touchscreen controllers.
      If unsure, say N.
```

## drivers/input/sec_input/stm_spi/Kconfig
```kconfig
# SPDX-License-Identifier: GPL-2.0-only
#
# STM TOUCH driver configuration
#

config TOUCHSCREEN_STM_SPI
	tristate "STM SPI Touchscreen"
	depends on SPI
    help
      Say Y here if you want support for STM SPI touchscreen controllers.
      If unsure, say N.
```

## drivers/input/touchscreen/HS03/nvt_touch/Kconfig
```kconfig
#
# Novatek NT36xxx touchscreen driver configuration
#
config TOUCHSCREEN_NT36xxx_HOSTDL_SPI
	bool "Novatek NT36xxx host download SPI driver"
#Tab A8 code for SR-AX6300-01-405 by luxinjun at 2021/09/05 start
	default n
#Tab A8 code for SR-AX6300-01-405 by luxinjun at 2021/09/05 end
	help
	  Say Y here if you have a Novatek NT36xxx no flash touchscreen connected
	  to your system by SPI bus.

	  If unsure, say N.
```

## drivers/input/touchscreen/Tab_A7_Unisoc/NVT_Touch/Kconfig
```kconfig
#
# Novatek NT36xxx touchscreen driver configuration
#
config TOUCHSCREEN_NT36XXX_HOSTDL_SPI_OT9
	bool "Novatek NT36XXX host download SPI driver"
	default n
	help
	  Say Y here if you have a Novatek NT36xxx no flash touchscreen connected
	  to your system by SPI bus.

	  If unsure, say N.
```

## drivers/input/touchscreen/Tab_A8/NVT_Touch_HostDL/Kconfig
```kconfig
#
# Novatek NT36xxx touchscreen driver configuration
#
config TOUCHSCREEN_NT36XXX_HOSTDL_SPI_A8
	bool "Novatek NT36XXX host download SPI driver"
	default n
	help
	  Say Y here if you have a Novatek NT36xxx no flash touchscreen connected
	  to your system by SPI bus.

	  If unsure, say N.
```

## drivers/input/touchscreen/bt541/Kconfig
```kconfig
#
# Kconfig for ZINITIX BT541 Touchscreen driver
#

if INPUT_TOUCHSCREEN

config TOUCHSCREEN_BT541
	tristate "Zinitix BT541C touchscreen"
	depends on I2C
	help
		Say Y here if you have a touchscreen using the BT541.

		If unsure, say N.

		To compile this driver as a module, choose M here: the
		module will be called bt541_ts.

endif
```

## drivers/input/touchscreen/chipone_tddi_spi/Kconfig
```kconfig
#
# CHIPONE Touchscreen driver configuration
#

config TOUCHSCREEN_CHIPONE_ICNL9958R
    tristate "CHIPONE Touchscreen"
    default m
    help
      Say Y here if you have CHIPONE touch panel.
      If unsure, say N.
```

## drivers/input/touchscreen/cyttsp4/Kconfig
```kconfig
# Cypress Touchscreen driver configuration
#

config TOUCHSCREEN_CYTTSP4
	tristate "CYPRESS touchscreen driver"
	default n
	depends on I2C
	help
	  Cypress TrueTouch(tm) Standard Product Generation4
	  I2C bus interface.

	  Say Y here to enable I2C bus interface to TTSP
	  touchscreen controller.
```

## drivers/input/touchscreen/cyttsp5/Kconfig
```kconfig
#
# Cypress cyttsp5 touchscreen driver configuration
#

config CYPRESS_CYTTSP5_BUS
        bool "Cypress TTSP core bus"
        default n
        help
          This option enables support Cypress TTSP core bus.
          This support is needed for various device and drivers
          using Cypress TrueTouch(TM) Standard Product
          protocol.

config TOUCHSCREEN_CYPRESS_CYTTSP5
        tristate "Cypress TrueTouch Gen5 Touchscreen Driver"
        default n
        select CYPRESS_CYTTSP5_BUS
        select TOUCHSCREEN_CYPRESS_CYTTSP5_I2C
        select TOUCHSCREEN_CYPRESS_CYTTSP5_MT_B
        help
          Core driver for Cypress TrueTouch(tm) Standard Product
          Geneartion5 touchscreen controllers.

          Say Y here if you have a Cypress Gen5 touchscreen.
          If unsure, say N.
          To compile this driver as a module, choose M here.

config TOUCHSCREEN_CYPRESS_CYTTSP5_DEVICETREE_SUPPORT
        bool "Enable Device Tree support"
        default n
        depends on TOUCHSCREEN_CYPRESS_CYTTSP5 && OF
        help
          This option enables support for device tree.

          Say Y here to enable device tree support.

config TOUCHSCREEN_CYPRESS_CYTTSP5_DEBUG
        bool "Enable debug output"
        depends on TOUCHSCREEN_CYPRESS_CYTTSP5
        default n
        help
          Enable Debug output for Cypress TrueTouch(tm)
          Standard Product Generation5 drivers set.

          Say Y here to enable debug output.

config TOUCHSCREEN_CYPRESS_CYTTSP5_VDEBUG
        bool "Enable verbose debug output"
        depends on TOUCHSCREEN_CYPRESS_CYTTSP5_DEBUG
        default n
        help
          Enable Verbose Debug output for Cypress TrueTouch(tm)
          Standard Product Generation5 drivers set.

          Say Y here to enable verbose debug output.

config TOUCHSCREEN_CYPRESS_CYTTSP5_I2C
        tristate "Cypress TrueTouch Gen5 I2C"
        depends on TOUCHSCREEN_CYPRESS_CYTTSP5
        select I2C
        default n
        help
          Cypress TrueTouch(tm) Standard Product Generation5
          I2C bus interface.

          Say Y here to enable I2C bus interface to TTSP
          touchscreen controller.

config TOUCHSCREEN_CYPRESS_CYTTSP5_SPI
        tristate "Cypress TrueTouch Gen5 SPI"
        depends on TOUCHSCREEN_CYPRESS_CYTTSP5
        select SPI
        default n
        help
          Cypress TrueTouch(tm) Standard Product Generation5
          SPI bus interface.

          Say Y here to enable SPI bus interface to TTSP
          touchscreen controller.

config TOUCHSCREEN_CYPRESS_CYTTSP5_MT_A
        tristate "Cypress TrueTouch Gen5 MultiTouch Protocol A"
        depends on TOUCHSCREEN_CYPRESS_CYTTSP5
        default n
        help
          Cypress TrueTouch(tm) Standard Product Generation5
          MutliTouch Protocol A support.

          Say Y here to enable MutiTouch touch reporting
          using protocol A.

config TOUCHSCREEN_CYPRESS_CYTTSP5_MT_B
        tristate "Cypress TrueTouch Gen5 MultiTouch Protocol B"
        depends on TOUCHSCREEN_CYPRESS_CYTTSP5
        default n
        help
          Cypress TrueTouch(tm) Standard Product Generation5
          MutliTouch Protocol B support.

          Say Y here to enable MutiTouch touch reporting
          using protocol B.

config TOUCHSCREEN_CYPRESS_CYTTSP5_BUTTON
        tristate "Cypress TrueTouch Gen5 MultiTouch CapSense Button"
        depends on TOUCHSCREEN_CYPRESS_CYTTSP5
        default n
        help
          Cypress TrueTouch(tm) Standard Product Generation5
          CapSense driver.

          Say Y here to enable CapSense reporting.

config TOUCHSCREEN_CYPRESS_CYTTSP5_DEVICE_ACCESS
        tristate "Cypress TrueTouch Gen5 MultiTouch Device Access"
        depends on TOUCHSCREEN_CYPRESS_CYTTSP5
        default n
        help
          Cypress TrueTouch(tm) Standard Product Generation5
          Device access module.

          This modules adds an interface to access touchscreen
          controller using driver sysfs nodes.

config TOUCHSCREEN_CYPRESS_CYTTSP5_LOADER
        tristate "Cypress TrueTouch Gen5 MultiTouch Loader"
        depends on TOUCHSCREEN_CYPRESS_CYTTSP5
        default n
        help
          Cypress TrueTouch(tm) Standard Product Generation5
          FW Loader module.

          This module enables support for Firmware upgrade.

config TOUCHSCREEN_CYPRESS_CYTTSP5_PLATFORM_FW_UPGRADE
        bool "FW upgrade from header file"
        depends on TOUCHSCREEN_CYPRESS_CYTTSP5_LOADER
        default n
        help
          Include Cypress TrueTouch(tm) Standard Product
          Generation5 device Firmware into driver.

          Need proper header file for this.

config TOUCHSCREEN_CYPRESS_CYTTSP5_BINARY_FW_UPGRADE
        bool "FW upgrade from binary file"
        depends on TOUCHSCREEN_CYPRESS_CYTTSP5_LOADER
        default n
        help
          Include Cypress TrueTouch(tm) Standard Product
          Generation5 device Firmware into kernel itself.

          This should be enabled for manual FW upgrade.

config TOUCHSCREEN_CYPRESS_CYTTSP5_PLATFORM_TTCONFIG_UPGRADE
        bool "TT Configuration upgrade from header file"
        depends on TOUCHSCREEN_CYPRESS_CYTTSP5_LOADER
        default n
        help
          Include Cypress TrueTouch(tm) Standard Product
          Generation5 device TrueTouch Configuration into
          kernel itself.

          Need proper header file for this.

config TOUCHSCREEN_CYPRESS_CYTTSP5_MANUAL_TTCONFIG_UPGRADE
        bool "TT Configuration upgrade via SysFs"
        depends on TOUCHSCREEN_CYPRESS_CYTTSP5_LOADER
        default n
        help
          Provides a SysFs interface to upgrade TrueTouch
          Configuration with a binary configuration file.

          Need proper binary version of config file for this
          feature.

config TOUCHSCREEN_CYPRESS_CYTTSP5_DEBUG_MODULE
        tristate "Cypress TrueTouch Gen5 MultiTouch Debug Module"
        depends on TOUCHSCREEN_CYPRESS_CYTTSP5
        default n
        help
          Cypress TrueTouch(tm) Standard Product Generation5
          Debug module.

          This module adds support for verbose printing touch
          information.
```

## drivers/input/touchscreen/focaltech/ft820x/Kconfig
```kconfig
#
# Focaltech Touchscreen driver configuration
#

config TOUCHSCREEN_FTS_FT820X
    bool "Focaltech Touchscreen"
    default n
    help
      Say Y here if you have Focaltech touch panel.
      If unsure, say N.
```

## drivers/input/touchscreen/focaltech/ft8720/Kconfig
```kconfig
#
# Focaltech Touchscreen driver configuration
#

config TOUCHSCREEN_FTS_FT8720
    tristate "Focaltech Touchscreen"
    default n
    help
      Say Y here if you have Focaltech touch panel.
      If unsure, say N.
```

## drivers/input/touchscreen/focaltech_touch_1695/Kconfig
```kconfig
#
# Focaltech Touchscreen driver configuration
#

config TOUCHSCREEN_FTS_1695
       tristate "FocalTech touchscreens"
       depends on I2C
       help
         Say Y here if you have a ft5446 touchscreen.
         Ft5446 controllers are multi touch controllers which can
         report 10 touches at a time.

         If unsure, say N.

         To compile this driver as a module, choose M here: the
         module will be called ft5446_ts.

config TOUCHSCREEN_FTS_DIRECTORY
    string "Focaltech ts directory name"
    default "focaltech_touch"
    depends on TOUCHSCREEN_FTS_1695
```

## drivers/input/touchscreen/focaltech_touch_n9/Kconfig
```kconfig
#
# Focaltech Touchscreen driver configuration
#

config TOUCHSCREEN_FTS_N9
    depends on SPI
    help
      Say Y here if you have Focaltech touch panel.
      If unsure, say N.
      
config TOUCHSCREEN_FTS_DIRECTORY_N9
    string "Focaltech_n9 ts directory name"
    default "focaltech_touch"
    depends on TOUCHSCREEN_FTS_N9
    
```

## drivers/input/touchscreen/focaltech_touch_spi/Kconfig
```kconfig
#
# Focaltech Touchscreen driver configuration
#

config TOUCHSCREEN_FTS
    tristate "Focaltech Touchscreen"
    default m
    depends on SPI
    help
      Say Y here if you have Focaltech touch panel.
      If unsure, say N.
```

## drivers/input/touchscreen/ft6x06/Kconfig
```kconfig
#
# Cypress cyttsp5 touchscreen driver configuration
#

config TOUCHSCREEN_FT6436
	tristate "Focaltech Touchscreen Driver"
	default n
	depends on I2C
	help
	  Focaltech touch driver
	  I2C bus interface.

	  Say Y here to enable I2C bus interface to TTSP
	  touchscreen controller.

config TOUCHSCREEN_LU202x
	tristate "leadingui Touchscreen Driver"
	default n
	depends on I2C
	help
	  leadingui touch driver
	  I2C bus interface.

	  Say Y here to enable I2C bus interface to TTSP
	  touchscreen controller.

config TOUCHSCREEN_MELFAS_MMS500
        tristate "MELFAS MMS500 Touchscreen"
        depends on I2C
        help
          Say Y here if you have a MELFAS MMS500 touchscreen device in your system.

          If unsure, say N.

          To compile this driver as a module, choose M here: the module will be called mip4_ts.

config TOUCHSCREEN_MELFAS_MCS8040L
        tristate "MELFAS MCS8040L Touchscreen"
        depends on I2C
        help
          Say Y here if you have a MELFAS MCS8040L touchscreen device in your system.

          If unsure, say N.

          To compile this driver as a module, choose M here: the module will be called mip4_ts.	  
```

## drivers/input/touchscreen/gt9895/Kconfig
```kconfig
#
# Goodix touchscreen driver configuration
#
menuconfig TOUCHSCREEN_GOODIX_9895_BRL
	tristate "Goodix berlin touchscreen"
	help
	  Say Y here if you have a Goodix berlin series touch controller
	  to your system.
```
