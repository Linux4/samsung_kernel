## drivers/input/touchscreen/himax/himax_83112/Kconfig
```kconfig
#
# Himax Touchscreen driver configuration
#

config TOUCHSCREEN_HIMAX_CHIPSET
	bool "Himax touchpanel CHIPSET"
	help
		Say Y here if you have a Himax CHIPSET touchscreen.
		HIMAX controllers are multi touch controllers which can
		report 10 touches at a time.
		If unsure, say N.

config TOUCHSCREEN_HIMAX_COMMON
        tristate "HIMAX chipset i2c touchscreen"
		depends on TOUCHSCREEN_HIMAX_CHIPSET
		help
		This enables support for HIMAX CHIPSET over I2C based touchscreens.

# ***************** In-cell Start *****************
config TOUCHSCREEN_HIMAX_INCELL
        tristate "HIMAX chipset in-cell function"
		depends on TOUCHSCREEN_HIMAX_COMMON
		help
		This enables support for HIMAX CHIPSET of in-cell function.

config TOUCHSCREEN_HIMAX_IC_HX83112
        tristate "HIMAX chipset HX83112 function"
		depends on TOUCHSCREEN_HIMAX_INCELL
		help
		This enables support for HIMAX CHIPSET of HX83112.
# ***************** In-cell End *******************

config TOUCHSCREEN_HIMAX_DEBUG
        tristate "HIMAX debug function"
		depends on TOUCHSCREEN_HIMAX_COMMON
		help
		This enables support for HIMAX debug function.
config TOUCHSCREEN_HIMAX_INSPECT
        tristate "HIMAX inspect function"
		depends on TOUCHSCREEN_HIMAX_COMMON
		help
		This enables support for HIMAX debug function.
config HMX_DB
	tristate "HIMAX driver test over Dragon Board"
	depends on TOUCHSCREEN_HIMAX_COMMON
	help
	  This enables support for HIMAX driver test over Dragon Board.
```

## drivers/input/touchscreen/himax/himax_ic_hx83102/Kconfig
```kconfig
#
# Himax Touchscreen driver configuration
#


config TOUCHSCREEN_HX83102_COMMON
	bool "HIMAX chipset i2c touchscreen"
	depends on TOUCHSCREEN_HIMAX_HX83102
	help
		This enables support for HIMAX CHIPSET over I2C based touchscreens.

# ***************** In-cell Start *****************
config TOUCHSCREEN_HX83102_INCELL
	bool "HIMAX chipset in-cell function"
	depends on TOUCHSCREEN_HX83102_COMMON
	help
		This enables support for HIMAX CHIPSET of in-cell function.

config TOUCHSCREEN_HIMAX_HX83102
	bool "HIMAX chipset HX83102 function"
	help
		This enables support for HIMAX CHIPSET of HX83112.
# ***************** In-cell End *******************

config TOUCHSCREEN_HX83102_DEBUG
	bool "HIMAX debug function"
	depends on TOUCHSCREEN_HX83102_COMMON
	help
		This enables support for HIMAX debug function.

config TOUCHSCREEN_HX83102_INSPECT
	bool "HIMAX inspect function"
	depends on TOUCHSCREEN_HX83102_COMMON
	help
		This enables support for HIMAX debug function.

config HMX_DB
	bool "HIMAX driver test over Dragon Board"
	depends on TOUCHSCREEN_HX83102_COMMON
	help
		This enables support for HIMAX driver test over Dragon Board.
```

## drivers/input/touchscreen/himax/himax_ic_hx83102j/Kconfig
```kconfig
#
# Himax Touchscreen driver configuration
#
config TOUCHSCREEN_HX83102J_COMMON
	tristate "HIMAX chipset i2c touchscreen"
	depends on TOUCHSCREEN_HIMAX_IC_HX83102J
	help
		This enables support for HIMAX CHIPSET touchscreens.

choice
	prompt "HIMAX touch IC types"
	depends on TOUCHSCREEN_HX83102J_COMMON
	default TOUCHSCREEN_HX83102J_INCELL

config TOUCHSCREEN_HIMAX_ONCELL
	bool "HIMAX chipset on-cell function"
	depends on TOUCHSCREEN_HX83102J_COMMON
	help
		This enables support for HIMAX CHIPSET of on-cell function.

config TOUCHSCREEN_HX83102J_INCELL
	bool "HIMAX chipset in-cell function"
	depends on TOUCHSCREEN_HX83102J_COMMON
	help
		This enables support for HIMAX CHIPSET of in-cell function.
endchoice

# ***************** In-cell Start *****************
config TOUCHSCREEN_HIMAX_IC_HX83102J
	tristate "HIMAX chipset HX83102J function"
	help
		This enables support for HIMAX CHIPSET of HX83102J.
# ***************** In-cell End *******************

config TOUCHSCREEN_HX83102J_DEBUG
	bool "HIMAX debug function"
	depends on TOUCHSCREEN_HX83102J_INCELL || TOUCHSCREEN_HIMAX_ONCELL
	help
		This enables support for HIMAX debug function.

config TOUCHSCREEN_HX83102J_INSPECT
	bool "HIMAX inspect function"
	depends on TOUCHSCREEN_HX83102J_INCELL || TOUCHSCREEN_HIMAX_ONCELL
	help
		This enables support for HIMAX inspect function.

config TOUCHSCREEN_HIMAX_EMBEDDED_FIRMWARE
	bool "HIMAX embedded firmware function"
	depends on TOUCHSCREEN_HX83102J_INCELL || TOUCHSCREEN_HIMAX_ONCELL
	help
		This enables built-in FW inside kernel as binary array
```

## drivers/input/touchscreen/himax/himax_ic_hx83108/Kconfig
```kconfig
#
# Himax Touchscreen driver configuration
#

config TOUCHSCREEN_HIMAX_COMMON
	bool "HIMAX chipset i2c touchscreen"
	depends on TOUCHSCREEN_HIMAX_IC_HX83108
	help
		This enables support for HIMAX CHIPSET over I2C based touchscreens.

config TOUCHSCREEN_HIMAX_IC_HX83108
	bool "HIMAX chipset HX83108 function"
	help
		This enables support for HIMAX CHIPSET of HX83108.

# ***************** In-cell Start *****************
config TOUCHSCREEN_HIMAX_INCELL
	bool "HIMAX chipset in-cell function"
	depends on TOUCHSCREEN_HIMAX_COMMON
	help
		This enables support for HIMAX CHIPSET of in-cell function.

# ***************** In-cell End *******************

config TOUCHSCREEN_HIMAX_DEBUG
	bool "HIMAX debug function"
	depends on TOUCHSCREEN_HIMAX_COMMON
	help
		This enables support for HIMAX debug function.

config TOUCHSCREEN_HIMAX_INSPECT
	bool "HIMAX inspect function"
	depends on TOUCHSCREEN_HIMAX_COMMON
	help
		This enables support for HIMAX debug function.

config HMX_DB
	bool "HIMAX driver test over Dragon Board"
	depends on TOUCHSCREEN_HIMAX_COMMON
	help
		This enables support for HIMAX driver test over Dragon Board.
```

## drivers/input/touchscreen/himax/hx83xxx_spi/Kconfig
```kconfig
#
# Himax Touchscreen driver configuration
#
config TOUCHSCREEN_HIMAX_HX83XXX_SPI
	tristate "HIMAX chipset hx83xxx spi touchscreen"
	help
		This enables support for hx83xxx_spi based touchscreens.

config TOUCHSCREEN_HIMAX_SPI
        tristate "HIMAX chipset spi touchscreen"
		depends on TOUCHSCREEN_HIMAX_HX83XXX_SPI
		default y
		help
		This enables support for HIMAX SPI based touchscreens.

config TOUCHSCREEN_HIMAX_ZERO_FLASH
        tristate "HIMAX chipset zero flash touchscreen"
		depends on TOUCHSCREEN_HIMAX_HX83XXX_SPI
		default y
		help
		This enables support for HIMAX zero flash based touchscreens.

# ***************** In-cell Start *****************
config TOUCHSCREEN_HIMAX_INCELL_CORE
        tristate "HIMAX chipset in-cell function"
		depends on TOUCHSCREEN_HIMAX_HX83XXX_SPI
		default y
		help
		This enables support for HIMAX CHIPSET of in-cell function.

config TOUCHSCREEN_HIMAX_IC_HX83102
        tristate "HIMAX chipset HX83102 function"
		depends on TOUCHSCREEN_HIMAX_HX83XXX_SPI
		help
		This enables support for HIMAX CHIPSET of HX83102.

config TOUCHSCREEN_HIMAX_IC_HX83108
        tristate "HIMAX chipset HX83108 function"
		depends on TOUCHSCREEN_HIMAX_HX83XXX_SPI
		help
		This enables support for HIMAX CHIPSET of HX83108.

config TOUCHSCREEN_HIMAX_IC_HX83121
        tristate "HIMAX chipset HX83121 function"
		depends on TOUCHSCREEN_HIMAX_HX83XXX_SPI
		help
		This enables support for HIMAX CHIPSET of HX83121.

config TOUCHSCREEN_HIMAX_IC_HX83112
        tristate "HIMAX chipset HX83112 function"
		depends on TOUCHSCREEN_HIMAX_HX83XXX_SPI
		help
		This enables support for HIMAX CHIPSET of HX83112.

config TOUCHSCREEN_HIMAX_IC_HX83122
        tristate "HIMAX chipset HX83122 function"
		depends on TOUCHSCREEN_HIMAX_HX83XXX_SPI
		help
		This enables support for HIMAX CHIPSET of HX83122.

# ***************** In-cell End *******************
config TOUCHSCREEN_HIMAX_DEBUG
        tristate "HIMAX debug function"
		depends on TOUCHSCREEN_HIMAX_HX83XXX_SPI
		default y
		help
		This enables support for HIMAX debug function.
config TOUCHSCREEN_HIMAX_INSPECT
        tristate "HIMAX inspect function"
		depends on TOUCHSCREEN_HIMAX_HX83XXX_SPI
		default y
		help
		This enables support for HIMAX debug function.
```
