## drivers/gud/gud-exynos5433/Kconfig
```kconfig
#
# MobiCore configuration
#
config MOBICORE_DRIVER
    tristate "MobiCore Driver"
    depends on ARM
    ---help---
      Enable Linux Kernel MobiCore Support

config MOBICORE_DEBUG
    bool "MobiCore Module debug mode"
    depends on MOBICORE_DRIVER
    ---help---
      Enable Debug mode in the MobiCore Driver.
      It enables printing information about mobicore operations

config MOBICORE_VERBOSE
    bool "MobiCore Module verbose debug mode"
    depends on MOBICORE_DEBUG
    ---help---
      Enable Verbose Debug mode in the MobiCore Driver.
      It enables printing extra information about mobicore operations
      Beware: this is only useful for debuging deep in the driver because
      it prints too much logs

config MOBICORE_API
    tristate "Linux MobiCore API"
    depends on MOBICORE_DRIVER
    ---help---
      Enable Linux Kernel MobiCore API

config TRUSTONIC_TRUSTED_UI
    tristate "TBase Trusted UI"
    depends on ARM_TRUSTZONE && MOBICORE_DRIVER
    ---help---
    Enable Linux Kernel Tusted UI

config TRUSTONIC_TRUSTED_UI_FB_BLANK
    bool "TBase Trusted UI use fb_blank"
    default y
    depends on TRUSTONIC_TRUSTED_UI

source "drivers/gud/gud-exynos5433/sec-os-ctrl/Kconfig"
source "drivers/gud/gud-exynos5433/sec-os-booster/Kconfig"
```

## drivers/gud/gud-exynos7870/Kconfig
```kconfig
#
# MobiCore configuration
#
config TRUSTONIC_TEE
    tristate "Trustonic TEE Driver"
    depends on ARM || ARM64
    default y
    ---help---
      Enable Trustonic TEE support

config TRUSTONIC_TEE_LPAE
    bool "Trustonic TEE uses LPAE"
    depends on TRUSTONIC_TEE
    default y if ARM64
    default n if ARM
    ---help---
      Enable Trustonic TEE 64-bit physical addresses support

config MOBICORE_DEBUG
    bool "MobiCore Module debug mode"
    depends on TRUSTONIC_TEE
    default n
    ---help---
      Enable Debug mode in the MobiCore Driver.
      It enables printing information about mobicore operations

config TRUSTONIC_TRUSTED_UI
    tristate "<t-base TUI"
    depends on TRUSTONIC_TEE
    ---help---
      Enable <t-base Trusted User Interface

config TRUSTONIC_TRUSTED_UI_FB_BLANK
    bool "<t-base TUI with fb_blank"
    depends on TRUSTONIC_TRUSTED_UI
    ---help---
    Blank the framebuffer before starting a TUI session

source "drivers/gud/gud-exynos7870/sec-os-ctrl/Kconfig"
source "drivers/gud/gud-exynos7870/sec-os-booster/Kconfig"
```

## drivers/hid/i2c-hid/Kconfig
```kconfig
# SPDX-License-Identifier: GPL-2.0-only
menu "I2C HID support"
	depends on I2C

config I2C_HID
	tristate "HID over I2C transport layer"
	default n
	depends on I2C && INPUT
	select HID
	---help---
	  Say Y here if you use a keyboard, a touchpad, a touchscreen, or any
	  other HID based devices which is connected to your computer via I2C.

	  If unsure, say N.

	  This support is also available as a module.  If so, the module
	  will be called i2c-hid.

if I2C_HID

menu "Special I2C HID drivers"
	depends on I2C_HID

config POGOPIN_HID
	tristate "POGOPIN_HID support for kbd connect"
	depends on I2C_HID
	---help---
	Support for keyboard connected.
	If keyboard connect, setup HW buffers and start the device.

endmenu

endif # HID

endmenu
```

## drivers/hwmon/bme280/Kconfig
```kconfig
#
# Makefile for Bosch sensors driver.
#

config SENSORS_BME280
	tristate "BME280 digital Environment Sensor"
	depends on (I2C || SPI_MASTER) && SYSFS
	help
	 If you say yes here, you get support for Bosch Sensortec's BME280 digital environment sensors.

config SENSORS_BME280_I2C
	tristate "support I2C bus communication"
	depends on SENSORS_BME280 && I2C
	help
	 If you say yes here, you get support Bosch Sensortec's BME280 sensor hooked to an I2C bus.
```

## drivers/hwmon/bmp280/Kconfig
```kconfig
#
# Makefile for Bosch sensors driver.
#

config SENSORS_BMP280
	tristate "BMP280 digital Pressure Sensor"
	depends on (I2C || SPI_MASTER) && SYSFS
	help
	 If you say yes here, you get support for Bosch Sensortec's BMP280 digital pressure sensors.

config SENSORS_BMP280_I2C
	tristate "support I2C bus communication"
	depends on SENSORS_BMP280 && I2C
	help
	 If you say yes here, you get support Bosch Sensortec's BMP280 pressure sensor hooked to an I2C bus.

config SENSORS_BMP280_SPI
	tristate "support SPI bus communication"
	depends on SENSORS_BMP280 && SPI_MASTER
	help
	 If you say yes here, you get support Bosch Sensortec's BMP280 pressure sensor hooked to an SPI bus.
```

## drivers/hwmon/sec/Kconfig
```kconfig
menuconfig SEC_SENSORS
	bool "Samsung Sensors Sets Support"
	default y
	help
		Say Y to enable Sensors support. This allows control of supported
		Sensors.

if SEC_SENSORS
config SEC_SENSORS_CORE
	bool "SEC Sensors Core"
	depends on I2C

config SEC_SENSORS_CM36686
	depends on I2C
	tristate "CM36686 driver"
	default n
	select SENSORS_CORE
	help
	  This option enables proximity & light sensors using CM36686 driver.

config SEC_SENSORS_K2HH
	depends on I2C
	tristate "ST K2HH accel,magnetic combo"
	default n
	select SENSORS_CORE
	help
	  This option enables st k2hh accel and mag driver
endif # SSS_SENSORS
```

## drivers/hwmon/sec_thermistor/Kconfig
```kconfig
if HWMON

config SENSORS_SEC_THERMISTOR
    tristate "SEC Thermistor support"
    default n
    help
      This driver supports SEC Thermistor sensor reading and its
      interpretation.

endif # HWMON
```

## drivers/hwtracing/coresight/phy/Kconfig
```kconfig
#
# Physical Layer Coresight PHY driver configuration
#
menu "Coresight Physical Layer drivers"

config CORESIGHT_PHY
	select EXTCON
	def_bool n

config SPRD_ORCA_CORESIGHT_PHY
	tristate "Spreadtrum ORCA CORESIGHT PHY Driver"
	select CORESIGHT_PHY
	help
	  Enable this to support ORCA CORESIGHT PHY that is part of SOC.

config SPRD_SHARKL6PRO_CORESIGHT_PHY
	tristate "Spreadtrum SHARKL6PRO CORESIGHT PHY Driver"
	select CORESIGHT_PHY
	help
	  Enable this to support SHARKL6PRO CORESIGHT PHY that is part of SOC.

endmenu
```

## drivers/i2c/chips/Kconfig
```kconfig
config SENSORS_GP2A002S
	tristate "gp2a proximity_sensor"
	default n
	help
	  This option enables magnetic sensors using gp2a002s proximity driver.

config SENSORS_BMA2X2
	tristate "BMA255/BMA250E/BMA222E/BMA280 acceleration sensor support"
	depends on I2C=y
	help
	  If you say yes here you get support for Bosch Sensortec's 
	  acceleration sensors BMA255/BMA250E/BMA222E/BMA280.


config SENSORS_BMM050
	tristate "BMM050 Magnetic Sensor Driver"
	depends on I2C=y
	help
	 BMM050 Magnetic Sensor Driver implemented by Bosch-Sensortec.
	 
config INPUT_BMA2x2_ACC_ALERT_INT
	tristate "BMA255/BMA250E/BMA222E/BMA280 acceleration sensor support"
	depends on I2C=y
	help
	  If you say yes here you get support for Bosch Sensortec's 
	  acceleration sensors BMA255/BMA250E/BMA222E/BMA280.	
	 
```

## drivers/i3c/master/exynos/Kconfig
```kconfig
# SPDX-License-Identifier: GPL-2.0-only
config I3C_HCI_EXYNOS
	tristate "EXYNOS I3C HCI driver"
	depends on I3C
	depends on HAS_IOMEM
	help
		I3C HCI protocol control device driver on EXYNOS SoC.
		EXYNOS supports I3C HCI v1.0 protocol.
```

## drivers/if-pmic/maxim/Kconfig
```kconfig
#
# MUIC devices
#

source "drivers/if-pmic/maxim/muic-mcd/Kconfig"
source "drivers/if-pmic/maxim/usb/Kconfig"
```

## drivers/if-pmic/maxim/usb/Kconfig
```kconfig
# SPDX-License-Identifier: GPL-2.0

source "drivers/if-pmic/maxim/usb/notify/Kconfig"
source "drivers/if-pmic/maxim/usb/typec/Kconfig"
```

## drivers/if-pmic/maxim/usb/typec/Kconfig
```kconfig
# SPDX-License-Identifier: GPL-2.0

source "drivers/if-pmic/maxim/usb/typec/manager/Kconfig"
source "drivers/if-pmic/maxim/usb/typec/common/Kconfig"
source "drivers/if-pmic/maxim/usb/typec/maxim/Kconfig"
```

## drivers/if-pmic/maxim/usb/typec/common/Kconfig
```kconfig
#
# USB PDIC common driver
#

comment "USB PDIC common configs"

config CCIC_NOTIFIER
	bool "PDIC notifier support"
	depends on I2C
	default n
	help
	  If you say yes here you will get support for
	  the PDIC attached device status change notification.
	  
config CCIC_NOTIFIER_MODULE
	tristate "PDIC notifier module"
	help
	 this feature is for module build
	 If this feature is "m", KO object will be make
	 need modprobe for loading
	 It is made by samsung

config PDIC_NOTIFIER
	tristate "PDIC notifier support"
	depends on I2C
	default n
	help
	  If you say yes here you will get support for
	  the PDIC attached device status change notification.

config PDIC_POLICY
	bool "PDIC policy common"
	default n
	help
	  If you want to use common policy api,
          enable this feature.
          It should not be enabled in privios ic driver.
          Use to bringup new ic driver.

config USB_ARCH_EXYNOS
	bool "Using exynos"
	default n
	help
	  If you say yes here you will get support for
          using exynos.
          For distinguish with Qcom

config PDIC_USE_MODULE_PARAM
	bool "Using module param"
	depends on PDIC_NOTIFIER
	default n
	help
	  If this feature is enabled, pdic_param will use module_param directly.
	  Should not use extern variable and __setup for param.
	  need to add cmdline in bootloader.
	  (ex: pdic_notifier_module.xxx)
```

## drivers/if-pmic/maxim/usb/typec/maxim/max77705/Kconfig
```kconfig
#
# CCIC devices
#

comment "CCIC configs"

config CCIC_MAX77705
	bool "CCIC 77705"
	depends on I2C
	default n
	help
	  If you say yes here you will get support for
	  max77705 ccic full version chipset
	  
config CCIC_MAX77705_MODULE
	tristate "CCIC 77705 module"
	help
	 this feature is for module build
	 If this feature is "m", KO object will be make
	 need modprobe for loading
	 It is made by samsung

config CCIC_MAX77705_DEBUG
	bool "CCIC 77705 DEBUG"
	depends on CCIC_MAX77705
	default n
	help
	  If you say yes here you will get support for
	  debugging feature with max77705 ccic chipset

config MAX77705_FW_PID03_SUPPORT
	bool "support MAX77705 FW PID 0x03"
	depends on CCIC_MAX77705
	default n
	help
	  If you say yes here you will get support for
	  specified firmware with max77705 ccic chipset
	  
config MAX77705_GRL_ENABLE
	bool "support Eye Diagram"
	depends on CCIC_MAX77705
	default n
	help
	  If you say yes here you will get support for Eye Diagram
	  This isn't needed for MAX77705C(MD15)

config MUIC_MAX77705
        bool "Using MAX77705 MUIC"
        depends on USE_MUIC
        default n
        help
          If you say yes here you will get support for
          the MAX77705 MUIC chip.
	  To enable this driver,
	  USE_MUIC should be enabled.

config HV_MUIC_MAX77705_AFC
        bool "Using MAX77705 AFC MUIC"
        default n
        help
          If you say yes here you will get support for
	  the MAX77705 AFC MUIC.
	  To enable this driver,
	  MUIC_MAX77705 should be enabled.

config MUIC_MAX77705_CCIC
        bool "Using MAX77705 MUIC supports CCIC chip interface"
        default n
        help
          If you say yes here you will get support for
	  the CCIC chip with MAX77705 MUIC.
	  To enable this driver,
	  MUIC_MAX77705 and MUIC_SUPPORT_CCIC should be enabled.
```

## drivers/if-pmic/sm/Kconfig
```kconfig
#
# MUIC devices
#

source "drivers/if-pmic/sm/muic-mcd/Kconfig"
source "drivers/if-pmic/sm/usb/Kconfig"
```

## drivers/if-pmic/sm/muic-mcd/Kconfig
```kconfig
#
# MUIC devices
#
source "drivers/if-pmic/sm/muic-mcd/common/Kconfig"
source "drivers/if-pmic/sm/muic-mcd/sm5714/Kconfig"
```

## drivers/if-pmic/sm/usb/Kconfig
```kconfig
# SPDX-License-Identifier: GPL-2.0

source "drivers/if-pmic/sm/usb/notify/Kconfig"
source "drivers/if-pmic/sm/usb/typec/Kconfig"
```

## drivers/if-pmic/sm/usb/typec/Kconfig
```kconfig
# SPDX-License-Identifier: GPL-2.0

source "drivers/if-pmic/sm/usb/typec/manager/Kconfig"
source "drivers/if-pmic/sm/usb/typec/common/Kconfig"
source "drivers/if-pmic/sm/usb/typec/sm5714/Kconfig"
```

## drivers/if-pmic/sm/usb/typec/common/Kconfig
```kconfig
#
# USB PDIC common driver
#

source "drivers/if-pmic/sm/usb/typec/common/sm/Kconfig"
```

## drivers/if-pmic/sm/usb/typec/manager/Kconfig
```kconfig
#
# USB TypeC Manager driver
#

comment "USB TypeC Manager configs"

config USB_TYPEC_MANAGER_NOTIFIER
    bool "USB TypeC Manager driver"
    help
    If you say yes here you will get support for
      USB TypeC Manager function

config USB_TYPEC_MANAGER_NOTIFIER_SM5714
    tristate "USB TypeC Manager driver SM5714 module"
    help
    If you say yes here you will get support for
      USB TypeC Manager function

config USB_TYPEC_MANAGER_NOTIFIER_MODULE
    tristate "USB TypeC Manager driver module"
    help
	 this feature is for module build
	 If this feature is "m", KO object will be make
	 need modprobe for loading
	 It is made by samsung

config IF_CB_MANAGER
    bool "IF CallBack function Manager"
    default n
    help
    If you say yes here you will use if_cb_manager structure
    that makes functions to callback functions

config IF_CB_MANAGER_SM5714
    tristate "IF CallBack function Manager"
    default n
    help
    If you say yes here you will use if_cb_manager structure
    that makes functions to callback functions

config IF_CB_MANAGER_MODULE
    tristate "IF CallBack function Manager module"
    default n
    help
	 this feature is for module build
	 If this feature is "m", KO object will be make
	 need modprobe for loading
	 It is made by samsung

config USB_TYPEC_MANAGER_NOTIFIER_TEST
	bool "KUnit test for usb_typec_manager_notifier_test"
	depends on SEC_KUNIT
	depends on USB_TYPEC_MANAGER_NOTIFIER
	default y
	help
	 TODO: Describe config fully.
```

## drivers/ifpmic/motor/Kconfig
```kconfig
config MOTOR_DRV_MAX77833
	tristate "Maxim MAX77833 motor"
	default n
	depends on MFD_MAX77833

config MOTOR_DRV_MAX77854
	tristate "Maxim MAX77854 motor"
	default n
	depends on MFD_MAX77854

config MOTOR_DRV_SM5720
	tristate "SM5720 motor"
	default n
	depends on MFD_SM5720 && I2C

config SS_VIBRATOR
	tristate "SS_VIBRATOR"
	default n
	help
	  Say Y to enable SAMSUNG VIBRATOR support

config MOTOR_DRV2624
	tristate "motor"
	default n
	help
	  Say Y to enable MOTOR DRV2624.

config BOOST_POWER_SHARE
	bool "Boost Power Share"
	default n
	help
	  Say Y to enable Boost Power(5V) share.

config BLDC_VIBRATOR
	tristate "BLDC_VIBRATOR"
	default n
	help
	  Say Y to enable MOTOR BLDC drive by PMIC support
```
