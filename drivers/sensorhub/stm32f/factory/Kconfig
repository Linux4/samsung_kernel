## drivers/sensorhub/stm32f/factory/Kconfig
```kconfig
#
# sensor drivers configuration
#

config SENSORS_SSP_ATUC128L5HAR
	tristate "Sensors ssp atuc128l5har"
	default n
	depends on SPI
	help
	  atuc128l5har file for factory test in ssp driver.
          If you say yes here you get atuc128l5har support for
	  factory test.
	  To compile this driver as a module, choose M here: the
	  module will be called ssp.

config SENSORS_SSP_ACCEL
	tristate "Sensors ssp accel sensor"
	default n
	depends on SPI
	help
	  accelerometer sensor file for factory test in ssp driver.
          If you say yes here you get accelerometer sensor support for
	  factory test.
	  To compile this driver as a module, choose M here: the
	  module will be called ssp.

config SENSORS_SSP_6AXIS
	tristate "Sensors ssp 6axis sensor"
	default n
	depends on SPI
	help
	  6axis sensor file for factory test in ssp driver.
          If you say yes here you get 6axis sensor support for
	  factory test.
	  To compile this driver as a module, choose M here: the
	  module will be called ssp.

config SENSORS_SSP_TMD3725
	tristate "Sensors ssp tmd3725"
	default n
	depends on SPI
	help
	  tmd3725 file for factory test in ssp driver.
          If you say yes here you get tmd3725 support for
	  factory test.
	  To compile this driver as a module, choose M here: the
	  module will be called ssp.
	  
config SENSORS_SSP_AK09916
	tristate "Sensors ssp ak09916"
	default n
	depends on SPI
	help
	  ak09916 file for factory test and doeplus in ssp driver.
          If you say yes here you get ak09916 support for
	  factory test.
	  To compile this driver as a module, choose M here: the
	  module will be called ssp.

config SENSORS_SSP_MOBEAM
	tristate "Sensors ssp mobeam"
	default n
	depends on SPI
	help
	  mobeam file for ssp driver.
          If you say yes here you get mobeam support using TMG399x.
	  To compile this driver as a module, choose M here: the
	  module will be called ssp.
```

## drivers/sensors/Kconfig
```kconfig
config SENSORS
	bool "Sensors Class Support"
	help
	  This option enables the sensor sysfs class in /sys/class/sensors.
	  You'll need this to do anything useful with sensorss. If unsure, say N.

config SENSORS_SSC
	bool "Enable Sensors Driver Support for SSC"
	help
	  Add support for sensors SSC driver.
	  This driver is used for exercising sensors use case,
	  time syncing with ADSP clock.

config SENSORS_SYSFS
	tristate "Sensors sysfs"
	help
	  Support sysfs for sensors.
          If you say yes here you get sysfs support for
	  sensor factory test.
	  To compile this driver as a module, choose M here: the
	  module will be called sensors_core.

config SENSORS_CM36672P_IRIS
	depends on I2C
	tristate "CM36672P IRIS driver"
	default n
	help
	  This option enables proximity sensor for iris using CM36672P driver.

config SENSORS_SX9320
	depends on I2C
	tristate "SX9320 driver"
	default n
	help
	  Say Y here if you use sx9320.
	  This option enables grip sensors using
	  SemTech sx9320 device driver.
	  Say N here if you do not use sx9320.

config SENSORS_SX9320_WIFI
	depends on I2C
	tristate "SX9320 WIFI driver"
	default n
	help
	  Say Y here if you use sx9320 for wifi.
	  This option enables grip sensors using
	  SemTech sx9320 device driver for wifi.
	  Say N here if you do not use sx9320 for wifi.

config SENSORS_SX9320_WIFI_SUB
	depends on I2C
	tristate "SX9320 WIFI SUB driver"
	default n
	help
	  Say Y here if you use sx9320 for wifi sub.
	  This option enables grip sensors using
	  SemTech sx9320 device driver for wifi sub.
	  Say N here if you do not use sx9320 for wifi sub.

config SENSORS_SX9310
	depends on I2C
	tristate "SX9310 driver"
	default n
	help
	  Say Y here if you use sx9310.
	  This option enables grip sensors using
	  SemTech sx9310 device driver.
	  Say N here if you do not use sx9310.
```

## drivers/sensors/a96t349/Kconfig
```kconfig
config SENSORS_A96T349
    tristate "GRIP_SENSOR"
    depends on I2C
    default n
    help
      Say Y to enable the SAR detection application, if N here not to use the
      this SAR sensor
```

## drivers/sensors/abov/Kconfig
```kconfig
config SENSORS_A96T346
    tristate "A96T346_SAR"
    depends on I2C
    default n
    help
      Say Y to enable the SAR detection application, if N here not to use the
      this SAR sensor
```

## drivers/sensors/accelerometer/Kconfig
```kconfig
#
# Copyright (c) 2010 Yamaha Corporation
#
# This program is free software; you can redistribute it and/or
# modify it under the terms of the GNU General Public License
# as published by the Free Software Foundation; either version 2
# of the License, or (at your option) any later version.
#
# This program is distributed in the hope that it will be useful,
# but WITHOUT ANY WARRANTY; without even the implied warranty of
# MERCHANTABILITY or FITNESS FOR A PARTICULAR PURPOSE.  See the
# GNU General Public License for more details.
#
# You should have received a copy of the GNU General Public License
# along with this program; if not, write to the Free Software
# Foundation, Inc., 51 Franklin Street, Fifth Floor, Boston, MA  02110-1301,
# USA.
#

config INPUT_YAS_ACCELEROMETER
	tristate "YAS Acceleration Sensor"
	depends on I2C
	help
	  Say Y here if you want support for the accelerometer sensor
	  device.

	  To compile this driver as a module, choose M here: the
	  module will be called accelerometer.

config YAS_ACC_DRIVER_LIS3DH
	tristate "YAS Acceleration Sensor- LIS3DH(K3dh)"
	depends on I2C
	help
	  Say Y here if you want support for the LIS3DH sensor
	  device.

	  To compile this driver as a module, choose M here: the
	  module will be called LIS3DH.

config YAS_ACC_DRIVER_BMA250
	tristate "YAS Acceleration Sensor- BMA250"
	depends on I2C
	help
	  Say Y here if you want support for the BMA250 sensor
	  device.

	  To compile this driver as a module, choose M here: the
	  module will be called BMA250.

config YAS_ACC_MULTI_SUPPORT
	tristate "YAS Acceleration Sensor- MULTI"
	depends on I2C
    help
	  Say Y here if you want support for the YAS acceleration Senser
	  - MULTI.

	  To compile this driver as a module, choose M here: the
	  module will be called YAS acc-MULTI.

config INPUT_YAS_ACCELEROMETER_POSITION
         int "YAS Acceleration Sensor Mounting Position on Board"
         depends on INPUT_YAS_ACCELEROMETER
         default "0"
         help
           Chip mounting position (pin 1).
              0: top, upper-left
              1: top, upper-right
              2: top, lower-right
              3: top, lower-left
              4: bottom, upper-left
              5: bottom, upper-right
              6: bottom, lower-right
              7: bottom, lower-left
```

## drivers/sensors/accelerometer_bma250/Kconfig
```kconfig
#
# Copyright (c) 2010 Yamaha Corporation
#
# This program is free software; you can redistribute it and/or
# modify it under the terms of the GNU General Public License
# as published by the Free Software Foundation; either version 2
# of the License, or (at your option) any later version.
#
# This program is distributed in the hope that it will be useful,
# but WITHOUT ANY WARRANTY; without even the implied warranty of
# MERCHANTABILITY or FITNESS FOR A PARTICULAR PURPOSE.  See the
# GNU General Public License for more details.
#
# You should have received a copy of the GNU General Public License
# along with this program; if not, write to the Free Software
# Foundation, Inc., 51 Franklin Street, Fifth Floor, Boston, MA  02110-1301,
# USA.
#



config BMA250_ACC_DRIVER
	tristate "YAS Acceleration Sensor- BMA250"
	depends on I2C
	help
	  Say Y here if you want support for the BMA250 sensor
	  device.

	  To compile this driver as a module, choose M here: the
	  module will be called BMA250.
```

## drivers/sensors/accelerometer_k2dh/Kconfig
```kconfig
#
# Sensor  drivers configuration
#
config SENSORS_K2DH
	tristate "K2DH acceleration sensor support"
	depends on I2C
        default n
	help
	  Say Y here if you use K2DH.
	  This option enables accelerometer sensors using
	  STM K2DH in K2DH device driver.

	  Say N here if you do not use K2DH.

config SENSORS_K3DH
	tristate "K3DH acceleration sensor support"
	depends on I2C
        default n
	help
	  Driver for STMicroelectronic K3DH accelerometer.

config SENSOR_K3DH_INPUTDEV
	bool "K3DH acceleration sensor input dev support"
	depends on SENSORS_K3DH
        default n
	help
	  Say Y here if you use K3DH.
	  This option enables accelerometer sensor using
	  K3DH device driver.

	  Say N here if you do not use K3DH.
```

## drivers/sensors/alps/Kconfig
```kconfig
#
# Sensors core device.
#
config SENSORS_ALPS
	bool "ALPS Sensor"
	default n
	help
	 This option enables alps sensors

config SENSORS_ALPS_CORE
	depends on SENSORS_ALPS
	tristate "sensors core for alps sensors"
	default n
	help
	  Say Y here to enable debugging messages for power supply class
	  and drivers.

config SENSORS_HSCD
	depends on I2C && SENSORS_ALPS
	tristate "hscd alps mag"
	default n
	help
	  This option enables hscd alps mag driver

config SENSORS_HSCDTD008A
	depends on I2C && SENSORS_ALPS
	tristate "hscd alps HSCDTD008A"
	default n
	help
	  This option enables hscd alps HSCDTD008A mag driver
```

## drivers/sensors/core/Kconfig
```kconfig
#
# Sensors core device.
#

config SENSORS_CORE
	tristate "Sensors core"
	default n
	help
	  Say Y here to enable debugging messages for power supply class
	  and drivers.
```

## drivers/sensors/grip_sensor/Kconfig
```kconfig
config SENSORS_ASP01
	tristate "ANALOG DEVICES ASP01 Multi-Proximity Sensor"
	depends on I2C && SYSFS
	help
	  If you say yes here you get support for the ASP01
	  multi proximity sensor.
	  This driver can also be built as a module.  If so, the module
	  will be called asp01.
```

## drivers/sensors/optical/Kconfig
```kconfig
config PROXIMITY_SENSOR
	tristate "proximity_sensor"
	default n
config SENSORS_CM36653
	depends on I2C && GENERIC_GPIO
	tristate "Capella CM3663 ambient light and proximity sensor"
	default n
	help
	  This option enables proximity & light sensors using CM3663 driver.
config OPTICAL_TAOS_TMD2672X
	tristate "OPTICAL_TAOS_TMD2672X"
	default n
config OPTICAL_TAOS
	tristate "OPTICAL_TAOS_TMD2772S9"
	default n

config SENSORS_CM36651
	depends on I2C && GENERIC_GPIO
	tristate "Capella CM3663 ambient light and proximity sensor"
	default n
	help
	  This option enables proximity & light sensors using CM3663 driver.
```

## drivers/sensors/sx9311/Kconfig
```kconfig
config SENSORS_SX9311
    tristate "SX9311_SAR"
    depends on I2C
    default n
    help
      Say Y to enable the SAR detection application, if N here not to use the
      this SAR sensor
```

## drivers/sensors/sx9325/Kconfig
```kconfig
config SENSORS_SX9325
    tristate "SX9325_SAR"
    depends on I2C
    default n
    help
      Say Y to enable the SAR detection application, if N here not to use the
      this SAR sensor
```

## drivers/sensors/sx932x/Kconfig
```kconfig
# SPDX-License-Identifier: GPL-2.0-only
config SENSORS_SX932X
    tristate "GRIP_SENSOR"
    depends on I2C
    default n
    help
      Say Y to enable the SAR detection application, if N here not to use the
      this SAR sensor
```

## drivers/sensors_lego/Kconfig
```kconfig
#
# grip sensors configuration
#
config SENSORS_A96T396
	depends on I2C
	tristate "A96T396 driver for grip"
	default n
	help
	  If you say yes here if you use A96T396 for grip.
	  This option enables grip sensors using
	  Above A96T396 device driver for grip.

config SENSORS_A96T396_SUB
	depends on I2C
	tristate "A96T396_SUB driver for grip"
	default n
	help
	  Say Y here if you use A96T396_SUB for grip.
	  This option enables grip sensors using
	  Above A96T396_SUB device driver for grip.

config SENSORS_A96T396_LDO_SHARE
	depends on I2C
	tristate "SENSOR_A96T396_LDO_SHARE driver for grip"
	default n
	help
	  Say Y here if you use SENSOR_A96T396_LDO_SHARE for grip.
	  This option enables grip sensors using
	  Above SENSOR_A96T396_LDO_SHARE device driver for grip.

config SENSORS_A96T396_CRC_CHECK
	bool "check crc check instead of checksum compare"
	default n
	help
	  Say Y here if you use crc check instead of checksum compare

config SENSORS_A96T396_A13X
	depends on I2C
	tristate "SENSORS_A96T396_A13X driver for grip firmware"
	default n
	help
	  Say Y here if you use A13X model grip firmware.

config SENSORS_A96T396_A13X_EUR
	depends on I2C
	tristate "SENSORS_A96T396_A13X_EUR driver for grip firmware"
	default n
	help
	  Say Y here if you use A13X_EUR model grip firmware.

config SENSORS_A96T396_BENZ2
	depends on I2C
	tristate "benz2 driver for grip firmware and 'sensor_core'"
	default n
	help
	Say Y here if you use Benz2 grip firmware.

config SENSORS_A96T396_A13
	depends on I2C
	tristate "for grip sensor firmware of A13_LTE"
	default n
	help
	Say Y here if you use A13_LTE grip firmware.

config SENSORS_A96T396_2CH
	depends on I2C
	tristate "SENSORS_A96T396_2CH driver for grip 2ch"
	default n
	help
	  Say Y here if you use model grip 2ch.

config SENSORS_A96T396_SUB_2CH
	depends on I2C
	tristate "SENSORS_A96T396_SUB_2CH driver for grip sub 2ch"
	default n
	help
	Say Y here if you use model grip_sub 2ch.
```
