## drivers/regulator/samsung/pmic/Kconfig
```kconfig
# SPDX-License-Identifier: GPL-2.0-only
# SAMSUNG PMIC

config DRV_SAMSUNG_PMIC
	tristate "Samsung PMIC common and sysfs system"
	depends on I2C
	help
	 This driver supports a Samsung PMIC sysfs amd common.

config REGULATOR_S2MPS25
	tristate "Samsung S2MPS25 voltage regulator"
	depends on MFD_S2MPS25
	help
	  This driver supports a Samsung S2MPS25 voltage output regulator
	  via I2C bus. S2MPS25 is comprised of high efficient Buck converters
	  including Dual-Phase Buck converter, Buck-Boost converter, various LDOs.

config REGULATOR_S2MPS26
	tristate "Samsung S2MPS26 voltage regulator"
	depends on MFD_S2MPS26
	help
	  This driver supports a Samsung S2MPS26 voltage output regulator
	  via I2C bus. S2MPS26 is comprised of high efficient Buck converters
	  including Dual-Phase Buck converter, Buck-Boost converter, various LDOs.

config REGULATOR_S2MPM07
	tristate "Samsung S2MPM07 voltage regulator"
	depends on MFD_S2MPM07
	help
	  This driver supports a Samsung S2MPM07 voltage output regulator
	  via I2C bus. S2MPM07 is comprised of high efficient Buck converters
	  including Dual-Phase Buck converter, Buck-Boost converter, various LDOs.

config REGULATOR_S2MPB02
	tristate "Samsung S2MPB02 regulator"
	depends on MFD_S2MPB02
	help
	  This driver controls a Samsung S2MPB02 regulator
	  via I2C bus.

config REGULATOR_S2MPB03
	tristate "Samsung S2MPB03 regulator"
	depends on I2C
	help
	  This driver controls a Samsung S2MPB03 regulator
	  via I2C bus.

config REGULATOR_S2DOS05
	tristate "Samsung S2DOS05 regulator"
	depends on I2C
	help
	  This driver controls a Samsung S2DOS05 regulator
	  via I2C bus.

config REGULATOR_S2DPS01
	tristate "Samsung S2DPS01 regulator"
	depends on I2C
	help
	  This driver controls a Samsung S2DPS01 regulator
	  via I2C bus.

config REGULATOR_S2MPS25_9935
	tristate "Samsung S2MPS25 voltage regulator for s5e9935"
	depends on MFD_S2MPS25_9935
	help
	  This driver supports a Samsung S2MPS25 voltage output regulator
	  via I2C bus. S2MPS25 is comprised of high efficient Buck converters
	  including Dual-Phase Buck converter, Buck-Boost converter, various LDOs.

config REGULATOR_S2MPS26_9935
	tristate "Samsung S2MPS26 voltage regulator for s5e9935"
	depends on MFD_S2MPS26_9935
	help
	  This driver supports a Samsung S2MPS26 voltage output regulator
	  via I2C bus. S2MPS26 is comprised of high efficient Buck converters
	  including Dual-Phase Buck converter, Buck-Boost converter, various LDOs.

config REGULATOR_S2MPM07_9935
	tristate "Samsung S2MPM07 voltage regulator for s5e9935"
	depends on MFD_S2MPM07_9935
	help
	  This driver supports a Samsung S2MPM07 voltage output regulator
	  via I2C bus. S2MPM07 is comprised of high efficient Buck converters
	  including Dual-Phase Buck converter, Buck-Boost converter, various LDOs.

config REGULATOR_S2MPA05_9935
	tristate "Samsung S2MPA05 voltage regulator for s5e9935"
	depends on MFD_S2MPA05_9935
	help
	  This driver supports a Samsung S2MPA05 voltage output regulator
	  via I2C bus. S2MPA05 is comprised of high efficient Buck converters
	  including Dual-Phase Buck converter, Buck-Boost converter, various LDOs.

config REGULATOR_S2MPU15_8535
	tristate "Samsung S2MPU15 voltage regulator for s5e8535"
	depends on MFD_S2MPU15_8535
	help
	  This driver supports a Samsung S2MPU15 voltage output regulator
	  via I2C bus. S2MPU15 is comprised of high efficient Buck converters
	  including Dual-Phase Buck converter, Buck-Boost converter, various LDOs.

config REGULATOR_S2MPA05_8535
	tristate "Samsung S2MPA05 voltage regulator for s5e8535"
	depends on MFD_S2MPA05_8535
	help
	  This driver supports a Samsung S2MPA05 voltage output regulator
	  via I2C bus. S2MPA05 is comprised of high efficient Buck converters
	  including Dual-Phase Buck converter, Buck-Boost converter, various LDOs.

config REGULATOR_S2MPB06
	tristate "Samsung S2MPB06 regulator"
	depends on MFD_S2MPB06
	help
	  This driver controls a Samsung S2MPB06 regulator
	  via I2C bus.

config REGULATOR_S2MPU15_8835
	tristate "Samsung S2MPU15 voltage regulator for s5e8835"
	depends on MFD_S2MPU15_8835
	help
	  This driver supports a Samsung S2MPU15 voltage output regulator
	  via I2C bus. S2MPU15 is comprised of high efficient Buck converters
	  including Dual-Phase Buck converter, Buck-Boost converter, various LDOs.

config REGULATOR_S2MPU16_8835
	tristate "Samsung S2MPA05 voltage regulator for s5e8835"
	depends on MFD_S2MPU16_8835
	help
	  This driver supports a Samsung S2MPA05 voltage output regulator
	  via I2C bus. S2MPA05 is comprised of high efficient Buck converters
	  including Dual-Phase Buck converter, Buck-Boost converter, various LDOs.
```

## drivers/rid_adc/Kconfig
```kconfig
#
# RID_ADC devices
#

comment "RID_ADC configs"

config RID_ADC
	bool "Using RID_ADC device driver"
	default n
	help
	  If you say yes here you will get support for
	  the RID device driver.

config PM6150L_RID_ADC
	bool "Using PM6150L_RID_ADC device driver"
	default n
	help
	  If you say yes here you will get support for
	  the PM6150L_RID_ADC device driver.
```

## drivers/rtc/samsung/pmic/Kconfig
```kconfig
# SPDX-License-Identifier: GPL-2.0-only
#
# PMIC RTC class/drivers configuration
#

config RTC_SAMSUNG_PMIC
	tristate "Samsung PMIC COMMON RTC"
	depends on I2C
	help
	  If you say yes here you will get support for the
	  RTC of Samsung PMIC series.
	  This driver can also be built as a module. If so, the module
	  will be called RTC_SAMSUNG_PMIC.

config RTC_DRV_S2MPS25
	tristate "Samsung PMIC S2MPS25 RTC"
	depends on MFD_S2MPS25
	help
	  If you say yes here you will get support for the
	  RTC of Samsung PMIC series.
	  This driver can also be built as a module. If so, the module
	  will be called rtc-s2mps25.

config RTC_DRV_S2MPS25_9935
	tristate "Samsung PMIC S2MPS25 RTC for 9935"
	depends on MFD_S2MPS25_9935
	help
	  If you say yes here you will get support for the
	  RTC of Samsung PMIC series.
	  This driver can also be built as a module. If so, the module
	  will be called s2mps25_rtc_9935.

config RTC_DRV_S2MPU15_8535
	tristate "Samsung PMIC S2MPU15 RTC for 8535"
	depends on MFD_S2MPU15_8535
	help
	  If you say yes here you will get support for the
	  RTC of Samsung PMIC series.
	  This driver can also be built as a module. If so, the module
	  will be called s2mpu15_rtc_8535.

config RTC_DRV_S2MPU15_8835
	tristate "Samsung PMIC S2MPU15 RTC for 8835"
	depends on MFD_S2MPU15_8835
	help
	  If you say yes here you will get support for the
	  RTC of Samsung PMIC series.
	  This driver can also be built as a module. If so, the module
	  will be called s2mpu15_rtc_8835.
```

## drivers/samsung/Kconfig.debug
```kconfig
menu "Samsung Rooting Restriction Feature"

config SEC_RESTRICT_ROOTING
	bool "Samsung Rooting Restriction Feature"
	default n
	help
	  Restrict unauthorized executions with root permission.

config SEC_RESTRICT_SETUID
	bool "Restrict changing root privilege except allowed process"
	depends on SEC_RESTRICT_ROOTING
	default y
	help
	  Say Y here if you want to restrict functions related setuid. Only allowed
	  process can chanage ROOT privilege. Saying N will not restrict changing
	  permission.

config SEC_RESTRICT_FORK
	bool "Restrict forking process except allowed process"
	depends on SEC_RESTRICT_ROOTING
	default y
	help
	  Say Y here if you want to restrict function related fork. Process matched
	  special condition will be not forked. Saying N will not restrict forking
	  process.

config SEC_RESTRICT_ROOTING_LOG
	bool "Print restricted result to kernel log"
	depends on SEC_RESTRICT_ROOTING
	default n
	help
	   Say Y here if you want to see result of restricting SETUID or FORK. It will
	   be displayed by kernel error log. Saying N will not be displayed anything.

endmenu
```

## drivers/samsung/bsp/Kconfig
```kconfig
menu "Samsung Factory Feature"
config SEC_FACTORY
	bool "when it comes to sec factory mode"
	default n
	select SEC_FORCE_ERR
	select EDAC_KYRO_ARM64_PANIC_ON_CE
	help
	  It will support a sec factory mode
endmenu

config SAMSUNG_PRODUCT_SHIP
	bool "set up for product shipping"
	default n

source "drivers/samsung/bsp/class/Kconfig"
source "drivers/samsung/bsp/param/Kconfig"
source "drivers/samsung/bsp/key_notifier/Kconfig"
source "drivers/samsung/bsp/reloc_gpio/Kconfig"
source "drivers/samsung/bsp/sysup/Kconfig"
source "drivers/samsung/bsp/argos/Kconfig"

source "drivers/samsung/bsp/qcom/Kconfig"
```

## drivers/samsung/debug/Kconfig
```kconfig
# drivers/staging/samsung/Kconfig
#
# Copyright (c) 2010-2016 Samsung Electronics Co., Ltd.
#		http://www.samsung.com/
#
# Licensed under GPLv2


menuconfig SEC_DEBUG
	bool "Enable Samsung debugging feature"
	depends on SEC_REBOOT
	default y
	help
	  Samsung TN debugging feature.

config SEC_DEBUG_EXTRA_INFO
	bool "Enable Samsung reset reason extra info"
	depends on SEC_DEBUG
	default y
	help
	  This option enables storing reset reason extra info
	  This option enables ap reset info bigdata based on reset reason extra info

config SEC_DEBUG_HW_PARAM
	bool "Enable Samsung HW PARAM bigdata info"
	depends on SEC_DEBUG && SEC_DEBUG_EXTRA_INFO
	default y
	help
	  This option enables storing hw param bigdata info

config SEC_DEBUG_LAST_KMSG
	bool "Enable /proc/last_kmsg support" if EMBEDDED
	depends on SEC_DEBUG
	default y
	help
	  This option enables /proc/last_kmsg support.

config SEC_DEBUG_AUTO_COMMENT
	bool "Enable Samsung kernel fault auto comment"
	depends on PRINTK
	depends on SEC_DEBUG
	default y
	help
	  This option enables kernel fault auto comment feature.
	  This option also requires bootloader change that enables auto comment
	  extraction along with ramdump.

config SEC_DEBUG_LIMIT_BACKTRACE
	bool "Forcely break infinity backtrace"
	depends on SEC_DEBUG
	default n
	help
	  Forcely break dump_backtrace to avoid infinity backtrace

config SEC_DEBUG_INIT_EXIT_PANIC
	bool "Trigger panic when exiting init task group"
	depends on SEC_DEBUG
	default y
	help
	  This option enables early panic when it attempt to kill init tasks.
	  It may happen before init task stack is destroyed for debugging.

config SEC_DEBUG_SOFTDOG_PWDT
	bool "Enable Soft Watchdog for Platform"
	default y
	depends on WATCHDOG
	select SOFT_WATCHDOG
	help
	  This option enables soft watchdog device and soft_panic.
```

## drivers/samsung/debug/kboot_stat/Kconfig
```kconfig
config SEC_KBOOT_STAT
	tristate "SEC Kernel-Boot-stat driver"
	help
	  TODO: help is not ready.
```

## drivers/samsung/debug/qcom/poweroff/Kconfig
```kconfig
config SEC_QC_MSM_POWEROFF
	tristate "SEC Reboot Commands - Concrete writer using msm-poweroff"
	depends on SEC_QC_RBCMD && POWER_RESET_MSM
	help
	  TODO: help is not ready.
```

## drivers/samsung/misc/Kconfig
```kconfig
# drivers/staging/samsung/Kconfig
#
# Copyright (c) 2010-2016 Samsung Electronics Co., Ltd.
#		http://www.samsung.com/
#
# Licensed under GPLv2

menuconfig SEC_MISC
	bool "Enable Samsung miscellaneous feature"
	depends on SEC_EXT
	default y

config SEC_BOOTSTAT
	bool "Enable Samsung Bootstat logging"
	default y
	depends on SEC_EXT
	help
	  Samsung TN Bootstat Feature.

config SEC_DEVICE_BOOTSTAT
	bool "Enable Samsung Device Bootstat logging"
	default n
	depends on SEC_EXT
	help
	  Samsung TN Device Bootstat Feature.

config SEC_LOG_HOOK_PMSG
	bool "Enable hooking android platform log for ramdump"
	depends on SEC_EXT && PSTORE_PMSG
	default y
	help
	  This option enables hooking android platform log.

config SEC_AVC_LOG
	default n
	bool "Enable avc audit log support" if EMBEDDED
	depends on SEC_EXT
	help
	  This option enables additional log buffer for audit log.

config SEC_NAD
	bool "Samsung TN NAD Feature"
	default n
	depends on SEC_FACTORY
	help
	  Samsung TN NAD Feature, support AT CMD for NAD 2.0

comment "NOTIFIER configs"
config VBUS_NOTIFIER
	bool "VBUS notifier support"
	default n
	help
	  If you say yes here you will get support for
	  the VBUS status change notification.

config CABLE_TYPE_NOTIFIER
	bool "CABLE TYPE notifier support"
	depends on USB_NOTIFIER
	default n
	help
	  If you say yes here you will get support for
	  the CABLE TYPE status change notification.
```

## drivers/samsung/perf/Kconfig
```kconfig
#
# Copyright (c) 2010-2019 Samsung Electronics Co., Ltd.
#		http://www.samsung.com/
#
# Licensed under GPLv2

comment "Samsung Performance Tools"
menuconfig SEC_PERF
	bool "Enable Samsung Debugging features"
	depends on SEC_EXT
	default y

config SEC_BOOTSTAT
	bool "Enable TN Bootstat logging"
	depends on SEC_PERF
	default y

config DELAY_CHECKER
	bool "enable delay checker"
	depends on !SAMSUNG_PRODUCT_SHIP && SEC_PERF
	default n

config SEC_PERF_LATENCYCHECKER
	bool "Enable Samsung latenychecker"
	depends on SEC_PERF
	default n
	help
	  This option enables Samsung Latencychecker.
	  Select the option if the kernel should check latency point.
```

## drivers/samsung/pm/Kconfig
```kconfig
# drivers/samsung/pm/Kconfig
#
# Copyright (c) 2010-2021 Samsung Electronics Co., Ltd.
#		http://www.samsung.com/
#
# Licensed under GPLv2
#
comment "Samsung Mobile Power Management Options"
menuconfig SEC_PM
	bool "Samsung Mobile Power Management"
	default n
	help
	  This option enables support for various drivers and features for
	  Samsung Mobile Power Management.

config SEC_PM_DEBUG
	tristate "Enable Samsung Mobile Power management debug support"
	default n
	depends on SEC_PM
	help
	  This option enables Samsung Mobile Power management debug support.
	  Intended for test and debug only.
```

## drivers/samsung/quest/Kconfig
```kconfig
config SEC_QUEST
	bool "Samsung QUEST Feature"
	default n
	depends on SEC_FACTORY
	help
	  Samsung QUEST Feature, to test chipset quality

config SEC_QUEST_UEFI
	bool "Samsung QUEST UEFI Feature"
	default n
	depends on SEC_FACTORY
	help
	  Samsung QUEST UEFI Feature, to test chipset quality	  

config SEC_QUEST_UEFI_ENHENCEMENT
	bool "Samsung QUEST UEFI ENHENCEMENT Feature"
	default n
	depends on SEC_FACTORY
	help
	  Samsung QUEST UEFI ENHENCEMENT Feature, to test chipset quality

config SEC_SKP
	bool "Samsung SKP Feature"
	default n
	help
	  Samsung SKP Feature, to test chipset quality	
```

## drivers/samsung/startup_reason/Kconfig
```kconfig
config STARTUP_REASON 
	bool "Startup reason"
	default n
	help
	  Say Y here to enable startup class support. 
```
