## drivers/sensor/Kconfig
```kconfig
menu "Sensor support"

config SENSORS
	bool "Support for sensors"
	help
	  Say Y here to add support for accelerometer sensors

if SENSORS

config SENSORS_GP2A
        tristate "Sharp GP2AP002A00F I2C Proximity/Opto sensor driver"
        depends on I2C
        help
	  Say Y here if you have a Sharp GP2AP002A00F proximity/als combo-chip
	  hooked to an I2C bus.
	  To compile this driver as a module, choose M here: the
	  module will be called gp2ap002a00f.
 
config SENSORS_BMA2X2
	tristate "BMA255/BMA250E/BMA222E/BMA280 acceleration sensor support"
	depends on I2C
	help
	  If you say yes here you get support for Bosch Sensortec's
	  acceleration sensors BMA255/BMA250E/BMA222E/BMA280.

config SENSORS_BMM050
	tristate "BMM050 Magnetic Sensor Driver"
	depends on I2C
	help
	 BMM050 Magnetic Sensor Driver implemented by Bosch-Sensortec.

config SENSORS_K2HH
        depends on I2C
        tristate "SENSORS_K2HH"
        default n
        help
          Say Y here if you use SENSORS_K2HH.
          This option enables accelerometer sensors using
          STMicroelectronic K2HH device driver.

config SENSORS_GP2A002
	tristate "GP2A002 proximity sensor support"
	depends on I2C
	default n
	help
	  If you say yes here you get support for sharp Sensortec's
	  proximity sensors GP2A002.

config SENSORS_CM36672P
	depends on I2C
	tristate "CM36672P driver"
	default n
	help
	  This option enables proximity sensor using CM36672P driver.

config SENSORS_EMUL_I2C
        tristate "Sensor module different HW version support"
        depends on I2C
        default n
        help
          Support gpio emulator i2c for sensor module different HW version

config SENSORS_SX9500
	depends on I2C
	tristate "SX9500 driver"
	default n
	help
	  Say Y here if you use sx9500.
	  This option enables grip sensors using
	  SemTech sx9500 device driver.

	  Say N here if you do not use sx9500.

config SENSORS_GRIP_ADJDET
	depends on I2C
	tristate "GRIP sensor adj cable detect"
	default n
	help
	  GRIP sensor adj cable detect

config SENSORS_SX9500_REGULATOR_ONOFF
	tristate "GRIP sensor regulator onoff function"
	default n
	help
	  GRIP sensor regulator onoff

config SENSORS_SX9500_INIT_TOUCH_THRESHOLD
	int "SX9500 Grip sensor threshold for init touch"
	depends on SENSORS_SX9500
	default "3000"
	help
	  This value is the standard of init touch using
	  SemTech sx9500 device driver.

config SENSORS_SX9500_NORMAL_TOUCH_THRESHOLD
	int "SX9500 Grip sensor threshold for normal touch"
	depends on SENSORS_SX9500
	default "17"
	help
	  This value is the standard of normal touch using
	  SemTech sx9500 device driver.

config SENSORS_BMA254
	tristate "BMA254 acceleration sensor support"
	depends on I2C
	default n
	help
		If you say yes here you get support for Bosch Sensortec's
		acceleration sensors BMA254.

config SENSORS_POWERCONTROL
	tristate "Sensors power control"
	default n
	help
		Say Y here to control power supply for drivers.

config BMA254_SMART_ALERT
	depends on I2C
	tristate "bma254 smart alert"
	default n
	help
		This option enables bma254 smart alert function.

config INPUT_BMA2x2_ACC_ALERT_INT
	tristate "BMA255/BMA250E/BMA222E/BMA280 acceleration sensor support"
	depends on I2C=y
	help
		If you say yes here you get support for Bosch Sensortec's
		acceleration sensors BMA255/BMA250E/BMA222E/BMA280.

config SEC_USE_DEVICE_NODE_NAME
	bool "Use device node name"
	default n
	help
	  Say Y here to set name of input device node instead of number.

endif
endmenu
```

## drivers/sensorhub/Kconfig
```kconfig
config SENSORS_SSP
	tristate "Sensors ssp"
	default n
	help
	  ssp driver for sensor hub.
          If you say yes here you get ssp support for
	  sensor hub.
	  To compile this driver as a module, choose M here: the
	  module will be called ssp.

config SSP_ENG_DEBUG
	tristate "sensor hub eng debug mode"
	default n
	help
	  If you want to use eng debug mode for sensor hub, it should be set.

config SENSORS_SSP_FIRMWARE_DOWNLOAD
	tristate "Sensor hub firmware download"
	default y
	help
	  ssp driver for sensor hub.
          If you say yes here you download firmware of
	  sensor hub.
	  To compile this driver as a module, choose M here: the
	  module will be called ssp.

config SSP_PM_WAKEUP_LINUX_VER_5_4
	tristate "pm wakeup linux version 5.4"
	default n
	help
	  ssp driver for sensor hub.
          If you say yes here, the code of pm_wakeup is applied over linux version 5.4.
	  To compile this driver as a module, choose M here: the
	  module will be called ssp.

config SSP_SUPPORT_SPU_FW
	tristate "support spu firmware"
	default n
	depends on SENSORS_SSP_FIRMWARE_DOWNLOAD

config SENSORS_SSP_DUMP
	tristate "support ssp dump"
	default y

config SENSORS_SSP_A71X
	tristate "Sensors ssp a71x"
	default n
	help
	  If you want to use sensor hub for a71x project, it should be set.

config SENSORS_SSP_A51X
	tristate "Sensors ssp a51x"
	default n
	help
	  If you want to use sensor hub for a51x project, it should be set.

config SENSORS_SSP_A41SX
	tristate "Sensors ssp a41sx"
	default n
	help
	  If you want to use sensor hub for a41sx project, it should be set.

#
# grip sensors configuration
#

config SENSORS_SX9360
	depends on I2C
	tristate "SX9360 driver"
	default n
	help
	  Say Y here if you use sx9360.
	  This option enables grip sensors using
	  SemTech sx9360 device driver.
	  Say N here if you do not use sx9360.

config SENSORS_SX9360_SUB
	depends on I2C
	tristate "SX9360 sub driver"
	default n
	help
	  Say Y here if you use sx9360 sub.
	  This option enables grip sensors using
	  SemTech sx9360 sub device driver.
	  Say N here if you do not use sx9360 sub.

config SENSORS_SX9364
	depends on I2C
	tristate "SX9364 driver"
	default n
	help
	  Say Y here if you use sx9364.
	  This option enables grip sensors using
	  SemTech sx9360 device driver.
	  Say N here if you do not use sx9364.

config SENSORS_SX9364_SUB
	depends on I2C
	tristate "SX9364_SUB driver"
	default n
	help
	  Say Y here if you use sx9364_sub.
	  This option enables grip sensors using
	  SemTech sx9364_sub device driver.
	  Say N here if you do not use sx9364_sub.


config SENSORS_DUMP_DATA
	tristate "Grip sensor dump log"
	default n
	help
	  Enable grip dump log data
	  This option activates log output of grip error data using sensordump_notifier.

config SENSORS_GRIP_FAILURE_DEBUG
	bool "Grip failure debug"
	help
	  Say Y here, Enable Grip failure debug flag.
```

## drivers/sensorhub/accelerometer/Kconfig
```kconfig
#
# sensor drivers configuration
#

config SENSORS_SSP_ACCELOMETER
	tristate "Sensors ssp accelometer sensor"
	default n
	depends on SPI
	help
	  accelerometer sensor file for factory test in ssp driver.
          If you say yes here you get accelerometer sensor support for
	  factory test.
	  To compile this driver as a module, choose M here: the
	  module will be called ssp.

config SENSORS_SSP_ACCELOMETER_ICM42605M
	tristate "Sensors ssp accelometer sensor icm42605m"
	default n
	depends on SPI
	help
	  accelerometer sensor icm42605m file for factory test in ssp driver.
          If you say yes here you get accelerometer sensor icm42605m support for
	  factory test.
	  To compile this driver as a module, choose M here: the
	  module will be called ssp.

config SENSORS_SSP_ACCELOMETER_ICM42632M
	tristate "Sensors ssp accelometer sensor icm42632m"
	default n
	depends on SPI
	help
	  accelerometer sensor icm42632m file for factory test in ssp driver.
          If you say yes here you get accelerometer sensor icm42632m support for
	  factory test.
	  To compile this driver as a module, choose M here: the
	  module will be called ssp.

config SENSORS_SSP_ACCELOMETER_LSM6DSL
	tristate "Sensors ssp accelometer sensor lsm6dsl"
	default n
	depends on SPI
	help
	  accelerometer sensor lsm6dsl file for factory test in ssp driver.
          If you say yes here you get accelerometer sensor lsm6dsl support for
	  factory test.
	  To compile this driver as a module, choose M here: the
	  module will be called ssp.

config SENSORS_SSP_ACCELOMETER_K6DS3TR
	tristate "Sensors ssp accelometer sensor k6ds3tr"
	default n
	depends on SPI
	help
	  accelerometer sensor k6ds3tr file for factory test in ssp driver.
          If you say yes here you get accelerometer sensor k6ds3tr support for
	  factory test.
	  To compile this driver as a module, choose M here: the
	  module will be called ssp.

config SENSORS_SSP_ACCELOMETER_LIS2DLC12
	tristate "Sensors ssp accelometer sensor lis2dlc12"
	default n
	depends on SPI
	help
	  accelerometer sensor lis2dlc12 file for factory test in ssp driver.
          If you say yes here you get accelerometer sensor lis2dlc12 support for
	  factory test.
	  To compile this driver as a module, choose M here: the
	  module will be called ssp.
```

## drivers/sensorhub/atmel/Kconfig
```kconfig
#
# sensor drivers configuration
#
config SENSORS_SYSFS
	tristate "Sensors sysfs"
	help
	  Support sysfs for sensors.
          If you say yes here you get sysfs support for
	  sensor factory test.
	  To compile this driver as a module, choose M here: the
	  module will be called sensors_core.

config SENSORS_SSP
	tristate "Sensors ssp"
	default n
	depends on SPI
	help
	  ssp driver for sensor hub.
          If you say yes here you get ssp support for
	  sensor hub.
	  To compile this driver as a module, choose M here: the
	  module will be called ssp.

config SENSORS_SSP_SENSORHUB
	tristate "Sensors ssp sensorhub"
	default n
	depends on SPI
	help
	  ssp sensor hub driver for sensor hub.
          If you say yes here you get ssp support for
	  sensor hub.
	  To compile this driver as a module, choose M here: the
	  module will be called ssp.

config SENSORS_SSP_FACTORY
	tristate "ssp factory"
	depends on SENSORS_SSP
	default n
	help
	  ssp sensor hub driver for factory test.
          If you say yes here you can enable fatory drvier for
	  factory test.
	  To compile this driver as a module, choose M here: the
	  module will be called ssp.

config SENSORS_MAX86900
	tristate "MAXIM MAX86900 HRM Sensor"
	default n
	depends on I2C && SYSFS
	help
	  If you say yes here you get support for the MAX86900
	  HRM sensor.
	  This driver can also be built as a module.  If so, the module
	  will be called max86900.

config SENSORS_MAX86902
	tristate "MAXIM MAX86902 UV HRM Sensor"
	default n
	depends on I2C
	help
	  If you say yes here you get support for the MAX86902
	  HRM sensor & uv sensor.
	  This driver can also be built as a module.  If so, the module
	  will be called MAX86902.

config SENSORS_ADPD142
	depends on I2C
	tristate "ADI hrm sensor driver"
	default n
	help
	  This option enables hrm sensors using adpd142 driver.

config SWI2C_MAX86902
	depends on I2C
	tristate "using Software I2C"
	default n
	help
	  This option enables the max86902 using software I2C.
	  
config SENSOR_SSP_PROXIMTY_FOR_WINDOW_TYPE
	tristate "PROXIMITY THRESHOLD FOR WINDOW_TYPE"
	default n
	depends on SPI
	help
	  If you say yes here you get support for the proximity threshold
	  This threshold is changed by window type.

config SENSORS_SSP_DIRECTION_EXCEPTION
	tristate "ssp direction exception"
	default n
	depends on SPI
	help
	  ssp sensor hub check direction exception.
	  If you say yes here you enable this routine.

config SENSORS_SSP_ENG
	tristate "ssp eng binary"
	default n
	depends on SPI
	help
	  ssp sensor hub check binary mode
	  If you say yes here you enable this routine.

config SENSORS_SX9306
	depends on I2C
	tristate "SX9306 driver"
	default n
	help
	  Say Y here if you use sx9306.
	  This option enables grip sensors using
	  SemTech sx9306 device driver.

	  Say N here if you do not use sx9306.

config SENSORS_SX9306_INIT_TOUCH_THRESHOLD
	int "SX9306 Grip sensor threshold for init touch"
	depends on SENSORS_SX9306
	default "3000"
	help
	  This value is the standard of init touch using
	  SemTech sx9306 device driver.

config SENSORS_SX9306_NORMAL_TOUCH_THRESHOLD
	int "SX9306 Grip sensor threshold for normal touch"
	depends on SENSORS_SX9306
	default "17"
	help
	  This value is the standard of normal touch using
	  SemTech sx9306 device driver.

config SENSORS_SX9306_TEMPERATURE_COMPENSATION
	depends on SENSORS_SX9306
	tristate "SX9306 Grip sensor temperature compensation"
	default n
	help
	  Say Y here if you use temperature compensation code.
	  This option enables grip sensors using
	  temperature compensation code.

config SENSORS_GRIP_SIMDET
	depends on SENSORS_SX9306
	tristate "SX9306 Grip sensor Simcard detect code"
	default n
	help
	  Say Y here if you use sim card detect code for grip sensor.
	  This option enables grip sensors using
	  sim card detect code for grip sensor

source "drivers/sensorhub/atmel/factory/Kconfig"
source "drivers/sensorhub/atmel/max_notchfilter/Kconfig"
```

## drivers/sensorhub/atmel/factory/Kconfig
```kconfig
#
# sensor drivers configuration
#
config SENSORS_SSP_LPS25H
	tristate "Sensors ssp lps25h"
	default n
	depends on SPI
	help
	  lps25h file for factory test in ssp driver.
          If you say yes here you get lps25h support for
	  factory test.
	  To compile this driver as a module, choose M here: the
	  module will be called ssp.

config SENSORS_SSP_BMI058
	tristate "Sensors ssp bmi058"
	default n
	depends on SPI
	help
	  bmi058 file for factory test in ssp driver.
          If you say yes here you get bmi058 support for
	  factory test.
	  To compile this driver as a module, choose M here: the
	  module will be called ssp.

config SENSORS_SSP_BMI160
	tristate "Sensors ssp bmi160"
	default n
	depends on SPI
	help
	  bmi160 file for factory test in ssp driver.
          If you say yes here you get bmi160 support for
	  factory test.
	  To compile this driver as a module, choose M here: the
	  module will be called ssp.

config SENSORS_SSP_MPU6500
	tristate "Sensors ssp mpu6500"
	default n
	depends on SPI
	help
	  mpu6500 file for factory test in ssp driver.
          If you say yes here you get mpu6500 support for
	  factory test.
	  To compile this driver as a module, choose M here: the
	  module will be called ssp.

config SENSORS_SSP_ICM20610
	tristate "Sensors ssp icm20610"
	default n
	depends on SPI
	help
	  icm20610 file for factory test in ssp driver.
          If you say yes here you get icm20610 support for
	  factory test.
	  To compile this driver as a module, choose M here: the
	  module will be called ssp.

config SENSORS_SSP_ATUC128L5HAR
	tristate "Sensors ssp atuc128l5har"
	default n
	depends on SPI
	help
	  atuc128l5har file for factory test in ssp driver.
          If you say yes here you get atuc128l5har support for
	  factory test.
	  To compile this driver as a module, choose M here: the
	  module will be called ssp.

config SENSORS_SSP_TMG399X
	tristate "Sensors ssp tmg399x"
	default n
	depends on SPI
	help
	  max88005 file for factory test in ssp driver.
          If you say yes here you get tmg399x support for
	  factory test.
	  To compile this driver as a module, choose M here: the
	  module will be called ssp.

config SENSORS_SSP_MOBEAM
	tristate "Sensors ssp mobeam"
	default n
	depends on SPI
	help
	  mobeam file for ssp driver.
          If you say yes here you get mobeam support using TMG399x.
	  To compile this driver as a module, choose M here: the
	  module will be called ssp.

config SENSORS_SSP_YAS532
	tristate "Sensors ssp yas532"
	default n
	depends on SPI
	help
	  yas532 file for factory test in ssp driver.
          If you say yes here you get yas532 support for
	  factory test.
	  To compile this driver as a module, choose M here: the
	  module will be called ssp.

config SENSORS_SSP_AK09911C
	tristate "Sensors ssp ak09911c"
	default n
	depends on SPI
	help
	  ak09911c file for factory test in ssp driver.
          If you say yes here you get ak09911c support for
	  factory test.
	  To compile this driver as a module, choose M here: the
	  module will be called ssp.
```
