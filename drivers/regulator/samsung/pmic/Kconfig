## drivers/sensorhub/barometer/Kconfig
```kconfig
#
# sensor drivers configuration
#

config SENSORS_SSP_BAROMETER
	tristate "Sensors ssp barometer sensor"
	default n
	depends on SPI
	help
	  barometer sensor file for factory test in ssp driver.
          If you say yes here you get barometer sensor support for
	  factory test.
	  To compile this driver as a module, choose M here: the
	  module will be called ssp.

config SENSORS_SSP_BAROMETER_LPS22H
	tristate "Sensors ssp barometer lps22hb"
	default n
	depends on SPI
	help
	  barometer lps22hb file for factory test in ssp driver.
          If you say yes here you get barometer lps22hb support for
	  factory test.
	  To compile this driver as a module, choose M here: the
	  module will be called ssp.

config SENSORS_SSP_BAROMETER_LPS25H
	tristate "Sensors ssp barometer lps25h"
	default n
	depends on SPI
	help
	  barometer lps25h file for factory test in ssp driver.
          If you say yes here you get barometer lps25h support for
	  factory test.
	  To compile this driver as a module, choose M here: the
	  module will be called ssp.

config SENSORS_SSP_BAROMETER_LPS22HH
	tristate "Sensors ssp barometer lps22hh"
	default n
	depends on SPI
	help
	  barometer lps22hh file for factory test in ssp driver.
          If you say yes here you get barometer lps22hh support for
	  factory test.
	  To compile this driver as a module, choose M here: the
	  module will be called ssp.
```

## drivers/sensorhub/debug/Kconfig
```kconfig
config SHUB_DEBUG
	tristate "sensor hub debug mode"
	default y
	help
	  If you want to use debug mode for sensor hub, it should be set.
#it have to modify before official submit to "n"

config SHUB_DUMP
	tristate "support ssp dump"
	default n
```

## drivers/sensorhub/magnetic/Kconfig
```kconfig
#
# sensor drivers configuration
#

config SENSORS_SSP_MAGNETIC
	tristate "Sensors ssp magnetic sensor"
	default n
	depends on SPI
	help
	  magnetic sensor file for factory test in ssp driver.
          If you say yes here you get magnetic sensor support for
	  factory test.
	  To compile this driver as a module, choose M here: the
	  module will be called ssp.

config SENSORS_SSP_MAGNETIC_AK09918C
	tristate "Sensors ssp magnetic sensor ak09918c"
	default n
	depends on SPI
	help
	  magnetic sensor ak09918c file for factory test in ssp driver.
          If you say yes here you get magnetic sensor ak09918c support for
	  factory test.
	  To compile this driver as a module, choose M here: the
	  module will be called ssp.

config SENSORS_SSP_MAGNETIC_AK09916C
	tristate "Sensors ssp magnetic sensor ak09916c"
	default n
	depends on SPI
	help
	  magnetic sensor ak09916c file for factory test in ssp driver.
          If you say yes here you get magnetic sensor ak09916c support for
	  factory test.
	  To compile this driver as a module, choose M here: the
	  module will be called ssp.

config SENSORS_SSP_MAGNETIC_LSM303AH
	tristate "Sensors ssp magnetic sensor lsm303ah"
	default n
	depends on SPI
	help
	  magnetic sensor lsm303ah file for factory test in ssp driver.
          If you say yes here you get magnetic sensor lsm303ah support for
	  factory test.
	  To compile this driver as a module, choose M here: the
	  module will be called ssp.

config SENSORS_SSP_MAGNETIC_MMC5603
	tristate "Sensors ssp magnetic sensor mmc5603"
	default n
	depends on SPI
	help
	  magnetic sensor mmc5603 file for factory test in ssp driver.
          If you say yes here you get magnetic sensor mmc5603 support for
	  factory test.
	  To compile this driver as a module, choose M here: the
	  module will be called ssp.

config SENSORS_SSP_MAGNETIC_YAS539
	tristate "Sensors ssp magnetic sensor yas539"
	default n
	depends on SPI
	help
	  magnetic sensor yas539 file for factory test in ssp driver.
          If you say yes here you get magnetic sensor yas539 support for
	  factory test.
	  To compile this driver as a module, choose M here: the
	  module will be called ssp.
```

## drivers/sensorhub/proximity/Kconfig
```kconfig
#
# sensor drivers configuration
#

config SENSORS_SSP_PROXIMITY
	tristate "Sensors ssp proximity sensor"
	default n
	depends on SPI
	help
	  proximity sensor file for factory test in ssp driver.
	  If you say yes here you get proximity sensor support for
	  factory test.
	  To compile this driver as a module, choose M here: the
	  module will be called ssp.

config SENSORS_SSP_PROXIMITY_AUTO_CAL_TMD3725
	tristate "Sensors ssp proximity auto cal tmd3725"
	default n
	help
	  proximity tmd3725 file for factory test in ssp driver.
	  If you say yes here you get proximity tmd3725 support for
	  factory test.
	  To compile this driver as a module, choose M here: the
	  module will be called ssp.

config SENSORS_SSP_PROXIMITY_STK3X3X
	tristate "Sensors ssp proximity stk3x3x"
	default n
	help
	  proximity stk3x3x file for factory test in ssp driver.
	  If you say yes here you get proximity stk3x3x support for
	  factory test.
	  To compile this driver as a module, choose M here: the
	  module will be called ssp.

config SENSORS_SSP_PROXIMITY_STK3X6X
	tristate "Sensors ssp proximity stk3x6x"
	default n
	help
	  proximity stk3x6x file for factory test in ssp driver.
	  If you say yes here you get proximity stk3x6x support for
	  factory test.
	  To compile this driver as a module, choose M here: the
	  module will be called ssp.

config SENSORS_SSP_PROXIMITY_GP2AP110S
	tristate "Sensors ssp proximity gp2ap110s"
	default n
	help
	  proximity gp2ap110s file for factory test in ssp driver.
	  If you say yes here you get proximity gp2ap110s support for
	  factory test.
	  To compile this driver as a module, choose M here: the
	  module will be called ssp.

config SENSORS_SSP_PROXIMITY_STK3A5X
	tristate "Sensors ssp proximity stk3a5x"
	default n
	help
	  proximity stk3a5x file for factory test in ssp driver.
	  If you say yes here you get proximity stk3a5x support for
	  factory test.
	  To compile this driver as a module, choose M here: the
	  module will be called ssp.

config SENSORS_SSP_PROXIMITY_STK3328
	tristate "Sensors ssp proximity stk3328"
	default n
	help
	  proximity stk3328 file for factory test in ssp driver.
	  If you say yes here you get proximity stk3328 support for
	  factory test.
	  To compile this driver as a module, choose M here: the
	  module will be called ssp.

config SENSORS_SSP_PROXIMITY_FACTORY_CAL_THRESH
	tristate "Sensors ssp proximity threshold factory cal"
	default n
	help
	  If you say yes here you get threshold factory cal support for
	  factory test.
	  To compile this driver as a module, choose M here: the
	  module will be called ssp.

config SENSORS_SSP_PROXIMITY_FACTORY_CAL_OFFSET
	tristate "Sensors ssp proximity offset factory cal"
	default n
	help
	  If you say yes here you get offset factory cal support for
	  factory test.
	  To compile this driver as a module, choose M here: the
	  module will be called ssp.
```

## drivers/sensorhub/stm/factory/Kconfig
```kconfig
#
# sensor drivers configuration
#

config SENSORS_SSP_ATUC128L5HAR
	tristate "Sensors ssp atuc128l5har"
	default n
	depends on SPI
	help
	  atuc128l5har file for factory test in ssp driver.
          If you say yes here you get atuc128l5har support for
	  factory test.
	  To compile this driver as a module, choose M here: the
	  module will be called ssp.

config SENSORS_SSP_MPU6500
	tristate "Sensors ssp mpu6500"
	default n
	depends on SPI
	help
	  mpu6500 file for factory test in ssp driver.
          If you say yes here you get mpu6500 support for
	  factory test.
	  To compile this driver as a module, choose M here: the
	  module will be called ssp.

config SENSORS_SSP_BMP280
	tristate "Sensors ssp bmp280"
	default n
	depends on SPI
	help
	  bmp182 file for factory test in ssp driver.
          If you say yes here you get bmp280 support for
	  factory test.
	  To compile this driver as a module, choose M here: the
	  module will be called ssp.

config SENSORS_SSP_LPS25H
        tristate "Sensors ssp lps25h"
        default n
        depends on SPI
        help
          lps25h file for factory test in ssp driver.
          If you say yes here you get lps25h support for
          factory test.
          To compile this driver as a module, choose M here: the
          module will be called ssp.

config SENSORS_SSP_TMG399X
	tristate "Sensors ssp tmg399x"
	default n
	depends on SPI
	help
	  tmd4903 file for factory test in ssp driver.
          If you say yes here you get tmd4903 support for
	  factory test.
	  To compile this driver as a module, choose M here: the
	  module will be called ssp.

config SENSORS_SSP_MOBEAM
	tristate "Sensors ssp mobeam"
	default n
	depends on SPI
	help
	  mobeam file for ssp driver.
          If you say yes here you get mobeam support using TMG399x.
	  To compile this driver as a module, choose M here: the
	  module will be called ssp.
```

## drivers/sensorhub/stm32f/Kconfig
```kconfig
#
# sensor drivers configuration
#

config SENSORS_SSP
	tristate "Sensors ssp"
	default n
	depends on SPI
	help
	  ssp driver for sensor hub.
          If you say yes here you get ssp support for
	  sensor hub.
	  To compile this driver as a module, choose M here: the
	  module will be called ssp.

config SENSORS_SSP_STM32f
	tristate "Sensors ssp stm32f410"
	default n
	depends on SPI
	help
	  ssp driver for sensor hub.
          If you say yes here you get ssp support for
	  sensor hub.
	  To compile this driver as a module, choose M here: the
	  module will be called ssp.

config SENSORS_SX9320
	depends on I2C
	tristate "SX9320 driver"
	default n
	help
	  Say Y here if you use sx9320.
	  This option enables grip sensors using
	  SemTech sx9320 device driver.
	  Say N here if you do not use sx9320.

source "drivers/sensorhub/stm32f/factory/Kconfig"
source "drivers/sensorhub/stm32f/max_notchfilter/Kconfig"
```
