## drivers/staging/nanohub/Kconfig
```kconfig
config NANOHUB
	tristate "Nanohub"
	default N
	select IIO
	help
	  Enable support for the nanohub sensorhub driver.

	  This driver supports the android nanohub sensorhub.

	  If in doubt, say N here.

if NANOHUB

config NANOHUB_MAILBOX
	bool "Nanohub Mailbox"
	default Y
	help
	  Enable nanohub Mailbox support.

	  Either this or NANOHUB_MAILBOX should be selected.

	  If in doubt, say N here.

config SENSOR_DRV
	bool "Sensor driver to support exynos sensor Hal"
	default N
	help
	  Enable sensorhub hal support.

config CONTEXTHUB_DEBUG
	bool "Nanohub debug"
	default N
	help
	  Enable nanohub device debug message

config CONTEXTHUB_SENSOR_DEBUG
	bool "Nanohub sensor debug"
	default N
	help
	  Enable nanohub seneor alive check

endif # NANOHUB
```

## drivers/staging/samsung/Kconfig
```kconfig
# drivers/staging/samsung/Kconfig
#
# Copyright (c) 2010-2011 Samsung Electronics Co., Ltd.
#		http://www.samsung.com/
#
# Licensed under GPLv2

comment "Samsung TN Features"
menuconfig SEC_EXT
	bool "Samsung TN extension Feature"

config SEC_SYSFS
	bool "Samsung sec sysfs Feature"
	depends on SEC_EXT
	default y

config SEC_FD_DETECT
	bool "Detect a file descriptor invalid closer"
	depends on SEC_EXT
	default n
```

## drivers/staging/sec-libs/Kconfig
```kconfig
# drivers/staging/sec-libs/Kconfig
#
# Copyright (C) 2013-2015 Samsung Electronics Co, Ltd.
#
# This software is licensed under the terms of the GNU General Public
# License version 2, as published by the Free Software Foundation, and
# may be copied, distributed, and modified under those terms.
#
# This program is distributed in the hope that it will be useful,
# but WITHOUT ANY WARRANTY; without even the implied warranty of
# MERCHANTABILITY or FITNESS FOR A PARTICULAR PURPOSE.  See the
# GNU General Public License for more details.
#

comment "SEC Debug Feature"
config SEC_DEBUG
	bool "Enable SEC DEBUG"
	default n

if SEC_DEBUG
config SEC_BSP
	bool "Samsung BSP Feature"
	default n
	help
	  Samsung BSP Feature.

config SEC_DEBUG_SCHED_LOG
	bool "Samsung Scheduler Logging Feature"
	default n
	help
	  Samsung Scheduler Logging Feature for Debug use.

config SEC_DEBUG_SCHED_LOG_NONCACHED
    bool "Samsung Scheduler log for non cache"
	default n
	depends on SEC_DEBUG_SCHED_LOG

config SEC_DEBUG_TIMER_LOG
	bool "Samsung Timer Logging Feature"
	default n
	help
	  Samsung Timer Logging Feature for Debug use.

config SEC_LOG
	bool "Samsung log buffer"
	default n

config SEC_LOG_BUF_NOCACHE
	bool "samsung log buf for cache type"
	depends on SEC_LOG
	default n
	
config SEC_LOG_LAST_KMSG
	bool "Samsung Use Sec Log Last Kmsg"
	depends on SEC_LOG
	default n
	help
	  This feature creats a node to read contents of sec_log_buf
	  area just before booting into kernel from bootloader.
	  This is very helpful to read sec_log_buf area without reset
	  or entering upload mode.

config SEC_DEBUG_USER
	bool "Enable user options"
	default n

config SEC_DEBUG_REG_ACCESS
	bool "Samsung reg access debugging"
	default n

config SEC_DEBUG_CORESIGHT
	bool "Samsung feature to control coresight registers"
	default n
endif
```

## drivers/staging/sec_irled/Kconfig
```kconfig
#
# IR_LED
#
config SEC_IRLED
	bool "SEC IrLED driver"
	depends on I2C
	default n
	help
		Say Y here to enable the SEC IrLED driver using AVOV MC96 IC.
```

## drivers/staging/sprd/sipa_delegate/Kconfig
```kconfig
menu "SIPA delegate modules"
config SPRD_SIPA_DELEGATE
	bool "Enable delegate for modem side sipa"
	default n
	depends on SPRD_SIPA || SPRD_SIPA_V3
	help
	  This option enables delegate for modem side sipa.

config SPRD_SIPA_DELE_MINIAP_IN_AP
	bool "Enable sipa delegate for mini ap in ap side"
	default n
	depends on SPRD_SIPA_DELEGATE
	help
	  This option enables a sipa delegate featrue in ap side.
	  And this option enables ap to create a delegatro for mini ap.

config SPRD_SIPA_DELE_AP_IN_MINIAP
	bool "Enable sipa delegate for ap in mini ap side"
	default n
	depends on SPRD_SIPA_DELEGATE
	help
	  This option enables a sipa delegate featrue in mini ap side.
	  And this option enables ap to create a delegatro for ap.

config SPRD_SIPA_DELE_THIRD_IN_MINIAP
	bool "Enable sipa delegate for third ap in mini ap side"
	default n
	depends on SPRD_SIPA_DELEGATE
	help
	  This option enables a sipa delegate featrue in mini ap side.
	  And this option enables ap to create a delegatro for ap.

	  When orca is equipped with a third-party AP, you need to
	  open the resource agent of this feature on the orca side
	  in order to control the power on and off of ipa.

config SPRD_SIPA_DELE_CP_IN_MINIAP
	bool "Enable sipa delegate for cp in mini ap side"
	default n
	depends on SPRD_SIPA_DELEGATE
	help
	  This option enables a sipa delegate featrue in mini ap side.
	  And this option enables ap to create a delegatro for cp.

config SPRD_SIPA_DELE_CP_IN_AP
	bool "Enable sipa delegate for cp in ap side"
	default n
	depends on SPRD_SIPA_DELEGATE
	help
	  This option enables a sipa delegate featrue in ap side.
	  And this option enables ap to create a delegator for cp.
endmenu
```
