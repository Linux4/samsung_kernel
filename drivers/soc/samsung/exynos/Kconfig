## drivers/soc/samsung/exynos/Kconfig
```kconfig
# SPDX-License-Identifier: GPL-2.0-only
#
# Samsung SoC drivers
#

source "drivers/soc/samsung/exynos/debug/Kconfig"
source "drivers/soc/samsung/exynos/exynos-hdcp/Kconfig"

config EXYNOS_MEMORY_LOGGER
	tristate "Exynos Memory Logger"
	default n
	help
	  Exynos Memory Logger API is provided by memlog driver.

	  Memlog means exynos memory Logger driver. The memlog provides
	  the logging method desired by each driver in memory for debugging,
	  memlog provides APIs for memory logging.

config EXYNOS_IMGLOADER
	tristate "Exynos Image Loader"
	default n
	help
	  Enable Image Loader for Exynos SoC.

config EXYNOS_SYSTEM_EVENT
	tristate "Exynos System Event Framework"
	default n
	help
	  Enable System Event Framework for Exynos SoC.

config EXYNOS_EL2
	tristate "Exynos EL2 Solution"
	depends on ARCH_EXYNOS
	help
	  Exynos EL2 Solution has implemented Stage 2
	  MMU and IOMMU.

config EXYNOS_S2MPU
        tristate "Exynos Stage 2 Memory Protection Unit(S2MPU)"
	depends on EXYNOS_EL2
        help
          Exynos S2MPU driver to set S2MPU access permission.

config EXYNOS_S2MPU_PD
	bool "Exynos S2MPU PM domain support"
	depends on EXYNOS_S2MPU
	default y
	help
	  Backup and restore S2MPU when PM domains
	  turn on and off.

config EXYNOS_SDM
	tristate "Exynos Security Dump Manager Support"
	depends on DEBUG_SNAPSHOT
	default m
	help
	  Exynos Security Dump Manager

config EXYNOS_CRYPTOMANAGER
	tristate "Exynos Samsung CryptoManager"
	default m
	help
	  Support Exynos Samsung CryptoManager

config EXYNOS_CHIPID_V2
	tristate "Exynos Chipid controller driver v2"
	depends on ARCH_EXYNOS
	help
	  Exynos chipid V2 driver.
	  Support newly added soc chipid.

config EXYNOS_TZASC_FAIL_DETECTOR
	tristate "Exynos TZASC Fail Detector"
	default m
	help
	  Support Exynos TZASC Fail Detector

config EXYNOS_TZASC_ILLEGAL_READ_LOGGING
	bool "Logging TZASC Read Fail Information"
	depends on EXYNOS_TZASC_FAIL_DETECTOR
	default n
	help
	  TZASC fail information of illegal reads will be printed
	  by the Kernel logging system.

config EXYNOS_TZASC_ILLEGAL_ACCESS_PANIC
	bool "Kernel Panic over TZASC Illegal Access"
	depends on EXYNOS_TZASC_FAIL_DETECTOR
	default y
	help
	  Kernel panic will occur in case that TZASC illegal
	  access is detected.

config EXYNOS_MCINFO
        tristate "Exynos memory controller information"
        default m

config MCINFO_SYSFS
        bool "Exynos memory controller information sysfs"
        depends on EXYNOS_MCINFO
        default y if SYSFS

config EXYNOS_CONTENT_PATH_PROTECTION
	tristate "Exynos Content Path Protection"
	default m
	help
	  Enable content path protection of EXYNOS.

config EXYNOS_DP_POWER_CONTROL
	bool "Exynos DP power control for DRM"
	depends on HDCP2_DP_ENABLE
	default n
	help
	  Enable DP power control of EXYNOS.

config EXYNOS_USI_V2
	tristate "Enable Exynos Universal Serial Interface version 2"
```

## drivers/soc/samsung/exynos_perf/Kconfig
```kconfig
#
# Exynos CPU Performance Profiling
#
config EXYNOS_PERF
	tristate "Exynos Performance"
	default n
	help
	  Enable Exynos Performance Profiling
```

## drivers/soc/samsung/gnssif/Kconfig
```kconfig
config EXYNOS_GNSS_IF
	bool "Exynos GNSS interface driver"
	default n
	---help---
	  Exynos GNSS interface driver
```

## drivers/soc/samsung/linkforward/Kconfig
```kconfig
#
# SAMSUNG Link Forward Driver
#
menuconfig LINK_FORWARD
	bool "Lower layer packet forwarding/translation support"
	depends on !HW_FORWARD
	default n
	help
	  This option enables link layer forwarding using SW translation. This
	  support IP packet NAT translation. This option can not be used with
	  DIT(Direct IP Translation) feature (HW_FORWARD).
```

## drivers/soc/samsung/strong/Kconfig
```kconfig
#
# Exynos Smart Secure Platform configuration
#

config EXYNOS_SSP
	tristate "Exynos Smart Secure Platform"
	depends on ARCH_EXYNOS
	help
	Support Smart Secure Platform

config EXYNOS_CAMELLIA_TEST
	tristate "Exynos Camellia test driver"
	depends on ARCH_EXYNOS
	help
	Test for strong mailbox
```

## drivers/soc/samsung/xperf/Kconfig
```kconfig
#
# Exynos CPU Performance Profiling
#
config EXYNOS_PERF
	tristate "Exynos Performance Drivers"
	default n
	help
	  Enable Exynos Performance Drivers
```

## drivers/soc/sprd/Kconfig
```kconfig
#
# SPRD Soc drivers
#
config SPRD_PIKE2_SLEEP
        bool "Spreadtrum light sleep driver for pike2 processors"
	depends on ARM_SPRD_CPUIDLE
	help
	  Select this to enable light sleep function for pike2 soc.

config SPRD_HWFEATURE
	bool "Spreadtrum hwfeature driver"
	depends on ARCH_SPRD
	help
	  Select this to enable hwfeature property function for all platform board

config SPRD_MEMDISK
	tristate "SPRD memdisk driver"
	depends on ARCH_SPRD
	help
	  This option can support sprd memdisk driver, which can use a block of
	  DDR memory as a disk. we can load the android image to this disk when
	  mmc driver is not ready, for example in vdk and FPGA platform.

config SPRD_7SRESET
        tristate "Spreadtrum PMIC 7s reset driver"
	depends on ARCH_SPRD || COMPILE_TEST
        help
          This driver support for 7Sreset of PMIC(2731,2730,2721)

config SPRD_PMIC_SYSCON
	tristate "Spreadtrum PMIC global driver"
	depends on MFD_SC27XX_PMIC || MFD_UMP96XX_PMIC || COMPILE_TEST
        help
          Enable this configuration option to enable pmic global driver.

config SPRD_SYSTIMER
	tristate "Spreadtrum system timer driver (systimer/sysfrt)"
	depends on ARCH_SPRD
	help
	  Support sprd system timer driver.

config SPRD_HRTIMER_DEBUG
	bool "Spreadtrum hrtimer debug driver"
	depends on ARCH_SPRD && HIGH_RES_TIMERS && DEBUG_FS
	default y
	help
	  Support sprd hrtimer debug driver.

config SPRD_TIME_SYNC
	bool "Spreadtrum time sync driver"
	depends on ARCH_SPRD
	default y
	help
	  Support sprd time sync with other subsystem.

config SPRD_TIME_SYNC_CH
	tristate "Spreadtrum AP/CH time synchronization"
	depends on ARCH_SPRD && SPRD_SYSTIMER && SPRD_TIME_SYNC
	default n
	help
	  Support sprd sensor time synchronization between AP
	  (Application Processor) and CH(Context Hub).

config SPRD_TIME_SYNC_CP
	bool "Spreadtrum cp time sync driver"
	depends on ARCH_SPRD && SPRD_TIME_SYNC
	default y
	help
	  Support sprd time sync with cp system.

source drivers/soc/sprd/iommu/Kconfig
source "drivers/soc/sprd/modem/Kconfig"
source "drivers/soc/sprd/domain/Kconfig"
source "drivers/soc/sprd/autotest/Kconfig"

config SPRD_DEBUG
	tristate "Spreadtrum debug module"
	depends on ARCH_SPRD
	help
	  Say y here to enable Debug support.

source "drivers/soc/sprd/debug/Kconfig"
source "drivers/soc/sprd/performance/Kconfig"
source "drivers/soc/sprd/pub/Kconfig"

menuconfig SPRD_POWER
	tristate "Spreadtrum debug power driver"
	depends on PM_SLEEP && ARCH_SPRD
	default n
	help
	  Select this to enable debug power driver for sprd soc.

source "drivers/soc/sprd/power/Kconfig"
source "drivers/soc/sprd/usbpinmux/Kconfig"
```

## drivers/soc/sprd/debug/busmonitor/Kconfig
```kconfig
config SPRD_BUSMONITOR
	bool "Spreadtrum BUS Monitor Support"
	depends on SPRD_DEBUG
	help
	  Say Y here to support BUS monitor.

config SPRD_APB_BUSMONITOR
	bool "Spreadtrum APB BUS Monitor Support"
	depends on SPRD_DEBUG
	help
	  Say Y here to support APB BUS monitor.

config SPRD_BUSMONITOR_GCOV
	bool "open gcov for BUS monitor"
	depends on GCOV_PROFILE_MODULES
	help
	  Say Y here to enable gcov in busmonitor.
```

## drivers/soc/sprd/debug/dmc_mpu/Kconfig
```kconfig
config SPRD_DMC_MPU_CORE
	bool "Spreadtrum DMC MPU Core Support"
	depends on SPRD_DEBUG
	help
	  Say Y here to support the dmc mpu core.

config SPRD_DMC_MPU
	bool "Spreadtrum DMC MPU Support"
	depends on SPRD_DEBUG
	select SPRD_DMC_MPU_CORE
	help
	  Say Y here to support dmc mpu support.

config SPRD_DMC_MPU_R3P0
	bool "Spreadtrum DMC MPU R3P0 Support"
	depends on SPRD_DEBUG
	help
	  Say Y here to support R3P0 dmc mpu support.

config SPRD_DMC_MPU_GCOV
	bool "open gcov for dmc mpu"
	depends on GCOV_PROFILE_MODULES
	help
	  Say Y here to enable gcov in efuse.
```

## drivers/soc/sprd/debug/hang_debug/Kconfig
```kconfig
config SPRD_HANG_DEBUG
	bool "Enable SPRD hang debug feature"
	default n
	help
		This option enables SPRD hang debug feature which dump and
		print debug info when kernel panics.

config SPRD_HANG_DEBUG_UART
	bool "sprd hang debug using uart for log output"
	depends on SPRD_HANG_DEBUG && SERIAL_SPRD_CONSOLE
	default y
```

## drivers/soc/sprd/debug/native_hang_monitor/Kconfig
```kconfig
config SPRD_NATIVE_HANG_MONITOR
	bool "Enable SPRD android native hang detect handler"
	help
		This option enables Spreatrum android native hang detect which prepare debug info
		for the case to debug.
```

## drivers/soc/sprd/debug/userspace_debug/Kconfig
```kconfig
config SHOW_UREGS_WITH_PHYSICAL
	bool "Show user regs with their physcial address"
	depends on ARM64
        default y
	help
	  This option enables process show user regs with their physcial
          address before coredump
```

## drivers/soc/sprd/modem/cp_dump/Kconfig
```kconfig
config SPRD_CP_DUMP
	tristate "SPRD CP Dump"
	default n
	help
	  SPRD cp dump driver, used for cp dump.
```

## drivers/soc/sprd/power/Kconfig
```kconfig
#
# SPRD Soc power debug drivers
#
menuconfig SPRD_POWER_LOG
	tristate "Spreadtrum debug power log output"
	depends on SPRD_POWER && SPRD_SIP_FW
	default n
	help
	  Select this to enable debug power log driver for sprd soc.

source "drivers/soc/sprd/power/log/Kconfig"

menuconfig SPRD_POWER_STAT
	tristate "Spreadtrum debug power stat output"
	depends on SPRD_POWER
	default y
	help
	Select this to enable debug power stat driver for sprd soc.

source "drivers/soc/sprd/power/stat/Kconfig"
```

## drivers/soc/sprd/power/log/Kconfig
```kconfig
#
# SPRD Soc power log
#

config SPRD_POWER_LOG_SHARKL6PRO
	tristate "SharkL6Pro debug power log"
	depends on SPRD_POWER_LOG

config SPRD_POWER_LOG_SHARKL6
	tristate "SharkL6 debug power log"
	depends on SPRD_POWER_LOG

config SPRD_POWER_LOG_SHARKL5PRO
	tristate "SharkL5Pro debug power log"
	depends on SPRD_POWER_LOG

config SPRD_POWER_LOG_SHARKL5
	tristate "SharkL5 debug power log"
	depends on SPRD_POWER_LOG

config SPRD_POWER_LOG_SHARKL3
	tristate "SharkL3 debug power log"
	depends on SPRD_POWER_LOG

config SPRD_POWER_LOG_SHARKLE
	tristate "SharkLE debug power log"
	depends on SPRD_POWER_LOG
```

## drivers/soc/sprd/power/stat/Kconfig
```kconfig
#
# SPRD Soc power statistics
#

config SPRD_POWER_STAT_SHARKL6PRO
	tristate "SharkL6Pro debug power statistics"
	depends on SPRD_POWER_STAT

config SPRD_POWER_STAT_SHARKL6
	tristate "SharkL6 debug power statistics"
	depends on SPRD_POWER_STAT

config SPRD_POWER_STAT_SHARKL5PRO
	tristate "SharkL5Pro debug power statistics"
	depends on SPRD_POWER_STAT

config SPRD_POWER_STAT_SHARKL5
	tristate "SharkL5 debug power statistics"
	depends on SPRD_POWER_STAT

config SPRD_POWER_STAT_SHARKL3
	tristate "SharkL3 debug power statistics"
	depends on SPRD_POWER_STAT

config SPRD_POWER_STAT_SHARKLE
	tristate "SharkLE debug power statistics"
	depends on SPRD_POWER_STAT

config SPRD_POWER_STAT_PIKE2
	tristate "Pike2 debug power statistics"
	depends on SPRD_POWER_STAT
```

## drivers/soc/sprd/usbpinmux/Kconfig
```kconfig
config SPRD_USBPINMUX
	bool "Spreadtrum USBPINMUX Support"
        default n
	help
	  Say Y here to support USBPINMUX.

config SPRD_USBPINMUX_QOGIRL6
	bool "Spreadtrum QOGIRL6 USBPINMUX Support"
        default n
	help
	  Say Y here to support QOGIRL6 USBPINMUX.
```

## drivers/staging/android/Kconfig
```kconfig
# SPDX-License-Identifier: GPL-2.0
menu "Android"

if ANDROID

config ASHMEM
	bool "Enable the Anonymous Shared Memory Subsystem"
	depends on SHMEM
	help
	  The ashmem subsystem is a new shared memory allocator, similar to
	  POSIX SHM but with different behavior and sporting a simpler
	  file-based API.

	  It is, in theory, a good memory allocator for low-memory devices,
	  because it can discard shared memory units when under memory pressure.

config ANDROID_VSOC
	tristate "Android Virtual SoC support"
	depends on PCI_MSI
	help
	  This option adds support for the Virtual SoC driver needed to boot
	  a 'cuttlefish' Android image inside QEmu. The driver interacts with
	  a QEmu ivshmem device. If built as a module, it will be called vsoc.

config DEBUG_KINFO
	bool "Debug Kernel Information Support"
	depends on KALLSYMS
	help
	  This supports kernel information backup for bootloader usage.
	  Specifics:
	   - The kallsyms symbols for unwind_backtrace
	   - Page directory pointer
	   - UTS_RELEASE
	   - BUILD_INFO(ro.build.fingerprint)

config SAMSUNG_LMKD_DEBUG
	bool "record lmkd kill history"
	default y
	help
	  record lmkd kill history

source "drivers/staging/android/ion/Kconfig"

endif # if ANDROID

endmenu
```

## drivers/staging/iio/light/Kconfig
```kconfig
#
# Light sensors
#
menu "Light sensors"

config SENSORS_ISL29018
	tristate "ISL 29018 light and proximity sensor"
	depends on I2C
	select REGMAP_I2C
	default n
	help
	 If you say yes here you get support for ambient light sensing and
	 proximity infrared sensing from Intersil ISL29018.
	 This driver will provide the measurements of ambient light intensity
	 in lux, proximity infrared sensing and normal infrared sensing.
	 Data from sensor is accessible via sysfs.

config SENSORS_ISL29028
	tristate "Intersil ISL29028 Concurrent Light and Proximity Sensor"
	depends on I2C
	select REGMAP_I2C
	help
	 Provides driver for the Intersil's ISL29028 device.
	 This driver supports the sysfs interface to get the ALS, IR intensity,
	 Proximity value via iio. The ISL29028 provides the concurrent sensing
	 of ambient light and proximity.

config TSL2583
	tristate "TAOS TSL2580, TSL2581 and TSL2583 light-to-digital converters"
	depends on I2C
	help
	 Provides support for the TAOS tsl2580, tsl2581 and tsl2583 devices.
	 Access ALS data via iio, sysfs.

config SENSORS_TSL2X7X
	tristate "Taos TSL2X7X ambient light sensor (based on driver/staging/iio)"
	depends on I2C
	help
	  If you say yes here you get support for the Taos TSL2X7X ambient
	  light sensor based on iio structure of driver/staging/iio

endmenu
```

## drivers/staging/iio/magnetometer/Kconfig
```kconfig
#
# Magnetometer sensors
#
menu "Magnetometer sensors"

config SENSORS_AK8975
	tristate "Asahi Kasei AK8975 3-Axis Magnetometer"
	depends on I2C
	depends on GENERIC_GPIO
	help
	  Say yes here to build support for Asahi Kasei AK8975 3-Axis
	  Magnetometer.

	  To compile this driver as a module, choose M here: the module
	  will be called ak8975.

config SENSORS_HMC5843
	tristate "Honeywell HMC5843 3-Axis Magnetometer"
	depends on I2C
	help
	  Say Y here to add support for the Honeywell HMC 5843 3-Axis
	  Magnetometer (digital compass).

	  To compile this driver as a module, choose M here: the module
	  will be called hmc5843

config INV_MMC328X_IIO
    tristate "Invensense IIO driver for Memsic MMC328x compass"
    depends on I2C && SYSFS && IIO && IIO_KFIFO_BUF
    default n
    help
      This driver supports the Memsic MMC328x compass. It is the Invensense
      IIO implementation for the MMC328x compass device.
      This driver can be built as a module. The module will be called
      inv-mmc328x-iio.

source "drivers/staging/iio/magnetometer/inv_compass/Kconfig"
endmenu
```
