/* Copyright (c) 2013-2014, The Linux Foundation. All rights reserved.
 *
 * This program is free software; you can redistribute it and/or modify
 * it under the terms of the GNU General Public License version 2 and
 * only version 2 as published by the Free Software Foundation.
 *
 * This program is distributed in the hope that it will be useful,
 * but WITHOUT ANY WARRANTY; without even the implied warranty of
 * MERCHANTABILITY or FITNESS FOR A PARTICULAR PURPOSE.  See the
 * GNU General Public License for more details.
 */

&mdss_mdp {
	ss_dsi_panel_ANA38401_AMSA05RB01_WQXGA: ss_dsi_panel_ANA38401_AMSA05RB01_WQXGA {
		qcom,mdss-dsi-panel-name = "ss_dsi_panel_ANA38401_AMSA05RB01_WQXGA";
		label = "ss_dsi_panel_ANA38401_AMSA05RB01_WQXGA";

		qcom,mdss-dsi-panel-width = <1280>;
		qcom,mdss-dsi-panel-height = <1600>;
		qcom,mdss-dsi-bpp = <24>;
		qcom,mdss-dsi-panel-timings = [00 1E 08 08 24 22 08 08 05 03 04 00];

		qcom,mdss-dsi-on-command= [
			/* Common Setting */
			15 01 00 00 00 00 02 B0 7F		/* Global Para 127th */
			39 01 00 00 00 00 02 B2 15		/* TSP_HTE, TSP_VTE Setting */

			/* Calculate Gamma */
			15 01 00 00 00 00 02 B0 BC		/* Global Para 188th */
			39 01 00 00 00 00 02 B2 04		/* Change Gamma Offset Index : 4 */

			39 01 00 00 00 00 22 83			/* Brightness condition set */
				80 80
				80 80
				80 80
				80 00
				80 80
				00
				80 80
				80 80
				80 80
				80 00
				80 80
				00
				80 80
				80 80
				80 80
				80 00
				80 80
				00

			39 01 00 00 00 00 04 90 00 00 0E	/* AID 360 nit */

			15 01 00 00 00 00 02 B0 67		/* Global Para 103rd */
			39 01 00 00 00 00 02 B2 0F		/* 360 nit ELVSS */

			15 01 00 00 00 00 02 B0 4D		/* Global Para 77th */
			39 01 00 00 00 00 02 B2 04		/* 16 Frame Avg at ACL off */

			15 01 00 00 00 00 02 B0 49		/* Global Para 73rd */
			39 01 00 00 00 00 02 B2 99		/* 60% Start  */

			15 01 00 00 00 00 02 B0 36		/* Global Para 54th */
			39 01 00 00 00 00 02 B2 10		/* ACL off */

			15 01 00 00 00 00 02 B0 35		/* Global Para 53rd */
			39 01 00 00 DC 00 02 B2 01		/* Gamma Update + Wait 220ms (Panel Spec) */

			/* Display On (29h) Command should be transferred after 220ms from TCON_RDY (L'H)*/
			05 01 00 00 00 00 02 29 00		/* Display on */
		];

		qcom,mdss-dsi-off-command=[
			05 01 00 00 64 00 02 28 00		/* Display Off + Wait 100ms */
		];

		qcom,dcs-cmd-by-left;
		/*qcom,mdss-dsi-force-clk-lane-hs;*/
		/*qcom,cmd-sync-wait-broadcast;*/
		/*qcom,cmd-sync-wait-trigger;*/
		/*qcom,mdss-dsi-fbc-enable=*/
		/*qcom,mdss-dsi-fbc-bpp=*/
		/*qcom,mdss-dsi-fbc-packing=*/
		/*qcom,mdss-dsi-fbc-quant-error=*/
		/*qcom,mdss-dsi-fbc-bias=*/
		/*qcom,mdss-dsi-fbc-pat-mode=*/
		/*qcom,mdss-dsi-fbc-vlc-mode=*/
		/*qcom,mdss-dsi-fbc-bflc-mode=*/
		/*qcom,mdss-dsi-fbc-h-line-budget=*/
		/*qcom,mdss-dsi-fbc-budget-ctrl=*/
		/*qcom,mdss-dsi-fbc-block-budget=*/
		/*qcom,mdss-dsi-fbc-lossless-threshold=*/
		/*qcom,mdss-dsi-fbc-lossy-threshold=*/
		/*qcom,mdss-dsi-fbc-rgb-threshold=*/
		/*qcom,mdss-dsi-fbc-lossy-mode-idx=*/

		qcom,mdss-dsi-h-back-porch = <108>;
		qcom,mdss-dsi-h-front-porch = <212>;
		qcom,mdss-dsi-h-pulse-width = <16>;
		qcom,mdss-dsi-h-sync-skew = <0>;
		qcom,mdss-dsi-v-back-porch = <6>;
		qcom,mdss-dsi-v-front-porch = <10>;
		qcom,mdss-dsi-v-pulse-width = <2>;

		qcom,mdss-dsi-h-left-border = <0>;
		qcom,mdss-dsi-h-right-border = <0>;
		qcom,mdss-dsi-v-top-border = <0>;
		qcom,mdss-dsi-v-bottom-border = <0>;

		qcom,mdss-dsi-underflow-color = <0xFF>;
		qcom,mdss-dsi-border-color = <0>;

		/*qcom,mdss-dsi-pan-enable-dynamic-fps=*/
		/*qcom,mdss-dsi-pan-fps-update=*/

		qcom,mdss-dsi-bl-pmic-control-type = "bl_ctrl_dcs";
		/*qcom,mdss-dsi-bl-pmic-bank-select=*/
		/*qcom,mdss-dsi-bl-pmic-pwm-frequency=*/
		/*qcom,mdss-dsi-pwm-gpio=*/

		qcom,mdss-dsi-bl-min-level = <1>;
		qcom,mdss-dsi-bl-max-level = <355>;
		qcom,mdss-brightness-max-level = <355>;
		qcom,mdss-dsi-interleave-mode = <0>;
		qcom,mdss-dsi-panel-type = "dsi_cmd_mode";
		qcom,mdss-dsi-force-clock-lane-hs;

		qcom,mdss-dsi-te-check-enable;
		qcom,mdss-dsi-te-using-te-pin;
		qcom,mdss-dsi-te-pin-select = <1>;

		qcom,mdss-dsi-te-dcs-command = <1>;
		qcom,mdss-dsi-wr-mem-start = <0x2C>;
		qcom,mdss-dsi-wr-mem-continue = <0x3C>;

		/* CMD mode panel doesn't need below stuff */
		/*qcom,mdss-dsi-h-sync-pulse=*/
		/*qcom,mdss-dsi-hfp-power-mode=*/
		/*qcom,mdss-dsi-hbp-power-mode=*/
		/*qcom,mdss-dsi-hsa-power-mode=*/
		/*qcom,mdss-dsi-last-line-interleave=*/
		/*qcom,mdss-dsi-bllp-eof-power-mode;*/
		/*qcom,mdss-dsi-bllp-power-mode;*/
		/*qcom,mdss-dsi-traffic-mode= "burst_mode";*/

		qcom,mdss-dsi-pixel-packing = "loose";

		qcom,mdss-dsi-virtual-channel-id = <0>;
		qcom,mdss-dsi-color-order = "rgb_swap_rgb";
		qcom,mdss-dsi-lane-0-state;
		qcom,mdss-dsi-lane-1-state;
		qcom,mdss-dsi-lane-2-state;
		qcom,mdss-dsi-lane-3-state;
		qcom,mdss-dsi-lane-map = "lane_map_0123";
		qcom,mdss-dsi-t-clk-pre = <0x2F>;
		qcom,mdss-dsi-t-clk-post = <0x0D>;

		qcom,mdss-dsi-stream = <0>;
		qcom,mdss-dsi-mdp-trigger = "none";
		qcom,mdss-dsi-dma-trigger = "trigger_sw";
		qcom,mdss-dsi-panel-framerate = <60>;
		qcom,mdss-dsi-panel-clockrate = <898020000>;
		qcom,mdss-dsi-on-command-state = "dsi_lp_mode";
		qcom,mdss-dsi-off-command-state = "dsi_hs_mode";

		qcom,mdss-pan-physical-width-dimension = <227>;
		qcom,mdss-pan-physical-height-dimension = <142>;

		qcom,mdss-dsi-panel-mode-gpio-state = "invalid";
		qcom,mdss-dsi-reset-sequence = <0 0>, <0 70>, <1 0>;

		/*qcom,partial-update-enabled;*/
		/*qcom,partial-update-roi-merge;*/
		/*qcom,panel-roi-alignment=<8 8 1 1 1 1>;*/
		/*qcom,mdss-dsi-horizontal-line-idle*/

		qcom,mdss-dsi-lp11-init;
		qcom,mdss-dsi-init-delay-us = <1000>;

		qcom,mdss-dsi-rx-eot-ignore;
		qcom,mdss-dsi-tx-eot-append;

		/*qcom,ulps-enabled*/
		/*qcom,suspend-ulps-enabled;*/
		/*qcom,mdss-dsi-panel-status-command=*/
		/*qcom,mdss-dsi-panel-status-command-mode="dsi_lp_mode";*/

		qcom,esd-check-enabled;
		qcom,mdss-dsi-panel-status-check-mode="reg_read_irq";
		qcom,mdss-dsi-panel-status-irq-trigger1="falling";

		qcom,mdss-dsi-panel-hdr-enabled;
		qcom,mdss-dsi-panel-hdr-color-primaries = <14880 15935 32435
			16555 14945 30910 7790 3415>;
		qcom,mdss-dsi-panel-peak-brightness = <5643000>;
		qcom,mdss-dsi-panel-average-brightness = <2000000>;
		qcom,mdss-dsi-panel-blackness-level = <6134>;

		/*qcom,mdss-dsi-panel-status-value = <1>;*/
		/*qcom,mdss-dsi-panel-orientation = "180";*/
		/*qcom,dynamic-mode-switch-enabled*/
		/*qcom,video-to-cmd-mode-switch-commands=*/
		/*qcom,cmd-to-video-mode-switch-commands=*/
/*
 * ************************************************************************************************************************************
 *
 *
 *			Below  parameters are samsung dependent thigs
 *
 *
 * ************************************************************************************************************************************
 */
		samsung,panel-vendor = "SDC";
		samsung,disp-model = "AMSA05RB01";
		samsung,support_panel_max = <1>;
		samsung,tcon-clk-on-support;
		samsung,hw-config = "split_dsi";
		/*samsung,panel-lpm-enable;*/
		/*samsung,support_irc;*/
		/*samsung,elvss_interpolation_temperature = <(-15)>;*/
		/*samsung,support_factory_panel_swap;*/
		/*samsung,panel-extra-power-gpio1 = <&tlmm 117 0>;*/
		/*samsung ESD pin*/
		//samsung,esd-irq-gpio1 = <&tlmm 5 0>;
		samsung,mdss-power-on-reset-delay-us = <70000>;
		samsung,mdss-power-off-delay-us = <10000>;
		samsung,mdss-dsi-off-reset-delay-us = <3000>;
		samsung,dsi-lp11-init;

		samsung,support_mdnie_lite;
		/*samsung,line_split;*/

		/*
		the last byte in read commands	represent READ LENGH,
		like below  READ LENGH = 0x21
		*/

		samsung,packet_size_tx_cmds_revA = [
			37 01 00 00 00 00 02 21 00
		];

		/*
		 * First parameters can be changed
		 * by function of samsung_nv_read()
		 * because of that means offset of
		 * read position
		 */
		samsung,reg_read_pos_tx_cmds_revA = [
			15 01 00 00 00 00 02 B0 00
		];

		samsung,smart_dimming_mtp_rx_cmds_revA	= [24 01 00 00 00 00 02 D8 08 08 5A];	/* Offset 0x5A */
		samsung,mdnie_read_rx_cmds_revA 	= [24 01 00 00 00 00 02 D8 04 04 7B];	/* Offset 0x7B : 123~ 126th para */
		samsung,elvss_rx_cmds_revA		= [24 01 00 00 00 00 02 D2 01 01 70];	/* Offset 0x70 */
		samsung,mtp_read_sysfs_rx_cmds_revA = [24 01 00 00 00 00 02 00 00 00 00];

		samsung,manufacture_id0_rx_cmds_revA 	= [ 06 01 00 00 00 00 01 DA 01 00];
		samsung,manufacture_id1_rx_cmds_revA 	= [ 06 01 00 00 00 00 01 DB 01 00];
		samsung,manufacture_id2_rx_cmds_revA 	= [ 06 01 00 00 00 00 01 DC 01 00];

		samsung,manufacture_date_rx_cmds_revA 	= [24 01 00 00 00 00 02 D8 07 07 86];	/* Offset 0x86 */
		samsung,cell_id_rx_cmds_revA 		= [24 01 00 00 00 00 02 D8 07 07 86];	/* Offset 0x86 */

		/* Display On (29h) Command moved to mdss-dsi-on-command */
		/* samsung,display_on_tx_cmds_revA = [05 01 00 00 00 00 02 29 00]; */
		samsung,display_off_tx_cmds_revA = [05 01 00 00 64 00 02 28 00];

		/*
		* ************************************************************************************************************************
		*  GAMMA
		* ************************************************************************************************************************
		*/
		samsung,gamma_tx_cmds_revA = [
			39 01 00 00 00 00 22			/* Brightness condition set */
			83 80 80 80 80 80 80
			80 00 80 80 00 80 80
			80 80 80 80 80 00 80
			80 00 80 80 80 80 80
			80 80 00 80 80 00

			15 01 00 00 00 00 02 B0 35		/* Global Para 53rd */
			39 01 00 00 00 00 02 B2 01		/* Update key */
		];

		/*
		* ************************************************************************************************************************
		*  HBM
		* ************************************************************************************************************************
		*/
		samsung,enter_hbm_lux = <10000>;
		samsung,hbm_rx_cmds_revA  = [24 01 00 00 00 00 02 D4 08 08 5B]; /*Offset 91(0x5B) Para  : HBM GAMMA */
		samsung,hbm2_rx_cmds_revA = [24 01 00 00 00 00 02 D8 01 01 81]; /*Offset 129(0x81) Para : HBM ELVSS */

		samsung,hbm_gamma_tx_cmds_revA = [
			39 01 00 00 00 00 22			/* Brightness condition set */
			83 80 80 80 80 80 80
			80 00 80 80 00 80 80
			80 80 80 80 80 00 80
			80 00 80 80 80 80 80
			80 80 00 80 80 00
		];

		samsung,hbm_etc_tx_cmds_revA = [
			39 01 00 00 00 00 04 90 00 00 0E	/* AID 360 nit */
			15 01 00 00 00 00 02 B0 70		/* Global Para 112nd */
			39 01 00 00 00 00 02 B2 00		/* HBM ELVSS */
			15 01 00 00 00 00 02 B0 67		/* Global Para 103rd */
			39 01 00 00 00 00 02 B2 0F		/* ELVSS dim offset : Table2 */
			15 01 00 00 00 00 02 B0 4D		/* Global Para 77th */
			39 01 00 00 00 00 02 B2 05		/* 32 Frame Avg at ACL on */
			15 01 00 00 00 00 02 B0 49		/* Global Para 73th */
			39 01 00 00 00 00 02 B2 99		/* Start setting: 60% start */
			15 01 00 00 00 00 02 B0 36		/* Global Para 54th */
			39 01 00 00 00 00 02 B2 11		/* ACL 8% on */
			15 01 00 00 00 00 02 B0 35		/* Global Para 53rd */
			39 01 00 00 00 00 02 B2 01		/* Update key */
		];

		samsung,hbm_off_tx_cmds_revA = [
			15 00 00 00 00 00 02 B0 70		/* Global Para 112nd */
			39 00 00 00 00 00 02 B2 00		/* HBM ELVSS */
		];

		/*
		* ************************************************************************************************************************
		* AID command list and mappings
		* ************************************************************************************************************************
		*/

		samsung,aid_subdivision_tx_cmds_revA = [
						/* AOR   bl   */
			39 01 00 00 00 00 04 90 01 00 8D /*   0 */
			39 01 00 00 00 00 04 90 01 00 8A /*   1 */
			39 01 00 00 00 00 04 90 01 00 87 /*   2 */
			39 01 00 00 00 00 04 90 01 00 84 /*   3 */
			39 01 00 00 00 00 04 90 01 00 80 /*   4 */
			39 01 00 00 00 00 04 90 01 00 7E /*   5 */
			39 01 00 00 00 00 04 90 01 00 7A /*   6 */
			39 01 00 00 00 00 04 90 01 00 77 /*   7 */
			39 01 00 00 00 00 04 90 01 00 74 /*   8 */
			39 01 00 00 00 00 04 90 01 00 6F /*   9 */
			39 01 00 00 00 00 04 90 01 00 6D /*  10 */
			39 01 00 00 00 00 04 90 01 00 6A /*  11 */
			39 01 00 00 00 00 04 90 01 00 66 /*  12 */
			39 01 00 00 00 00 04 90 01 00 63 /*  13 */
			39 01 00 00 00 00 04 90 01 00 5F /*  14 */
			39 01 00 00 00 00 04 90 01 00 5C /*  15 */
			39 01 00 00 00 00 04 90 01 00 55 /*  16 */
			39 01 00 00 00 00 04 90 01 00 52 /*  17 */
			39 01 00 00 00 00 04 90 01 00 4E /*  18 */
			39 01 00 00 00 00 04 90 01 00 4A /*  19 */
			39 01 00 00 00 00 04 90 01 00 44 /*  20 */
			39 01 00 00 00 00 04 90 01 00 40 /*  21 */
			39 01 00 00 00 00 04 90 01 00 3D /*  22 */
			39 01 00 00 00 00 04 90 01 00 3A /*  23 */
			39 01 00 00 00 00 04 90 01 00 36 /*  24 */
			39 01 00 00 00 00 04 90 01 00 32 /*  25 */
			39 01 00 00 00 00 04 90 01 00 30 /*  26 */
			39 01 00 00 00 00 04 90 01 00 2F /*  27 */
			39 01 00 00 00 00 04 90 01 00 2C /*  28 */
			39 01 00 00 00 00 04 90 01 00 28 /*  29 */
			39 01 00 00 00 00 04 90 01 00 24 /*  30 */
			39 01 00 00 00 00 04 90 01 00 20 /*  31 */
			39 01 00 00 00 00 04 90 01 00 1B /*  32 */
			39 01 00 00 00 00 04 90 01 00 16 /*  33 */
			39 01 00 00 00 00 04 90 01 00 12 /*  34 */
			39 01 00 00 00 00 04 90 01 00 0E /*  35 */
			39 01 00 00 00 00 04 90 01 00 0B /*  36 */
			39 01 00 00 00 00 04 90 01 00 07 /*  37 */
			39 01 00 00 00 00 04 90 01 00 02 /*  38 */
			39 01 00 00 00 00 04 90 00 00 FC /*  39 */
			39 01 00 00 00 00 04 90 00 00 F7 /*  40 */
			39 01 00 00 00 00 04 90 00 00 F2 /*  41 */
			39 01 00 00 00 00 04 90 00 00 EC /*  42 */
			39 01 00 00 00 00 04 90 00 00 E6 /*  43 */
			39 01 00 00 00 00 04 90 00 00 E1 /*  44 */
			39 01 00 00 00 00 04 90 00 00 DB /*  45 */
			39 01 00 00 00 00 04 90 00 00 D7 /*  46 */
			39 01 00 00 00 00 04 90 00 00 D3 /*  47 */
			39 01 00 00 00 00 04 90 00 00 CF /*  48 */
			39 01 00 00 00 00 04 90 00 00 CA /*  49 */
			39 01 00 00 00 00 04 90 00 00 C4 /*  50 */
			39 01 00 00 00 00 04 90 00 00 BF /*  51 */
			39 01 00 00 00 00 04 90 00 00 BA /*  52 */
			39 01 00 00 00 00 04 90 00 00 B6 /*  53 */
			39 01 00 00 00 00 04 90 00 00 B1 /*  54 */
			39 01 00 00 00 00 04 90 00 00 AC /*  55 */
			39 01 00 00 00 00 04 90 00 00 A8 /*  56 */
			39 01 00 00 00 00 04 90 00 00 A3 /*  57 */
			39 01 00 00 00 00 04 90 00 00 A5 /*  58 */
			39 01 00 00 00 00 04 90 00 00 A1 /*  59 */
			39 01 00 00 00 00 04 90 00 00 9C /*  60 */
			39 01 00 00 00 00 04 90 00 00 A7 /*  61 */
			39 01 00 00 00 00 04 90 00 00 A1 /*  62 */
			39 01 00 00 00 00 04 90 00 00 9C /*  63 */
			39 01 00 00 00 00 04 90 00 00 A6 /*  64 */
			39 01 00 00 00 00 04 90 00 00 A1 /*  65 */
			39 01 00 00 00 00 04 90 00 00 9C /*  66 */
			39 01 00 00 00 00 04 90 00 00 A5 /*  67 */
			39 01 00 00 00 00 04 90 00 00 A1 /*  68 */
			39 01 00 00 00 00 04 90 00 00 9C /*  69 */
			39 01 00 00 00 00 04 90 00 00 A7 /*  70 */
			39 01 00 00 00 00 04 90 00 00 A1 /*  71 */
			39 01 00 00 00 00 04 90 00 00 9C /*  72 */
			39 01 00 00 00 00 04 90 00 00 A5 /*  73 */
			39 01 00 00 00 00 04 90 00 00 A2 /*  74 */
			39 01 00 00 00 00 04 90 00 00 9F /*  75 */
			39 01 00 00 00 00 04 90 00 00 9C /*  76 */
			39 01 00 00 00 00 04 90 00 00 A8 /*  77 */
			39 01 00 00 00 00 04 90 00 00 A4 /*  78 */
			39 01 00 00 00 00 04 90 00 00 A0 /*  79 */
			39 01 00 00 00 00 04 90 00 00 9C /*  80 */
			39 01 00 00 00 00 04 90 00 00 A7 /*  81 */
			39 01 00 00 00 00 04 90 00 00 A5 /*  82 */
			39 01 00 00 00 00 04 90 00 00 A3 /*  83 */
			39 01 00 00 00 00 04 90 00 00 A0 /*  84 */
			39 01 00 00 00 00 04 90 00 00 9E /*  85 */
			39 01 00 00 00 00 04 90 00 00 9C /*  86 */
			39 01 00 00 00 00 04 90 00 00 A9 /*  87 */
			39 01 00 00 00 00 04 90 00 00 A6 /*  88 */
			39 01 00 00 00 00 04 90 00 00 A3 /*  89 */
			39 01 00 00 00 00 04 90 00 00 9F /*  90 */
			39 01 00 00 00 00 04 90 00 00 9C /*  91 */
			39 01 00 00 00 00 04 90 00 00 A7 /*  92 */
			39 01 00 00 00 00 04 90 00 00 A5 /*  93 */
			39 01 00 00 00 00 04 90 00 00 A3 /*  94 */
			39 01 00 00 00 00 04 90 00 00 A1 /*  95 */
			39 01 00 00 00 00 04 90 00 00 9E /*  96 */
			39 01 00 00 00 00 04 90 00 00 9C /*  97 */
			39 01 00 00 00 00 04 90 00 00 A9 /*  98 */
			39 01 00 00 00 00 04 90 00 00 A7 /*  99 */
			39 01 00 00 00 00 04 90 00 00 A4 /* 100 */
			39 01 00 00 00 00 04 90 00 00 A2 /* 101 */
			39 01 00 00 00 00 04 90 00 00 A0 /* 102 */
			39 01 00 00 00 00 04 90 00 00 9E /* 103 */
			39 01 00 00 00 00 04 90 00 00 9C /* 104 */
			39 01 00 00 00 00 04 90 00 00 A9 /* 105 */
			39 01 00 00 00 00 04 90 00 00 A6 /* 106 */
			39 01 00 00 00 00 04 90 00 00 A4 /* 107 */
			39 01 00 00 00 00 04 90 00 00 A1 /* 108 */
			39 01 00 00 00 00 04 90 00 00 9F /* 109 */
			39 01 00 00 00 00 04 90 00 00 9C /* 110 */
			39 01 00 00 00 00 04 90 00 00 A9 /* 111 */
			39 01 00 00 00 00 04 90 00 00 A7 /* 112 */
			39 01 00 00 00 00 04 90 00 00 A5 /* 113 */
			39 01 00 00 00 00 04 90 00 00 A3 /* 114 */
			39 01 00 00 00 00 04 90 00 00 A1 /* 115 */
			39 01 00 00 00 00 04 90 00 00 A0 /* 116 */
			39 01 00 00 00 00 04 90 00 00 9E /* 117 */
			39 01 00 00 00 00 04 90 00 00 9C /* 118 */
			39 01 00 00 00 00 04 90 00 00 A9 /* 119 */
			39 01 00 00 00 00 04 90 00 00 A7 /* 120 */
			39 01 00 00 00 00 04 90 00 00 A5 /* 121 */
			39 01 00 00 00 00 04 90 00 00 A3 /* 122 */
			39 01 00 00 00 00 04 90 00 00 A0 /* 123 */
			39 01 00 00 00 00 04 90 00 00 9E /* 124 */
			39 01 00 00 00 00 04 90 00 00 9C /* 125 */
			39 01 00 00 00 00 04 90 00 00 9B /* 126 */
			39 01 00 00 00 00 04 90 00 00 99 /* 127 */
			39 01 00 00 00 00 04 90 00 00 98 /* 128 */
			39 01 00 00 00 00 04 90 00 00 96 /* 129 */
			39 01 00 00 00 00 04 90 00 00 94 /* 130 */
			39 01 00 00 00 00 04 90 00 00 92 /* 131 */
			39 01 00 00 00 00 04 90 00 00 90 /* 132 */
			39 01 00 00 00 00 04 90 00 00 8E /* 133 */
			39 01 00 00 00 00 04 90 00 00 8C /* 134 */
			39 01 00 00 00 00 04 90 00 00 8A /* 135 */
			39 01 00 00 00 00 04 90 00 00 88 /* 136 */
			39 01 00 00 00 00 04 90 00 00 86 /* 137 */
			39 01 00 00 00 00 04 90 00 00 84 /* 138 */
			39 01 00 00 00 00 04 90 00 00 82 /* 139 */
			39 01 00 00 00 00 04 90 00 00 80 /* 140 */
			39 01 00 00 00 00 04 90 00 00 7E /* 141 */
			39 01 00 00 00 00 04 90 00 00 7C /* 142 */
			39 01 00 00 00 00 04 90 00 00 79 /* 143 */
			39 01 00 00 00 00 04 90 00 00 77 /* 144 */
			39 01 00 00 00 00 04 90 00 00 74 /* 145 */
			39 01 00 00 00 00 04 90 00 00 72 /* 146 */
			39 01 00 00 00 00 04 90 00 00 70 /* 147 */
			39 01 00 00 00 00 04 90 00 00 6D /* 148 */
			39 01 00 00 00 00 04 90 00 00 6A /* 149 */
			39 01 00 00 00 00 04 90 00 00 68 /* 150 */
			39 01 00 00 00 00 04 90 00 00 66 /* 151 */
			39 01 00 00 00 00 04 90 00 00 64 /* 152 */
			39 01 00 00 00 00 04 90 00 00 62 /* 153 */
			39 01 00 00 00 00 04 90 00 00 60 /* 154 */
			39 01 00 00 00 00 04 90 00 00 5E /* 155 */
			39 01 00 00 00 00 04 90 00 00 5C /* 156 */
			39 01 00 00 00 00 04 90 00 00 5A /* 157 */
			39 01 00 00 00 00 04 90 00 00 58 /* 158 */
			39 01 00 00 00 00 04 90 00 00 56 /* 159 */
			39 01 00 00 00 00 04 90 00 00 54 /* 160 */
			39 01 00 00 00 00 04 90 00 00 52 /* 161 */
			39 01 00 00 00 00 04 90 00 00 50 /* 162 */
			39 01 00 00 00 00 04 90 00 00 4D /* 163 */
			39 01 00 00 00 00 04 90 00 00 4B /* 164 */
			39 01 00 00 00 00 04 90 00 00 49 /* 165 */
			39 01 00 00 00 00 04 90 00 00 47 /* 166 */
			39 01 00 00 00 00 04 90 00 00 45 /* 167 */
			39 01 00 00 00 00 04 90 00 00 42 /* 168 */
			39 01 00 00 00 00 04 90 00 00 40 /* 169 */
			39 01 00 00 00 00 04 90 00 00 3E /* 170 */
			39 01 00 00 00 00 04 90 00 00 3C /* 171 */
			39 01 00 00 00 00 04 90 00 00 39 /* 172 */
			39 01 00 00 00 00 04 90 00 00 37 /* 173 */
			39 01 00 00 00 00 04 90 00 00 35 /* 174 */
			39 01 00 00 00 00 04 90 00 00 32 /* 175 */
			39 01 00 00 00 00 04 90 00 00 30 /* 176 */
			39 01 00 00 00 00 04 90 00 00 2D /* 177 */
			39 01 00 00 00 00 04 90 00 00 2B /* 178 */
			39 01 00 00 00 00 04 90 00 00 29 /* 179 */
			39 01 00 00 00 00 04 90 00 00 26 /* 180 */
			39 01 00 00 00 00 04 90 00 00 24 /* 181 */
			39 01 00 00 00 00 04 90 00 00 22 /* 182 */
			39 01 00 00 00 00 04 90 00 00 20 /* 183 */
			39 01 00 00 00 00 04 90 00 00 1E /* 184 */
			39 01 00 00 00 00 04 90 00 00 1C /* 185 */
			39 01 00 00 00 00 04 90 00 00 1A /* 186 */
			39 01 00 00 00 00 04 90 00 00 18 /* 187 */
			39 01 00 00 00 00 04 90 00 00 16 /* 188 */
			39 01 00 00 00 00 04 90 00 00 14 /* 189 */
			39 01 00 00 00 00 04 90 00 00 12 /* 190 */
			39 01 00 00 00 00 04 90 00 00 10 /* 191 */
			39 01 00 00 00 00 04 90 00 00 0E /* 192 */
			39 01 00 00 00 00 04 90 00 00 23 /* 193 */
			39 01 00 00 00 00 04 90 00 00 21 /* 194 */
			39 01 00 00 00 00 04 90 00 00 1F /* 195 */
			39 01 00 00 00 00 04 90 00 00 1D /* 196 */
			39 01 00 00 00 00 04 90 00 00 1B /* 197 */
			39 01 00 00 00 00 04 90 00 00 19 /* 198 */
			39 01 00 00 00 00 04 90 00 00 17 /* 199 */
			39 01 00 00 00 00 04 90 00 00 14 /* 200 */
			39 01 00 00 00 00 04 90 00 00 12 /* 201 */
			39 01 00 00 00 00 04 90 00 00 10 /* 202 */
			39 01 00 00 00 00 04 90 00 00 0E /* 203 */
			39 01 00 00 00 00 04 90 00 00 23 /* 204 */
			39 01 00 00 00 00 04 90 00 00 21 /* 205 */
			39 01 00 00 00 00 04 90 00 00 1F /* 206 */
			39 01 00 00 00 00 04 90 00 00 1D /* 207 */
			39 01 00 00 00 00 04 90 00 00 1B /* 208 */
			39 01 00 00 00 00 04 90 00 00 19 /* 209 */
			39 01 00 00 00 00 04 90 00 00 17 /* 210 */
			39 01 00 00 00 00 04 90 00 00 14 /* 211 */
			39 01 00 00 00 00 04 90 00 00 12 /* 212 */
			39 01 00 00 00 00 04 90 00 00 10 /* 213 */
			39 01 00 00 00 00 04 90 00 00 0E /* 214 */
			39 01 00 00 00 00 04 90 00 00 23 /* 215 */
			39 01 00 00 00 00 04 90 00 00 21 /* 216 */
			39 01 00 00 00 00 04 90 00 00 1F /* 217 */
			39 01 00 00 00 00 04 90 00 00 1D /* 218 */
			39 01 00 00 00 00 04 90 00 00 1B /* 219 */
			39 01 00 00 00 00 04 90 00 00 19 /* 220 */
			39 01 00 00 00 00 04 90 00 00 17 /* 221 */
			39 01 00 00 00 00 04 90 00 00 14 /* 222 */
			39 01 00 00 00 00 04 90 00 00 12 /* 223 */
			39 01 00 00 00 00 04 90 00 00 10 /* 224 */
			39 01 00 00 00 00 04 90 00 00 0E /* 225 */
			39 01 00 00 00 00 04 90 00 00 20 /* 226 */
			39 01 00 00 00 00 04 90 00 00 1E /* 227 */
			39 01 00 00 00 00 04 90 00 00 1C /* 228 */
			39 01 00 00 00 00 04 90 00 00 1A /* 229 */
			39 01 00 00 00 00 04 90 00 00 18 /* 230 */
			39 01 00 00 00 00 04 90 00 00 16 /* 231 */
			39 01 00 00 00 00 04 90 00 00 14 /* 232 */
			39 01 00 00 00 00 04 90 00 00 12 /* 233 */
			39 01 00 00 00 00 04 90 00 00 10 /* 234 */
			39 01 00 00 00 00 04 90 00 00 0E /* 235 */
			39 01 00 00 00 00 04 90 00 00 20 /* 236 */
			39 01 00 00 00 00 04 90 00 00 1E /* 237 */
			39 01 00 00 00 00 04 90 00 00 1C /* 238 */
			39 01 00 00 00 00 04 90 00 00 1A /* 239 */
			39 01 00 00 00 00 04 90 00 00 18 /* 240 */
			39 01 00 00 00 00 04 90 00 00 16 /* 241 */
			39 01 00 00 00 00 04 90 00 00 14 /* 242 */
			39 01 00 00 00 00 04 90 00 00 12 /* 243 */
			39 01 00 00 00 00 04 90 00 00 10 /* 244 */
			39 01 00 00 00 00 04 90 00 00 0E /* 245 */
			39 01 00 00 00 00 04 90 00 00 28 /* 246 */
			39 01 00 00 00 00 04 90 00 00 25 /* 247 */
			39 01 00 00 00 00 04 90 00 00 22 /* 248 */
			39 01 00 00 00 00 04 90 00 00 20 /* 249 */
			39 01 00 00 00 00 04 90 00 00 1D /* 250 */
			39 01 00 00 00 00 04 90 00 00 1A /* 251 */
			39 01 00 00 00 00 04 90 00 00 17 /* 252 */
			39 01 00 00 00 00 04 90 00 00 14 /* 253 */
			39 01 00 00 00 00 04 90 00 00 11 /* 254 */
			39 01 00 00 00 00 04 90 00 00 0E /* 255 */
		];

		/*
		 * ************************************************************************************************************************
		* ACL command list and mappings
		 * ************************************************************************************************************************
		 */
		samsung,acl_on_tx_cmds_revA = [
			15 01 00 00 00 00 02 B0 4D		/* Global Para 77th */
			39 01 00 00 00 00 02 B2 05		/* 32 Frame Avg at ACL on */
			15 01 00 00 00 00 02 B0 49		/* Global Para 73th */
			39 01 00 00 00 00 02 B2 99		/* Start setting: 60% start */
			15 01 00 00 00 00 02 B0 36		/* Global Para 54th */
			39 01 00 00 00 00 02 B2 12		/* ACL 15% on */
		]; /* ACL on, B2 <- 0x05 */

		samsung,acl_off_tx_cmds_revA = [
			15 01 00 00 00 00 02 B0 4D		/* Global Para 77th */
			39 01 00 00 00 00 02 B2 04		/* 16 Frame Avg at ACL off */
			15 01 00 00 00 00 02 B0 49		/* Global Para 73th */
			39 01 00 00 00 00 02 B2 99		/* Start setting: 60% start */
			15 01 00 00 00 00 02 B0 36		/* Global Para 54th */
			39 01 00 00 00 00 02 B2 10		/* ACL off */
		];/* ACL off, B2 <- 0x04 */

		/*
		 * ************************************************************************************************************************
		* ELVSS(ACL Off) command list and mappings
		 * ************************************************************************************************************************
		 */
		/* 0xB2 address 103rd parameter value*/
		samsung,elvss_pre_tx_cmds_revA = [15 01 00 00 00 00 02 B0 67]; /* 0x67 : 103rd Para  */
		samsung,elvss_tx_cmds_revA = [
			39 01 00 00 00 00 02 B2 0F /* 0: 360cd */
			39 01 00 00 00 00 02 B2 0E /* 1: 333cd */
			39 01 00 00 00 00 02 B2 0C /* 2: 316cd */
			39 01 00 00 00 00 02 B2 0C /* 3: 300cd */
			39 01 00 00 00 00 02 B2 0B /* 4: 282cd */
			39 01 00 00 00 00 02 B2 0B /* 5: 265cd */
			39 01 00 00 00 00 02 B2 0A /* 6: 249cd */
			39 01 00 00 00 00 02 B2 0A /* 7: 234cd */
			39 01 00 00 00 00 02 B2 0A /* 8: 220cd */
			39 01 00 00 00 00 02 B2 09 /* 9: 207cd */
			39 01 00 00 00 00 02 B2 09 /* 10: 195cd */
			39 01 00 00 00 00 02 B2 09 /* 11: 183cd */
			39 01 00 00 00 00 02 B2 09 /* 12: 172cd */
			39 01 00 00 00 00 02 B2 08 /* 13: 162cd */
			39 01 00 00 00 00 02 B2 08 /* 14: 152cd */
			39 01 00 00 00 00 02 B2 06 /* 15: 143cd */
			39 01 00 00 00 00 02 B2 06 /* 16: 134cd */
			39 01 00 00 00 00 02 B2 06 /* 17: 126cd */
			39 01 00 00 00 00 02 B2 05 /* 18: 119cd */
			39 01 00 00 00 00 02 B2 05 /* 19: 111cd */
			39 01 00 00 00 00 02 B2 05 /* 20: 105-60cd */
			39 01 00 00 00 00 02 B2 05 /* 21: 56cd */
			39 01 00 00 00 00 02 B2 06 /* 22: 53cd */
			39 01 00 00 00 00 02 B2 06 /* 23: 50cd */
			39 01 00 00 00 00 02 B2 06 /* 24: 47cd */
			39 01 00 00 00 00 02 B2 06 /* 25: 44cd */
			39 01 00 00 00 00 02 B2 08 /* 26: 41cd */
			39 01 00 00 00 00 02 B2 08 /* 27: 39cd */
			39 01 00 00 00 00 02 B2 08 /* 28: 37cd */
			39 01 00 00 00 00 02 B2 09 /* 29: 34cd */
			39 01 00 00 00 00 02 B2 09 /* 30: 32cd */
			39 01 00 00 00 00 02 B2 0A /* 31: 30cd */
			39 01 00 00 00 00 02 B2 0A /* 32: 29cd */
			39 01 00 00 00 00 02 B2 0A /* 33: 27cd */
			39 01 00 00 00 00 02 B2 0B /* 34: 25-21cd */
			39 01 00 00 00 00 02 B2 0C /* 35: 20-16cd */
			39 01 00 00 00 00 02 B2 0C /* 36: 15-11cd */
			39 01 00 00 00 00 02 B2 0E /* 37: 10-5cd */
			39 01 00 00 00 00 02 B2 0F /* 38: 4-2cd */
		];

		samsung,elvss_lowtemp_tx_cmds_revA = [
			39 01 00 00 00 00 02 B2 05 /* 0: 360cd */
			39 01 00 00 00 00 02 B2 04 /* 1: 333cd */
			39 01 00 00 00 00 02 B2 02 /* 2: 316cd */
			39 01 00 00 00 00 02 B2 02 /* 3: 300cd */
			39 01 00 00 00 00 02 B2 01 /* 4: 282cd */
			39 01 00 00 00 00 02 B2 01 /* 5: 265cd */
			39 01 00 00 00 00 02 B2 00 /* 6: 249cd */
			39 01 00 00 00 00 02 B2 00 /* 7: 234cd */
			39 01 00 00 00 00 02 B2 00 /* 8: 220cd */
			39 01 00 00 00 00 02 B2 00 /* 9: 207cd */
			39 01 00 00 00 00 02 B2 00 /* 10: 195cd */
			39 01 00 00 00 00 02 B2 00 /* 11: 183cd */
			39 01 00 00 00 00 02 B2 00 /* 12: 172cd */
			39 01 00 00 00 00 02 B2 00 /* 13: 162cd */
			39 01 00 00 00 00 02 B2 00 /* 14: 152cd */
			39 01 00 00 00 00 02 B2 00 /* 15: 143cd */
			39 01 00 00 00 00 02 B2 00 /* 16: 134cd */
			39 01 00 00 00 00 02 B2 00 /* 17: 126cd */
			39 01 00 00 00 00 02 B2 00 /* 18: 119cd */
			39 01 00 00 00 00 02 B2 00 /* 19: 111cd */
			39 01 00 00 00 00 02 B2 00 /* 20: 105-60cd */
			39 01 00 00 00 00 02 B2 00 /* 21: 56cd */
			39 01 00 00 00 00 02 B2 00 /* 22: 53cd */
			39 01 00 00 00 00 02 B2 00 /* 23: 50cd */
			39 01 00 00 00 00 02 B2 00 /* 24: 47cd */
			39 01 00 00 00 00 02 B2 00 /* 25: 44cd */
			39 01 00 00 00 00 02 B2 00 /* 26: 41cd */
			39 01 00 00 00 00 02 B2 00 /* 27: 39cd */
			39 01 00 00 00 00 02 B2 00 /* 28: 37cd */
			39 01 00 00 00 00 02 B2 00 /* 29: 34cd */
			39 01 00 00 00 00 02 B2 00 /* 30: 32cd */
			39 01 00 00 00 00 02 B2 00 /* 31: 30cd */
			39 01 00 00 00 00 02 B2 00 /* 32: 29cd */
			39 01 00 00 00 00 02 B2 00 /* 33: 27cd */
			39 01 00 00 00 00 02 B2 01 /* 34: 25-21cd */
			39 01 00 00 00 00 02 B2 02 /* 35: 20-16cd */
			39 01 00 00 00 00 02 B2 02 /* 36: 15-11cd */
			39 01 00 00 00 00 02 B2 04 /* 37: 10-5cd */
			39 01 00 00 00 00 02 B2 05 /* 38: 4-2cd */
		];

		samsung,elvss_lowtemp2_tx_cmds_revA = [
			39 01 00 00 00 00 02 B2 00 /* 0: 360cd */
			39 01 00 00 00 00 02 B2 00 /* 1: 333cd */
			39 01 00 00 00 00 02 B2 00 /* 2: 316cd */
			39 01 00 00 00 00 02 B2 00 /* 3: 300cd */
			39 01 00 00 00 00 02 B2 00 /* 4: 282cd */
			39 01 00 00 00 00 02 B2 00 /* 5: 265cd */
			39 01 00 00 00 00 02 B2 00 /* 6: 249cd */
			39 01 00 00 00 00 02 B2 00 /* 7: 234cd */
			39 01 00 00 00 00 02 B2 00 /* 8: 220cd */
			39 01 00 00 00 00 02 B2 00 /* 9: 207cd */
			39 01 00 00 00 00 02 B2 00 /* 10: 195cd */
			39 01 00 00 00 00 02 B2 00 /* 11: 183cd */
			39 01 00 00 00 00 02 B2 00 /* 12: 172cd */
			39 01 00 00 00 00 02 B2 00 /* 13: 162cd */
			39 01 00 00 00 00 02 B2 00 /* 14: 152cd */
			39 01 00 00 00 00 02 B2 00 /* 15: 143cd */
			39 01 00 00 00 00 02 B2 00 /* 16: 134cd */
			39 01 00 00 00 00 02 B2 00 /* 17: 126cd */
			39 01 00 00 00 00 02 B2 00 /* 18: 119cd */
			39 01 00 00 00 00 02 B2 00 /* 19: 111cd */
			39 01 00 00 00 00 02 B2 00 /* 20: 105-60cd */
			39 01 00 00 00 00 02 B2 00 /* 21: 56cd */
			39 01 00 00 00 00 02 B2 00 /* 22: 53cd */
			39 01 00 00 00 00 02 B2 00 /* 23: 50cd */
			39 01 00 00 00 00 02 B2 00 /* 24: 47cd */
			39 01 00 00 00 00 02 B2 00 /* 25: 44cd */
			39 01 00 00 00 00 02 B2 00 /* 26: 41cd */
			39 01 00 00 00 00 02 B2 00 /* 27: 39cd */
			39 01 00 00 00 00 02 B2 00 /* 28: 37cd */
			39 01 00 00 00 00 02 B2 00 /* 29: 34cd */
			39 01 00 00 00 00 02 B2 00 /* 30: 32cd */
			39 01 00 00 00 00 02 B2 00 /* 31: 30cd */
			39 01 00 00 00 00 02 B2 00 /* 32: 29cd */
			39 01 00 00 00 00 02 B2 00 /* 33: 27cd */
			39 01 00 00 00 00 02 B2 00 /* 34: 25-21cd */
			39 01 00 00 00 00 02 B2 00 /* 35: 20-16cd */
			39 01 00 00 00 00 02 B2 00 /* 36: 15-11cd */
			39 01 00 00 00 00 02 B2 00 /* 37: 10-5cd */
			39 01 00 00 00 00 02 B2 00 /* 38: 4-2cd */
		];

		/* bl_level, Index in elvss command list */
		samsung,elvss_map_table_revA = <
		     /* candela elvss_tx_cmd_id */
			2	38
			3	38
			4	38
			5	37
			6	37
			7	37
			8	37
			9	37
			10	37
			11	36
			12	36
			13	36
			14	36
			15	36
			16	35
			17	35
			19	35
			20	35
			21	34
			22	34
			24	34
			25	34
			27	33
			29	32
			30	31
			32	30
			34	29
			37	28
			39	27
			41	26
			44	25
			47	24
			50	23
			53	22
			56	21
			60	20
			64	20
			68	20
			72	20
			77	20
			82	20
			87	20
			93	20
			98	20
			105	20
			111	19
			119	18
			126	17
			134	16
			143	15
			152	14
			162	13
			172	12
			183	11
			195	10
			207	9
			220	8
			234	7
			249	6
			265	5
			282	4
			300	3
			316	2
			333	1
			360	0
		>;

		/*
		 * ************************************************************************************************************************
		 * SMART ACL(ACL On) ELVSS command list and mappings
		 * ************************************************************************************************************************
		 */

		/* 0xB2 address 103rd parameter value*/
		samsung,smart_acl_elvss_tx_cmds_revA = [
			39 01 00 00 00 00 02 B2 0F /* 0: 360cd */
			39 01 00 00 00 00 02 B2 10 /* 1: 333cd */
			39 01 00 00 00 00 02 B2 11 /* 2: 316cd */
			39 01 00 00 00 00 02 B2 12 /* 3: 300cd */
			39 01 00 00 00 00 02 B2 13 /* 4: 282cd */
			39 01 00 00 00 00 02 B2 13 /* 5: 265cd */
			39 01 00 00 00 00 02 B2 14 /* 6: 249cd */
			39 01 00 00 00 00 02 B2 14 /* 7: 234cd */
			39 01 00 00 00 00 02 B2 14 /* 8: 220cd */
			39 01 00 00 00 00 02 B2 15 /* 9: 207cd */
			39 01 00 00 00 00 02 B2 15 /* 10: 195cd */
			39 01 00 00 00 00 02 B2 15 /* 11: 183cd */
			39 01 00 00 00 00 02 B2 15 /* 12: 172cd */
			39 01 00 00 00 00 02 B2 16 /* 13: 162cd */
			39 01 00 00 00 00 02 B2 16 /* 14: 152cd */
			39 01 00 00 00 00 02 B2 17 /* 15: 143cd */
			39 01 00 00 00 00 02 B2 18 /* 16: 134cd */
			39 01 00 00 00 00 02 B2 18 /* 17: 126cd */
			39 01 00 00 00 00 02 B2 19 /* 18: 119cd */
			39 01 00 00 00 00 02 B2 19 /* 19: 111cd */
			39 01 00 00 00 00 02 B2 19 /* 20: 105-60cd */
			39 01 00 00 00 00 02 B2 19 /* 21: 56cd */
			39 01 00 00 00 00 02 B2 18 /* 22: 53cd */
			39 01 00 00 00 00 02 B2 18 /* 23: 50cd */
			39 01 00 00 00 00 02 B2 17 /* 24: 47cd */
			39 01 00 00 00 00 02 B2 17 /* 25: 44cd */
			39 01 00 00 00 00 02 B2 16 /* 26: 41cd */
			39 01 00 00 00 00 02 B2 16 /* 27: 39cd */
			39 01 00 00 00 00 02 B2 16 /* 28: 37cd */
			39 01 00 00 00 00 02 B2 15 /* 29: 34cd */
			39 01 00 00 00 00 02 B2 15 /* 30: 32cd */
			39 01 00 00 00 00 02 B2 14 /* 31: 30cd */
			39 01 00 00 00 00 02 B2 14 /* 32: 29cd */
			39 01 00 00 00 00 02 B2 14 /* 33: 27cd */
			39 01 00 00 00 00 02 B2 13 /* 34: 25-21cd */
			39 01 00 00 00 00 02 B2 12 /* 35: 20-16cd */
			39 01 00 00 00 00 02 B2 11 /* 36: 15-11cd */
			39 01 00 00 00 00 02 B2 10 /* 37: 10-5cd */
			39 01 00 00 00 00 02 B2 0F /* 38: 4-2cd */
		];

		samsung,smart_acl_elvss_lowtemp_tx_cmds_revA = [
			39 01 00 00 00 00 02 B2 05 /* 0: 360cd */
			39 01 00 00 00 00 02 B2 06 /* 1: 333cd */
			39 01 00 00 00 00 02 B2 07 /* 2: 316cd */
			39 01 00 00 00 00 02 B2 08 /* 3: 300cd */
			39 01 00 00 00 00 02 B2 09 /* 4: 282cd */
			39 01 00 00 00 00 02 B2 09 /* 5: 265cd */
			39 01 00 00 00 00 02 B2 0A /* 6: 249cd */
			39 01 00 00 00 00 02 B2 0A /* 7: 234cd */
			39 01 00 00 00 00 02 B2 0A /* 8: 220cd */
			39 01 00 00 00 00 02 B2 0B /* 9: 207cd */
			39 01 00 00 00 00 02 B2 0B /* 10: 195cd */
			39 01 00 00 00 00 02 B2 0B /* 11: 183cd */
			39 01 00 00 00 00 02 B2 0B /* 12: 172cd */
			39 01 00 00 00 00 02 B2 0C /* 13: 162cd */
			39 01 00 00 00 00 02 B2 0C /* 14: 152cd */
			39 01 00 00 00 00 02 B2 0D /* 15: 143cd */
			39 01 00 00 00 00 02 B2 0E /* 16: 134cd */
			39 01 00 00 00 00 02 B2 0E /* 17: 126cd */
			39 01 00 00 00 00 02 B2 0F /* 18: 119cd */
			39 01 00 00 00 00 02 B2 0F /* 19: 111cd */
			39 01 00 00 00 00 02 B2 0F /* 20: 105-60cd */
			39 01 00 00 00 00 02 B2 0F /* 21: 56cd */
			39 01 00 00 00 00 02 B2 0E /* 22: 53cd */
			39 01 00 00 00 00 02 B2 0E /* 23: 50cd */
			39 01 00 00 00 00 02 B2 0D /* 24: 47cd */
			39 01 00 00 00 00 02 B2 0D /* 25: 44cd */
			39 01 00 00 00 00 02 B2 0C /* 26: 41cd */
			39 01 00 00 00 00 02 B2 0C /* 27: 39cd */
			39 01 00 00 00 00 02 B2 0C /* 28: 37cd */
			39 01 00 00 00 00 02 B2 0B /* 29: 34cd */
			39 01 00 00 00 00 02 B2 0B /* 30: 32cd */
			39 01 00 00 00 00 02 B2 0A /* 31: 30cd */
			39 01 00 00 00 00 02 B2 0A /* 32: 29cd */
			39 01 00 00 00 00 02 B2 0A /* 33: 27cd */
			39 01 00 00 00 00 02 B2 09 /* 34: 25-21cd */
			39 01 00 00 00 00 02 B2 08 /* 35: 20-16cd */
			39 01 00 00 00 00 02 B2 07 /* 36: 15-11cd */
			39 01 00 00 00 00 02 B2 06 /* 37: 10-5cd */
			39 01 00 00 00 00 02 B2 05 /* 38: 4-2cd */
		];

		samsung,smart_acl_elvss_lowtemp2_tx_cmds_revA = [
			39 01 00 00 00 00 02 B2 00 /* 0: 360cd */
			39 01 00 00 00 00 02 B2 01 /* 1: 333cd */
			39 01 00 00 00 00 02 B2 02 /* 2: 316cd */
			39 01 00 00 00 00 02 B2 03 /* 3: 300cd */
			39 01 00 00 00 00 02 B2 04 /* 4: 282cd */
			39 01 00 00 00 00 02 B2 04 /* 5: 265cd */
			39 01 00 00 00 00 02 B2 05 /* 6: 249cd */
			39 01 00 00 00 00 02 B2 05 /* 7: 234cd */
			39 01 00 00 00 00 02 B2 05 /* 8: 220cd */
			39 01 00 00 00 00 02 B2 06 /* 9: 207cd */
			39 01 00 00 00 00 02 B2 06 /* 10: 195cd */
			39 01 00 00 00 00 02 B2 06 /* 11: 183cd */
			39 01 00 00 00 00 02 B2 06 /* 12: 172cd */
			39 01 00 00 00 00 02 B2 07 /* 13: 162cd */
			39 01 00 00 00 00 02 B2 07 /* 14: 152cd */
			39 01 00 00 00 00 02 B2 08 /* 15: 143cd */
			39 01 00 00 00 00 02 B2 09 /* 16: 134cd */
			39 01 00 00 00 00 02 B2 09 /* 17: 126cd */
			39 01 00 00 00 00 02 B2 0A /* 18: 119cd */
			39 01 00 00 00 00 02 B2 0A /* 19: 111cd */
			39 01 00 00 00 00 02 B2 0A /* 20: 105-60cd */
			39 01 00 00 00 00 02 B2 0A /* 21: 56cd */
			39 01 00 00 00 00 02 B2 09 /* 22: 53cd */
			39 01 00 00 00 00 02 B2 09 /* 23: 50cd */
			39 01 00 00 00 00 02 B2 08 /* 24: 47cd */
			39 01 00 00 00 00 02 B2 08 /* 25: 44cd */
			39 01 00 00 00 00 02 B2 07 /* 26: 41cd */
			39 01 00 00 00 00 02 B2 07 /* 27: 39cd */
			39 01 00 00 00 00 02 B2 07 /* 28: 37cd */
			39 01 00 00 00 00 02 B2 06 /* 29: 34cd */
			39 01 00 00 00 00 02 B2 06 /* 30: 32cd */
			39 01 00 00 00 00 02 B2 05 /* 31: 30cd */
			39 01 00 00 00 00 02 B2 05 /* 32: 29cd */
			39 01 00 00 00 00 02 B2 05 /* 33: 27cd */
			39 01 00 00 00 00 02 B2 04 /* 34: 25-21cd */
			39 01 00 00 00 00 02 B2 03 /* 35: 20-16cd */
			39 01 00 00 00 00 02 B2 02 /* 36: 15-11cd */
			39 01 00 00 00 00 02 B2 01 /* 37: 10-5cd */
			39 01 00 00 00 00 02 B2 00 /* 38: 4-2cd */
		];

		/* bl_level, Index in elvss command list */
		samsung,smart_acl_elvss_map_table_revA = <
		     /* candela elvss_tx_cmd_id */
			2	38
			3	38
			4	38
			5	37
			6	37
			7	37
			8	37
			9	37
			10	37
			11	36
			12	36
			13	36
			14	36
			15	36
			16	35
			17	35
			19	35
			20	35
			21	34
			22	34
			24	34
			25	34
			27	33
			29	32
			30	31
			32	30
			34	29
			37	28
			39	27
			41	26
			44	25
			47	24
			50	23
			53	22
			56	21
			60	20
			64	20
			68	20
			72	20
			77	20
			82	20
			87	20
			93	20
			98	20
			105	20
			111	19
			119	18
			126	17
			134	16
			143	15
			152	14
			162	13
			172	12
			183	11
			195	10
			207	9
			220	8
			234	7
			249	6
			265	5
			282	4
			300	3
			316	2
			333	1
			360	0
		>;
		/*
		 * ************************************************************************************************************************
		 * candela to index mappings
		 * ************************************************************************************************************************
		 */
		samsung,candela_map_table_revA = <
		/*<idx>   <from>  <till> <candella> */
			0	0	0	2
			1       1	1       3
			2       2	2       4
			3       3	3       5
			4       4	4       6
			5       5	5       7
			6       6	6       8
			7       7	7       9
			8       8	8       10
			9       9	9       11
			10	10	10      12
			11	11	11      13
			12	12	12      14
			13	13	13      15
			14	14	14      16
			15	15	15      17
			16	16	16      19
			17	17	17      20
			18	18	18      21
			19	19	19      22
			20	20	20      24
			21	21	21      25
			22	22	23      27
			23	24	25      29
			24	26	27      30
			25	28	29      32
			26	30	31      34
			27	32	33      37
			28	34	35      39
			29	36	37      41
			30	38	39      44
			31	40	41      47
			32	42	43      50
			33	44	45      53
			34	46	48      56
			35	49	51      60
			36	52	54      64
			37	55	57      68
			38	58	60      72
			39	61	63      77
			40	64	66      82
			41	67	69      87
			42	70	72      93
			43	73	76      98
			44	77	80      105
			45	81	86      111
			46	87	91      119
			47	92	97      126
			48	98	104	134
			49	105	110	143
			50	111	118	152
			51	119	125	162
			52	126	133	172
			53	134	142	183
			54	143	150	195
			55	151	160	207
			56	161	170	220
			57	171	181	234
			58	182	192	249
			59	193	203	265
			60	204	214	282
			61	215	225	300
			62	226	235	316
			63	236	245	333
			64	246	255	360
		>;

		samsung,hbm_candela_map_table_revA = <
			0	268	279	378	6
			1	280	292	395	7
			2	293	304	413	8
			3	305	317	430	9
			4	318	329	448	10
			5	330	341	465	11
			6	342	354	483	12
			7	355	355	500	13
		>;
	};
};
