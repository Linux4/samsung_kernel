/* Copyright (c) 2013-2014, The Linux Foundation. All rights reserved.
 *
 * This program is free software; you can redistribute it and/or modify
 * it under the terms of the GNU General Public License version 2 and
 * only version 2 as published by the Free Software Foundation.
 *
 * This program is distributed in the hope that it will be useful,
 * but WITHOUT ANY WARRANTY; without even the implied warranty of
 * MERCHANTABILITY or FITNESS FOR A PARTICULAR PURPOSE.  See the
 * GNU General Public License for more details.
 */

&mdss_mdp {
	ss_dsi_panel_ANA38401_AMS968HH01_QXGA: ss_dsi_panel_ANA38401_AMS968HH01_QXGA {
		qcom,mdss-dsi-panel-name = "ss_dsi_panel_ANA38401_AMS968HH01_QXGA";
		label = "ss_dsi_panel_ANA38401_AMS968HH01_QXGA";

		qcom,mdss-dsi-panel-width = <1024>;
		qcom,mdss-dsi-panel-height = <1536>;
		qcom,mdss-dsi-bpp = <24>;
		qcom,mdss-dsi-panel-timings = [00 1E 08 07 24 22 08 08 05 03 04 00];
		qcom,mdss-dsi-panel-timings-phy-v2 = [
			24 1F 08 09 05 03 04 a0
			24 1F 08 09 05 03 04 a0
			24 1F 08 09 05 03 04 a0
			24 1F 08 09 05 03 04 a0
			24 1B 08 09 05 03 04 a0
		];

		qcom,mdss-dsi-on-command= [
			15 01 00 00 00 00 02 B0 34		/* Global Para*/
			39 01 00 00 00 00 03 B2 64 00		/* check fail off */

			15 01 00 00 00 00 02 B0 75		/* Global Para 117th */
			39 01 00 00 00 00 02 B2 28		/* INTR Setting */

			15 01 00 00 00 00 02 B0 51		/* Global Para 81st */
			39 01 00 00 00 00 02 B1 06		/* dual dsi Setting */

			15 01 00 00 00 00 02 B0 D9		/* Global Para 217th */
			39 01 00 00 00 00 02 B1 08		/* Anapass compression mode Setting */

			15 01 00 00 00 00 02 B0 7F		/* Global Para 127th */
			39 01 00 00 00 00 02 B2 15		/* TSP_HTE TSP_VTE Setting */

			39 01 00 00 00 00 03 44 05 F6		/* Set Tear Scanline 1526  */

			15 01 00 00 00 00 02 B0 BC		/* Global Para 188th  ?? */
			39 01 00 00 00 00 02 B2 04		/* Gamma Offset index setting  ??*/

			39 01 00 00 00 00 22 83			/* Brightness condition set */
				80 80
				80 80
				80 80
				80 00
				80 80
				00
				80 80
				80 80
				80 80
				80 00
				80 80
				00
				80 80
				80 80
				80 80
				80 00
				80 80
				00

			39 01 00 00 00 00 04 90 00 00 0E	/* AID 360 nit */

			15 01 00 00 00 00 02 B0 67		/* Global Para 103rd */
			39 01 00 00 00 00 02 B2 0F		/* 360 nit ELVSS */

			15 01 00 00 00 00 02 B0 4D		/* Global Para 77th */
			39 01 00 00 00 00 02 B2 04		/* 16 Frame Avg at ACL off */

			15 01 00 00 00 00 02 B0 36		/* Global Para 54th */
			39 01 00 00 00 00 02 B2 10		/* ACL off */

			15 01 00 00 00 00 02 B0 6D		/* Global Para 109th */
			39 01 00 00 00 00 02 B2 85		/* CAPS on */

			15 01 00 00 00 00 02 B0 35		/* Global Para 53rd */
			39 01 00 00 00 00 02 B2 01		/* Gamma Update: Update key */

								/* ELVSS Temp Compensation */

			15 01 00 00 00 00 02 B0 D0		/* Global Para 208th */
			39 01 00 00 D7 00 02 B1 1D		/* UPLL_F = 35 then delay  215ms */

			05 01 00 00 00 00 02 29 00		/* display on then 50ms delay??*/
		];

		qcom,mdss-dsi-off-command=[
			05 01 00 00 64 00 02 28 00
		];

		/*qcom,cont-splash-enabled;*/
		qcom,dcs-cmd-by-left;
		/*qcom,mdss-dsi-force-clk-lane-hs;*/
		/*qcom,cmd-sync-wait-broadcast;*/
		/*qcom,cmd-sync-wait-trigger;*/
		/*qcom,mdss-dsi-fbc-enable=*/
		/*qcom,mdss-dsi-fbc-bpp=*/
		/*qcom,mdss-dsi-fbc-packing=*/
		/*qcom,mdss-dsi-fbc-quant-error=*/
		/*qcom,mdss-dsi-fbc-bias=*/
		/*qcom,mdss-dsi-fbc-pat-mode=*/
		/*qcom,mdss-dsi-fbc-vlc-mode=*/
		/*qcom,mdss-dsi-fbc-bflc-mode=*/
		/*qcom,mdss-dsi-fbc-h-line-budget=*/
		/*qcom,mdss-dsi-fbc-budget-ctrl=*/
		/*qcom,mdss-dsi-fbc-block-budget=*/
		/*qcom,mdss-dsi-fbc-lossless-threshold=*/
		/*qcom,mdss-dsi-fbc-lossy-threshold=*/
		/*qcom,mdss-dsi-fbc-rgb-threshold=*/
		/*qcom,mdss-dsi-fbc-lossy-mode-idx=*/

		qcom,mdss-dsi-h-back-porch = <108>;//<108>;
		qcom,mdss-dsi-h-front-porch = <212>; //<16>;
		qcom,mdss-dsi-h-pulse-width = <16>; //<212>;
		qcom,mdss-dsi-h-sync-skew = <0>;
		qcom,mdss-dsi-v-back-porch = <6>;
		qcom,mdss-dsi-v-front-porch = <10>;
		qcom,mdss-dsi-v-pulse-width = <2>;

		qcom,mdss-dsi-h-left-border = <0>;
		qcom,mdss-dsi-h-right-border = <0>;
		qcom,mdss-dsi-v-top-border = <0>;
		qcom,mdss-dsi-v-bottom-border = <0>;

		qcom,mdss-dsi-underflow-color = <0xFF>;
		qcom,mdss-dsi-border-color = <0>;

		/*qcom,mdss-dsi-pan-enable-dynamic-fps=*/
		/*qcom,mdss-dsi-pan-fps-update=*/

		qcom,mdss-dsi-bl-pmic-control-type = "bl_ctrl_dcs";
		/*qcom,mdss-dsi-bl-pmic-bank-select=*/
		/*qcom,mdss-dsi-bl-pmic-pwm-frequency=*/
		/*qcom,mdss-dsi-pwm-gpio=*/

		qcom,mdss-dsi-bl-min-level = <1>;
		qcom,mdss-dsi-bl-max-level = <355>;
		qcom,mdss-brightness-max-level = <355>;
		qcom,mdss-dsi-interleave-mode = <0>;
		qcom,mdss-dsi-panel-type = "dsi_cmd_mode";
		qcom,mdss-dsi-force-clock-lane-hs;

		qcom,mdss-dsi-te-check-enable;
		qcom,mdss-dsi-te-using-te-pin;
		qcom,mdss-dsi-te-pin-select = <1>;

		qcom,mdss-dsi-te-dcs-command = <1>;
		qcom,mdss-dsi-wr-mem-start = <0x2C>;
		qcom,mdss-dsi-wr-mem-continue = <0x3C>;

		/* CMD mode panel doesn't need below stuff */
		qcom,mdss-dsi-h-sync-pulse= <0>;
		/*qcom,mdss-dsi-hfp-power-mode=*/
		/*qcom,mdss-dsi-hbp-power-mode=*/
		/*qcom,mdss-dsi-hsa-power-mode=*/
		/*qcom,mdss-dsi-last-line-interleave=*/
		/*qcom,mdss-dsi-bllp-eof-power-mode;*/
		/*qcom,mdss-dsi-bllp-power-mode;*/
		/*qcom,mdss-dsi-traffic-mode= "burst_mode";*/

		qcom,mdss-dsi-pixel-packing = "loose";

		qcom,mdss-dsi-virtual-channel-id = <0>;
		qcom,mdss-dsi-color-order = "rgb_swap_rgb";
		qcom,mdss-dsi-lane-0-state;
		qcom,mdss-dsi-lane-1-state;
		qcom,mdss-dsi-lane-2-state;
		qcom,mdss-dsi-lane-3-state;
		qcom,mdss-dsi-lane-map = "lane_map_0123";
		qcom,mdss-dsi-t-clk-pre = <0x2F>;
		qcom,mdss-dsi-t-clk-post = <0x0D>;

		qcom,mdss-dsi-stream = <0>;
		qcom,mdss-dsi-mdp-trigger = "none";
		qcom,mdss-dsi-dma-trigger = "trigger_sw";
		qcom,mdss-dsi-panel-framerate = <60>;
		qcom,mdss-dsi-panel-clockrate = <893200000>;
		qcom,mdss-dsi-on-command-state = "dsi_lp_mode";
		qcom,mdss-dsi-off-command-state = "dsi_hs_mode";

		qcom,mdss-pan-physical-width-dimension = <196>;
		qcom,mdss-pan-physical-height-dimension = <147>;
		
		qcom,mdss-dsi-panel-mode-gpio-state = "invalid";
		/* use fake_regulators in board dtsi,
		 * instead of qcom,mdss-dsi-reset-sequence
		 */
		qcom,mdss-dsi-reset-sequence = <1 5>, <0 5>, <1 5>;

		/*qcom,partial-update-enabled;*/
		/*qcom,partial-update-roi-merge;*/
		/*qcom,panel-roi-alignment=<8 8 1 1 1 1>;*/
		/*qcom,mdss-dsi-horizontal-line-idle*/

		qcom,mdss-dsi-lp11-init;
		qcom,mdss-dsi-init-delay-us = <1000>;

		qcom,mdss-dsi-rx-eot-ignore;
		qcom,mdss-dsi-tx-eot-append;

		/*qcom,ulps-enabled*/
		/*qcom,mdss-dsi-panel-status-command=*/
		/*qcom,mdss-dsi-panel-status-command-mode="dsi_lp_mode";*/

		qcom,esd-check-enabled;
		qcom,mdss-dsi-panel-status-check-mode="reg_read_irq";
 		qcom,mdss-dsi-panel-status-irq-trigger1="falling";

		qcom,mdss-dsi-panel-hdr-enabled;
		qcom,mdss-dsi-panel-hdr-color-primaries = <14880 15935 32435
			16555 14945 30910 7790 3415>;
		qcom,mdss-dsi-panel-peak-brightness = <5643000>;
		qcom,mdss-dsi-panel-blackness-level = <6134>;

		/*qcom,mdss-dsi-panel-status-value = <1>;*/
		/*qcom,mdss-dsi-panel-orientation = "180";*/
		/*qcom,dynamic-mode-switch-enabled*/
		/*qcom,video-to-cmd-mode-switch-commands=*/
		/*qcom,cmd-to-video-mode-switch-commands=*/
/*
 * ************************************************************************************************************************************
 *
 *
 *			Below  parameters are samsung dependent thigs
 *
 *
 * ************************************************************************************************************************************
 */
 		samsung,panel-vendor = "SDC";
		samsung,disp-model = "AMS968HH01";
		samsung,support_panel_max = <1>;
		samsung,tcon-clk-on-support;
		samsung,hw-config = "split_dsi";
		/*samsung,panel-lpm-enable;*/
		/*samsung,support_irc;*/
		/*samsung,elvss_interpolation_temperature = <(-15)>;*/
		/*samsung,support_factory_panel_swap;*/
		/*samsung,panel-extra-power-gpio1 = <&tlmm 117 0>;*/
		/*samsung ESD pin*/
		//samsung,esd-irq-gpio1 = <&tlmm 5 0>;
		samsung,mdss-power-on-reset-delay-us = <70000>;
		samsung,mdss-power-off-delay-us = <10000>;
		samsung,dsi-lp11-init;
 		samsung,enter_hbm_lux = <10000>;

		samsung,support_mdnie_lite;
		/*samsung,line_split;*/

		/*
		the last byte in read commands	represent READ LENGH,
		like below  READ LENGH = 0x21
		*/

		samsung,packet_size_tx_cmds_revA = [
			37 01 00 00 00 00 02 21 00
		];

		/*
		 * First parameters can be changed
		 * by function of samsung_nv_read()
		 * because of that means offset of
		 * read position
		 */
		samsung,reg_read_pos_tx_cmds_revA = [
			15 01 00 00 00 00 02 B0 00
		];

		samsung,smart_dimming_mtp_rx_cmds_revA = [24 01 00 00 00 00 02 d8 08 08 5A]; /*Offset 0x5A*/
		samsung,hbm_rx_cmds_revA = [24 01 00 00 00 00 02 d4 08 08 5B]; /*Offset 0x5B*/
		samsung,hbm2_rx_cmds_revA = [24 01 00 00 00 00 02 d8 01 01 81]; /*Offset 0x7B*/
		samsung,mdnie_read_rx_cmds_revA = [24 01 00 00 00 00 02 d8 04 04 7B]; /*Offset 0x7B : 123~ 126th para */
		samsung,elvss_rx_cmds_revA = [24 01 00 00 00 00 02 d2 01 01 70]; /*Offset 0x70*/
		samsung,mtp_read_sysfs_rx_cmds_revA = [24 01 00 00 00 00 02 00 00 00 00];

		/* the last byte in all read commands will represent READ LENGH */
		samsung,manufacture_read_pre_tx_cmds_revA = [
			15 01 00 00 00 00 02 B0 34
			39 01 00 00 00 00 03 B2 64 00

			15 01 00 00 00 00 02 B0 D9
			39 01 00 00 00 00 02 B1 08

			15 01 00 00 00 00 02 B0 51
			39 01 00 00 00 00 02 B1 06

			15 01 00 00 00 00 02 B0 75
			39 01 00 00 00 00 02 B2 28
		];

		samsung,manufacture_id0_rx_cmds_revA = [ 06 01 00 00 00 00 01 da 01 00];
		samsung,manufacture_id1_rx_cmds_revA = [ 06 01 00 00 00 00 01 db 01 00];
		samsung,manufacture_id2_rx_cmds_revA = [ 06 01 00 00 00 00 01 dc 01 00];

		samsung,manufacture_date_rx_cmds_revA = [24 01 00 00 00 00 02 D8 02 02 7F]; /*Offset 0x7F*/

		/*samsung,display_on_tx_cmds_revA = [05 01 00 00 32 00 02 29 00];*/
		samsung,display_off_tx_cmds_revA = [05 01 00 00 32 00 02 28 00];

		samsung,gamma_tx_cmds_revA = [
			39 01 00 00 00 00 22			/* Brightness condition set */
			83 80 80 80 80 80 80
			80 00 80 80 00 80 80
			80 80 80 80 80 00 80
			80 00 80 80 80 80 80
			80 80 00 80 80 00

			15 01 00 00 00 00 02 B0 35		/* Global Para 53rd */
			39 01 00 00 00 00 02 B2 01		/* Update key */
		];

		samsung,hbm_gamma_tx_cmds_revA = [
			39 01 00 00 00 00 22			/* Brightness condition set */
			83 80 80 80 80 80 80
			80 00 80 80 00 80 80
			80 80 80 80 80 00 80
			80 00 80 80 80 80 80
			80 80 00 80 80 00
		];

		samsung,hbm_etc_tx_cmds_revA = [
			39 01 00 00 00 00 04 90 00 00 0E	/* AID 360 nit */
			15 01 00 00 00 00 02 B0 67		/* Global Para 103rd */
			39 01 00 00 00 00 02 B2 17		/* ELVSS dim offset */
			15 01 00 00 00 00 02 B0 70		/* Global Para 112nd */
			39 01 00 00 00 00 02 B2 00		/* HBM ELVSS */
			15 01 00 00 00 00 02 B0 4D		/* Global Para 77th */
			39 01 00 00 00 00 02 B2 05		/* 32 Frame Avg at ACL on */
			15 01 00 00 00 00 02 B0 49		/* Global Para 73th */
			39 01 00 00 00 00 02 B2 99		/* Start setting: 60% start */
			15 01 00 00 00 00 02 B0 36		/* Global Para 54th */
			39 01 00 00 00 00 02 B2 11		/* ACL 8% on */
			15 01 00 00 00 00 02 B0 6D		/* Global Para 109th */
			39 01 00 00 00 00 02 B2 85		/* CAPS on */
			15 01 00 00 00 00 02 B0 35		/* Global Para 53rd */
			39 01 00 00 00 00 02 B2 01		/* Update key */
		];

		samsung,hbm_off_tx_cmds_revA = [
			15 00 00 00 00 00 02 B0 70		/* Global Para 112nd */
			39 00 00 00 00 00 02 B2 00		/* HBM ELVSS */
		];

		/*
		* ************************************************************************************************************************
		* AID command list and mappings
		* ************************************************************************************************************************
		*/

		samsung,aid_subdivision_tx_cmds_revA = [
						   /* AOR   bl  */
			39 01 00 00 00 00 04 90 01 00 7F /* 0   */
			39 01 00 00 00 00 04 90 01 00 7D /* 1   */
			39 01 00 00 00 00 04 90 01 00 7A /* 2   */
			39 01 00 00 00 00 04 90 01 00 78 /* 3   */
			39 01 00 00 00 00 04 90 01 00 75 /* 4   */
			39 01 00 00 00 00 04 90 01 00 72 /* 5   */
			39 01 00 00 00 00 04 90 01 00 6F /* 6   */
			39 01 00 00 00 00 04 90 01 00 6C /* 7   */
			39 01 00 00 00 00 04 90 01 00 69 /* 8   */
			39 01 00 00 00 00 04 90 01 00 67 /* 9   */
			39 01 00 00 00 00 04 90 01 00 64 /* 10  */
			39 01 00 00 00 00 04 90 01 00 61 /* 11  */
			39 01 00 00 00 00 04 90 01 00 5E /* 12  */
			39 01 00 00 00 00 04 90 01 00 5A /* 13  */
			39 01 00 00 00 00 04 90 01 00 58 /* 14  */
			39 01 00 00 00 00 04 90 01 00 56 /* 15  */
			39 01 00 00 00 00 04 90 01 00 50 /* 16  */
			39 01 00 00 00 00 04 90 01 00 4D /* 17  */
			39 01 00 00 00 00 04 90 01 00 48 /* 18  */
			39 01 00 00 00 00 04 90 01 00 45 /* 19  */
			39 01 00 00 00 00 04 90 01 00 3F /* 20  */
			39 01 00 00 00 00 04 90 01 00 3C /* 21  */
			39 01 00 00 00 00 04 90 01 00 39 /* 22  */
			39 01 00 00 00 00 04 90 01 00 36 /* 23  */
			39 01 00 00 00 00 04 90 01 00 33 /* 24  */
			39 01 00 00 00 00 04 90 01 00 30 /* 25  */
			39 01 00 00 00 00 04 90 01 00 2E /* 26  */
			39 01 00 00 00 00 04 90 01 00 2C /* 27  */
			39 01 00 00 00 00 04 90 01 00 29 /* 28  */
			39 01 00 00 00 00 04 90 01 00 26 /* 29  */
			39 01 00 00 00 00 04 90 01 00 22 /* 30  */
			39 01 00 00 00 00 04 90 01 00 1F /* 31  */
			39 01 00 00 00 00 04 90 01 00 1B /* 32  */
			39 01 00 00 00 00 04 90 01 00 16 /* 33  */
			39 01 00 00 00 00 04 90 01 00 13 /* 34  */
			39 01 00 00 00 00 04 90 01 00 0F /* 35  */
			39 01 00 00 00 00 04 90 01 00 0C /* 36  */
			39 01 00 00 00 00 04 90 01 00 09 /* 37  */
			39 01 00 00 00 00 04 90 01 00 04 /* 38  */
			39 01 00 00 00 00 04 90 00 00 FF /* 39  */
			39 01 00 00 00 00 04 90 00 00 FA /* 40  */
			39 01 00 00 00 00 04 90 00 00 F5 /* 41  */
			39 01 00 00 00 00 04 90 00 00 F0 /* 42  */
			39 01 00 00 00 00 04 90 00 00 EB /* 43  */
			39 01 00 00 00 00 04 90 00 00 E6 /* 44  */
			39 01 00 00 00 00 04 90 00 00 E1 /* 45  */
			39 01 00 00 00 00 04 90 00 00 DE /* 46  */
			39 01 00 00 00 00 04 90 00 00 DA /* 47  */
			39 01 00 00 00 00 04 90 00 00 D7 /* 48  */
			39 01 00 00 00 00 04 90 00 00 D2 /* 49  */
			39 01 00 00 00 00 04 90 00 00 CE /* 50  */
			39 01 00 00 00 00 04 90 00 00 C9 /* 51  */
			39 01 00 00 00 00 04 90 00 00 C4 /* 52  */
			39 01 00 00 00 00 04 90 00 00 C0 /* 53  */
			39 01 00 00 00 00 04 90 00 00 BB /* 54  */
			39 01 00 00 00 00 04 90 00 00 B6 /* 55  */
			39 01 00 00 00 00 04 90 00 00 B2 /* 56  */
			39 01 00 00 00 00 04 90 00 00 AD /* 57  */
			39 01 00 00 00 00 04 90 00 00 A6 /* 58  */
			39 01 00 00 00 00 04 90 00 00 A0 /* 59  */
			39 01 00 00 00 00 04 90 00 00 99 /* 60  */
			39 01 00 00 00 00 04 90 00 00 A3 /* 61  */
			39 01 00 00 00 00 04 90 00 00 9E /* 62  */
			39 01 00 00 00 00 04 90 00 00 99 /* 63  */
			39 01 00 00 00 00 04 90 00 00 A3 /* 64  */
			39 01 00 00 00 00 04 90 00 00 9E /* 65  */
			39 01 00 00 00 00 04 90 00 00 99 /* 66  */
			39 01 00 00 00 00 04 90 00 00 A2 /* 67  */
			39 01 00 00 00 00 04 90 00 00 9D /* 68  */
			39 01 00 00 00 00 04 90 00 00 99 /* 69  */
			39 01 00 00 00 00 04 90 00 00 A3 /* 70  */
			39 01 00 00 00 00 04 90 00 00 9E /* 71  */
			39 01 00 00 00 00 04 90 00 00 99 /* 72  */
			39 01 00 00 00 00 04 90 00 00 A2 /* 73  */
			39 01 00 00 00 00 04 90 00 00 9F /* 74  */
			39 01 00 00 00 00 04 90 00 00 9C /* 75  */
			39 01 00 00 00 00 04 90 00 00 99 /* 76  */
			39 01 00 00 00 00 04 90 00 00 A5 /* 77  */
			39 01 00 00 00 00 04 90 00 00 A1 /* 78  */
			39 01 00 00 00 00 04 90 00 00 9D /* 79  */
			39 01 00 00 00 00 04 90 00 00 99 /* 80  */
			39 01 00 00 00 00 04 90 00 00 A4 /* 81  */
			39 01 00 00 00 00 04 90 00 00 A1 /* 82  */
			39 01 00 00 00 00 04 90 00 00 9F /* 83  */
			39 01 00 00 00 00 04 90 00 00 9D /* 84  */
			39 01 00 00 00 00 04 90 00 00 9B /* 85  */
			39 01 00 00 00 00 04 90 00 00 99 /* 86  */
			39 01 00 00 00 00 04 90 00 00 A6 /* 87  */
			39 01 00 00 00 00 04 90 00 00 A2 /* 88  */
			39 01 00 00 00 00 04 90 00 00 9F /* 89  */
			39 01 00 00 00 00 04 90 00 00 9C /* 90  */
			39 01 00 00 00 00 04 90 00 00 99 /* 91  */
			39 01 00 00 00 00 04 90 00 00 A4 /* 92  */
			39 01 00 00 00 00 04 90 00 00 A2 /* 93  */
			39 01 00 00 00 00 04 90 00 00 A0 /* 94  */
			39 01 00 00 00 00 04 90 00 00 9D /* 95  */
			39 01 00 00 00 00 04 90 00 00 9B /* 96  */
			39 01 00 00 00 00 04 90 00 00 99 /* 97  */
			39 01 00 00 00 00 04 90 00 00 A5 /* 98  */
			39 01 00 00 00 00 04 90 00 00 A3 /* 99  */
			39 01 00 00 00 00 04 90 00 00 A1 /* 100 */
			39 01 00 00 00 00 04 90 00 00 9F /* 101 */
			39 01 00 00 00 00 04 90 00 00 9D /* 102 */
			39 01 00 00 00 00 04 90 00 00 9B /* 103 */
			39 01 00 00 00 00 04 90 00 00 99 /* 104 */
			39 01 00 00 00 00 04 90 00 00 A5 /* 105 */
			39 01 00 00 00 00 04 90 00 00 A3 /* 106 */
			39 01 00 00 00 00 04 90 00 00 A0 /* 107 */
			39 01 00 00 00 00 04 90 00 00 9E /* 108 */
			39 01 00 00 00 00 04 90 00 00 9B /* 109 */
			39 01 00 00 00 00 04 90 00 00 99 /* 110 */
			39 01 00 00 00 00 04 90 00 00 A5 /* 111 */
			39 01 00 00 00 00 04 90 00 00 A3 /* 112 */
			39 01 00 00 00 00 04 90 00 00 A2 /* 113 */
			39 01 00 00 00 00 04 90 00 00 A0 /* 114 */
			39 01 00 00 00 00 04 90 00 00 9E /* 115 */
			39 01 00 00 00 00 04 90 00 00 9C /* 116 */
			39 01 00 00 00 00 04 90 00 00 9B /* 117 */
			39 01 00 00 00 00 04 90 00 00 99 /* 118 */
			39 01 00 00 00 00 04 90 00 00 A5 /* 119 */
			39 01 00 00 00 00 04 90 00 00 A3 /* 120 */
			39 01 00 00 00 00 04 90 00 00 A1 /* 121 */
			39 01 00 00 00 00 04 90 00 00 9F /* 122 */
			39 01 00 00 00 00 04 90 00 00 9D /* 123 */
			39 01 00 00 00 00 04 90 00 00 9B /* 124 */
			39 01 00 00 00 00 04 90 00 00 99 /* 125 */
			39 01 00 00 00 00 04 90 00 00 A5 /* 126 */
			39 01 00 00 00 00 04 90 00 00 A3 /* 127 */
			39 01 00 00 00 00 04 90 00 00 A2 /* 128 */
			39 01 00 00 00 00 04 90 00 00 A0 /* 129 */
			39 01 00 00 00 00 04 90 00 00 9E /* 130 */
			39 01 00 00 00 00 04 90 00 00 9C /* 131 */
			39 01 00 00 00 00 04 90 00 00 9B /* 132 */
			39 01 00 00 00 00 04 90 00 00 99 /* 133 */
			39 01 00 00 00 00 04 90 00 00 97 /* 134 */
			39 01 00 00 00 00 04 90 00 00 95 /* 135 */
			39 01 00 00 00 00 04 90 00 00 93 /* 136 */
			39 01 00 00 00 00 04 90 00 00 91 /* 137 */
			39 01 00 00 00 00 04 90 00 00 8E /* 138 */
			39 01 00 00 00 00 04 90 00 00 8C /* 139 */
			39 01 00 00 00 00 04 90 00 00 8A /* 140 */
			39 01 00 00 00 00 04 90 00 00 88 /* 141 */
			39 01 00 00 00 00 04 90 00 00 86 /* 142 */
			39 01 00 00 00 00 04 90 00 00 83 /* 143 */
			39 01 00 00 00 00 04 90 00 00 81 /* 144 */
			39 01 00 00 00 00 04 90 00 00 7E /* 145 */
			39 01 00 00 00 00 04 90 00 00 7C /* 146 */
			39 01 00 00 00 00 04 90 00 00 79 /* 147 */
			39 01 00 00 00 00 04 90 00 00 76 /* 148 */
			39 01 00 00 00 00 04 90 00 00 74 /* 149 */
			39 01 00 00 00 00 04 90 00 00 71 /* 150 */
			39 01 00 00 00 00 04 90 00 00 6F /* 151 */
			39 01 00 00 00 00 04 90 00 00 6D /* 152 */
			39 01 00 00 00 00 04 90 00 00 6B /* 153 */
			39 01 00 00 00 00 04 90 00 00 69 /* 154 */
			39 01 00 00 00 00 04 90 00 00 67 /* 155 */
			39 01 00 00 00 00 04 90 00 00 64 /* 156 */
			39 01 00 00 00 00 04 90 00 00 62 /* 157 */
			39 01 00 00 00 00 04 90 00 00 60 /* 158 */
			39 01 00 00 00 00 04 90 00 00 5E /* 159 */
			39 01 00 00 00 00 04 90 00 00 5C /* 160 */
			39 01 00 00 00 00 04 90 00 00 5A /* 161 */
			39 01 00 00 00 00 04 90 00 00 57 /* 162 */
			39 01 00 00 00 00 04 90 00 00 55 /* 163 */
			39 01 00 00 00 00 04 90 00 00 53 /* 164 */
			39 01 00 00 00 00 04 90 00 00 51 /* 165 */
			39 01 00 00 00 00 04 90 00 00 4E /* 166 */
			39 01 00 00 00 00 04 90 00 00 4C /* 167 */
			39 01 00 00 00 00 04 90 00 00 4A /* 168 */
			39 01 00 00 00 00 04 90 00 00 47 /* 169 */
			39 01 00 00 00 00 04 90 00 00 45 /* 170 */
			39 01 00 00 00 00 04 90 00 00 43 /* 171 */
			39 01 00 00 00 00 04 90 00 00 40 /* 172 */
			39 01 00 00 00 00 04 90 00 00 3E /* 173 */
			39 01 00 00 00 00 04 90 00 00 3C /* 174 */
			39 01 00 00 00 00 04 90 00 00 39 /* 175 */
			39 01 00 00 00 00 04 90 00 00 37 /* 176 */
			39 01 00 00 00 00 04 90 00 00 34 /* 177 */
			39 01 00 00 00 00 04 90 00 00 32 /* 178 */
			39 01 00 00 00 00 04 90 00 00 30 /* 179 */
			39 01 00 00 00 00 04 90 00 00 2D /* 180 */
			39 01 00 00 00 00 04 90 00 00 2B /* 181 */
			39 01 00 00 00 00 04 90 00 00 29 /* 182 */
			39 01 00 00 00 00 04 90 00 00 26 /* 183 */
			39 01 00 00 00 00 04 90 00 00 24 /* 184 */
			39 01 00 00 00 00 04 90 00 00 21 /* 185 */
			39 01 00 00 00 00 04 90 00 00 1F /* 186 */
			39 01 00 00 00 00 04 90 00 00 1D /* 187 */
			39 01 00 00 00 00 04 90 00 00 1A /* 188 */
			39 01 00 00 00 00 04 90 00 00 18 /* 189 */
			39 01 00 00 00 00 04 90 00 00 15 /* 190 */
			39 01 00 00 00 00 04 90 00 00 13 /* 191 */
			39 01 00 00 00 00 04 90 00 00 10 /* 192 */
			39 01 00 00 00 00 04 90 00 00 0E /* 193 */
			39 01 00 00 00 00 04 90 00 00 23 /* 194 */
			39 01 00 00 00 00 04 90 00 00 21 /* 195 */
			39 01 00 00 00 00 04 90 00 00 1F /* 196 */
			39 01 00 00 00 00 04 90 00 00 1D /* 197 */
			39 01 00 00 00 00 04 90 00 00 1B /* 198 */
			39 01 00 00 00 00 04 90 00 00 19 /* 199 */
			39 01 00 00 00 00 04 90 00 00 17 /* 200 */
			39 01 00 00 00 00 04 90 00 00 16 /* 201 */
			39 01 00 00 00 00 04 90 00 00 14 /* 202 */
			39 01 00 00 00 00 04 90 00 00 12 /* 203 */
			39 01 00 00 00 00 04 90 00 00 10 /* 204 */
			39 01 00 00 00 00 04 90 00 00 0E /* 205 */
			39 01 00 00 00 00 04 90 00 00 23 /* 206 */
			39 01 00 00 00 00 04 90 00 00 21 /* 207 */
			39 01 00 00 00 00 04 90 00 00 1F /* 208 */
			39 01 00 00 00 00 04 90 00 00 1E /* 209 */
			39 01 00 00 00 00 04 90 00 00 1C /* 210 */
			39 01 00 00 00 00 04 90 00 00 1A /* 211 */
			39 01 00 00 00 00 04 90 00 00 18 /* 212 */
			39 01 00 00 00 00 04 90 00 00 17 /* 213 */
			39 01 00 00 00 00 04 90 00 00 15 /* 214 */
			39 01 00 00 00 00 04 90 00 00 13 /* 215 */
			39 01 00 00 00 00 04 90 00 00 11 /* 216 */
			39 01 00 00 00 00 04 90 00 00 10 /* 217 */
			39 01 00 00 00 00 04 90 00 00 0E /* 218 */
			39 01 00 00 00 00 04 90 00 00 23 /* 219 */
			39 01 00 00 00 00 04 90 00 00 21 /* 220 */
			39 01 00 00 00 00 04 90 00 00 1F /* 221 */
			39 01 00 00 00 00 04 90 00 00 1D /* 222 */
			39 01 00 00 00 00 04 90 00 00 1B /* 223 */
			39 01 00 00 00 00 04 90 00 00 19 /* 224 */
			39 01 00 00 00 00 04 90 00 00 17 /* 225 */
			39 01 00 00 00 00 04 90 00 00 15 /* 226 */
			39 01 00 00 00 00 04 90 00 00 14 /* 227 */
			39 01 00 00 00 00 04 90 00 00 12 /* 228 */
			39 01 00 00 00 00 04 90 00 00 10 /* 229 */
			39 01 00 00 00 00 04 90 00 00 0E /* 230 */
			39 01 00 00 00 00 04 90 00 00 1F /* 231 */
			39 01 00 00 00 00 04 90 00 00 1E /* 232 */
			39 01 00 00 00 00 04 90 00 00 1C /* 233 */
			39 01 00 00 00 00 04 90 00 00 1B /* 234 */
			39 01 00 00 00 00 04 90 00 00 19 /* 235 */
			39 01 00 00 00 00 04 90 00 00 17 /* 236 */
			39 01 00 00 00 00 04 90 00 00 16 /* 237 */
			39 01 00 00 00 00 04 90 00 00 14 /* 238 */
			39 01 00 00 00 00 04 90 00 00 13 /* 239 */
			39 01 00 00 00 00 04 90 00 00 11 /* 240 */
			39 01 00 00 00 00 04 90 00 00 10 /* 241 */
			39 01 00 00 00 00 04 90 00 00 0E /* 242 */
			39 01 00 00 00 00 04 90 00 00 1F /* 243 */
			39 01 00 00 00 00 04 90 00 00 1E /* 244 */
			39 01 00 00 00 00 04 90 00 00 1C /* 245 */
			39 01 00 00 00 00 04 90 00 00 1A /* 246 */
			39 01 00 00 00 00 04 90 00 00 18 /* 247 */
			39 01 00 00 00 00 04 90 00 00 17 /* 248 */
			39 01 00 00 00 00 04 90 00 00 15 /* 249 */
			39 01 00 00 00 00 04 90 00 00 13 /* 250 */
			39 01 00 00 00 00 04 90 00 00 11 /* 251 */
			39 01 00 00 00 00 04 90 00 00 10 /* 252 */
			39 01 00 00 00 00 04 90 00 00 0E /* 253 */
			39 01 00 00 00 00 04 90 00 00 0E /* 254 */
			39 01 00 00 00 00 04 90 00 00 0E /* 255 */
		];


		/*
		* ************************************************************************************************************************
		* CAPS on/off command list and mappings
		* ************************************************************************************************************************
		*/

		samsung,pre_caps_setting_tx_cmds_revA = [
			15 01 00 00 00 00 02 B0 6D		/* Global para 109 */
		];

		samsung,caps_setting_tx_cmds_revA = [
			39 01 00 00 00 00 02 B2 81		/* 2~39CD 0 */
			39 01 00 00 00 00 02 B2 85		/* 44~143CD 1 */
		];

		/* bl_level , Index in caps command list */
		samsung,caps_map_table_revA =  <
			2	0
			3	0
			4	0
			5	0
			6	0
			7	0
			8	0
			9	0
			10	0
			11	0
			12	0
			13	0
			14	0
			15	0
			16	0
			17	0
			19	0
			20	0
			21	0
			22	0
			24	0
			25	0
			27	0
			29	0
			30	0
			32	0
			34	0
			37	0
			39	0
			41	1
			44	1
			47	1
			50	1
			53	1
			56	1
			60	1
			64	1
			68	1
			72	1
			77	1
			82	1
			87	1
			93	1
			98	1
			105	1
			111	1
			119	1
			126	1
			134	1
			143	1
			152	1
			162	1
			172	1
			183	1
			195	1
			207	1
			220	1
			234	1
			249	1
			265	1
			282	1
			300	1
			316	1
			333	1
			360	1
		>;

		/*
		 * ************************************************************************************************************************
		* ACL command list and mappings
		 * ************************************************************************************************************************
		 */
		samsung,acl_on_tx_cmds_revA = [
			15 01 00 00 00 00 02 B0 4D		/* Global Para 77th */
			39 01 00 00 00 00 02 B2 05		/* 32 Frame Avg at ACL on */
			15 01 00 00 00 00 02 B0 49		/* Global Para 73th */
			39 01 00 00 00 00 02 B2 7F		/* Start setting: 50% start */
			15 01 00 00 00 00 02 B0 36		/* Global Para 54th */
			39 01 00 00 00 00 02 B2 12		/* ACL 15% on */
		]; /* ACL on, B2 <- 0x05 */

		samsung,acl_off_tx_cmds_revA = [
			15 01 00 00 00 00 02 B0 4D		/* Global Para 77th */
			39 01 00 00 00 00 02 B2 04		/* 16 Frame Avg at ACL off */
			15 01 00 00 00 00 02 B0 49		/* Global Para 73th */
			39 01 00 00 00 00 02 B2 7F		/* Start setting: 50% start */
			15 01 00 00 00 00 02 B0 36		/* Global Para 54th */
			39 01 00 00 00 00 02 B2 10		/* ACL off */
		];/*off, b2<-0x04*/

		/*
		 * ************************************************************************************************************************
		* ELVSS(ACL Off) command list and mappings
		 * ************************************************************************************************************************
		 */
		samsung,elvss_pre_tx_cmds_revA = [15 01 00 00 00 00 02 B0 67];
		samsung,elvss_tx_cmds_revA = [
			39 01 00 00 00 00 02 b2 19 /* 0: 360cd */
			39 01 00 00 00 00 02 b2 1A /* 1: 333cd */
			39 01 00 00 00 00 02 b2 1B /* 2: 316cd */
			39 01 00 00 00 00 02 b2 1C /* 3: 300cd */
			39 01 00 00 00 00 02 b2 1D /* 4: 282cd */
			39 01 00 00 00 00 02 b2 1D /* 5: 265cd */
			39 01 00 00 00 00 02 b2 1E /* 6: 249cd */
			39 01 00 00 00 00 02 b2 1E /* 7: 234cd */
			39 01 00 00 00 00 02 b2 1E /* 8: 220cd */
			39 01 00 00 00 00 02 b2 1F /* 9: 207cd */
			39 01 00 00 00 00 02 b2 1F /* 10: 195cd */
			39 01 00 00 00 00 02 b2 1F /* 11: 183cd */
			39 01 00 00 00 00 02 b2 1F /* 12: 172cd */
			39 01 00 00 00 00 02 b2 20 /* 13: 162cd */
			39 01 00 00 00 00 02 b2 20 /* 14: 152cd */
			39 01 00 00 00 00 02 b2 21 /* 15: 143cd */
			39 01 00 00 00 00 02 b2 21 /* 16: 134cd */
			39 01 00 00 00 00 02 b2 21 /* 17: 126cd */
			39 01 00 00 00 00 02 b2 21 /* 18: 119cd */
			39 01 00 00 00 00 02 b2 21 /* 19: 111cd */
			39 01 00 00 00 00 02 b2 21 /* 20: 105-60cd */
			39 01 00 00 00 00 02 b2 21 /* 21: 56cd */
			39 01 00 00 00 00 02 b2 21 /* 22: 53cd */
			39 01 00 00 00 00 02 b2 21 /* 23: 50cd */
			39 01 00 00 00 00 02 b2 21 /* 24: 47cd */
			39 01 00 00 00 00 02 b2 21 /* 25: 44cd */
			39 01 00 00 00 00 02 b2 20 /* 26: 41cd */
			39 01 00 00 00 00 02 b2 20 /* 27: 39cd */
			39 01 00 00 00 00 02 b2 20 /* 28: 37cd */
			39 01 00 00 00 00 02 b2 1F /* 29: 34cd */
			39 01 00 00 00 00 02 b2 1F /* 30: 32cd */
			39 01 00 00 00 00 02 b2 1E /* 31: 30cd */
			39 01 00 00 00 00 02 b2 1E /* 32: 29cd */
			39 01 00 00 00 00 02 b2 1E /* 33: 27cd */
			39 01 00 00 00 00 02 b2 1D /* 34: 25-21cd */
			39 01 00 00 00 00 02 b2 1C /* 35: 20-16cd */
			39 01 00 00 00 00 02 b2 1B /* 36: 15-11cd */
			39 01 00 00 00 00 02 b2 1A /* 37: 10-5cd */
			39 01 00 00 00 00 02 b2 19 /* 38: 4-2cd */
		];

		samsung,elvss_lowtemp_tx_cmds_revA = [
			39 01 00 00 00 00 02 b2 0F /* 0: 360cd */
			39 01 00 00 00 00 02 b2 10 /* 1: 333cd */
			39 01 00 00 00 00 02 b2 11 /* 2: 316cd */
			39 01 00 00 00 00 02 b2 12 /* 3: 300cd */
			39 01 00 00 00 00 02 b2 13 /* 4: 282cd */
			39 01 00 00 00 00 02 b2 13 /* 5: 265cd */
			39 01 00 00 00 00 02 b2 14 /* 6: 249cd */
			39 01 00 00 00 00 02 b2 14 /* 7: 234cd */
			39 01 00 00 00 00 02 b2 14 /* 8: 220cd */
			39 01 00 00 00 00 02 b2 15 /* 9: 207cd */
			39 01 00 00 00 00 02 b2 15 /* 10: 195cd */
			39 01 00 00 00 00 02 b2 15 /* 11: 183cd */
			39 01 00 00 00 00 02 b2 15 /* 12: 172cd */
			39 01 00 00 00 00 02 b2 16 /* 13: 162cd */
			39 01 00 00 00 00 02 b2 16 /* 14: 152cd */
			39 01 00 00 00 00 02 b2 17 /* 15: 143cd */
			39 01 00 00 00 00 02 b2 17 /* 16: 134cd */
			39 01 00 00 00 00 02 b2 17 /* 17: 126cd */
			39 01 00 00 00 00 02 b2 17 /* 18: 119cd */
			39 01 00 00 00 00 02 b2 17 /* 19: 111cd */
			39 01 00 00 00 00 02 b2 17 /* 20: 105-60cd */
			39 01 00 00 00 00 02 b2 17 /* 21: 56cd */
			39 01 00 00 00 00 02 b2 17 /* 22: 53cd */
			39 01 00 00 00 00 02 b2 17 /* 23: 50cd */
			39 01 00 00 00 00 02 b2 17 /* 24: 47cd */
			39 01 00 00 00 00 02 b2 17 /* 25: 44cd */
			39 01 00 00 00 00 02 b2 16 /* 26: 41cd */
			39 01 00 00 00 00 02 b2 16 /* 27: 39cd */
			39 01 00 00 00 00 02 b2 16 /* 28: 37cd */
			39 01 00 00 00 00 02 b2 15 /* 29: 34cd */
			39 01 00 00 00 00 02 b2 15 /* 30: 32cd */
			39 01 00 00 00 00 02 b2 14 /* 31: 30cd */
			39 01 00 00 00 00 02 b2 14 /* 32: 29cd */
			39 01 00 00 00 00 02 b2 14 /* 33: 27cd */
			39 01 00 00 00 00 02 b2 13 /* 34: 25-21cd */
			39 01 00 00 00 00 02 b2 12 /* 35: 20-16cd */
			39 01 00 00 00 00 02 b2 11 /* 36: 15-11cd */
			39 01 00 00 00 00 02 b2 10 /* 37: 10-5cd */
			39 01 00 00 00 00 02 b2 0F /* 38: 4-2cd */
		];
		samsung,elvss_lowtemp2_tx_cmds_revA = [
			39 01 00 00 00 00 02 b2 0A /* 0: 360cd */
			39 01 00 00 00 00 02 b2 0B /* 1: 333cd */
			39 01 00 00 00 00 02 b2 0C /* 2: 316cd */
			39 01 00 00 00 00 02 b2 0D /* 3: 300cd */
			39 01 00 00 00 00 02 b2 0E /* 4: 282cd */
			39 01 00 00 00 00 02 b2 0E /* 5: 265cd */
			39 01 00 00 00 00 02 b2 0F /* 6: 249cd */
			39 01 00 00 00 00 02 b2 0F /* 7: 234cd */
			39 01 00 00 00 00 02 b2 0F /* 8: 220cd */
			39 01 00 00 00 00 02 b2 10 /* 9: 207cd */
			39 01 00 00 00 00 02 b2 10 /* 10: 195cd */
			39 01 00 00 00 00 02 b2 10 /* 11: 183cd */
			39 01 00 00 00 00 02 b2 10 /* 12: 172cd */
			39 01 00 00 00 00 02 b2 11 /* 13: 162cd */
			39 01 00 00 00 00 02 b2 11 /* 14: 152cd */
			39 01 00 00 00 00 02 b2 12 /* 15: 143cd */
			39 01 00 00 00 00 02 b2 12 /* 16: 134cd */
			39 01 00 00 00 00 02 b2 12 /* 17: 126cd */
			39 01 00 00 00 00 02 b2 12 /* 18: 119cd */
			39 01 00 00 00 00 02 b2 12 /* 19: 111cd */
			39 01 00 00 00 00 02 b2 12 /* 20: 105-60cd */
			39 01 00 00 00 00 02 b2 12 /* 21: 56cd */
			39 01 00 00 00 00 02 b2 12 /* 22: 53cd */
			39 01 00 00 00 00 02 b2 12 /* 23: 50cd */
			39 01 00 00 00 00 02 b2 12 /* 24: 47cd */
			39 01 00 00 00 00 02 b2 12 /* 25: 44cd */
			39 01 00 00 00 00 02 b2 11 /* 26: 41cd */
			39 01 00 00 00 00 02 b2 11 /* 27: 39cd */
			39 01 00 00 00 00 02 b2 11 /* 28: 37cd */
			39 01 00 00 00 00 02 b2 10 /* 29: 34cd */
			39 01 00 00 00 00 02 b2 10 /* 30: 32cd */
			39 01 00 00 00 00 02 b2 0F /* 31: 30cd */
			39 01 00 00 00 00 02 b2 0F /* 32: 29cd */
			39 01 00 00 00 00 02 b2 0F /* 33: 27cd */
			39 01 00 00 00 00 02 b2 0E /* 34: 25-21cd */
			39 01 00 00 00 00 02 b2 0D /* 35: 20-16cd */
			39 01 00 00 00 00 02 b2 0C /* 36: 15-11cd */
			39 01 00 00 00 00 02 b2 0B /* 37: 10-5cd */
			39 01 00 00 00 00 02 b2 0A /* 38: 4-2cd */
		];

		/* bl_level, Index in elvss command list */
		samsung,elvss_map_table_revA = <
		     /* candela elvss_tx_cmd_id */
			2	38
			3	38
			4	38
			5	37
			6	37
			7	37
			8	37
			9	37
			10	37
			11	36
			12	36
			13	36
			14	36
			15	36
			16	35
			17	35
			19	35
			20	35
			21	34
			22	34
			24	34
			25	34
			27	33
			29	32
			30	31
			32	30
			34	29
			37	28
			39	27
			41	26
			44	25
			47	24
			50	23
			53	22
			56	21
			60	20
			64	20
			68	20
			72	20
			77	20
			82	20
			87	20
			93	20
			98	20
			105	20
			111	19
			119	18
			126	17
			134	16
			143	15
			152	14
			162	13
			172	12
			183	11
			195	10
			207	9
			220	8
			234	7
			249	6
			265	5
			282	4
			300	3
			316	2
			333	1
			360	0
		>;

		/*
		 * ************************************************************************************************************************
		 * SMART ACL(ACL On) ELVSS command list and mappings
		 * ************************************************************************************************************************
		 */

		/* 0xB2 address 103rd parameter value*/
		samsung,smart_acl_elvss_tx_cmds_revA = [
			39 01 00 00 00 00 02 b2 1B /* 0: 360cd */
			39 01 00 00 00 00 02 b2 1C /* 1: 333cd */
			39 01 00 00 00 00 02 b2 1C /* 2: 316cd */
			39 01 00 00 00 00 02 b2 1D /* 3: 300cd */
			39 01 00 00 00 00 02 b2 1E /* 4: 282cd */
			39 01 00 00 00 00 02 b2 1E /* 5: 265cd */
			39 01 00 00 00 00 02 b2 1E /* 6: 249cd */
			39 01 00 00 00 00 02 b2 1E /* 7: 234cd */
			39 01 00 00 00 00 02 b2 1E /* 8: 220cd */
			39 01 00 00 00 00 02 b2 1F /* 9: 207cd */
			39 01 00 00 00 00 02 b2 1F /* 10: 195cd */
			39 01 00 00 00 00 02 b2 1F /* 11: 183cd */
			39 01 00 00 00 00 02 b2 1F /* 12: 172cd */
			39 01 00 00 00 00 02 b2 20 /* 13: 162cd */
			39 01 00 00 00 00 02 b2 20 /* 14: 152cd */
			39 01 00 00 00 00 02 b2 21 /* 15: 143cd */
			39 01 00 00 00 00 02 b2 21 /* 16: 134cd */
			39 01 00 00 00 00 02 b2 21 /* 17: 126cd */
			39 01 00 00 00 00 02 b2 21 /* 18: 119cd */
			39 01 00 00 00 00 02 b2 21 /* 19: 111cd */
			39 01 00 00 00 00 02 b2 21 /* 20: 105-60cd */
			39 01 00 00 00 00 02 b2 21 /* 21: 56cd */
			39 01 00 00 00 00 02 b2 21 /* 22: 53cd */
			39 01 00 00 00 00 02 b2 21 /* 23: 50cd */
			39 01 00 00 00 00 02 b2 21 /* 24: 47cd */
			39 01 00 00 00 00 02 b2 21 /* 25: 44cd */
			39 01 00 00 00 00 02 b2 20 /* 26: 41cd */
			39 01 00 00 00 00 02 b2 20 /* 27: 39cd */
			39 01 00 00 00 00 02 b2 20 /* 28: 37cd */
			39 01 00 00 00 00 02 b2 1F /* 29: 34cd */
			39 01 00 00 00 00 02 b2 1F /* 30: 32cd */
			39 01 00 00 00 00 02 b2 1E /* 31: 30cd */
			39 01 00 00 00 00 02 b2 1E /* 32: 29cd */
			39 01 00 00 00 00 02 b2 1E /* 33: 27cd */
			39 01 00 00 00 00 02 b2 1D /* 34: 25-21cd */
			39 01 00 00 00 00 02 b2 1C /* 35: 20-16cd */
			39 01 00 00 00 00 02 b2 1B /* 36: 15-11cd */
			39 01 00 00 00 00 02 b2 1A /* 37: 10-5cd */
			39 01 00 00 00 00 02 b2 19 /* 38: 4-2cd */
		];
		samsung,smart_acl_elvss_lowtemp_tx_cmds_revA = [
			39 01 00 00 00 00 02 b2 11 /* 0: 360cd */
			39 01 00 00 00 00 02 b2 12 /* 1: 333cd */
			39 01 00 00 00 00 02 b2 12 /* 2: 316cd */
			39 01 00 00 00 00 02 b2 13 /* 3: 300cd */
			39 01 00 00 00 00 02 b2 14 /* 4: 282cd */
			39 01 00 00 00 00 02 b2 14 /* 5: 265cd */
			39 01 00 00 00 00 02 b2 14 /* 6: 249cd */
			39 01 00 00 00 00 02 b2 14 /* 7: 234cd */
			39 01 00 00 00 00 02 b2 14 /* 8: 220cd */
			39 01 00 00 00 00 02 b2 15 /* 9: 207cd */
			39 01 00 00 00 00 02 b2 15 /* 10: 195cd */
			39 01 00 00 00 00 02 b2 15 /* 11: 183cd */
			39 01 00 00 00 00 02 b2 15 /* 12: 172cd */
			39 01 00 00 00 00 02 b2 16 /* 13: 162cd */
			39 01 00 00 00 00 02 b2 16 /* 14: 152cd */
			39 01 00 00 00 00 02 b2 17 /* 15: 143cd */
			39 01 00 00 00 00 02 b2 17 /* 16: 134cd */
			39 01 00 00 00 00 02 b2 17 /* 17: 126cd */
			39 01 00 00 00 00 02 b2 17 /* 18: 119cd */
			39 01 00 00 00 00 02 b2 17 /* 19: 111cd */
			39 01 00 00 00 00 02 b2 17 /* 20: 105-60cd */
			39 01 00 00 00 00 02 b2 17 /* 21: 56cd */
			39 01 00 00 00 00 02 b2 17 /* 22: 53cd */
			39 01 00 00 00 00 02 b2 17 /* 23: 50cd */
			39 01 00 00 00 00 02 b2 17 /* 24: 47cd */
			39 01 00 00 00 00 02 b2 17 /* 25: 44cd */
			39 01 00 00 00 00 02 b2 16 /* 26: 41cd */
			39 01 00 00 00 00 02 b2 16 /* 27: 39cd */
			39 01 00 00 00 00 02 b2 16 /* 28: 37cd */
			39 01 00 00 00 00 02 b2 15 /* 29: 34cd */
			39 01 00 00 00 00 02 b2 15 /* 30: 32cd */
			39 01 00 00 00 00 02 b2 14 /* 31: 30cd */
			39 01 00 00 00 00 02 b2 14 /* 32: 29cd */
			39 01 00 00 00 00 02 b2 14 /* 33: 27cd */
			39 01 00 00 00 00 02 b2 13 /* 34: 25-21cd */
			39 01 00 00 00 00 02 b2 12 /* 35: 20-16cd */
			39 01 00 00 00 00 02 b2 11 /* 36: 15-11cd */
			39 01 00 00 00 00 02 b2 10 /* 37: 10-5cd */
			39 01 00 00 00 00 02 b2 0F /* 38: 4-2cd */
		];
		samsung,smart_acl_elvss_lowtemp2_tx_cmds_revA = [
			39 01 00 00 00 00 02 b2 0A /* 0: 360cd */
			39 01 00 00 00 00 02 b2 0B /* 1: 333cd */
			39 01 00 00 00 00 02 b2 0C /* 2: 316cd */
			39 01 00 00 00 00 02 b2 0D /* 3: 300cd */
			39 01 00 00 00 00 02 b2 0E /* 4: 282cd */
			39 01 00 00 00 00 02 b2 0E /* 5: 265cd */
			39 01 00 00 00 00 02 b2 0F /* 6: 249cd */
			39 01 00 00 00 00 02 b2 0F /* 7: 234cd */
			39 01 00 00 00 00 02 b2 0F /* 8: 220cd */
			39 01 00 00 00 00 02 b2 10 /* 9: 207cd */
			39 01 00 00 00 00 02 b2 10 /* 10: 195cd */
			39 01 00 00 00 00 02 b2 10 /* 11: 183cd */
			39 01 00 00 00 00 02 b2 10 /* 12: 172cd */
			39 01 00 00 00 00 02 b2 11 /* 13: 162cd */
			39 01 00 00 00 00 02 b2 11 /* 14: 152cd */
			39 01 00 00 00 00 02 b2 12 /* 15: 143cd */
			39 01 00 00 00 00 02 b2 12 /* 16: 134cd */
			39 01 00 00 00 00 02 b2 12 /* 17: 126cd */
			39 01 00 00 00 00 02 b2 12 /* 18: 119cd */
			39 01 00 00 00 00 02 b2 12 /* 19: 111cd */
			39 01 00 00 00 00 02 b2 12 /* 20: 105-60cd */
			39 01 00 00 00 00 02 b2 12 /* 21: 56cd */
			39 01 00 00 00 00 02 b2 12 /* 22: 53cd */
			39 01 00 00 00 00 02 b2 12 /* 23: 50cd */
			39 01 00 00 00 00 02 b2 12 /* 24: 47cd */
			39 01 00 00 00 00 02 b2 12 /* 25: 44cd */
			39 01 00 00 00 00 02 b2 11 /* 26: 41cd */
			39 01 00 00 00 00 02 b2 11 /* 27: 39cd */
			39 01 00 00 00 00 02 b2 11 /* 28: 37cd */
			39 01 00 00 00 00 02 b2 10 /* 29: 34cd */
			39 01 00 00 00 00 02 b2 10 /* 30: 32cd */
			39 01 00 00 00 00 02 b2 0F /* 31: 30cd */
			39 01 00 00 00 00 02 b2 0F /* 32: 29cd */
			39 01 00 00 00 00 02 b2 0F /* 33: 27cd */
			39 01 00 00 00 00 02 b2 0E /* 34: 25-21cd */
			39 01 00 00 00 00 02 b2 0D /* 35: 20-16cd */
			39 01 00 00 00 00 02 b2 0C /* 36: 15-11cd */
			39 01 00 00 00 00 02 b2 0B /* 37: 10-5cd */
			39 01 00 00 00 00 02 b2 0A /* 38: 4-2cd */
		];

		/* bl_level, Index in elvss command list */
		samsung,smart_acl_elvss_map_table_revA = <
		     /* candela elvss_tx_cmd_id */
			2	38
			3	38
			4	38
			5	37
			6	37
			7	37
			8	37
			9	37
			10	37
			11	36
			12	36
			13	36
			14	36
			15	36
			16	35
			17	35
			19	35
			20	35
			21	34
			22	34
			24	34
			25	34
			27	33
			29	32
			30	31
			32	30
			34	29
			37	28
			39	27
			41	26
			44	25
			47	24
			50	23
			53	22
			56	21
			60	20
			64	20
			68	20
			72	20
			77	20
			82	20
			87	20
			93	20
			98	20
			105	20
			111	19
			119	18
			126	17
			134	16
			143	15
			152	14
			162	13
			172	12
			183	11
			195	10
			207	9
			220	8
			234	7
			249	6
			265	5
			282	4
			300	3
			316	2
			333	1
			360	0

		>;
		/*
		 * ************************************************************************************************************************
		 * candela to index mappings
		 * ************************************************************************************************************************
		 */
		samsung,candela_map_table_revA = <
		/*<idx>   <from>  <till> <candella> */
			0		0			0			2
			1       1	1       3
			2       2	2       4
			3       3	3       5
			4       4	4       6
			5       5	5       7
			6       6	6       8
			7       7	7       9
			8       8	8       10
			9       9	9       11
			10	10	10      12
			11	11	11      13
			12	12	12      14
			13	13	13      15
			14	14	14      16
			15	15	15      17
			16	16	16      19
			17	17	17      20
			18	18	18      21
			19	19	19      22
			20	20	20      24
			21	21	21      25
			22	22	23      27
			23	24	25      29
			24	26	27      30
			25	28	29      32
			26	30	31      34
			27	32	33      37
			28	34	35      39
			29	36	37      41
			30	38	39      44
			31	40	41      47
			32	42	43      50
			33	44	45      53
			34	46	48      56
			35	49	51      60
			36	52	54      64
			37	55	57      68
			38	58	60      72
			39	61	63      77
			40	64	66      82
			41	67	69      87
			42	70	72      93
			43	73	76      98
			44	77	80      105
			45	81	86      111
			46	87	91      119
			47	92	97      126
			48	98	104	134
			49	105	110	143
			50	111	118	152
			51	119	125	162
			52	126	133	172
			53	134	142	183
			54	143	150	195
			55	151	160	207
			56	161	170	220
			57	171	181	234
			58	182	193	249
			59	194	205	265
			60	206	218	282
			61	219	230	300
			62	231	242	316
			63	243	253	333
			64	254	255	360
		>;

		samsung,hbm_candela_map_table_revA = <
			0	268	279	378	6
			1	280	292	395	7
			2	293	304	413	8
			3	305	317	430	9
			4	318	329	448	10
			5	330	341	465	11
			6	342	354	483	12
			7	355	355	500	13
		>;
	};
};
