/* Copyright (c) 2012, Samsung Electronics Corporation. All rights reserved.
 *
 * This program is free software; you can redistribute it and/or modify
 * it under the terms of the GNU General Public License version 2 and
 * only version 2 as published by the Free Software Foundation.
 *
 * This program is distributed in the hope that it will be useful,
 * but WITHOUT ANY WARRANTY; without even the implied warranty of
 * MERCHANTABILITY or FITNESS FOR A PARTICULAR PURPOSE.  See the
 * GNU General Public License for more details.
 */

&mdss_mdp {
	ss_dsi_panel_S6E3HA6_AMB632NF01_WQHD: ss_dsi_panel_S6E3HA6_AMB632NF01_WQHD {
		/*
		* ************************************************************************************************************************
		*  IRC
		* ************************************************************************************************************************
		*/
		samsung,pac_irc_subdivision_tx_cmds_revE = [
			29 01 00 00 00 00 15 B8 61 F0 27 24 3B B6 33 69 12 7A FF 00 00 00 00 00 00 00 00 00  /* 0 */
			29 01 00 00 00 00 15 B8 61 F0 27 24 3B B6 33 69 12 7A FF 00 00 00 00 00 00 00 00 00  /* 1 */
			29 01 00 00 00 00 15 B8 61 F0 27 24 3B B6 33 69 12 7A FF 00 00 00 00 00 00 00 00 00  /* 2 */
			29 01 00 00 00 00 15 B8 61 F0 27 24 3B B6 33 69 12 7A FF 00 00 00 00 00 00 00 00 00  /* 3 */
			29 01 00 00 00 00 15 B8 61 F0 27 24 3B B6 33 69 12 7A FF 00 00 00 00 00 00 00 00 00  /* 4 */
			29 01 00 00 00 00 15 B8 61 F0 27 24 3B B6 33 69 12 7A FF 00 00 00 00 00 00 00 00 00  /* 5 */
			29 01 00 00 00 00 15 B8 61 F0 27 24 3B B6 33 69 12 7A FF 00 00 00 00 00 00 00 00 00  /* 6 */
			29 01 00 00 00 00 15 B8 61 F0 27 24 3B B6 33 69 12 7A FF 00 00 00 00 00 00 00 00 00  /* 7 */
			29 01 00 00 00 00 15 B8 61 F0 27 24 3B B6 33 69 12 7A FF 00 00 00 00 00 00 00 00 00  /* 8 */
			29 01 00 00 00 00 15 B8 61 F0 27 24 3B B6 33 69 12 7A FF 00 00 00 00 00 00 00 00 00  /* 9 */
			29 01 00 00 00 00 15 B8 61 F0 27 24 3B B6 33 69 12 7A FF 00 00 00 00 00 00 00 00 00  /* 10 */
			29 01 00 00 00 00 15 B8 61 F0 27 24 3B B6 33 69 12 7A FF 00 00 00 00 00 00 00 00 00  /* 11 */
			29 01 00 00 00 00 15 B8 61 F0 27 24 3B B6 33 69 12 7A FF 00 00 00 00 00 00 00 00 00  /* 12 */
			29 01 00 00 00 00 15 B8 61 F0 27 24 3B B6 33 69 12 7A FF 00 00 00 00 00 00 00 00 00  /* 13 */
			29 01 00 00 00 00 15 B8 61 F0 27 24 3B B6 33 69 12 7A FF 00 00 00 00 00 00 00 00 00  /* 14 */
			29 01 00 00 00 00 15 B8 61 F0 27 24 3B B6 33 69 12 7A FF 00 00 00 00 00 00 00 00 00  /* 15 */
			29 01 00 00 00 00 15 B8 61 F0 27 24 3B B6 33 69 12 7A FF 00 00 00 00 00 00 00 00 00  /* 16 */
			29 01 00 00 00 00 15 B8 61 F0 27 24 3B B6 33 69 12 7A FF 00 00 00 00 00 00 00 00 00  /* 17 */
			29 01 00 00 00 00 15 B8 61 F0 27 24 3B B6 33 69 12 7A FF 00 00 00 00 00 00 00 00 00  /* 18 */
			29 01 00 00 00 00 15 B8 61 F0 27 24 3B B6 33 69 12 7A FF 00 00 00 00 00 00 00 00 00  /* 19 */
			29 01 00 00 00 00 15 B8 61 F0 27 24 3B B6 33 69 12 7A FF 00 00 00 00 00 00 00 00 00  /* 20 */
			29 01 00 00 00 00 15 B8 61 F0 27 24 3B B6 33 69 12 7A FF 00 00 00 00 00 00 00 00 00  /* 21 */
			29 01 00 00 00 00 15 B8 61 F0 27 24 3B B6 33 69 12 7A FF 00 00 00 00 00 00 00 00 00  /* 22 */
			29 01 00 00 00 00 15 B8 61 F0 27 24 3B B6 33 69 12 7A FF 00 00 00 00 00 00 00 00 00  /* 23 */
			29 01 00 00 00 00 15 B8 61 F0 27 24 3B B6 33 69 12 7A FF 00 00 00 00 00 00 00 00 00  /* 24 */
			29 01 00 00 00 00 15 B8 61 F0 27 24 3B B6 33 69 12 7A FF 00 00 00 00 00 00 00 00 00  /* 25 */
			29 01 00 00 00 00 15 B8 61 F0 27 24 3B B6 33 69 12 7A FF 00 00 00 00 00 00 00 00 00  /* 26 */
			29 01 00 00 00 00 15 B8 61 F0 27 24 3B B6 33 69 12 7A FF 00 00 00 00 00 00 00 00 00  /* 27 */
			29 01 00 00 00 00 15 B8 61 F0 27 24 3B B6 33 69 12 7A FF 00 00 00 00 00 00 00 00 00  /* 28 */
			29 01 00 00 00 00 15 B8 61 F0 27 24 3B B6 33 69 12 7A FF 00 00 00 00 00 00 00 00 00  /* 29 */
			29 01 00 00 00 00 15 B8 61 F0 27 24 3B B6 33 69 12 7A FF 00 00 00 00 00 00 00 00 00  /* 30 */
			29 01 00 00 00 00 15 B8 61 F0 27 24 3B B6 33 69 12 7A FF 00 00 00 00 00 00 00 00 00  /* 31 */
			29 01 00 00 00 00 15 B8 61 F0 27 24 3B B6 33 69 12 7A FF 00 00 00 00 00 00 00 00 00  /* 32 */
			29 01 00 00 00 00 15 B8 61 F0 27 24 3B B6 33 69 12 7A FF 00 00 00 00 00 00 00 00 00  /* 33 */
			29 01 00 00 00 00 15 B8 61 F0 27 24 3B B6 33 69 12 7A FF 00 00 00 00 00 00 00 00 00  /* 34 */
			29 01 00 00 00 00 15 B8 61 F0 27 24 3B B6 33 69 12 7A FF 00 00 00 00 00 00 00 00 00  /* 35 */
			29 01 00 00 00 00 15 B8 61 F0 27 24 3B B6 33 69 12 7A FF 00 00 00 00 00 00 00 00 00  /* 36 */
			29 01 00 00 00 00 15 B8 61 F0 27 24 3B B6 33 69 12 7A FF 00 00 00 00 00 00 00 00 00  /* 37 */
			29 01 00 00 00 00 15 B8 61 F0 27 24 3B B6 33 69 12 7A FF 00 00 00 00 00 00 00 00 00  /* 38 */
			29 01 00 00 00 00 15 B8 61 F0 27 24 3B B6 33 69 12 7A FF 00 00 00 00 00 00 00 00 00  /* 39 */
			29 01 00 00 00 00 15 B8 61 F0 27 24 3B B6 33 69 12 7A FF 00 00 00 00 00 00 00 00 00  /* 40 */
			29 01 00 00 00 00 15 B8 61 F0 27 24 3B B6 33 69 12 7A FF 00 00 00 00 00 00 00 00 00  /* 41 */
			29 01 00 00 00 00 15 B8 61 F0 27 24 3B B6 33 69 12 7A FF 00 00 00 00 00 00 00 00 00  /* 42 */
			29 01 00 00 00 00 15 B8 61 F0 27 24 3B B6 33 69 12 7A FF 00 00 00 00 00 00 00 00 00  /* 43 */
			29 01 00 00 00 00 15 B8 61 F0 27 24 3B B6 33 69 12 7A FF 00 00 00 00 00 00 00 00 00  /* 44 */
			29 01 00 00 00 00 15 B8 61 F0 27 24 3B B6 33 69 12 7A FF 00 00 00 00 00 00 00 00 00  /* 45 */
			29 01 00 00 00 00 15 B8 61 F0 27 24 3B B6 33 69 12 7A FF 00 00 00 00 00 00 00 00 00  /* 46 */
			29 01 00 00 00 00 15 B8 61 F0 27 24 3B B6 33 69 12 7A FF 00 00 00 00 00 00 00 00 00  /* 47 */
			29 01 00 00 00 00 15 B8 61 F0 27 24 3B B6 33 69 12 7A FF 00 00 00 00 00 00 00 00 00  /* 48 */
			29 01 00 00 00 00 15 B8 61 F0 27 24 3B B6 33 69 12 7A FF 00 00 00 00 00 00 00 00 00  /* 49 */
			29 01 00 00 00 00 15 B8 61 F0 27 24 3B B6 33 69 12 7A FF 00 00 00 00 00 00 00 00 00  /* 50 */
			29 01 00 00 00 00 15 B8 61 F0 27 24 3B B6 33 69 12 7A FF 00 00 00 00 00 00 00 00 00  /* 51 */
			29 01 00 00 00 00 15 B8 61 F0 27 24 3B B6 33 69 12 7A FF 00 00 00 00 00 00 00 00 00  /* 52 */
			29 01 00 00 00 00 15 B8 61 F0 27 24 3B B6 33 69 12 7A FF 00 00 00 00 00 00 00 00 00  /* 53 */
			29 01 00 00 00 00 15 B8 61 F0 27 24 3B B6 33 69 12 7A FF 00 00 00 00 00 00 00 00 00  /* 54 */
			29 01 00 00 00 00 15 B8 61 F0 27 24 3B B6 33 69 12 7A FF 00 00 00 00 00 00 00 00 00  /* 55 */
			29 01 00 00 00 00 15 B8 61 F0 27 24 3B B6 33 69 12 7A FF 03 03 03 01 01 01 01 01 01  /* 56 */
			29 01 00 00 00 00 15 B8 61 F0 27 24 3B B6 33 69 12 7A FF 03 03 03 01 01 01 01 01 01  /* 57 */
			29 01 00 00 00 00 15 B8 61 F0 27 24 3B B6 33 69 12 7A FF 03 03 03 01 01 01 01 01 02  /* 58 */
			29 01 00 00 00 00 15 B8 61 F0 27 24 3B B6 33 69 12 7A FF 03 03 03 01 01 01 02 01 02  /* 59 */
			29 01 00 00 00 00 15 B8 61 F0 27 24 3B B6 33 69 12 7A FF 03 03 03 02 01 02 01 01 01  /* 60 */
			29 01 00 00 00 00 15 B8 61 F0 27 24 3B B6 33 69 12 7A FF 03 03 03 02 01 02 01 02 01  /* 61 */
			29 01 00 00 00 00 15 B8 61 F0 27 24 3B B6 33 69 12 7A FF 03 03 04 02 02 01 01 01 01  /* 62 */
			29 01 00 00 00 00 15 B8 61 F0 27 24 3B B6 33 69 12 7A FF 04 03 04 01 02 01 01 01 01  /* 63 */
			29 01 00 00 00 00 15 B8 61 F0 27 24 3B B6 33 69 12 7A FF 04 03 04 01 02 01 01 01 01  /* 64 */
			29 01 00 00 00 00 15 B8 61 F0 27 24 3B B6 33 69 12 7A FF 04 04 04 01 01 01 01 01 01  /* 65 */
			29 01 00 00 00 00 15 B8 61 F0 27 24 3B B6 33 69 12 7A FF 04 04 04 01 01 01 01 01 01  /* 66 */
			29 01 00 00 00 00 15 B8 61 F0 27 24 3B B6 33 69 12 7A FF 04 04 04 01 01 01 01 01 01  /* 67 */
			29 01 00 00 00 00 15 B8 61 F0 27 24 3B B6 33 69 12 7A FF 04 04 04 01 01 01 01 01 01  /* 68 */
			29 01 00 00 00 00 15 B8 61 F0 27 24 3B B6 33 69 12 7A FF 04 04 04 01 01 01 01 01 01  /* 69 */
			29 01 00 00 00 00 15 B8 61 F0 27 24 3B B6 33 69 12 7A FF 04 04 04 01 01 01 01 01 01  /* 70 */
			29 01 00 00 00 00 15 B8 61 F0 27 24 3B B6 33 69 12 7A FF 04 04 04 01 01 01 01 01 02  /* 71 */
			29 01 00 00 00 00 15 B8 61 F0 27 24 3B B6 33 69 12 7A FF 04 04 04 01 01 01 02 01 02  /* 72 */
			29 01 00 00 00 00 15 B8 61 F0 27 24 3B B6 33 69 12 7A FF 04 04 04 01 01 01 02 01 02  /* 73 */
			29 01 00 00 00 00 15 B8 61 F0 27 24 3B B6 33 69 12 7A FF 04 04 04 01 01 01 02 02 02  /* 74 */
			29 01 00 00 00 00 15 B8 61 F0 27 24 3B B6 33 69 12 7A FF 04 04 04 01 01 01 02 02 02  /* 75 */
			29 01 00 00 00 00 15 B8 61 F0 27 24 3B B6 33 69 12 7A FF 04 04 04 01 01 02 02 02 01  /* 76 */
			29 01 00 00 00 00 15 B8 61 F0 27 24 3B B6 33 69 12 7A FF 04 04 04 02 01 02 01 02 01  /* 77 */
			29 01 00 00 00 00 15 B8 61 F0 27 24 3B B6 33 69 12 7A FF 04 04 04 02 01 02 01 02 01  /* 78 */
			29 01 00 00 00 00 15 B8 61 F0 27 24 3B B6 33 69 12 7A FF 04 04 04 02 02 02 01 01 01  /* 79 */
			29 01 00 00 00 00 15 B8 61 F0 27 24 3B B6 33 69 12 7A FF 04 04 04 02 02 02 01 01 01  /* 80 */
			29 01 00 00 00 00 15 B8 61 F0 27 24 3B B6 33 69 12 7A FF 04 04 04 02 02 02 01 01 01  /* 81 */
			29 01 00 00 00 00 15 B8 61 F0 27 24 3B B6 33 69 12 7A FF 04 04 04 02 02 02 01 01 01  /* 82 */
			29 01 00 00 00 00 15 B8 61 F0 27 24 3B B6 33 69 12 7A FF 04 04 04 02 02 02 01 01 01  /* 83 */
			29 01 00 00 00 00 15 B8 61 F0 27 24 3B B6 33 69 12 7A FF 04 04 05 02 02 01 01 01 02  /* 84 */
			29 01 00 00 00 00 15 B8 61 F0 27 24 3B B6 33 69 12 7A FF 05 04 05 01 02 01 02 01 02  /* 85 */
			29 01 00 00 00 00 15 B8 61 F0 27 24 3B B6 33 69 12 7A FF 05 04 05 01 02 01 02 01 02  /* 86 */
			29 01 00 00 00 00 15 B8 61 F0 27 24 3B B6 33 69 12 7A FF 05 05 05 01 01 01 02 01 02  /* 87 */
			29 01 00 00 00 00 15 B8 61 F0 27 24 3B B6 33 69 12 7A FF 05 05 05 01 01 01 02 02 02  /* 88 */
			29 01 00 00 00 00 15 B8 61 F0 27 24 3B B6 33 69 12 7A FF 05 05 05 01 01 01 02 02 02  /* 89 */
			29 01 00 00 00 00 15 B8 61 F0 27 24 3B B6 33 69 12 7A FF 05 05 05 01 01 01 02 02 02  /* 90 */
			29 01 00 00 00 00 15 B8 61 F0 27 24 3B B6 33 69 12 7A FF 05 05 05 01 01 01 02 02 02  /* 91 */
			29 01 00 00 00 00 15 B8 61 F0 27 24 3B B6 33 69 12 7A FF 05 05 05 01 01 02 02 02 01  /* 92 */
			29 01 00 00 00 00 15 B8 61 F0 27 24 3B B6 33 69 12 7A FF 05 05 05 02 01 02 01 02 01  /* 93 */
			29 01 00 00 00 00 15 B8 61 F0 27 24 3B B6 33 69 12 7A FF 05 05 05 02 01 02 01 02 01  /* 94 */
			29 01 00 00 00 00 15 B8 61 F0 27 24 3B B6 33 69 12 7A FF 05 05 05 02 01 02 01 02 01  /* 95 */
			29 01 00 00 00 00 15 B8 61 F0 27 24 3B B6 33 69 12 7A FF 05 05 05 02 02 02 01 01 01  /* 96 */
			29 01 00 00 00 00 15 B8 61 F0 27 24 3B B6 33 69 12 7A FF 05 05 05 02 02 02 01 01 02  /* 97 */
			29 01 00 00 00 00 15 B8 61 F0 27 24 3B B6 33 69 12 7A FF 05 05 05 02 02 02 01 01 02  /* 98 */
			29 01 00 00 00 00 15 B8 61 F0 27 24 3B B6 33 69 12 7A FF 05 05 05 02 02 02 02 01 02  /* 99 */
			29 01 00 00 00 00 15 B8 61 F0 27 24 3B B6 33 69 12 7A FF 05 05 05 02 02 02 02 01 02  /* 100 */
			29 01 00 00 00 00 15 B8 61 F0 27 24 3B B6 33 69 12 7A FF 05 05 05 02 02 02 02 02 02  /* 101 */
			29 01 00 00 00 00 15 B8 61 F0 27 24 3B B6 33 69 12 7A FF 05 05 05 02 02 02 02 02 02  /* 102 */
			29 01 00 00 00 00 15 B8 61 F0 27 24 3B B6 33 69 12 7A FF 05 05 05 02 02 02 02 02 02  /* 103 */
			29 01 00 00 00 00 15 B8 61 F0 27 24 3B B6 33 69 12 7A FF 05 05 05 02 02 02 02 02 02  /* 104 */
			29 01 00 00 00 00 15 B8 61 F0 27 24 3B B6 33 69 12 7A FF 05 05 06 02 02 01 02 02 02  /* 105 */
			29 01 00 00 00 00 15 B8 61 F0 27 24 3B B6 33 69 12 7A FF 06 05 06 01 02 01 02 02 02  /* 106 */
			29 01 00 00 00 00 15 B8 61 F0 27 24 3B B6 33 69 12 7A FF 06 05 06 01 02 02 02 02 01  /* 107 */
			29 01 00 00 00 00 15 B8 61 F0 27 24 3B B6 33 69 12 7A FF 06 06 06 02 01 02 01 02 02  /* 108 */
			29 01 00 00 00 00 15 B8 61 F0 27 24 3B B6 33 69 12 7A FF 06 06 06 02 02 02 02 01 02  /* 109 */
			29 01 00 00 00 00 15 B8 61 F0 27 24 3B B6 33 69 12 7A FF 06 06 06 02 02 02 02 01 02  /* 110 */
			29 01 00 00 00 00 15 B8 61 F0 27 24 3B B6 33 69 12 7A FF 06 06 06 02 02 02 02 02 02  /* 111 */
			29 01 00 00 00 00 15 B8 61 F0 27 24 3B B6 33 69 12 7A FF 06 06 06 02 02 02 02 02 02  /* 112 */
			29 01 00 00 00 00 15 B8 61 F0 27 24 3B B6 33 69 12 7A FF 06 06 06 02 02 02 02 02 02  /* 113 */
			29 01 00 00 00 00 15 B8 61 F0 27 24 3B B6 33 69 12 7A FF 06 06 06 02 02 02 02 02 02  /* 114 */
			29 01 00 00 00 00 15 B8 61 F0 27 24 3B B6 33 69 12 7A FF 06 06 06 02 02 02 02 02 02  /* 115 */
			29 01 00 00 00 00 15 B8 61 F0 27 24 3B B6 33 69 12 7A FF 06 06 06 02 02 02 02 02 02  /* 116 */
			29 01 00 00 00 00 15 B8 61 F0 27 24 3B B6 33 69 12 7A FF 06 06 06 02 02 02 02 02 03  /* 117 */
			29 01 00 00 00 00 15 B8 61 F0 27 24 3B B6 33 69 12 7A FF 06 06 06 02 02 02 02 02 03  /* 118 */
			29 01 00 00 00 00 15 B8 61 F0 27 24 3B B6 33 69 12 7A FF 06 06 06 02 02 03 03 02 02  /* 119 */
			29 01 00 00 00 00 15 B8 61 F0 27 24 3B B6 33 69 12 7A FF 06 06 06 03 02 03 02 02 02  /* 120 */
			29 01 00 00 00 00 15 B8 61 F0 27 24 3B B6 33 69 12 7A FF 06 06 07 03 02 02 02 02 02  /* 121 */
			29 01 00 00 00 00 15 B8 61 F0 27 24 3B B6 33 69 12 7A FF 06 06 07 03 02 02 02 03 02  /* 122 */
			29 01 00 00 00 00 15 B8 61 F0 27 24 3B B6 33 69 12 7A FF 07 06 07 02 03 02 02 02 02  /* 123 */
			29 01 00 00 00 00 15 B8 61 F0 27 24 3B B6 33 69 12 7A FF 07 06 07 02 03 02 02 02 02  /* 124 */
			29 01 00 00 00 00 15 B8 61 F0 27 24 3B B6 33 69 12 7A FF 07 06 07 02 03 02 02 02 02  /* 125 */
			29 01 00 00 00 00 15 B8 61 F0 27 24 3B B6 33 69 12 7A FF 07 07 07 02 02 02 02 02 02  /* 126 */
			29 01 00 00 00 00 15 B8 61 F0 27 24 3B B6 33 69 12 7A FF 07 07 07 02 02 02 02 02 02  /* 127 */
			29 01 00 00 00 00 15 B8 61 F0 27 24 3B B6 33 69 12 7A FF 07 07 07 02 02 02 02 02 02  /* 128 */
			29 01 00 00 00 00 15 B8 61 F0 27 24 3B B6 33 69 12 7A FF 07 07 07 02 02 02 02 02 02  /* 129 */
			29 01 00 00 00 00 15 B8 61 F0 27 24 3B B6 33 69 12 7A FF 07 07 07 02 02 02 02 02 03  /* 130 */
			29 01 00 00 00 00 15 B8 61 F0 27 24 3B B6 33 69 12 7A FF 07 07 07 02 02 02 02 02 03  /* 131 */
			29 01 00 00 00 00 15 B8 61 F0 27 24 3B B6 33 69 12 7A FF 07 07 07 02 02 02 03 02 03  /* 132 */
			29 01 00 00 00 00 15 B8 61 F0 27 24 3B B6 33 69 12 7A FF 07 07 07 02 02 02 03 02 03  /* 133 */
			29 01 00 00 00 00 15 B8 61 F0 27 24 3B B6 33 69 12 7A FF 07 07 07 02 02 02 03 02 03  /* 134 */
			29 01 00 00 00 00 15 B8 61 F0 27 24 3B B6 33 69 12 7A FF 07 07 07 02 02 03 03 03 02  /* 135 */
			29 01 00 00 00 00 15 B8 61 F0 27 24 3B B6 33 69 12 7A FF 07 07 07 03 02 03 02 03 02  /* 136 */
			29 01 00 00 00 00 15 B8 61 F0 27 24 3B B6 33 69 12 7A FF 07 07 07 03 03 03 02 02 02  /* 137 */
			29 01 00 00 00 00 15 B8 61 F0 27 24 3B B6 33 69 12 7A FF 07 07 07 03 03 03 02 02 02  /* 138 */
			29 01 00 00 00 00 15 B8 61 F0 27 24 3B B6 33 69 12 7A FF 07 07 08 03 03 02 02 02 03  /* 139 */
			29 01 00 00 00 00 15 B8 61 F0 27 24 3B B6 33 69 12 7A FF 08 07 08 02 03 02 03 02 03  /* 140 */
			29 01 00 00 00 00 15 B8 61 F0 27 24 3B B6 33 69 12 7A FF 08 07 08 02 03 02 03 02 03  /* 141 */
			29 01 00 00 00 00 15 B8 61 F0 27 24 3B B6 33 69 12 7A FF 08 08 08 02 02 02 03 03 03  /* 142 */
			29 01 00 00 00 00 15 B8 61 F0 27 24 3B B6 33 69 12 7A FF 08 08 08 02 02 02 03 03 03  /* 143 */
			29 01 00 00 00 00 15 B8 61 F0 27 24 3B B6 33 69 12 7A FF 08 08 08 02 02 03 03 03 02  /* 144 */
			29 01 00 00 00 00 15 B8 61 F0 27 24 3B B6 33 69 12 7A FF 08 08 08 02 02 03 03 03 02  /* 145 */
			29 01 00 00 00 00 15 B8 61 F0 27 24 3B B6 33 69 12 7A FF 08 08 08 03 02 03 02 03 02  /* 146 */
			29 01 00 00 00 00 15 B8 61 F0 27 24 3B B6 33 69 12 7A FF 08 08 08 03 02 03 02 03 02  /* 147 */
			29 01 00 00 00 00 15 B8 61 F0 27 24 3B B6 33 69 12 7A FF 08 08 08 03 02 03 02 03 02  /* 148 */
			29 01 00 00 00 00 15 B8 61 F0 27 24 3B B6 33 69 12 7A FF 08 08 08 03 03 03 02 02 03  /* 149 */
			29 01 00 00 00 00 15 B8 61 F0 27 24 3B B6 33 69 12 7A FF 08 08 08 03 03 03 03 02 03  /* 150 */
			29 01 00 00 00 00 15 B8 61 F0 27 24 3B B6 33 69 12 7A FF 08 08 08 03 03 03 03 02 03  /* 151 */
			29 01 00 00 00 00 15 B8 61 F0 27 24 3B B6 33 69 12 7A FF 08 08 08 03 03 03 03 02 03  /* 152 */
			29 01 00 00 00 00 15 B8 61 F0 27 24 3B B6 33 69 12 7A FF 08 08 09 03 03 02 03 03 03  /* 153 */
			29 01 00 00 00 00 15 B8 61 F0 27 24 3B B6 33 69 12 7A FF 08 08 09 03 03 02 03 03 03  /* 154 */
			29 01 00 00 00 00 15 B8 61 F0 27 24 3B B6 33 69 12 7A FF 09 08 09 02 03 03 03 03 02  /* 155 */
			29 01 00 00 00 00 15 B8 61 F0 27 24 3B B6 33 69 12 7A FF 09 08 09 03 03 03 02 03 03  /* 156 */
			29 01 00 00 00 00 15 B8 61 F0 27 24 3B B6 33 69 12 7A FF 09 08 09 03 03 03 02 03 03  /* 157 */
			29 01 00 00 00 00 15 B8 61 F0 27 24 3B B6 33 69 12 7A FF 09 09 09 03 02 03 03 03 03  /* 158 */
			29 01 00 00 00 00 15 B8 61 F0 27 24 3B B6 33 69 12 7A FF 09 09 09 03 03 03 03 02 03  /* 159 */
			29 01 00 00 00 00 15 B8 61 F0 27 24 3B B6 33 69 12 7A FF 09 09 09 03 03 03 03 03 03  /* 160 */
			29 01 00 00 00 00 15 B8 61 F0 27 24 3B B6 33 69 12 7A FF 09 09 09 03 03 03 03 03 03  /* 161 */
			29 01 00 00 00 00 15 B8 61 F0 27 24 3B B6 33 69 12 7A FF 09 09 09 03 03 03 03 03 03  /* 162 */
			29 01 00 00 00 00 15 B8 61 F0 27 24 3B B6 33 69 12 7A FF 09 09 09 03 03 03 03 03 03  /* 163 */
			29 01 00 00 00 00 15 B8 61 F0 27 24 3B B6 33 69 12 7A FF 09 09 09 03 03 03 03 03 04  /* 164 */
			29 01 00 00 00 00 15 B8 61 F0 27 24 3B B6 33 69 12 7A FF 09 09 09 03 03 04 03 03 03  /* 165 */
			29 01 00 00 00 00 15 B8 61 F0 27 24 3B B6 33 69 12 7A FF 09 09 09 03 03 04 04 03 03  /* 166 */
			29 01 00 00 00 00 15 B8 61 F0 27 24 3B B6 33 69 12 7A FF 09 09 0A 04 03 03 03 03 03  /* 167 */
			29 01 00 00 00 00 15 B8 61 F0 27 24 3B B6 33 69 12 7A FF 09 09 0A 04 03 03 03 03 03  /* 168 */
			29 01 00 00 00 00 15 B8 61 F0 27 24 3B B6 33 69 12 7A FF 09 09 0A 04 03 03 03 03 03  /* 169 */
			29 01 00 00 00 00 15 B8 61 F0 27 24 3B B6 33 69 12 7A FF 09 09 0A 04 03 03 03 03 03  /* 170 */
			29 01 00 00 00 00 15 B8 61 F0 27 24 3B B6 33 69 12 7A FF 0A 09 0A 03 03 03 03 04 03  /* 171 */
			29 01 00 00 00 00 15 B8 61 F0 27 24 3B B6 33 69 12 7A FF 0A 09 0A 03 04 03 03 03 03  /* 172 */
			29 01 00 00 00 00 15 B8 61 F0 27 24 3B B6 33 69 12 7A FF 0A 09 0A 03 04 03 03 03 03  /* 173 */
			29 01 00 00 00 00 15 B8 61 F0 27 24 3B B6 33 69 12 7A FF 0A 0A 0A 03 03 03 03 03 03  /* 174 */
			29 01 00 00 00 00 15 B8 61 F0 27 24 3B B6 33 69 12 7A FF 0A 0A 0A 03 03 03 03 03 04  /* 175 */
			29 01 00 00 00 00 15 B8 61 F0 27 24 3B B6 33 69 12 7A FF 0A 0A 0A 03 03 03 03 03 04  /* 176 */
			29 01 00 00 00 00 15 B8 61 F0 27 24 3B B6 33 69 12 7A FF 0A 0A 0A 03 03 03 04 03 04  /* 177 */
			29 01 00 00 00 00 15 B8 61 F0 27 24 3B B6 33 69 12 7A FF 0A 0A 0A 03 03 04 04 03 03  /* 178 */
			29 01 00 00 00 00 15 B8 61 F0 27 24 3B B6 33 69 12 7A FF 0A 0A 0A 04 03 04 03 03 03  /* 179 */
			29 01 00 00 00 00 15 B8 61 F0 27 24 3B B6 33 69 12 7A FF 0A 0A 0A 04 03 04 03 04 03  /* 180 */
			29 01 00 00 00 00 15 B8 61 F0 27 24 3B B6 33 69 12 7A FF 0A 0A 0A 04 03 04 03 04 03  /* 181 */
			29 01 00 00 00 00 15 B8 61 F0 27 24 3B B6 33 69 12 7A FF 0A 0A 0B 04 04 03 03 03 03  /* 182 */
			29 01 00 00 00 00 15 B8 61 F0 27 24 3B B6 33 69 12 7A FF 0A 0A 0B 04 04 03 03 03 04  /* 183 */
			29 01 00 00 00 00 15 B8 61 F0 27 24 3B B6 33 69 12 7A FF 0B 0A 0B 03 04 03 04 03 04  /* 184 */
			29 01 00 00 00 00 15 B8 61 F0 27 24 3B B6 33 69 12 7A FF 0B 0A 0B 03 04 03 04 03 04  /* 185 */
			29 01 00 00 00 00 15 B8 61 F0 27 24 3B B6 33 69 12 7A FF 0B 0A 0B 03 04 03 04 03 04  /* 186 */
			29 01 00 00 00 00 15 B8 61 F0 27 24 3B B6 33 69 12 7A FF 0B 0B 0B 03 03 04 04 04 03  /* 187 */
			29 01 00 00 00 00 15 B8 61 F0 27 24 3B B6 33 69 12 7A FF 0B 0B 0B 03 03 04 04 04 03  /* 188 */
			29 01 00 00 00 00 15 B8 61 F0 27 24 3B B6 33 69 12 7A FF 0B 0B 0B 04 03 04 03 04 03  /* 189 */
			29 01 00 00 00 00 15 B8 61 F0 27 24 3B B6 33 69 12 7A FF 0B 0B 0B 04 03 04 03 04 04  /* 190 */
			29 01 00 00 00 00 15 B8 61 F0 27 24 3B B6 33 69 12 7A FF 0B 0B 0B 04 04 04 04 03 04  /* 191 */
			29 01 00 00 00 00 15 B8 61 F0 27 24 3B B6 33 69 12 7A FF 0B 0B 0B 04 04 04 04 03 04  /* 192 */
			29 01 00 00 00 00 15 B8 61 F0 27 24 3B B6 33 69 12 7A FF 0B 0B 0C 04 04 03 04 04 04  /* 193 */
			29 01 00 00 00 00 15 B8 61 F0 27 24 3B B6 33 69 12 7A FF 0B 0B 0C 04 04 04 04 04 03  /* 194 */
			29 01 00 00 00 00 15 B8 61 F0 27 24 3B B6 33 69 12 7A FF 0C 0B 0C 03 04 04 04 04 04  /* 195 */
			29 01 00 00 00 00 15 B8 61 F0 27 24 3B B6 33 69 12 7A FF 0C 0B 0C 04 04 04 03 04 04  /* 196 */
			29 01 00 00 00 00 15 B8 61 F0 27 24 3B B6 33 69 12 7A FF 0C 0C 0C 04 03 04 04 04 04  /* 197 */
			29 01 00 00 00 00 15 B8 61 F0 27 24 3B B6 33 69 12 7A FF 0C 0C 0C 04 04 04 04 03 04  /* 198 */
			29 01 00 00 00 00 15 B8 61 F0 27 24 3B B6 33 69 12 7A FF 0C 0C 0C 04 04 04 04 03 04  /* 199 */
			29 01 00 00 00 00 15 B8 61 F0 27 24 3B B6 33 69 12 7A FF 0C 0C 0C 04 04 04 04 04 04  /* 200 */
			29 01 00 00 00 00 15 B8 61 F0 27 24 3B B6 33 69 12 7A FF 0C 0C 0C 04 04 04 04 04 04  /* 201 */
			29 01 00 00 00 00 15 B8 61 F0 27 24 3B B6 33 69 12 7A FF 0C 0C 0C 04 04 04 04 04 05  /* 202 */
			29 01 00 00 00 00 15 B8 61 F0 27 24 3B B6 33 69 12 7A FF 0C 0C 0C 04 04 05 04 04 04  /* 203 */
			29 01 00 00 00 00 15 B8 61 F0 27 24 3B B6 33 69 12 7A FF 0C 0C 0D 05 04 04 04 04 04  /* 204 */
			29 01 00 00 00 00 15 B8 61 F0 27 24 3B B6 33 69 12 7A FF 0C 0C 0D 05 04 04 04 04 04  /* 205 */
			29 01 00 00 00 00 15 B8 61 F0 27 24 3B B6 33 69 12 7A FF 0D 0C 0D 04 04 04 04 04 04  /* 206 */
			29 01 00 00 00 00 15 B8 61 F0 27 24 3B B6 33 69 12 7A FF 0D 0C 0D 04 04 04 04 05 04  /* 207 */
			29 01 00 00 00 00 15 B8 61 F0 27 24 3B B6 33 69 12 7A FF 0D 0C 0D 04 05 04 04 04 04  /* 208 */
			29 01 00 00 00 00 15 B8 61 F0 27 24 3B B6 33 69 12 7A FF 0D 0C 0D 04 05 04 04 04 05  /* 209 */
			29 01 00 00 00 00 15 B8 61 F0 27 24 3B B6 33 69 12 7A FF 0D 0D 0D 04 04 04 04 04 05  /* 210 */
			29 01 00 00 00 00 15 B8 61 F0 27 24 3B B6 33 69 12 7A FF 0D 0D 0D 04 04 04 05 04 05  /* 211 */
			29 01 00 00 00 00 15 B8 61 F0 27 24 3B B6 33 69 12 7A FF 0D 0D 0D 04 04 05 05 04 04  /* 212 */
			29 01 00 00 00 00 15 B8 61 F0 27 24 3B B6 33 69 12 7A FF 0D 0D 0D 04 04 05 05 04 04  /* 213 */
			29 01 00 00 00 00 15 B8 61 F0 27 24 3B B6 33 69 12 7A FF 0D 0D 0D 05 04 05 04 04 04  /* 214 */
			29 01 00 00 00 00 15 B8 61 F0 27 24 3B B6 33 69 12 7A FF 0D 0D 0E 05 04 04 04 05 04  /* 215 */
			29 01 00 00 00 00 15 B8 61 F0 27 24 3B B6 33 69 12 7A FF 0D 0D 0E 05 05 04 04 04 05  /* 216 */
			29 01 00 00 00 00 15 B8 61 F0 27 24 3B B6 33 69 12 7A FF 0E 0D 0E 04 05 04 05 04 05  /* 217 */
			29 01 00 00 00 00 15 B8 61 F0 27 24 3B B6 33 69 12 7A FF 0E 0D 0E 04 05 04 05 04 05  /* 218 */
			29 01 00 00 00 00 15 B8 61 F0 27 24 3B B6 33 69 12 7A FF 0E 0D 0E 04 05 05 05 04 04  /* 219 */
			29 01 00 00 00 00 15 B8 61 F0 27 24 3B B6 33 69 12 7A FF 0E 0E 0E 05 04 05 04 05 04  /* 220 */
			29 01 00 00 00 00 15 B8 61 F0 27 24 3B B6 33 69 12 7A FF 0E 0E 0E 05 04 05 04 05 05  /* 221 */
			29 01 00 00 00 00 15 B8 61 F0 27 24 3B B6 33 69 12 7A FF 0E 0E 0E 05 04 05 05 05 05  /* 222 */
			29 01 00 00 00 00 15 B8 61 F0 27 24 3B B6 33 69 12 7A FF 0E 0E 0E 05 05 05 05 04 05  /* 223 */
			29 01 00 00 00 00 15 B8 61 F0 27 24 3B B6 33 69 12 7A FF 0E 0E 0F 05 05 04 05 04 05  /* 224 */
			29 01 00 00 00 00 15 B8 61 F0 27 24 3B B6 33 69 12 7A FF 0F 0E 0F 04 05 05 05 05 04  /* 225 */
			29 01 00 00 00 00 15 B8 61 F0 27 24 3B B6 33 69 12 7A FF 0F 0E 0F 05 05 05 04 05 05  /* 226 */
			29 01 00 00 00 00 15 B8 61 F0 27 24 3B B6 33 69 12 7A FF 0F 0E 0F 05 05 05 05 05 05  /* 227 */
			29 01 00 00 00 00 15 B8 61 F0 27 24 3B B6 33 69 12 7A FF 0F 0F 0F 05 04 05 05 05 05  /* 228 */
			29 01 00 00 00 00 15 B8 61 F0 27 24 3B B6 33 69 12 7A FF 0F 0F 0F 05 05 05 05 04 05  /* 229 */
			29 01 00 00 00 00 15 B8 61 F0 27 24 3B B6 33 69 12 7A FF 0F 0F 0F 05 05 05 05 05 05  /* 230 */
			29 01 00 00 00 00 15 B8 61 F0 27 24 3B B6 33 69 12 7A FF 0F 0F 0F 05 05 06 05 05 05  /* 231 */
			29 01 00 00 00 00 15 B8 61 F0 27 24 3B B6 33 69 12 7A FF 0F 0F 10 06 05 05 05 05 05  /* 232 */
			29 01 00 00 00 00 15 B8 61 F0 27 24 3B B6 33 69 12 7A FF 0F 0F 10 06 05 05 05 05 05  /* 233 */
			29 01 00 00 00 00 15 B8 61 F0 27 24 3B B6 33 69 12 7A FF 10 0F 10 05 05 05 05 05 05  /* 234 */
			29 01 00 00 00 00 15 B8 61 F0 27 24 3B B6 33 69 12 7A FF 10 0F 10 05 06 05 05 05 06  /* 235 */
			29 01 00 00 00 00 15 B8 61 F0 27 24 3B B6 33 69 12 7A FF 10 0F 10 05 06 05 05 05 06  /* 236 */
			29 01 00 00 00 00 15 B8 61 F0 27 24 3B B6 33 69 12 7A FF 10 10 10 05 05 06 06 05 05  /* 237 */
			29 01 00 00 00 00 15 B8 61 F0 27 24 3B B6 33 69 12 7A FF 10 10 10 05 05 06 06 05 05  /* 238 */
			29 01 00 00 00 00 15 B8 61 F0 27 24 3B B6 33 69 12 7A FF 10 10 10 06 05 06 05 05 05  /* 239 */
			29 01 00 00 00 00 15 B8 61 F0 27 24 3B B6 33 69 12 7A FF 10 10 11 06 05 05 05 06 06  /* 240 */
			29 01 00 00 00 00 15 B8 61 F0 27 24 3B B6 33 69 12 7A FF 10 10 11 06 06 05 05 05 06  /* 241 */
			29 01 00 00 00 00 15 B8 61 F0 27 24 3B B6 33 69 12 7A FF 11 10 11 05 06 05 06 05 06  /* 242 */
			29 01 00 00 00 00 15 B8 61 F0 27 24 3B B6 33 69 12 7A FF 11 10 11 05 06 06 06 05 05  /* 243 */
			29 01 00 00 00 00 15 B8 61 F0 27 24 3B B6 33 69 12 7A FF 11 11 11 06 05 06 05 06 06  /* 244 */
			29 01 00 00 00 00 15 B8 61 F0 27 24 3B B6 33 69 12 7A FF 11 11 11 06 05 06 05 06 06  /* 245 */
			29 01 00 00 00 00 15 B8 61 F0 27 24 3B B6 33 69 12 7A FF 11 11 11 06 05 06 06 06 06  /* 246 */
			29 01 00 00 00 00 15 B8 61 F0 27 24 3B B6 33 69 12 7A FF 11 11 12 06 06 05 06 05 06  /* 247 */
			29 01 00 00 00 00 15 B8 61 F0 27 24 3B B6 33 69 12 7A FF 11 11 12 06 06 06 06 05 05  /* 248 */
			29 01 00 00 00 00 15 B8 61 F0 27 24 3B B6 33 69 12 7A FF 12 11 12 06 06 06 05 06 06  /* 249 */
			29 01 00 00 00 00 15 B8 61 F0 27 24 3B B6 33 69 12 7A FF 12 11 12 06 06 06 06 06 06  /* 250 */
			29 01 00 00 00 00 15 B8 61 F0 27 24 3B B6 33 69 12 7A FF 12 11 12 06 06 06 06 06 06  /* 251 */
			29 01 00 00 00 00 15 B8 61 F0 27 24 3B B6 33 69 12 7A FF 12 12 12 06 06 06 06 05 06  /* 252 */
			29 01 00 00 00 00 15 B8 61 F0 27 24 3B B6 33 69 12 7A FF 12 12 13 06 06 06 06 06 06  /* 253 */
			29 01 00 00 00 00 15 B8 61 F0 27 24 3B B6 33 69 12 7A FF 12 12 13 07 06 06 06 06 06  /* 254 */
			29 01 00 00 00 00 15 B8 61 F0 27 24 3B B6 33 69 12 7A FF 13 12 13 06 06 06 06 06 06  /* 255 */
			29 01 00 00 00 00 15 B8 61 F0 27 24 3B B6 33 69 12 7A FF 13 12 13 06 07 06 06 06 07  /* 256 */
			29 01 00 00 00 00 15 B8 61 F0 27 24 3B B6 33 69 12 7A FF 13 13 13 06 06 07 07 06 06  /* 257 */
			29 01 00 00 00 00 15 B8 61 F0 27 24 3B B6 33 69 12 7A FF 13 13 13 07 06 07 06 06 06  /* 258 */
			29 01 00 00 00 00 15 B8 61 F0 27 24 3B B6 33 69 12 7A FF 13 13 14 07 06 06 06 06 07  /* 259 */
			29 01 00 00 00 00 15 B8 61 F0 27 24 3B B6 33 69 12 7A FF 14 13 14 06 06 06 06 07 07  /* 260 */
			29 01 00 00 00 00 15 B8 61 F0 27 24 3B B6 33 69 12 7A FF 14 13 14 06 07 07 07 06 06  /* 261 */
			29 01 00 00 00 00 15 B8 61 F0 27 24 3B B6 33 69 12 7A FF 14 13 14 07 07 07 06 06 07  /* 262 */
			29 01 00 00 00 00 15 B8 61 F0 27 24 3B B6 33 69 12 7A FF 14 14 14 07 06 07 06 07 07  /* 263 */
			29 01 00 00 00 00 15 B8 61 F0 27 24 3B B6 33 69 12 7A FF 14 14 15 07 06 06 07 07 07  /* 264 */
			29 01 00 00 00 00 15 B8 61 F0 27 24 3B B6 33 69 12 7A FF 14 14 15 07 07 07 07 06 06  /* 265 */
			29 01 00 00 00 00 15 B8 61 F0 27 24 3B B6 33 69 12 7A FF 15 14 15 07 07 07 06 07 07  /* 266 */
			29 01 00 00 00 00 15 B8 61 F0 27 24 3B B6 33 69 12 7A FF 15 14 15 07 07 07 07 07 07  /* 267 */
			29 01 00 00 00 00 15 B8 61 F0 27 24 3B B6 33 69 12 7A FF 15 14 15 07 07 07 07 07 07  /* 268 */
			29 01 00 00 00 00 15 B8 61 F0 27 24 3B B6 33 69 12 7A FF 15 15 15 07 07 08 07 06 07  /* 269 */
			29 01 00 00 00 00 15 B8 61 F0 27 24 3B B6 33 69 12 7A FF 15 15 16 07 07 07 07 07 07  /* 270 */
			29 01 00 00 00 00 15 B8 61 F0 27 24 3B B6 33 69 12 7A FF 16 15 16 07 07 07 07 07 07  /* 271 */
			29 01 00 00 00 00 15 B8 61 F0 27 24 3B B6 33 69 12 7A FF 16 15 16 07 07 07 07 07 08  /* 272 */
			29 01 00 00 00 00 15 B8 61 F0 27 24 3B B6 33 69 12 7A FF 16 15 16 07 08 08 07 07 07  /* 273 */
			29 01 00 00 00 00 15 B8 61 F0 27 24 3B B6 33 69 12 7A FF 16 16 16 07 07 08 08 07 07  /* 274 */
			29 01 00 00 00 00 15 B8 61 F0 27 24 3B B6 33 69 12 7A FF 16 16 17 08 07 07 07 07 08  /* 275 */
			29 01 00 00 00 00 15 B8 61 F0 27 24 3B B6 33 69 12 7A FF 16 16 17 08 07 07 07 07 08  /* 276 */
			29 01 00 00 00 00 15 B8 61 F0 27 24 3B B6 33 69 12 7A FF 17 16 17 07 08 08 08 07 07  /* 277 */
			29 01 00 00 00 00 15 B8 61 F0 27 24 3B B6 33 69 12 7A FF 17 16 17 07 08 08 08 07 07  /* 278 */
			29 01 00 00 00 00 15 B8 61 F0 27 24 3B B6 33 69 12 7A FF 17 16 17 08 08 08 07 07 08  /* 279 */
			29 01 00 00 00 00 15 B8 61 F0 27 24 3B B6 33 69 12 7A FF 17 17 18 08 07 07 08 08 08  /* 280 */
			29 01 00 00 00 00 15 B8 61 F0 27 24 3B B6 33 69 12 7A FF 17 17 18 08 08 08 08 07 08  /* 281 */
			29 01 00 00 00 00 15 B8 61 F0 27 24 3B B6 33 69 12 7A FF 18 17 18 08 08 08 07 07 08  /* 282 */
			29 01 00 00 00 00 15 B8 61 F0 27 24 3B B6 33 69 12 7A FF 18 17 18 08 08 08 08 08 08  /* 283 */
			29 01 00 00 00 00 15 B8 61 F0 27 24 3B B6 33 69 12 7A FF 18 18 18 08 07 09 08 08 08  /* 284 */
			29 01 00 00 00 00 15 B8 61 F0 27 24 3B B6 33 69 12 7A FF 18 18 19 09 08 08 08 08 08  /* 285 */
			29 01 00 00 00 00 15 B8 61 F0 27 24 3B B6 33 69 12 7A FF 19 18 19 08 08 08 08 08 08  /* 286 */
			29 01 00 00 00 00 15 B8 61 F0 27 24 3B B6 33 69 12 7A FF 19 18 19 08 08 08 08 08 09  /* 287 */
			29 01 00 00 00 00 15 B8 61 F0 27 24 3B B6 33 69 12 7A FF 19 18 19 08 09 09 09 08 08  /* 288 */
			29 01 00 00 00 00 15 B8 61 F0 27 24 3B B6 33 69 12 7A FF 19 19 1A 09 08 08 08 08 09  /* 289 */
			29 01 00 00 00 00 15 B8 61 F0 27 24 3B B6 33 69 12 7A FF 19 19 1A 09 08 08 08 08 09  /* 290 */
			29 01 00 00 00 00 15 B8 61 F0 27 24 3B B6 33 69 12 7A FF 1A 19 1A 08 09 09 09 08 08  /* 291 */
			29 01 00 00 00 00 15 B8 61 F0 27 24 3B B6 33 69 12 7A FF 1A 19 1A 09 09 09 08 08 09  /* 292 */
			29 01 00 00 00 00 15 B8 61 F0 27 24 3B B6 33 69 12 7A FF 1A 1A 1B 09 08 08 09 09 09  /* 293 */
			29 01 00 00 00 00 15 B8 61 F0 27 24 3B B6 33 69 12 7A FF 1A 1A 1B 09 08 09 09 09 09  /* 294 */
			29 01 00 00 00 00 15 B8 61 F0 27 24 3B B6 33 69 12 7A FF 1B 1A 1B 09 09 09 08 08 09  /* 295 */
			29 01 00 00 00 00 15 B8 61 F0 27 24 3B B6 33 69 12 7A FF 1B 1A 1B 09 09 09 09 09 09  /* 296 */
			29 01 00 00 00 00 15 B8 61 F0 27 24 3B B6 33 69 12 7A FF 1B 1A 1B 09 09 0A 09 09 09  /* 297 */
			29 01 00 00 00 00 15 B8 61 F0 27 24 3B B6 33 69 12 7A FF 1B 1B 1C 09 09 09 09 08 09  /* 298 */
			29 01 00 00 00 00 15 B8 61 F0 27 24 3B B6 33 69 12 7A FF 1C 1B 1C 09 09 09 09 09 09  /* 299 */
			29 01 00 00 00 00 15 B8 61 F0 27 24 3B B6 33 69 12 7A FF 1C 1B 1C 09 09 09 09 09 0A  /* 300 */
			29 01 00 00 00 00 15 B8 61 F0 27 24 3B B6 33 69 12 7A FF 1C 1B 1C 09 0A 0A 0A 09 09  /* 301 */
			29 01 00 00 00 00 15 B8 61 F0 27 24 3B B6 33 69 12 7A FF 1C 1C 1D 0A 09 09 09 09 0A  /* 302 */
			29 01 00 00 00 00 15 B8 61 F0 27 24 3B B6 33 69 12 7A FF 1D 1C 1D 09 09 0A 0A 09 09  /* 303 */
			29 01 00 00 00 00 15 B8 61 F0 27 24 3B B6 33 69 12 7A FF 1D 1C 1D 0A 0A 0A 09 09 0A  /* 304 */
			29 01 00 00 00 00 15 B8 61 F0 27 24 3B B6 33 69 12 7A FF 1D 1C 1E 0A 0A 09 09 09 0A  /* 305 */
			29 01 00 00 00 00 15 B8 61 F0 27 24 3B B6 33 69 12 7A FF 1D 1D 1E 0A 09 0A 0A 0A 0A  /* 306 */
			29 01 00 00 00 00 15 B8 61 F0 27 24 3B B6 33 69 12 7A FF 1E 1D 1E 0A 0A 0A 09 09 0A  /* 307 */
			29 01 00 00 00 00 15 B8 61 F0 27 24 3B B6 33 69 12 7A FF 1E 1D 1E 0A 0A 0A 0A 0A 0A  /* 308 */
			29 01 00 00 00 00 15 B8 61 F0 27 24 3B B6 33 69 12 7A FF 1E 1D 1F 0A 0A 0A 0A 0A 0A  /* 309 */
			29 01 00 00 00 00 15 B8 61 F0 27 24 3B B6 33 69 12 7A FF 1E 1E 1F 0B 0A 0A 0A 09 0A  /* 310 */
			29 01 00 00 00 00 15 B8 61 F0 27 24 3B B6 33 69 12 7A FF 1F 1E 1F 0A 0A 0A 0A 0A 0B  /* 311 */
			29 01 00 00 00 00 15 B8 61 F0 27 24 3B B6 33 69 12 7A FF 1F 1E 1F 0A 0A 0B 0A 0A 0A  /* 312 */
			29 01 00 00 00 00 15 B8 61 F0 27 24 3B B6 33 69 12 7A FF 1F 1E 20 0A 0B 0A 0B 09 0A  /* 313 */
			29 01 00 00 00 00 15 B8 61 F0 27 24 3B B6 33 69 12 7A FF 1F 1F 20 0B 0A 0A 0A 0A 0B  /* 314 */
			29 01 00 00 00 00 15 B8 61 F0 27 24 3B B6 33 69 12 7A FF 20 1F 20 0A 0A 0B 0B 0A 0A  /* 315 */
			29 01 00 00 00 00 15 B8 61 F0 27 24 3B B6 33 69 12 7A FF 20 1F 20 0B 0B 0B 0A 0A 0B  /* 316 */
			29 01 00 00 00 00 15 B8 61 F0 27 24 3B B6 33 69 12 7A FF 20 20 21 0B 0A 0B 0B 0A 0A  /* 317 */
			29 01 00 00 00 00 15 B8 61 F0 27 24 3B B6 33 69 12 7A FF 21 20 21 0A 0B 0B 0B 0A 0B  /* 318 */
			29 01 00 00 00 00 15 B8 61 F0 27 24 3B B6 33 69 12 7A FF 21 20 21 0B 0B 0B 0B 0A 0B  /* 319 */
			29 01 00 00 00 00 15 B8 61 F0 27 24 3B B6 33 69 12 7A FF 21 20 22 0B 0B 0B 0B 0B 0B  /* 320 */
			29 01 00 00 00 00 15 B8 61 F0 27 24 3B B6 33 69 12 7A FF 22 21 22 0B 0B 0B 0B 0B 0C  /* 321 */
			29 01 00 00 00 00 15 B8 61 F0 27 24 3B B6 33 69 12 7A FF 22 21 22 0B 0B 0C 0B 0B 0B  /* 322 */
			29 01 00 00 00 00 15 B8 61 F0 27 24 3B B6 33 69 12 7A FF 22 21 23 0B 0B 0B 0C 0B 0B  /* 323 */
			29 01 00 00 00 00 15 B8 61 F0 27 24 3B B6 33 69 12 7A FF 22 22 23 0C 0B 0B 0B 0B 0C  /* 324 */
			29 01 00 00 00 00 15 B8 61 F0 27 24 3B B6 33 69 12 7A FF 23 22 23 0B 0B 0C 0C 0B 0B  /* 325 */
			29 01 00 00 00 00 15 B8 61 F0 27 24 3B B6 33 69 12 7A FF 23 22 23 0C 0C 0C 0B 0B 0C  /* 326 */
			29 01 00 00 00 00 15 B8 61 F0 27 24 3B B6 33 69 12 7A FF 23 22 24 0C 0C 0B 0B 0B 0C  /* 327 */
			29 01 00 00 00 00 15 B8 61 F0 27 24 3B B6 33 69 12 7A FF 23 23 24 0C 0B 0C 0C 0C 0C  /* 328 */
			29 01 00 00 00 00 15 B8 61 F0 27 24 3B B6 33 69 12 7A FF 24 23 24 0C 0C 0C 0C 0B 0C  /* 329 */
			29 01 00 00 00 00 15 B8 61 F0 27 24 3B B6 33 69 12 7A FF 24 23 25 0C 0C 0C 0C 0C 0C  /* 330 */
			29 01 00 00 00 00 15 B8 61 F0 27 24 3B B6 33 69 12 7A FF 25 24 25 0C 0C 0C 0C 0B 0D  /* 331 */
			29 01 00 00 00 00 15 B8 61 F0 27 24 3B B6 33 69 12 7A FF 25 24 25 0C 0C 0D 0C 0C 0C  /* 332 */
			29 01 00 00 00 00 15 B8 61 F0 27 24 3B B6 33 69 12 7A FF 25 24 26 0D 0D 0C 0C 0C 0D  /* 333 */
			29 01 00 00 00 00 15 B8 61 F0 27 24 3B B6 33 69 12 7A FF 26 25 26 0C 0C 0D 0D 0C 0C  /* 334 */
			29 01 00 00 00 00 15 B8 61 F0 27 24 3B B6 33 69 12 7A FF 26 25 27 0D 0D 0C 0C 0C 0D  /* 335 */
			29 01 00 00 00 00 15 B8 61 F0 27 24 3B B6 33 69 12 7A FF 26 25 27 0D 0D 0D 0D 0C 0D  /* 336 */
			29 01 00 00 00 00 15 B8 61 F0 27 24 3B B6 33 69 12 7A FF 27 26 27 0D 0C 0D 0C 0D 0D  /* 337 */
			29 01 00 00 00 00 15 B8 61 F0 27 24 3B B6 33 69 12 7A FF 27 26 28 0D 0D 0D 0D 0C 0D  /* 338 */
			29 01 00 00 00 00 15 B8 61 F0 27 24 3B B6 33 69 12 7A FF 27 26 28 0D 0D 0D 0D 0D 0D  /* 339 */
			29 01 00 00 00 00 15 B8 61 F0 27 24 3B B6 33 69 12 7A FF 28 27 28 0D 0D 0D 0D 0C 0E  /* 340 */
			29 01 00 00 00 00 15 B8 61 F0 27 24 3B B6 33 69 12 7A FF 28 27 28 0D 0D 0E 0D 0D 0D  /* 341 */
			29 01 00 00 00 00 15 B8 61 F0 27 24 3B B6 33 69 12 7A FF 28 27 29 0E 0E 0D 0D 0C 0E  /* 342 */
			29 01 00 00 00 00 15 B8 61 F0 27 24 3B B6 33 69 12 7A FF 29 28 29 0D 0D 0E 0E 0D 0D  /* 343 */
			29 01 00 00 00 00 15 B8 61 F0 27 24 3B B6 33 69 12 7A FF 29 28 2A 0E 0D 0D 0D 0E 0E  /* 344 */
			29 01 00 00 00 00 15 B8 61 F0 27 24 3B B6 33 69 12 7A FF 29 28 2A 0E 0E 0E 0E 0D 0E  /* 345 */
			29 01 00 00 00 00 15 B8 61 F0 27 24 3B B6 33 69 12 7A FF 2A 29 2A 0E 0D 0E 0D 0E 0E  /* 346 */
			29 01 00 00 00 00 15 B8 61 F0 27 24 3B B6 33 69 12 7A FF 2A 29 2B 0E 0E 0E 0E 0D 0E  /* 347 */
			29 01 00 00 00 00 15 B8 61 F0 27 24 3B B6 33 69 12 7A FF 2A 29 2B 0F 0E 0E 0E 0E 0E  /* 348 */
			29 01 00 00 00 00 15 B8 61 F0 27 24 3B B6 33 69 12 7A FF 2B 2A 2B 0E 0E 0F 0E 0E 0E  /* 349 */
			29 01 00 00 00 00 15 B8 61 F0 27 24 3B B6 33 69 12 7A FF 2B 2A 2C 0F 0E 0E 0E 0E 0F  /* 350 */
			29 01 00 00 00 00 15 B8 61 F0 27 24 3B B6 33 69 12 7A FF 2C 2B 2C 0E 0E 0F 0F 0E 0E  /* 351 */
			29 01 00 00 00 00 15 B8 61 F0 27 24 3B B6 33 69 12 7A FF 2C 2B 2D 0F 0E 0E 0E 0F 0F  /* 352 */
			29 01 00 00 00 00 15 B8 61 F0 27 24 3B B6 33 69 12 7A FF 2C 2B 2D 0F 0F 0F 0F 0E 0F  /* 353 */
			29 01 00 00 00 00 15 B8 61 F0 27 24 3B B6 33 69 12 7A FF 2D 2C 2D 0F 0F 10 0F 0E 0F  /* 354 */
			29 01 00 00 00 00 15 B8 61 F0 27 24 3B B6 33 69 12 7A FF 2D 2C 2E 0F 0F 0F 0F 0F 0F  /* 355 */
			29 01 00 00 00 00 15 B8 61 F0 27 24 3B B6 33 69 12 7A FF 2E 2D 2E 0F 0F 10 0F 0E 0F  /* 356 */
			29 01 00 00 00 00 15 B8 61 F0 27 24 3B B6 33 69 12 7A FF 2E 2D 2F 0F 0F 0F 10 0F 10  /* 357 */
			29 01 00 00 00 00 15 B8 61 F0 27 24 3B B6 33 69 12 7A FF 2E 2D 2F 10 10 10 0F 0F 0F  /* 358 */
			29 01 00 00 00 00 15 B8 61 F0 27 24 3B B6 33 69 12 7A FF 2F 2E 30 10 0F 0F 0F 0F 10  /* 359 */
			29 01 00 00 00 00 15 B8 61 F0 27 24 3B B6 33 69 12 7A FF 2F 2E 30 10 10 10 10 0F 10  /* 360 */
			29 01 00 00 00 00 15 B8 61 F0 27 24 3B B6 33 69 12 7A FF 30 2F 30 10 0F 10 0F 10 10  /* 361 */
			29 01 00 00 00 00 15 B8 61 F0 27 24 3B B6 33 69 12 7A FF 30 2F 31 10 10 10 10 0F 10  /* 362 */
			29 01 00 00 00 00 15 B8 61 F0 27 24 3B B6 33 69 12 7A FF 30 2F 31 11 10 11 10 10 10  /* 363 */
			29 01 00 00 00 00 15 B8 61 F0 27 24 3B B6 33 69 12 7A FF 31 30 32 10 10 10 10 10 11  /* 364 */
			29 01 00 00 00 00 15 B8 61 F0 27 24 3B B6 33 69 12 7A FF 31 30 32 11 11 11 10 0F 10  /* 365 */
			29 01 00 00 00 00 15 B8 61 F0 27 24 3B B6 33 69 12 7A FF 32 31 33 11 10 10 10 10 11  /* 366 */
			29 01 00 00 00 00 15 B8 61 F0 27 24 3B B6 33 69 12 7A FF 32 31 33 11 11 11 11 10 11  /* 367 */
			29 01 00 00 00 00 15 B8 61 F0 27 24 3B B6 33 69 12 7A FF 33 32 34 11 10 11 10 11 11  /* 368 */
			29 01 00 00 00 00 15 B8 61 F0 27 24 3B B6 33 69 12 7A FF 33 32 34 11 11 11 11 10 11  /* 369 */
			29 01 00 00 00 00 15 B8 61 F0 27 24 3B B6 33 69 12 7A FF 34 33 34 11 11 12 11 10 11  /* 370 */
			29 01 00 00 00 00 15 B8 61 F0 27 24 3B B6 33 69 12 7A FF 34 33 35 12 11 11 11 11 12  /* 371 */
			29 01 00 00 00 00 15 B8 61 F0 27 24 3B B6 33 69 12 7A FF 35 33 35 11 12 12 12 11 12  /* 372 */
			29 01 00 00 00 00 15 B8 61 F0 27 24 3B B6 33 69 12 7A FF 35 34 36 12 11 12 11 11 11  /* 373 */
			29 01 00 00 00 00 15 B8 61 F0 27 24 3B B6 33 69 12 7A FF 36 34 36 11 12 12 12 11 12  /* 374 */
			29 01 00 00 00 00 15 B8 61 F0 27 24 3B B6 33 69 12 7A FF 36 35 37 12 11 12 12 12 12  /* 375 */
			29 01 00 00 00 00 15 B8 61 F0 27 24 3B B6 33 69 12 7A FF 36 35 37 13 12 13 12 12 12  /* 376 */
			29 01 00 00 00 00 15 B8 61 F0 27 24 3B B6 33 69 12 7A FF 37 36 38 12 12 12 12 11 13  /* 377 */
			29 01 00 00 00 00 15 B8 61 F0 27 24 3B B6 33 69 12 7A FF 37 36 38 13 12 13 12 12 12  /* 378 */
			29 01 00 00 00 00 15 B8 61 F0 27 24 3B B6 33 69 12 7A FF 38 37 39 13 12 12 12 12 13  /* 379 */
			29 01 00 00 00 00 15 B8 61 F0 27 24 3B B6 33 69 12 7A FF 38 37 39 13 13 13 13 12 13  /* 380 */
			29 01 00 00 00 00 15 B8 61 F0 27 24 3B B6 33 69 12 7A FF 39 38 3A 13 12 13 13 13 13  /* 381 */
			29 01 00 00 00 00 15 B8 61 F0 27 24 3B B6 33 69 12 7A FF 39 38 3A 14 13 14 12 12 13  /* 382 */
			29 01 00 00 00 00 15 B8 61 F0 27 24 3B B6 33 69 12 7A FF 3A 39 3B 13 13 13 13 12 14  /* 383 */
			29 01 00 00 00 00 15 B8 61 F0 27 24 3B B6 33 69 12 7A FF 3A 39 3B 14 13 14 13 13 13  /* 384 */
			29 01 00 00 00 00 15 B8 61 F0 27 24 3B B6 33 69 12 7A FF 3B 3A 3C 14 13 14 13 13 13  /* 385 */
			29 01 00 00 00 00 15 B8 61 F0 27 24 3B B6 33 69 12 7A FF 3B 3A 3C 14 14 14 14 13 14  /* 386 */
			29 01 00 00 00 00 15 B8 61 F0 27 24 3B B6 33 69 12 7A FF 3C 3B 3D 14 13 14 14 14 14  /* 387 */
			29 01 00 00 00 00 15 B8 61 F0 27 24 3B B6 33 69 12 7A FF 3D 3B 3D 14 14 15 14 14 14  /* 388 */
			29 01 00 00 00 00 15 B8 61 F0 27 24 3B B6 33 69 12 7A FF 3D 3C 3E 15 14 15 14 13 14  /* 389 */
			29 01 00 00 00 00 15 B8 61 F0 27 24 3B B6 33 69 12 7A FF 3E 3C 3F 14 15 14 15 13 15  /* 390 */
			29 01 00 00 00 00 15 B8 61 F0 27 24 3B B6 33 69 12 7A FF 3E 3D 3F 15 14 15 15 14 15  /* 391 */
			29 01 00 00 00 00 15 B8 61 F0 27 24 3B B6 33 69 12 7A FF 3F 3D 40 15 15 15 14 14 15  /* 392 */
			29 01 00 00 00 00 15 B8 61 F0 27 24 3B B6 33 69 12 7A FF 3F 3E 40 16 15 16 14 14 15  /* 393 */
			29 01 00 00 00 00 15 B8 61 F0 27 24 3B B6 33 69 12 7A FF 40 3E 41 15 15 15 15 15 16  /* 394 */
			29 01 00 00 00 00 15 B8 61 F0 27 24 3B B6 33 69 12 7A FF 40 3F 41 16 15 16 15 15 16  /* 395 */
			29 01 00 00 00 00 15 B8 61 F0 27 24 3B B6 33 69 12 7A FF 41 3F 42 16 16 16 15 15 16  /* 396 */
			29 01 00 00 00 00 15 B8 61 F0 27 24 3B B6 33 69 12 7A FF 41 40 42 16 16 16 16 15 16  /* 397 */
			29 01 00 00 00 00 15 B8 61 F0 27 24 3B B6 33 69 12 7A FF 42 41 43 16 15 16 16 15 16  /* 398 */
			29 01 00 00 00 00 15 B8 61 F0 27 24 3B B6 33 69 12 7A FF 43 41 44 16 16 16 16 15 16  /* 399 */
			29 01 00 00 00 00 15 B8 61 F0 27 24 3B B6 33 69 12 7A FF 43 42 44 17 16 17 16 15 16  /* 400 */
			29 01 00 00 00 00 15 B8 61 F0 27 24 3B B6 33 69 12 7A FF 44 42 45 17 17 17 16 15 16  /* 401 */
			29 01 00 00 00 00 15 B8 61 F0 27 24 3B B6 33 69 12 7A FF 44 43 45 17 16 17 17 16 17  /* 402 */
			29 01 00 00 00 00 15 B8 61 F0 27 24 3B B6 33 69 12 7A FF 45 43 46 17 17 17 17 16 17  /* 403 */
			29 01 00 00 00 00 15 B8 61 F0 27 24 3B B6 33 69 12 7A FF 46 44 47 17 17 17 17 16 17  /* 404 */
			29 01 00 00 00 00 15 B8 61 F0 27 24 3B B6 33 69 12 7A FF 46 45 47 18 17 18 17 16 17  /* 405 */
			29 01 00 00 00 00 15 B8 61 F0 27 24 3B B6 33 69 12 7A FF 47 45 48 18 17 18 17 17 17  /* 406 */
			29 01 00 00 00 00 15 B8 61 F0 27 24 3B B6 33 69 12 7A FF 47 46 48 18 17 18 18 17 18  /* 407 */
			29 01 00 00 00 00 15 B8 61 F0 27 24 3B B6 33 69 12 7A FF 48 46 49 18 18 18 18 17 18  /* 408 */
			29 01 00 00 00 00 15 B8 61 F0 27 24 3B B6 33 69 12 7A FF 48 47 4A 19 18 18 18 17 18  /* 409 */
			29 01 00 00 00 00 15 B8 61 F0 27 24 3B B6 33 69 12 7A FF 49 47 4A 18 18 19 18 18 18  /* 410 */
			29 01 00 00 00 00 15 B8 61 F0 27 24 3B B6 33 69 12 7A FF 4A 48 4B 18 18 18 18 18 19  /* 411 */
			29 01 00 00 00 00 15 B8 61 F0 27 24 3B B6 33 69 12 7A FF 4A 48 4B 19 19 19 18 18 19  /* 412 */
			29 01 00 00 00 00 15 B8 61 F0 27 24 3B B6 33 69 12 7A FF 4B 49 4C 19 19 19 18 17 19  /* 413 */
			29 01 00 00 00 00 15 B8 61 F0 27 24 3B B6 33 69 12 7A FF 4B 4A 4C 1A 18 1A 18 18 19  /* 414 */
			29 01 00 00 00 00 15 B8 61 F0 27 24 3B B6 33 69 12 7A FF 4C 4A 4D 19 19 19 19 18 1A  /* 415 */
			29 01 00 00 00 00 15 B8 61 F0 27 24 3B B6 33 69 12 7A FF 4C 4B 4E 1A 19 19 19 18 1A  /* 416 */
			29 01 00 00 00 00 15 B8 61 F0 27 24 3B B6 33 69 12 7A FF 4D 4B 4E 1A 1A 1A 19 18 1A  /* 417 */
			29 01 00 00 00 00 15 B8 61 F0 27 24 3B B6 33 69 12 7A FF 4E 4C 4F 1A 19 1A 19 19 1A  /* 418 */
			29 01 00 00 00 00 15 B8 61 F0 27 24 3B B6 33 69 12 7A FF 4E 4C 4F 1B 1A 1B 19 19 1A  /* 419 */
			29 01 00 00 00 00 15 B8 61 F0 27 24 3B B6 33 69 12 7A FF 4F 4D 50 1A 1A 1A 1A 19 1B  /* 420 */
			29 01 00 00 00 00 15 B8 61 F0 27 24 3B B6 33 69 12 7A FF 4F 4E 51 1B 1A 1A 1A 19 1B  /* 421 */
			29 01 00 00 00 00 15 B8 61 F0 27 24 3B B6 33 69 12 7A FF 50 4E 51 1B 1A 1B 1A 1A 1B  /* 422 */
			29 01 00 00 00 00 15 B8 61 F0 27 24 3B B6 33 69 12 7A FF 51 4F 52 1B 1A 1B 1A 1A 1B  /* 423 */
			29 01 00 00 00 00 15 B8 61 F0 27 24 3B B6 33 69 12 7A FF 51 4F 52 1B 1B 1C 1B 1A 1B  /* 424 */
			29 01 00 00 00 00 15 B8 61 F0 27 24 3B B6 33 69 12 7A FF 52 50 53 1B 1B 1B 1B 1A 1C  /* 425 */
			29 01 00 00 00 00 15 B8 61 F0 27 24 3B B6 33 69 12 7A FF 52 50 54 1C 1B 1B 1B 1B 1C  /* 426 */
			29 01 00 00 00 00 15 B8 61 F0 27 24 3B B6 33 69 12 7A FF 53 51 54 1C 1B 1C 1B 1B 1C  /* 427 */
			29 01 00 00 00 00 15 B8 61 F0 27 24 3B B6 33 69 12 7A FF 53 52 55 1C 1B 1C 1C 1B 1C  /* 428 */
			29 01 00 00 00 00 15 B8 61 F0 27 24 3B B6 33 69 12 7A FF 54 52 55 1C 1C 1C 1C 1B 1D  /* 429 */
			29 01 00 00 00 00 15 B8 61 F0 27 24 3B B6 33 69 12 7A FF 55 53 56 1C 1B 1C 1C 1C 1D  /* 430 */
			29 01 00 00 00 00 15 B8 61 F0 27 24 3B B6 33 69 12 7A FF 55 53 56 1D 1C 1D 1C 1C 1D  /* 431 */
			29 01 00 00 00 00 15 B8 61 F0 27 24 3B B6 33 69 12 7A FF 56 54 57 1D 1C 1D 1C 1C 1D  /* 432 */
			29 01 00 00 00 00 15 B8 61 F0 27 24 3B B6 33 69 12 7A FF 56 54 58 1D 1D 1D 1D 1B 1D  /* 433 */
			29 01 00 00 00 00 15 B8 61 F0 27 24 3B B6 33 69 12 7A FF 57 55 58 1D 1D 1D 1D 1B 1E  /* 434 */
			29 01 00 00 00 00 15 B8 61 F0 27 24 3B B6 33 69 12 7A FF 58 56 59 1D 1C 1D 1D 1C 1E  /* 435 */
			29 01 00 00 00 00 15 B8 61 F0 27 24 3B B6 33 69 12 7A FF 58 56 59 1E 1D 1E 1D 1C 1E  /* 436 */
			29 01 00 00 00 00 15 B8 61 F0 27 24 3B B6 33 69 12 7A FF 59 57 5A 1E 1D 1E 1D 1C 1E  /* 437 */
			29 01 00 00 00 00 15 B8 61 F0 27 24 3B B6 33 69 12 7A FF 59 57 5B 1E 1E 1E 1E 1C 1E  /* 438 */
			29 01 00 00 00 00 15 B8 61 F0 27 24 3B B6 33 69 12 7A FF 5A 58 5B 1E 1E 1F 1E 1C 1E  /* 439 */
			29 01 00 00 00 00 15 B8 61 F0 27 24 3B B6 33 69 12 7A FF 5B 59 5C 1E 1D 1E 1E 1D 1F  /* 440 */
			29 01 00 00 00 00 15 B8 61 F0 27 24 3B B6 33 69 12 7A FF 5B 59 5C 1F 1E 1F 1E 1D 1F  /* 441 */
			29 01 00 00 00 00 15 B8 61 F0 27 24 3B B6 33 69 12 7A FF 5C 5A 5D 1E 1E 1F 1F 1D 1F  /* 442 */
			29 01 00 00 00 00 15 B8 61 F0 27 24 3B B6 33 69 12 7A FF 5C 5A 5E 1F 1F 1F 1F 1D 1F  /* 443 */
			29 01 00 00 00 00 15 B8 61 F0 27 24 3B B6 33 69 12 7A FF 5D 5B 5E 1F 1E 1F 1F 1E 20  /* 444 */
			29 01 00 00 00 00 15 B8 61 F0 27 24 3B B6 33 69 12 7A FF 5D 5B 5F 20 1F 1F 1E 1E 20  /* 445 */
			29 01 00 00 00 00 15 B8 61 F0 27 24 3B B6 33 69 12 7A FF 5E 5C 5F 20 1F 20 1E 1E 20  /* 446 */
			29 01 00 00 00 00 15 B8 61 F0 27 24 3B B6 33 69 12 7A FF 5F 5C 60 1F 1F 20 1F 1F 1F  /* 447 */
			29 01 00 00 00 00 15 B8 61 F0 27 24 3B B6 33 69 12 7A FF 5F 5D 61 20 1F 20 1F 1F 1F  /* 448 */
			29 01 00 00 00 00 15 B8 61 F0 27 24 3B B6 33 69 12 7A FF 60 5E 61 20 1F 20 1F 1F 20  /* 449 */
			29 01 00 00 00 00 15 B8 61 F0 27 24 3B B6 33 69 12 7A FF 60 5E 62 21 20 20 1F 1F 21  /* 450 */
			29 01 00 00 00 00 15 B8 61 F0 27 24 3B B6 33 69 12 7A FF 61 5F 62 21 20 21 1F 1F 21  /* 451 */
			29 01 00 00 00 00 15 B8 61 F0 27 24 3B B6 33 69 12 7A FF 62 5F 63 20 21 21 20 1F 21  /* 452 */
			29 01 00 00 00 00 15 B8 61 F0 27 24 3B B6 33 69 12 7A FF 62 60 64 21 20 21 21 20 21  /* 453 */
			29 01 00 00 00 00 15 B8 61 F0 27 24 3B B6 33 69 12 7A FF 63 61 64 21 20 22 21 20 21  /* 454 */
			29 01 00 00 00 00 15 B8 61 F0 27 24 3B B6 33 69 12 7A FF 64 61 65 21 21 21 21 20 22  /* 455 */
			29 01 00 00 00 00 15 B8 61 F0 27 24 3B B6 33 69 12 7A FF 64 62 66 22 21 21 21 20 22  /* 456 */
			29 01 00 00 00 00 15 B8 61 F0 27 24 3B B6 33 69 12 7A FF 65 63 66 22 21 22 21 20 22  /* 457 */
			29 01 00 00 00 00 15 B8 61 F0 27 24 3B B6 33 69 12 7A FF 65 63 67 22 21 22 22 21 22  /* 458 */
			29 01 00 00 00 00 15 B8 61 F0 27 24 3B B6 33 69 12 7A FF 66 64 68 22 21 22 22 21 22  /* 459 */
			29 01 00 00 00 00 15 B8 61 F0 27 24 3B B6 33 69 12 7A FF 67 64 68 22 22 23 22 21 22  /* 460 */
			29 01 00 00 00 00 15 B8 61 F0 27 24 3B B6 33 69 12 7A FF 67 65 69 23 22 22 22 21 23  /* 461 */
			29 01 00 00 00 00 15 B8 61 F0 27 24 3B B6 33 69 12 7A FF 68 66 69 23 22 23 22 21 23  /* 462 */
			29 01 00 00 00 00 15 B8 61 F0 27 24 3B B6 33 69 12 7A FF 68 66 6A 24 22 23 22 22 23  /* 463 */
			29 01 00 00 00 00 15 B8 61 F0 27 24 3B B6 33 69 12 7A FF 69 67 6B 23 22 23 23 22 23  /* 464 */
			29 01 00 00 00 00 15 B8 61 F0 27 24 3B B6 33 69 12 7A FF 6A 67 6B 23 23 24 23 22 23  /* 465 */
			29 01 00 00 00 00 15 B8 61 F0 27 24 3B B6 33 69 12 7A FF 6A 68 6C 24 23 24 23 22 23  /* 466 */
			29 01 00 00 00 00 15 B8 61 F0 27 24 3B B6 33 69 12 7A FF 6B 68 6C 24 24 24 23 22 24  /* 467 */
			29 01 00 00 00 00 15 B8 61 F0 27 24 3B B6 33 69 12 7A FF 6B 69 6D 25 23 24 23 23 24  /* 468 */
			29 01 00 00 00 00 15 B8 61 F0 27 24 3B B6 33 69 12 7A FF 6C 6A 6E 24 23 24 24 23 24  /* 469 */
			29 01 00 00 00 00 15 B8 61 F0 27 24 3B B6 33 69 12 7A FF 6D 6A 6E 24 24 25 24 23 24  /* 470 */
			29 01 00 00 00 00 15 B8 61 F0 27 24 3B B6 33 69 12 7A FF 6D 6B 6F 25 24 25 24 23 24  /* 471 */
			29 01 00 00 00 00 15 B8 61 F0 27 24 3B B6 33 69 12 7A FF 6E 6B 6F 25 24 25 24 24 25  /* 472 */
			29 01 00 00 00 00 15 B8 61 F0 27 24 3B B6 33 69 12 7A FF 6E 6C 70 26 24 25 24 24 25  /* 473 */
			29 01 00 00 00 00 15 B8 61 F0 27 24 3B B6 33 69 12 7A FF 6F 6D 71 25 24 25 25 24 25  /* 474 */
			29 01 00 00 00 00 15 B8 61 F0 27 24 3B B6 33 69 12 7A FF 70 6D 71 25 25 26 25 24 25  /* 475 */
			29 01 00 00 00 00 15 B8 61 F0 27 24 3B B6 33 69 12 7A FF 70 6E 72 26 25 26 25 24 25  /* 476 */
			29 01 00 00 00 00 15 B8 61 F0 27 24 3B B6 33 69 12 7A FF 71 6E 72 26 25 26 25 24 26  /* 477 */
			29 01 00 00 00 00 15 B8 61 F0 27 24 3B B6 33 69 12 7A FF 71 6F 73 26 25 26 26 24 26  /* 478 */
			29 01 00 00 00 00 15 B8 61 F0 27 24 3B B6 33 69 12 7A FF 72 6F 74 26 26 26 26 24 26  /* 479 */
			29 01 00 00 00 00 15 B8 61 F0 27 24 3B B6 33 69 12 7A FF 73 70 74 26 26 27 26 24 26  /* 480 */
			29 01 00 00 00 00 15 B8 61 F0 27 24 3B B6 33 69 12 7A FF 73 71 75 27 25 27 26 25 26  /* 481 */
			29 01 00 00 00 00 15 B8 61 F0 27 24 3B B6 33 69 12 7A FF 74 71 76 27 26 26 26 25 27  /* 482 */
			29 01 00 00 00 00 15 B8 61 F0 27 24 3B B6 33 69 12 7A FF 74 72 76 28 26 27 26 25 27  /* 483 */
			29 01 00 00 00 00 15 B8 61 F0 27 24 3B B6 33 69 12 7A FF 75 73 77 28 26 27 26 26 28  /* 484 */
			29 01 00 00 00 00 15 B8 61 F0 27 24 3B B6 33 69 12 7A FF 76 73 78 28 27 27 26 26 28  /* 485 */
			29 01 00 00 00 00 15 B8 61 F0 27 24 3B B6 33 69 12 7A FF 77 74 78 28 27 28 27 26 28  /* 486 */
			29 01 00 00 00 00 15 B8 61 F0 27 24 3B B6 33 69 12 7A FF 77 75 79 28 27 28 28 26 28  /* 487 */
			29 01 00 00 00 00 15 B8 61 F0 27 24 3B B6 33 69 12 7A FF 78 75 7A 28 28 28 28 26 28  /* 488 */
			29 01 00 00 00 00 15 B8 61 F0 27 24 3B B6 33 69 12 7A FF 79 76 7A 28 28 29 28 26 28  /* 489 */
			29 01 00 00 00 00 15 B8 61 F0 27 24 3B B6 33 69 12 7A FF 79 77 7B 29 27 29 28 27 28  /* 490 */
			29 01 00 00 00 00 15 B8 61 F0 27 24 3B B6 33 69 12 7A FF 7A 77 7C 29 28 29 28 27 28  /* 491 */
			29 01 00 00 00 00 15 B8 61 F0 27 24 3B B6 33 69 12 7A FF 7A 78 7C 29 28 29 29 27 29  /* 492 */
			29 01 00 00 00 00 15 B8 61 F0 27 24 3B B6 33 69 12 7A FF 7B 78 7D 29 29 29 29 27 29  /* 493 */
			29 01 00 00 00 00 15 B8 61 F0 27 24 3B B6 33 69 12 7A FF 7B 79 7D 2A 28 2A 28 28 29  /* 494 */
			29 01 00 00 00 00 15 B8 61 F0 27 24 3B B6 33 69 12 7A FF 7C 79 7E 2A 29 2A 29 28 29  /* 495 */
			29 01 00 00 00 00 15 B8 61 F0 27 24 3B B6 33 69 12 7A FF 7D 7A 7F 2A 29 2A 29 28 29  /* 496 */
			29 01 00 00 00 00 15 B8 61 F0 27 24 3B B6 33 69 12 7A FF 7D 7B 7F 2A 29 2A 2A 28 2A  /* 497 */
			29 01 00 00 00 00 15 B8 61 F0 27 24 3B B6 33 69 12 7A FF 7E 7B 80 2A 2A 2A 2A 28 2B  /* 498 */
			29 01 00 00 00 00 15 B8 61 F0 27 24 3B B6 33 69 12 7A FF 7F 7C 81 2A 29 2A 2A 29 2B  /* 499 */
			29 01 00 00 00 00 15 B8 61 F0 27 24 3B B6 33 69 12 7A FF 7F 7C 81 2B 2A 2B 2A 29 2B  /* 500 */
			29 01 00 00 00 00 15 B8 61 F0 27 24 3B B6 33 69 12 7A FF 80 7D 82 2B 2A 2B 2A 29 2B  /* 501 */
			29 01 00 00 00 00 15 B8 61 F0 27 24 3B B6 33 69 12 7A FF 81 7E 82 2B 2A 2C 2A 29 2B  /* 502 */
			29 01 00 00 00 00 15 B8 61 F0 27 24 3B B6 33 69 12 7A FF 81 7E 83 2C 2B 2C 2A 29 2B  /* 503 */
			29 01 00 00 00 00 15 B8 61 F0 27 24 3B B6 33 69 12 7A FF 82 7F 84 2C 2B 2C 2A 2A 2B  /* 504 */
			29 01 00 00 00 00 15 B8 61 F0 27 24 3B B6 33 69 12 7A FF 83 80 85 2C 2B 2C 2B 2A 2B  /* 505 */
			29 01 00 00 00 00 15 B8 61 F0 27 24 3B B6 33 69 12 7A FF 83 81 85 2D 2B 2D 2B 2A 2C  /* 506 */
			29 01 00 00 00 00 15 B8 61 F0 27 24 3B B6 33 69 12 7A FF 84 81 86 2C 2C 2C 2C 2A 2D  /* 507 */
			29 01 00 00 00 00 15 B8 61 F0 27 24 3B B6 33 69 12 7A FF 85 82 87 2C 2B 2C 2C 2B 2D  /* 508 */
			29 01 00 00 00 00 15 B8 61 F0 27 24 3B B6 33 69 12 7A FF 85 82 87 2D 2C 2D 2C 2B 2D  /* 509 */
			29 01 00 00 00 00 15 B8 61 F0 27 24 3B B6 33 69 12 7A FF 86 83 88 2D 2C 2D 2C 2B 2D  /* 510 */
			29 01 00 00 00 00 15 B8 61 F0 27 24 3B B6 33 69 12 7A FF 86 83 88 2D 2C 2D 2C 2B 2D  /* 511 */
		];

		/*
		* ************************************************************************************************************************
		* AID command list and mappings
		* ************************************************************************************************************************
		*/
		samsung,pac_aid_subdivision_tx_cmds_revE = [
			29 01 00 00 00 00 03 B1 0B 75  /* 0 */
			29 01 00 00 00 00 03 B1 0B 73  /* 1 */
			29 01 00 00 00 00 03 B1 0B 71  /* 2 */
			29 01 00 00 00 00 03 B1 0B 6F  /* 3 */
			29 01 00 00 00 00 03 B1 0B 6D  /* 4 */
			29 01 00 00 00 00 03 B1 0B 65  /* 5 */
			29 01 00 00 00 00 03 B1 0B 63  /* 6 */
			29 01 00 00 00 00 03 B1 0B 62  /* 7 */
			29 01 00 00 00 00 03 B1 0B 61  /* 8 */
			29 01 00 00 00 00 03 B1 0B 5F  /* 9 */
			29 01 00 00 00 00 03 B1 0B 5D  /* 10 */
			29 01 00 00 00 00 03 B1 0B 53  /* 11 */
			29 01 00 00 00 00 03 B1 0B 51  /* 12 */
			29 01 00 00 00 00 03 B1 0B 4F  /* 13 */
			29 01 00 00 00 00 03 B1 0B 4E  /* 14 */
			29 01 00 00 00 00 03 B1 0B 4D  /* 15 */
			29 01 00 00 00 00 03 B1 0B 43  /* 16 */
			29 01 00 00 00 00 03 B1 0B 41  /* 17 */
			29 01 00 00 00 00 03 B1 0B 3F  /* 18 */
			29 01 00 00 00 00 03 B1 0B 3D  /* 19 */
			29 01 00 00 00 00 03 B1 0B 33  /* 20 */
			29 01 00 00 00 00 03 B1 0B 32  /* 21 */
			29 01 00 00 00 00 03 B1 0B 31  /* 22 */
			29 01 00 00 00 00 03 B1 0B 2F  /* 23 */
			29 01 00 00 00 00 03 B1 0B 2D  /* 24 */
			29 01 00 00 00 00 03 B1 0B 23  /* 25 */
			29 01 00 00 00 00 03 B1 0B 21  /* 26 */
			29 01 00 00 00 00 03 B1 0B 1F  /* 27 */
			29 01 00 00 00 00 03 B1 0B 1E  /* 28 */
			29 01 00 00 00 00 03 B1 0B 1D  /* 29 */
			29 01 00 00 00 00 03 B1 0B 13  /* 30 */
			29 01 00 00 00 00 03 B1 0B 11  /* 31 */
			29 01 00 00 00 00 03 B1 0B 0F  /* 32 */
			29 01 00 00 00 00 03 B1 0B 0D  /* 33 */
			29 01 00 00 00 00 03 B1 0B 03  /* 34 */
			29 01 00 00 00 00 03 B1 0B 02  /* 35 */
			29 01 00 00 00 00 03 B1 0B 01  /* 36 */
			29 01 00 00 00 00 03 B1 0A FF  /* 37 */
			29 01 00 00 00 00 03 B1 0A FD  /* 38 */
			29 01 00 00 00 00 03 B1 0A F3  /* 39 */
			29 01 00 00 00 00 03 B1 0A F1  /* 40 */
			29 01 00 00 00 00 03 B1 0A EF  /* 41 */
			29 01 00 00 00 00 03 B1 0A EE  /* 42 */
			29 01 00 00 00 00 03 B1 0A E3  /* 43 */
			29 01 00 00 00 00 03 B1 0A E1  /* 44 */
			29 01 00 00 00 00 03 B1 0A DF  /* 45 */
			29 01 00 00 00 00 03 B1 0A DD  /* 46 */
			29 01 00 00 00 00 03 B1 0A D3  /* 47 */
			29 01 00 00 00 00 03 B1 0A D1  /* 48 */
			29 01 00 00 00 00 03 B1 0A D0  /* 49 */
			29 01 00 00 00 00 03 B1 0A CD  /* 50 */
			29 01 00 00 00 00 03 B1 0A C3  /* 51 */
			29 01 00 00 00 00 03 B1 0A C1  /* 52 */
			29 01 00 00 00 00 03 B1 0A BF  /* 53 */
			29 01 00 00 00 00 03 B1 0A BD  /* 54 */
			29 01 00 00 00 00 03 B1 0A B3  /* 55 */
			29 01 00 00 00 00 03 B1 0A B2  /* 56 */
			29 01 00 00 00 00 03 B1 0A AF  /* 57 */
			29 01 00 00 00 00 03 B1 0A AD  /* 58 */
			29 01 00 00 00 00 03 B1 0A A3  /* 59 */
			29 01 00 00 00 00 03 B1 0A A1  /* 60 */
			29 01 00 00 00 00 03 B1 0A 9F  /* 61 */
			29 01 00 00 00 00 03 B1 0A 9D  /* 62 */
			29 01 00 00 00 00 03 B1 0A 93  /* 63 */
			29 01 00 00 00 00 03 B1 0A 90  /* 64 */
			29 01 00 00 00 00 03 B1 0A 8C  /* 65 */
			29 01 00 00 00 00 03 B1 0A 89  /* 66 */
			29 01 00 00 00 00 03 B1 0A 85  /* 67 */
			29 01 00 00 00 00 03 B1 0A 82  /* 68 */
			29 01 00 00 00 00 03 B1 0A 7E  /* 69 */
			29 01 00 00 00 00 03 B1 0A 7B  /* 70 */
			29 01 00 00 00 00 03 B1 0A 75  /* 71 */
			29 01 00 00 00 00 03 B1 0A 70  /* 72 */
			29 01 00 00 00 00 03 B1 0A 6A  /* 73 */
			29 01 00 00 00 00 03 B1 0A 64  /* 74 */
			29 01 00 00 00 00 03 B1 0A 5E  /* 75 */
			29 01 00 00 00 00 03 B1 0A 59  /* 76 */
			29 01 00 00 00 00 03 B1 0A 53  /* 77 */
			29 01 00 00 00 00 03 B1 0A 4E  /* 78 */
			29 01 00 00 00 00 03 B1 0A 49  /* 79 */
			29 01 00 00 00 00 03 B1 0A 44  /* 80 */
			29 01 00 00 00 00 03 B1 0A 3F  /* 81 */
			29 01 00 00 00 00 03 B1 0A 3A  /* 82 */
			29 01 00 00 00 00 03 B1 0A 35  /* 83 */
			29 01 00 00 00 00 03 B1 0A 30  /* 84 */
			29 01 00 00 00 00 03 B1 0A 29  /* 85 */
			29 01 00 00 00 00 03 B1 0A 23  /* 86 */
			29 01 00 00 00 00 03 B1 0A 1D  /* 87 */
			29 01 00 00 00 00 03 B1 0A 16  /* 88 */
			29 01 00 00 00 00 03 B1 0A 10  /* 89 */
			29 01 00 00 00 00 03 B1 0A 0A  /* 90 */
			29 01 00 00 00 00 03 B1 0A 03  /* 91 */
			29 01 00 00 00 00 03 B1 09 FE  /* 92 */
			29 01 00 00 00 00 03 B1 09 FA  /* 93 */
			29 01 00 00 00 00 03 B1 09 F6  /* 94 */
			29 01 00 00 00 00 03 B1 09 F1  /* 95 */
			29 01 00 00 00 00 03 B1 09 ED  /* 96 */
			29 01 00 00 00 00 03 B1 09 E8  /* 97 */
			29 01 00 00 00 00 03 B1 09 E4  /* 98 */
			29 01 00 00 00 00 03 B1 09 E1  /* 99 */
			29 01 00 00 00 00 03 B1 09 DD  /* 100 */
			29 01 00 00 00 00 03 B1 09 DA  /* 101 */
			29 01 00 00 00 00 03 B1 09 D7  /* 102 */
			29 01 00 00 00 00 03 B1 09 D4  /* 103 */
			29 01 00 00 00 00 03 B1 09 D0  /* 104 */
			29 01 00 00 00 00 03 B1 09 CD  /* 105 */
			29 01 00 00 00 00 03 B1 09 C5  /* 106 */
			29 01 00 00 00 00 03 B1 09 BE  /* 107 */
			29 01 00 00 00 00 03 B1 09 B7  /* 108 */
			29 01 00 00 00 00 03 B1 09 AF  /* 109 */
			29 01 00 00 00 00 03 B1 09 A7  /* 110 */
			29 01 00 00 00 00 03 B1 09 A0  /* 111 */
			29 01 00 00 00 00 03 B1 09 98  /* 112 */
			29 01 00 00 00 00 03 B1 09 91  /* 113 */
			29 01 00 00 00 00 03 B1 09 8D  /* 114 */
			29 01 00 00 00 00 03 B1 09 89  /* 115 */
			29 01 00 00 00 00 03 B1 09 84  /* 116 */
			29 01 00 00 00 00 03 B1 09 81  /* 117 */
			29 01 00 00 00 00 03 B1 09 7C  /* 118 */
			29 01 00 00 00 00 03 B1 09 78  /* 119 */
			29 01 00 00 00 00 03 B1 09 74  /* 120 */
			29 01 00 00 00 00 03 B1 09 6F  /* 121 */
			29 01 00 00 00 00 03 B1 09 6A  /* 122 */
			29 01 00 00 00 00 03 B1 09 65  /* 123 */
			29 01 00 00 00 00 03 B1 09 61  /* 124 */
			29 01 00 00 00 00 03 B1 09 5C  /* 125 */
			29 01 00 00 00 00 03 B1 09 57  /* 126 */
			29 01 00 00 00 00 03 B1 09 52  /* 127 */
			29 01 00 00 00 00 03 B1 09 4F  /* 128 */
			29 01 00 00 00 00 03 B1 09 4C  /* 129 */
			29 01 00 00 00 00 03 B1 09 48  /* 130 */
			29 01 00 00 00 00 03 B1 09 45  /* 131 */
			29 01 00 00 00 00 03 B1 09 42  /* 132 */
			29 01 00 00 00 00 03 B1 09 3F  /* 133 */
			29 01 00 00 00 00 03 B1 09 3C  /* 134 */
			29 01 00 00 00 00 03 B1 09 33  /* 135 */
			29 01 00 00 00 00 03 B1 09 2B  /* 136 */
			29 01 00 00 00 00 03 B1 09 22  /* 137 */
			29 01 00 00 00 00 03 B1 09 1A  /* 138 */
			29 01 00 00 00 00 03 B1 09 11  /* 139 */
			29 01 00 00 00 00 03 B1 09 09  /* 140 */
			29 01 00 00 00 00 03 B1 09 00  /* 141 */
			29 01 00 00 00 00 03 B1 08 FB  /* 142 */
			29 01 00 00 00 00 03 B1 08 F7  /* 143 */
			29 01 00 00 00 00 03 B1 08 F2  /* 144 */
			29 01 00 00 00 00 03 B1 08 EE  /* 145 */
			29 01 00 00 00 00 03 B1 08 E9  /* 146 */
			29 01 00 00 00 00 03 B1 08 E4  /* 147 */
			29 01 00 00 00 00 03 B1 08 E0  /* 148 */
			29 01 00 00 00 00 03 B1 08 D8  /* 149 */
			29 01 00 00 00 00 03 B1 08 D0  /* 150 */
			29 01 00 00 00 00 03 B1 08 C8  /* 151 */
			29 01 00 00 00 00 03 B1 08 C0  /* 152 */
			29 01 00 00 00 00 03 B1 08 B8  /* 153 */
			29 01 00 00 00 00 03 B1 08 B0  /* 154 */
			29 01 00 00 00 00 03 B1 08 A8  /* 155 */
			29 01 00 00 00 00 03 B1 08 A0  /* 156 */
			29 01 00 00 00 00 03 B1 08 98  /* 157 */
			29 01 00 00 00 00 03 B1 08 90  /* 158 */
			29 01 00 00 00 00 03 B1 08 89  /* 159 */
			29 01 00 00 00 00 03 B1 08 81  /* 160 */
			29 01 00 00 00 00 03 B1 08 79  /* 161 */
			29 01 00 00 00 00 03 B1 08 72  /* 162 */
			29 01 00 00 00 00 03 B1 08 6A  /* 163 */
			29 01 00 00 00 00 03 B1 08 62  /* 164 */
			29 01 00 00 00 00 03 B1 08 5F  /* 165 */
			29 01 00 00 00 00 03 B1 08 5C  /* 166 */
			29 01 00 00 00 00 03 B1 08 59  /* 167 */
			29 01 00 00 00 00 03 B1 08 56  /* 168 */
			29 01 00 00 00 00 03 B1 08 53  /* 169 */
			29 01 00 00 00 00 03 B1 08 4F  /* 170 */
			29 01 00 00 00 00 03 B1 08 4C  /* 171 */
			29 01 00 00 00 00 03 B1 08 49  /* 172 */
			29 01 00 00 00 00 03 B1 08 43  /* 173 */
			29 01 00 00 00 00 03 B1 08 3B  /* 174 */
			29 01 00 00 00 00 03 B1 08 33  /* 175 */
			29 01 00 00 00 00 03 B1 08 2B  /* 176 */
			29 01 00 00 00 00 03 B1 08 23  /* 177 */
			29 01 00 00 00 00 03 B1 08 1C  /* 178 */
			29 01 00 00 00 00 03 B1 08 14  /* 179 */
			29 01 00 00 00 00 03 B1 08 0C  /* 180 */
			29 01 00 00 00 00 03 B1 08 04  /* 181 */
			29 01 00 00 00 00 03 B1 07 FC  /* 182 */
			29 01 00 00 00 00 03 B1 07 F4  /* 183 */
			29 01 00 00 00 00 03 B1 07 ED  /* 184 */
			29 01 00 00 00 00 03 B1 07 E4  /* 185 */
			29 01 00 00 00 00 03 B1 07 DD  /* 186 */
			29 01 00 00 00 00 03 B1 07 D5  /* 187 */
			29 01 00 00 00 00 03 B1 07 CD  /* 188 */
			29 01 00 00 00 00 03 B1 07 C3  /* 189 */
			29 01 00 00 00 00 03 B1 07 B9  /* 190 */
			29 01 00 00 00 00 03 B1 07 AE  /* 191 */
			29 01 00 00 00 00 03 B1 07 A4  /* 192 */
			29 01 00 00 00 00 03 B1 07 9A  /* 193 */
			29 01 00 00 00 00 03 B1 07 90  /* 194 */
			29 01 00 00 00 00 03 B1 07 85  /* 195 */
			29 01 00 00 00 00 03 B1 07 7B  /* 196 */
			29 01 00 00 00 00 03 B1 07 71  /* 197 */
			29 01 00 00 00 00 03 B1 07 69  /* 198 */
			29 01 00 00 00 00 03 B1 07 61  /* 199 */
			29 01 00 00 00 00 03 B1 07 59  /* 200 */
			29 01 00 00 00 00 03 B1 07 50  /* 201 */
			29 01 00 00 00 00 03 B1 07 48  /* 202 */
			29 01 00 00 00 00 03 B1 07 40  /* 203 */
			29 01 00 00 00 00 03 B1 07 38  /* 204 */
			29 01 00 00 00 00 03 B1 07 30  /* 205 */
			29 01 00 00 00 00 03 B1 07 27  /* 206 */
			29 01 00 00 00 00 03 B1 07 1F  /* 207 */
			29 01 00 00 00 00 03 B1 07 16  /* 208 */
			29 01 00 00 00 00 03 B1 07 0D  /* 209 */
			29 01 00 00 00 00 03 B1 07 04  /* 210 */
			29 01 00 00 00 00 03 B1 06 FC  /* 211 */
			29 01 00 00 00 00 03 B1 06 F3  /* 212 */
			29 01 00 00 00 00 03 B1 06 EA  /* 213 */
			29 01 00 00 00 00 03 B1 06 DE  /* 214 */
			29 01 00 00 00 00 03 B1 06 D3  /* 215 */
			29 01 00 00 00 00 03 B1 06 C7  /* 216 */
			29 01 00 00 00 00 03 B1 06 BC  /* 217 */
			29 01 00 00 00 00 03 B1 06 B1  /* 218 */
			29 01 00 00 00 00 03 B1 06 A5  /* 219 */
			29 01 00 00 00 00 03 B1 06 9A  /* 220 */
			29 01 00 00 00 00 03 B1 06 8E  /* 221 */
			29 01 00 00 00 00 03 B1 06 82  /* 222 */
			29 01 00 00 00 00 03 B1 06 76  /* 223 */
			29 01 00 00 00 00 03 B1 06 6A  /* 224 */
			29 01 00 00 00 00 03 B1 06 5E  /* 225 */
			29 01 00 00 00 00 03 B1 06 53  /* 226 */
			29 01 00 00 00 00 03 B1 06 47  /* 227 */
			29 01 00 00 00 00 03 B1 06 3B  /* 228 */
			29 01 00 00 00 00 03 B1 06 2F  /* 229 */
			29 01 00 00 00 00 03 B1 06 22  /* 230 */
			29 01 00 00 00 00 03 B1 06 16  /* 231 */
			29 01 00 00 00 00 03 B1 06 09  /* 232 */
			29 01 00 00 00 00 03 B1 05 FC  /* 233 */
			29 01 00 00 00 00 03 B1 05 EF  /* 234 */
			29 01 00 00 00 00 03 B1 05 E3  /* 235 */
			29 01 00 00 00 00 03 B1 05 D6  /* 236 */
			29 01 00 00 00 00 03 B1 05 C9  /* 237 */
			29 01 00 00 00 00 03 B1 05 BB  /* 238 */
			29 01 00 00 00 00 03 B1 05 AC  /* 239 */
			29 01 00 00 00 00 03 B1 05 9E  /* 240 */
			29 01 00 00 00 00 03 B1 05 90  /* 241 */
			29 01 00 00 00 00 03 B1 05 82  /* 242 */
			29 01 00 00 00 00 03 B1 05 73  /* 243 */
			29 01 00 00 00 00 03 B1 05 65  /* 244 */
			29 01 00 00 00 00 03 B1 05 55  /* 245 */
			29 01 00 00 00 00 03 B1 05 46  /* 246 */
			29 01 00 00 00 00 03 B1 05 36  /* 247 */
			29 01 00 00 00 00 03 B1 05 26  /* 248 */
			29 01 00 00 00 00 03 B1 05 16  /* 249 */
			29 01 00 00 00 00 03 B1 05 07  /* 250 */
			29 01 00 00 00 00 03 B1 04 F7  /* 251 */
			29 01 00 00 00 00 03 B1 05 04  /* 252 */
			29 01 00 00 00 00 03 B1 04 F3  /* 253 */
			29 01 00 00 00 00 03 B1 04 E2  /* 254 */
			29 01 00 00 00 00 03 B1 04 D1  /* 255 */
			29 01 00 00 00 00 03 B1 04 BF  /* 256 */
			29 01 00 00 00 00 03 B1 04 AE  /* 257 */
			29 01 00 00 00 00 03 B1 04 9D  /* 258 */
			29 01 00 00 00 00 03 B1 04 FE  /* 259 */
			29 01 00 00 00 00 03 B1 04 EE  /* 260 */
			29 01 00 00 00 00 03 B1 04 DD  /* 261 */
			29 01 00 00 00 00 03 B1 04 CD  /* 262 */
			29 01 00 00 00 00 03 B1 04 BD  /* 263 */
			29 01 00 00 00 00 03 B1 04 AD  /* 264 */
			29 01 00 00 00 00 03 B1 04 9D  /* 265 */
			29 01 00 00 00 00 03 B1 04 F8  /* 266 */
			29 01 00 00 00 00 03 B1 04 E9  /* 267 */
			29 01 00 00 00 00 03 B1 04 DA  /* 268 */
			29 01 00 00 00 00 03 B1 04 CB  /* 269 */
			29 01 00 00 00 00 03 B1 04 BB  /* 270 */
			29 01 00 00 00 00 03 B1 04 AC  /* 271 */
			29 01 00 00 00 00 03 B1 04 9D  /* 272 */
			29 01 00 00 00 00 03 B1 04 F3  /* 273 */
			29 01 00 00 00 00 03 B1 04 E5  /* 274 */
			29 01 00 00 00 00 03 B1 04 D6  /* 275 */
			29 01 00 00 00 00 03 B1 04 C8  /* 276 */
			29 01 00 00 00 00 03 B1 04 BA  /* 277 */
			29 01 00 00 00 00 03 B1 04 AB  /* 278 */
			29 01 00 00 00 00 03 B1 04 9D  /* 279 */
			29 01 00 00 00 00 03 B1 05 01  /* 280 */
			29 01 00 00 00 00 03 B1 04 F1  /* 281 */
			29 01 00 00 00 00 03 B1 04 E0  /* 282 */
			29 01 00 00 00 00 03 B1 04 CF  /* 283 */
			29 01 00 00 00 00 03 B1 04 BF  /* 284 */
			29 01 00 00 00 00 03 B1 04 AE  /* 285 */
			29 01 00 00 00 00 03 B1 04 9D  /* 286 */
			29 01 00 00 00 00 03 B1 04 FB  /* 287 */
			29 01 00 00 00 00 03 B1 04 EC  /* 288 */
			29 01 00 00 00 00 03 B1 04 DC  /* 289 */
			29 01 00 00 00 00 03 B1 04 CC  /* 290 */
			29 01 00 00 00 00 03 B1 04 BC  /* 291 */
			29 01 00 00 00 00 03 B1 04 AD  /* 292 */
			29 01 00 00 00 00 03 B1 04 9D  /* 293 */
			29 01 00 00 00 00 03 B1 04 F6  /* 294 */
			29 01 00 00 00 00 03 B1 04 E7  /* 295 */
			29 01 00 00 00 00 03 B1 04 D8  /* 296 */
			29 01 00 00 00 00 03 B1 04 C9  /* 297 */
			29 01 00 00 00 00 03 B1 04 BB  /* 298 */
			29 01 00 00 00 00 03 B1 04 AC  /* 299 */
			29 01 00 00 00 00 03 B1 04 9D  /* 300 */
			29 01 00 00 00 00 03 B1 05 01  /* 301 */
			29 01 00 00 00 00 03 B1 04 F0  /* 302 */
			29 01 00 00 00 00 03 B1 04 E0  /* 303 */
			29 01 00 00 00 00 03 B1 04 CF  /* 304 */
			29 01 00 00 00 00 03 B1 04 BE  /* 305 */
			29 01 00 00 00 00 03 B1 04 AE  /* 306 */
			29 01 00 00 00 00 03 B1 04 9D  /* 307 */
			29 01 00 00 00 00 03 B1 04 EC  /* 308 */
			29 01 00 00 00 00 03 B1 04 DF  /* 309 */
			29 01 00 00 00 00 03 B1 04 D2  /* 310 */
			29 01 00 00 00 00 03 B1 04 C4  /* 311 */
			29 01 00 00 00 00 03 B1 04 B7  /* 312 */
			29 01 00 00 00 00 03 B1 04 AA  /* 313 */
			29 01 00 00 00 00 03 B1 04 9D  /* 314 */
			29 01 00 00 00 00 03 B1 05 04  /* 315 */
			29 01 00 00 00 00 03 B1 04 F3  /* 316 */
			29 01 00 00 00 00 03 B1 04 E2  /* 317 */
			29 01 00 00 00 00 03 B1 04 D1  /* 318 */
			29 01 00 00 00 00 03 B1 04 BF  /* 319 */
			29 01 00 00 00 00 03 B1 04 AE  /* 320 */
			29 01 00 00 00 00 03 B1 04 9D  /* 321 */
			29 01 00 00 00 00 03 B1 04 F1  /* 322 */
			29 01 00 00 00 00 03 B1 04 E3  /* 323 */
			29 01 00 00 00 00 03 B1 04 D5  /* 324 */
			29 01 00 00 00 00 03 B1 04 C7  /* 325 */
			29 01 00 00 00 00 03 B1 04 B9  /* 326 */
			29 01 00 00 00 00 03 B1 04 AB  /* 327 */
			29 01 00 00 00 00 03 B1 04 9D  /* 328 */
			29 01 00 00 00 00 03 B1 05 05  /* 329 */
			29 01 00 00 00 00 03 B1 04 F4  /* 330 */
			29 01 00 00 00 00 03 B1 04 E2  /* 331 */
			29 01 00 00 00 00 03 B1 04 D1  /* 332 */
			29 01 00 00 00 00 03 B1 04 C0  /* 333 */
			29 01 00 00 00 00 03 B1 04 AE  /* 334 */
			29 01 00 00 00 00 03 B1 04 9D  /* 335 */
			29 01 00 00 00 00 03 B1 04 F3  /* 336 */
			29 01 00 00 00 00 03 B1 04 E5  /* 337 */
			29 01 00 00 00 00 03 B1 04 D6  /* 338 */
			29 01 00 00 00 00 03 B1 04 C8  /* 339 */
			29 01 00 00 00 00 03 B1 04 BA  /* 340 */
			29 01 00 00 00 00 03 B1 04 AB  /* 341 */
			29 01 00 00 00 00 03 B1 04 9D  /* 342 */
			29 01 00 00 00 00 03 B1 04 F9  /* 343 */
			29 01 00 00 00 00 03 B1 04 EA  /* 344 */
			29 01 00 00 00 00 03 B1 04 DB  /* 345 */
			29 01 00 00 00 00 03 B1 04 CB  /* 346 */
			29 01 00 00 00 00 03 B1 04 BC  /* 347 */
			29 01 00 00 00 00 03 B1 04 AC  /* 348 */
			29 01 00 00 00 00 03 B1 04 9D  /* 349 */
			29 01 00 00 00 00 03 B1 04 FE  /* 350 */
			29 01 00 00 00 00 03 B1 04 EE  /* 351 */
			29 01 00 00 00 00 03 B1 04 DE  /* 352 */
			29 01 00 00 00 00 03 B1 04 CE  /* 353 */
			29 01 00 00 00 00 03 B1 04 BD  /* 354 */
			29 01 00 00 00 00 03 B1 04 AD  /* 355 */
			29 01 00 00 00 00 03 B1 04 9D  /* 356 */
			29 01 00 00 00 00 03 B1 04 F9  /* 357 */
			29 01 00 00 00 00 03 B1 04 E9  /* 358 */
			29 01 00 00 00 00 03 B1 04 DA  /* 359 */
			29 01 00 00 00 00 03 B1 04 CB  /* 360 */
			29 01 00 00 00 00 03 B1 04 BC  /* 361 */
			29 01 00 00 00 00 03 B1 04 AC  /* 362 */
			29 01 00 00 00 00 03 B1 04 9D  /* 363 */
			29 01 00 00 00 00 03 B1 04 FC  /* 364 */
			29 01 00 00 00 00 03 B1 04 ED  /* 365 */
			29 01 00 00 00 00 03 B1 04 DD  /* 366 */
			29 01 00 00 00 00 03 B1 04 CD  /* 367 */
			29 01 00 00 00 00 03 B1 04 BD  /* 368 */
			29 01 00 00 00 00 03 B1 04 AD  /* 369 */
			29 01 00 00 00 00 03 B1 04 9D  /* 370 */
			29 01 00 00 00 00 03 B1 04 F7  /* 371 */
			29 01 00 00 00 00 03 B1 04 E8  /* 372 */
			29 01 00 00 00 00 03 B1 04 D9  /* 373 */
			29 01 00 00 00 00 03 B1 04 CA  /* 374 */
			29 01 00 00 00 00 03 B1 04 BB  /* 375 */
			29 01 00 00 00 00 03 B1 04 AC  /* 376 */
			29 01 00 00 00 00 03 B1 04 9D  /* 377 */
			29 01 00 00 00 00 03 B1 04 F8  /* 378 */
			29 01 00 00 00 00 03 B1 04 E8  /* 379 */
			29 01 00 00 00 00 03 B1 04 D9  /* 380 */
			29 01 00 00 00 00 03 B1 04 C9  /* 381 */
			29 01 00 00 00 00 03 B1 04 BA  /* 382 */
			29 01 00 00 00 00 03 B1 04 AA  /* 383 */
			29 01 00 00 00 00 03 B1 04 9B  /* 384 */
			29 01 00 00 00 00 03 B1 04 84  /* 385 */
			29 01 00 00 00 00 03 B1 04 6D  /* 386 */
			29 01 00 00 00 00 03 B1 04 56  /* 387 */
			29 01 00 00 00 00 03 B1 04 40  /* 388 */
			29 01 00 00 00 00 03 B1 04 29  /* 389 */
			29 01 00 00 00 00 03 B1 04 12  /* 390 */
			29 01 00 00 00 00 03 B1 03 FB  /* 391 */
			29 01 00 00 00 00 03 B1 03 E3  /* 392 */
			29 01 00 00 00 00 03 B1 03 CA  /* 393 */
			29 01 00 00 00 00 03 B1 03 B2  /* 394 */
			29 01 00 00 00 00 03 B1 03 9A  /* 395 */
			29 01 00 00 00 00 03 B1 03 82  /* 396 */
			29 01 00 00 00 00 03 B1 03 69  /* 397 */
			29 01 00 00 00 00 03 B1 03 51  /* 398 */
			29 01 00 00 00 00 03 B1 03 3A  /* 399 */
			29 01 00 00 00 00 03 B1 03 23  /* 400 */
			29 01 00 00 00 00 03 B1 03 0C  /* 401 */
			29 01 00 00 00 00 03 B1 02 F6  /* 402 */
			29 01 00 00 00 00 03 B1 02 DF  /* 403 */
			29 01 00 00 00 00 03 B1 02 C8  /* 404 */
			29 01 00 00 00 00 03 B1 02 B1  /* 405 */
			29 01 00 00 00 00 03 B1 02 96  /* 406 */
			29 01 00 00 00 00 03 B1 02 7A  /* 407 */
			29 01 00 00 00 00 03 B1 02 5F  /* 408 */
			29 01 00 00 00 00 03 B1 02 43  /* 409 */
			29 01 00 00 00 00 03 B1 02 27  /* 410 */
			29 01 00 00 00 00 03 B1 02 0C  /* 411 */
			29 01 00 00 00 00 03 B1 01 F1  /* 412 */
			29 01 00 00 00 00 03 B1 01 D5  /* 413 */
			29 01 00 00 00 00 03 B1 02 12  /* 414 */
			29 01 00 00 00 00 03 B1 01 FF  /* 415 */
			29 01 00 00 00 00 03 B1 01 EB  /* 416 */
			29 01 00 00 00 00 03 B1 01 D8  /* 417 */
			29 01 00 00 00 00 03 B1 01 C4  /* 418 */
			29 01 00 00 00 00 03 B1 01 B1  /* 419 */
			29 01 00 00 00 00 03 B1 01 9D  /* 420 */
			29 01 00 00 00 00 03 B1 01 8A  /* 421 */
			29 01 00 00 00 00 03 B1 02 15  /* 422 */
			29 01 00 00 00 00 03 B1 02 04  /* 423 */
			29 01 00 00 00 00 03 B1 01 F2  /* 424 */
			29 01 00 00 00 00 03 B1 01 E1  /* 425 */
			29 01 00 00 00 00 03 B1 01 CF  /* 426 */
			29 01 00 00 00 00 03 B1 01 BE  /* 427 */
			29 01 00 00 00 00 03 B1 01 AD  /* 428 */
			29 01 00 00 00 00 03 B1 01 9B  /* 429 */
			29 01 00 00 00 00 03 B1 01 8A  /* 430 */
			29 01 00 00 00 00 03 B1 02 15  /* 431 */
			29 01 00 00 00 00 03 B1 02 03  /* 432 */
			29 01 00 00 00 00 03 B1 01 F2  /* 433 */
			29 01 00 00 00 00 03 B1 01 E1  /* 434 */
			29 01 00 00 00 00 03 B1 01 CF  /* 435 */
			29 01 00 00 00 00 03 B1 01 BE  /* 436 */
			29 01 00 00 00 00 03 B1 01 AD  /* 437 */
			29 01 00 00 00 00 03 B1 01 9B  /* 438 */
			29 01 00 00 00 00 03 B1 01 8A  /* 439 */
			29 01 00 00 00 00 03 B1 02 16  /* 440 */
			29 01 00 00 00 00 03 B1 02 06  /* 441 */
			29 01 00 00 00 00 03 B1 01 F7  /* 442 */
			29 01 00 00 00 00 03 B1 01 E7  /* 443 */
			29 01 00 00 00 00 03 B1 01 D8  /* 444 */
			29 01 00 00 00 00 03 B1 01 C8  /* 445 */
			29 01 00 00 00 00 03 B1 01 B9  /* 446 */
			29 01 00 00 00 00 03 B1 01 A9  /* 447 */
			29 01 00 00 00 00 03 B1 01 99  /* 448 */
			29 01 00 00 00 00 03 B1 01 8A  /* 449 */
			29 01 00 00 00 00 03 B1 01 FD  /* 450 */
			29 01 00 00 00 00 03 B1 01 EC  /* 451 */
			29 01 00 00 00 00 03 B1 01 DC  /* 452 */
			29 01 00 00 00 00 03 B1 01 CB  /* 453 */
			29 01 00 00 00 00 03 B1 01 BB  /* 454 */
			29 01 00 00 00 00 03 B1 01 AB  /* 455 */
			29 01 00 00 00 00 03 B1 01 9A  /* 456 */
			29 01 00 00 00 00 03 B1 01 8A  /* 457 */
			29 01 00 00 00 00 03 B1 01 FF  /* 458 */
			29 01 00 00 00 00 03 B1 01 F1  /* 459 */
			29 01 00 00 00 00 03 B1 01 E2  /* 460 */
			29 01 00 00 00 00 03 B1 01 D3  /* 461 */
			29 01 00 00 00 00 03 B1 01 C5  /* 462 */
			29 01 00 00 00 00 03 B1 01 B6  /* 463 */
			29 01 00 00 00 00 03 B1 01 A7  /* 464 */
			29 01 00 00 00 00 03 B1 01 99  /* 465 */
			29 01 00 00 00 00 03 B1 01 8A  /* 466 */
			29 01 00 00 00 00 03 B1 01 FA  /* 467 */
			29 01 00 00 00 00 03 B1 01 EC  /* 468 */
			29 01 00 00 00 00 03 B1 01 DE  /* 469 */
			29 01 00 00 00 00 03 B1 01 D0  /* 470 */
			29 01 00 00 00 00 03 B1 01 C2  /* 471 */
			29 01 00 00 00 00 03 B1 01 B4  /* 472 */
			29 01 00 00 00 00 03 B1 01 A6  /* 473 */
			29 01 00 00 00 00 03 B1 01 98  /* 474 */
			29 01 00 00 00 00 03 B1 01 8A  /* 475 */
			29 01 00 00 00 00 03 B1 01 B0  /* 476 */
			29 01 00 00 00 00 03 B1 01 A3  /* 477 */
			29 01 00 00 00 00 03 B1 01 97  /* 478 */
			29 01 00 00 00 00 03 B1 01 8A  /* 479 */
			29 01 00 00 00 00 03 B1 01 B3  /* 480 */
			29 01 00 00 00 00 03 B1 01 A5  /* 481 */
			29 01 00 00 00 00 03 B1 01 96  /* 482 */
			29 01 00 00 00 00 03 B1 01 88  /* 483 */
			29 01 00 00 00 00 03 B1 01 71  /* 484 */
			29 01 00 00 00 00 03 B1 01 59  /* 485 */
			29 01 00 00 00 00 03 B1 01 42  /* 486 */
			29 01 00 00 00 00 03 B1 01 29  /* 487 */
			29 01 00 00 00 00 03 B1 01 10  /* 488 */
			29 01 00 00 00 00 03 B1 00 F7  /* 489 */
			29 01 00 00 00 00 03 B1 00 DE  /* 490 */
			29 01 00 00 00 00 03 B1 00 D1  /* 491 */
			29 01 00 00 00 00 03 B1 00 C5  /* 492 */
			29 01 00 00 00 00 03 B1 00 B8  /* 493 */
			29 01 00 00 00 00 03 B1 00 AC  /* 494 */
			29 01 00 00 00 00 03 B1 00 93  /* 495 */
			29 01 00 00 00 00 03 B1 00 7A  /* 496 */
			29 01 00 00 00 00 03 B1 00 61  /* 497 */
			29 01 00 00 00 00 03 B1 00 48  /* 498 */
			29 01 00 00 00 00 03 B1 00 38  /* 499 */
			29 01 00 00 00 00 03 B1 00 29  /* 500 */
			29 01 00 00 00 00 03 B1 00 1B  /* 501 */
			29 01 00 00 00 00 03 B1 00 0C  /* 502 */
			29 01 00 00 00 00 03 B1 00 3D  /* 503 */
			29 01 00 00 00 00 03 B1 00 2C  /* 504 */
			29 01 00 00 00 00 03 B1 00 1C  /* 505 */
			29 01 00 00 00 00 03 B1 00 0C  /* 506 */
			29 01 00 00 00 00 03 B1 00 36  /* 507 */
			29 01 00 00 00 00 03 B1 00 28  /* 508 */
			29 01 00 00 00 00 03 B1 00 1A  /* 509 */
			29 01 00 00 00 00 03 B1 00 0C  /* 510 */
			29 01 00 00 00 00 03 B1 00 0C  /* 511 */
		];

		/*
		* ************************************************************************************************************************
		* candela to index mappings
		* ************************************************************************************************************************
		*/
		samsung,pac_candela_map_table_revA = <
/*<scaled idx> <idx>  <from>  <end> <cd> <interpolation cd>*/
			0	0	0		0		2	2
			1	1	1		100 	3	2
			2	1	101 	200 	3	2
			3	1	201 	300 	3	2
			4	1	301 	400 	3	3
			5	1	401 	500 	3	3
			6	1	501 	600 	3	3
			7	1	601 	700 	3	3
			8	2	701 	800 	4	3
			9	2	801 	900 	4	3
			10	2	901 	1000	4	3
			11	2	1001	1100	4	4
			12	2	1101	1200	4	4
			13	2	1201	1300	4	4
			14	2	1301	1400	4	4
			15	3	1401	1500	5	4
			16	3	1501	1600	5	4
			17	3	1601	1700	5	4
			18	3	1701	1800	5	5
			19	3	1801	1900	5	5
			20	3	1901	2000	5	5
			21	3	2001	2100	5	5
			22	4	2101	2200	6	5
			23	4	2201	2300	6	5
			24	4	2301	2400	6	5
			25	4	2401	2500	6	6
			26	4	2501	2600	6	6
			27	4	2601	2700	6	6
			28	4	2701	2800	6	6
			29	5	2801	2900	7	6
			30	5	2901	3000	7	6
			31	5	3001	3100	7	6
			32	5	3101	3200	7	7
			33	5	3201	3300	7	7
			34	5	3301	3400	7	7
			35	5	3401	3500	7	7
			36	6	3501	3557	8	7
			37	6	3558	3614	8	7
			38	6	3615	3671	8	7
			39	6	3672	3729	8	8
			40	6	3730	3786	8	8
			41	6	3787	3843	8	8
			42	6	3844	3900	8	8
			43	7	3901	3971	9	8
			44	7	3972	4043	9	8
			45	7	4044	4114	9	8
			46	7	4115	4186	9	9
			47	7	4187	4257	9	9
			48	7	4258	4329	9	9
			49	7	4330	4400	9	9
			50	8	4401	4471	10	9
			51	8	4472	4543	10	9
			52	8	4544	4614	10	9
			53	8	4615	4686	10	10
			54	8	4687	4757	10	10
			55	8	4758	4829	10	10
			56	8	4830	4900	10	10
			57	9	4901	4971	11	10
			58	9	4972	5043	11	10
			59	9	5044	5114	11	10
			60	9	5115	5186	11	11
			61	9	5187	5257	11	11
			62	9	5258	5329	11	11
			63	9	5330	5400	11	11
			64	10	5401	5471	12	11
			65	10	5472	5543	12	11
			66	10	5544	5614	12	11
			67	10	5615	5686	12	12
			68	10	5687	5757	12	12
			69	10	5758	5829	12	12
			70	10	5830	5900	12	12
			71	11	5901	5971	13	12
			72	11	5972	6043	13	12
			73	11	6044	6114	13	12
			74	11	6115	6186	13	13
			75	11	6187	6257	13	13
			76	11	6258	6329	13	13
			77	11	6330	6400	13	13
			78	12	6401	6457	14	13
			79	12	6458	6514	14	13
			80	12	6515	6571	14	13
			81	12	6572	6629	14	14
			82	12	6630	6686	14	14
			83	12	6687	6743	14	14
			84	12	6744	6800	14	14
			85	13	6801	6843	15	14
			86	13	6844	6886	15	14
			87	13	6887	6929	15	14
			88	13	6930	6971	15	15
			89	13	6972	7014	15	15
			90	13	7015	7057	15	15
			91	13	7058	7100	15	15
			92	14	7101	7143	16	15
			93	14	7144	7186	16	15
			94	14	7187	7229	16	15
			95	14	7230	7271	16	16
			96	14	7272	7314	16	16
			97	14	7315	7357	16	16
			98	14	7358	7400	16	16
			99	15	7401	7443	17	16
			100 15	7444	7486	17	16
			101 15	7487	7529	17	16
			102 15	7530	7571	17	17
			103 15	7572	7614	17	17
			104 15	7615	7657	17	17
			105 15	7658	7700	17	17
			106 16	7701	7738	19	17
			107 16	7739	7775	19	18
			108 16	7776	7813	19	18
			109 16	7814	7850	19	18
			110 16	7851	7888	19	18
			111 16	7889	7925	19	19
			112 16	7926	7963	19	19
			113 16	7964	8000	19	19
			114 17	8001	8043	20	19
			115 17	8044	8086	20	19
			116 17	8087	8129	20	19
			117 17	8130	8171	20	20
			118 17	8172	8214	20	20
			119 17	8215	8257	20	20
			120 17	8258	8300	20	20
			121 18	8301	8343	21	20
			122 18	8344	8386	21	20
			123 18	8387	8429	21	20
			124 18	8430	8471	21	21
			125 18	8472	8514	21	21
			126 18	8515	8557	21	21
			127 18	8558	8600	21	21
			128 19	8601	8643	22	21
			129 19	8644	8686	22	21
			130 19	8687	8729	22	21
			131 19	8730	8771	22	22
			132 19	8772	8814	22	22
			133 19	8815	8857	22	22
			134 19	8858	8900	22	22
			135 20	8901	8943	24	22
			136 20	8944	8986	24	23
			137 20	8987	9029	24	23
			138 20	9030	9071	24	23
			139 20	9072	9114	24	23
			140 20	9115	9157	24	24
			141 20	9158	9200	24	24
			142 21	9201	9243	25	24
			143 21	9244	9286	25	24
			144 21	9287	9329	25	24
			145 21	9330	9371	25	25
			146 21	9372	9414	25	25
			147 21	9415	9457	25	25
			148 21	9458	9500	25	25
			149 22	9501	9538	27	25
			150 22	9539	9575	27	26
			151 22	9576	9613	27	26
			152 22	9614	9650	27	26
			153 22	9651	9688	27	26
			154 22	9689	9725	27	27
			155 22	9726	9763	27	27
			156 22	9764	9800	27	27
			157 23	9801	9838	29	27
			158 23	9839	9875	29	28
			159 23	9876	9913	29	28
			160 23	9914	9950	29	28
			161 23	9951	9988	29	28
			162 23	9989	10025	29	29
			163 23	10026	10063	29	29
			164 23	10064	10100	29	29
			165 24	10101	10138	30	29
			166 24	10139	10175	30	29
			167 24	10176	10213	30	29
			168 24	10214	10250	30	30
			169 24	10251	10288	30	30
			170 24	10289	10325	30	30
			171 24	10326	10363	30	30
			172 24	10364	10400	30	30
			173 25	10401	10438	32	30
			174 25	10439	10475	32	31
			175 25	10476	10513	32	31
			176 25	10514	10550	32	31
			177 25	10551	10588	32	31
			178 25	10589	10625	32	32
			179 25	10626	10663	32	32
			180 25	10664	10700	32	32
			181 26	10701	10738	34	32
			182 26	10739	10775	34	33
			183 26	10776	10813	34	33
			184 26	10814	10850	34	33
			185 26	10851	10888	34	33
			186 26	10889	10925	34	34
			187 26	10926	10963	34	34
			188 26	10964	11000	34	34
			189 27	11001	11033	37	34
			190 27	11034	11067	37	35
			191 27	11068	11100	37	35
			192 27	11101	11133	37	35
			193 27	11134	11167	37	36
			194 27	11168	11200	37	36
			195 27	11201	11233	37	36
			196 27	11234	11267	37	37
			197 27	11268	11300	37	37
			198 28	11301	11338	39	37
			199 28	11339	11375	39	38
			200 28	11376	11413	39	38
			201 28	11414	11450	39	38
			202 28	11451	11488	39	38
			203 28	11489	11525	39	39
			204 28	11526	11563	39	39
			205 28	11564	11600	39	39
			206 29	11601	11638	41	39
			207 29	11639	11675	41	40
			208 29	11676	11713	41	40
			209 29	11714	11750	41	40
			210 29	11751	11788	41	40
			211 29	11789	11825	41	41
			212 29	11826	11863	41	41
			213 29	11864	11900	41	41
			214 30	11901	11938	44	41
			215 30	11939	11975	44	42
			216 30	11976	12013	44	42
			217 30	12014	12050	44	43
			218 30	12051	12088	44	43
			219 30	12089	12125	44	43
			220 30	12126	12163	44	44
			221 30	12164	12200	44	44
			222 31	12201	12238	47	44
			223 31	12239	12275	47	45
			224 31	12276	12313	47	45
			225 31	12314	12350	47	46
			226 31	12351	12388	47	46
			227 31	12389	12425	47	46
			228 31	12426	12463	47	47
			229 31	12464	12500	47	47
			230 32	12501	12538	50	47
			231 32	12539	12575	50	48
			232 32	12576	12613	50	48
			233 32	12614	12650	50	49
			234 32	12651	12688	50	49
			235 32	12689	12725	50	49
			236 32	12726	12763	50	50
			237 32	12764	12800	50	50
			238 33	12801	12829	53	50
			239 33	12830	12857	53	51
			240 33	12858	12886	53	51
			241 33	12887	12914	53	52
			242 33	12915	12943	53	52
			243 33	12944	12971	53	53
			244 33	12972	13000	53	53
			245 34	13001	13029	56	53
			246 34	13030	13057	56	54
			247 34	13058	13086	56	54
			248 34	13087	13114	56	55
			249 34	13115	13143	56	55
			250 34	13144	13171	56	56
			251 34	13172	13200	56	56
			252 35	13201	13229	60	57
			253 35	13230	13257	60	57
			254 35	13258	13286	60	58
			255 35	13287	13314	60	58
			256 35	13315	13343	60	59
			257 35	13344	13371	60	59
			258 35	13372	13400	60	60
			259 36	13401	13429	64	61
			260 36	13430	13457	64	61
			261 36	13458	13486	64	62
			262 36	13487	13514	64	62
			263 36	13515	13543	64	63
			264 36	13544	13571	64	63
			265 36	13572	13600	64	64
			266 37	13601	13629	68	65
			267 37	13630	13657	68	65
			268 37	13658	13686	68	66
			269 37	13687	13714	68	66
			270 37	13715	13743	68	67
			271 37	13744	13771	68	67
			272 37	13772	13800	68	68
			273 38	13801	13829	72	69
			274 38	13830	13857	72	69
			275 38	13858	13886	72	70
			276 38	13887	13914	72	70
			277 38	13915	13943	72	71
			278 38	13944	13971	72	71
			279 38	13972	14000	72	72
			280 39	14001	14029	77	73
			281 39	14030	14057	77	73
			282 39	14058	14086	77	74
			283 39	14087	14114	77	75
			284 39	14115	14143	77	76
			285 39	14144	14171	77	76
			286 39	14172	14200	77	77
			287 40	14201	14229	82	78
			288 40	14230	14257	82	78
			289 40	14258	14286	82	79
			290 40	14287	14314	82	80
			291 40	14315	14343	82	81
			292 40	14344	14371	82	81
			293 40	14372	14400	82	82
			294 41	14401	14429	87	83
			295 41	14430	14457	87	83
			296 41	14458	14486	87	84
			297 41	14487	14514	87	85
			298 41	14515	14543	87	86
			299 41	14544	14571	87	86
			300 41	14572	14600	87	87
			301 42	14601	14629	93	88
			302 42	14630	14657	93	89
			303 42	14658	14686	93	90
			304 42	14687	14714	93	90
			305 42	14715	14743	93	91
			306 42	14744	14771	93	92
			307 42	14772	14800	93	93
			308 43	14801	14829	98	94
			309 43	14830	14857	98	94
			310 43	14858	14886	98	95
			311 43	14887	14914	98	96
			312 43	14915	14943	98	97
			313 43	14944	14971	98	97
			314 43	14972	15000	98	98
			315 44	15001	15029	105 99
			316 44	15030	15057	105 100
			317 44	15058	15086	105 101
			318 44	15087	15114	105 102
			319 44	15115	15143	105 103
			320 44	15144	15171	105 104
			321 44	15172	15200	105 105
			322 45	15201	15229	111 106
			323 45	15230	15257	111 107
			324 45	15258	15286	111 108
			325 45	15287	15314	111 108
			326 45	15315	15343	111 109
			327 45	15344	15371	111 110
			328 45	15372	15400	111 111
			329 46	15401	15429	119 112
			330 46	15430	15457	119 113
			331 46	15458	15486	119 114
			332 46	15487	15514	119 116
			333 46	15515	15543	119 117
			334 46	15544	15571	119 118
			335 46	15572	15600	119 119
			336 47	15601	15629	126 120
			337 47	15630	15657	126 121
			338 47	15658	15686	126 122
			339 47	15687	15714	126 123
			340 47	15715	15743	126 124
			341 47	15744	15771	126 125
			342 47	15772	15800	126 126
			343 48	15801	15829	134 127
			344 48	15830	15857	134 128
			345 48	15858	15886	134 129
			346 48	15887	15914	134 131
			347 48	15915	15943	134 132
			348 48	15944	15971	134 133
			349 48	15972	16000	134 134
			350 49	16001	16029	143 135
			351 49	16030	16057	143 137
			352 49	16058	16086	143 138
			353 49	16087	16114	143 139
			354 49	16115	16143	143 140
			355 49	16144	16171	143 142
			356 49	16172	16200	143 143
			357 50	16201	16229	152 144
			358 50	16230	16257	152 146
			359 50	16258	16286	152 147
			360 50	16287	16314	152 148
			361 50	16315	16343	152 149
			362 50	16344	16371	152 151
			363 50	16372	16400	152 152
			364 51	16401	16429	162 153
			365 51	16430	16457	162 155
			366 51	16458	16486	162 156
			367 51	16487	16514	162 158
			368 51	16515	16543	162 159
			369 51	16544	16571	162 161
			370 51	16572	16600	162 162
			371 52	16601	16629	172 163
			372 52	16630	16657	172 165
			373 52	16658	16686	172 166
			374 52	16687	16714	172 168
			375 52	16715	16743	172 169
			376 52	16744	16771	172 171
			377 52	16772	16800	172 172
			378 53	16801	16829	183 174
			379 53	16830	16857	183 175
			380 53	16858	16886	183 177
			381 53	16887	16914	183 178
			382 53	16915	16943	183 180
			383 53	16944	16971	183 181
			384 53	16972	17000	183 183
			385 54	17001	17057	195 185
			386 54	17058	17114	195 186
			387 54	17115	17171	195 188
			388 54	17172	17229	195 190
			389 54	17230	17286	195 192
			390 54	17287	17343	195 193
			391 54	17344	17400	195 195
			392 55	17401	17457	207 197
			393 55	17458	17514	207 198
			394 55	17515	17571	207 200
			395 55	17572	17629	207 202
			396 55	17630	17686	207 204
			397 55	17687	17743	207 205
			398 55	17744	17800	207 207
			399 56	17801	17857	220 209
			400 56	17858	17914	220 211
			401 56	17915	17971	220 213
			402 56	17972	18029	220 214
			403 56	18030	18086	220 216
			404 56	18087	18143	220 218
			405 56	18144	18200	220 220
			406 57	18201	18250	234 222
			407 57	18251	18300	234 224
			408 57	18301	18350	234 225
			409 57	18351	18400	234 227
			410 57	18401	18450	234 229
			411 57	18451	18500	234 231
			412 57	18501	18550	234 232
			413 57	18551	18600	234 234
			414 58	18601	18650	249 236
			415 58	18651	18700	249 238
			416 58	18701	18750	249 240
			417 58	18751	18800	249 242
			418 58	18801	18850	249 243
			419 58	18851	18900	249 245
			420 58	18901	18950	249 247
			421 58	18951	19000	249 249
			422 59	19001	19044	265 251
			423 59	19045	19089	265 253
			424 59	19090	19133	265 254
			425 59	19134	19178	265 256
			426 59	19179	19222	265 258
			427 59	19223	19267	265 260
			428 59	19268	19311	265 261
			429 59	19312	19356	265 263
			430 59	19357	19400	265 265
			431 60	19401	19444	282 267
			432 60	19445	19489	282 269
			433 60	19490	19533	282 271
			434 60	19534	19578	282 273
			435 60	19579	19622	282 274
			436 60	19623	19667	282 276
			437 60	19668	19711	282 278
			438 60	19712	19756	282 280
			439 60	19757	19800	282 282
			440 61	19801	19860	300 284
			441 61	19861	19920	300 286
			442 61	19921	19980	300 287
			443 61	19981	20040	300 289
			444 61	20041	20100	300 291
			445 61	20101	20160	300 293
			446 61	20161	20220	300 295
			447 61	20221	20280	300 296
			448 61	20281	20340	300 298
			449 61	20341	20400	300 300
			450 62	20401	20463	316 302
			451 62	20464	20525	316 304
			452 62	20526	20588	316 306
			453 62	20589	20650	316 308
			454 62	20651	20713	316 310
			455 62	20714	20775	316 312
			456 62	20776	20838	316 314
			457 62	20839	20900	316 316
			458 63	20901	20956	333 318
			459 63	20957	21011	333 320
			460 63	21012	21067	333 322
			461 63	21068	21122	333 324
			462 63	21123	21178	333 325
			463 63	21179	21233	333 327
			464 63	21234	21289	333 329
			465 63	21290	21344	333 331
			466 63	21345	21400	333 333
			467 64	21401	21456	350 335
			468 64	21457	21511	350 337
			469 64	21512	21567	350 339
			470 64	21568	21622	350 341
			471 64	21623	21678	350 342
			472 64	21679	21733	350 344
			473 64	21734	21789	350 346
			474 64	21790	21844	350 348
			475 64	21845	21900	350 350
			476 65	21901	22000	357 352
			477 65	22001	22100	357 354
			478 65	22101	22200	357 355
			479 65	22201	22300	357 357
			480 66	22301	22400	365 359
			481 66	22401	22500	365 361
			482 66	22501	22600	365 363
			483 66	22601	22700	365 365
			484 67	22701	22800	372 367
			485 67	22801	22900	372 370
			486 67	22901	23000	372 372
			487 68	23001	23100	380 374
			488 68	23101	23200	380 376
			489 68	23201	23300	380 378
			490 68	23301	23400	380 380
			491 69	23401	23500	387 382
			492 69	23501	23600	387 384
			493 69	23601	23700	387 385
			494 69	23701	23800	387 387
			495 70	23801	23900	395 389
			496 70	23901	24000	395 391
			497 70	24001	24100	395 393
			498 70	24101	24200	395 395
			499 71	24201	24300	403 397
			500 71	24301	24400	403 399
			501 71	24401	24500	403 401
			502 71	24501	24600	403 403
			503 72	24601	24700	412 405
			504 72	24701	24800	412 408
			505 72	24801	24900	412 410
			506 72	24901	25000	412 412
			507 73	25001	25100	420 414
			508 73	25101	25200	420 416
			509 73	25201	25300	420 418
			510 73	25301	25400	420 420
			511 73	25401	25500	420 420
		>;

		samsung,pac_hbm_candela_map_table_revA = <
			0	28200	29500	465		6
			1	29501	30900	488		7
			2	30901	32300	510		8
			3	32301	33600	533		9
			4	33601	35000	555		10
			5	35001	36400	578		11
			6	36401	36500	600		12
		>;
	};
};
