/* Copyright (c) 2013-2014, The Linux Foundation. All rights reserved.
 *
 * This program is free software; you can redistribute it and/or modify
 * it under the terms of the GNU General Public License version 2 and
 * only version 2 as published by the Free Software Foundation.
 *
 * This program is distributed in the hope that it will be useful,
 * but WITHOUT ANY WARRANTY; without even the implied warranty of
 * MERCHANTABILITY or FITNESS FOR A PARTICULAR PURPOSE.  See the
 * GNU General Public License for more details.
 */

/*---------------------------------------------------------------------------
 * This file is autogenerated file using gcdb parser. Please do not edit it.
 * Update input XML file to add a new entry or update variable in this file
 * VERSION = "1.0"
 *---------------------------------------------------------------------------*/
&mdss_mdp {
	ss_dsi_panel_S6E3FA3_AMS559NK01_FHD: ss_dsi_panel_S6E3FA3_AMS559NK01_FHD {
		qcom,mdss-dsi-panel-name = "ss_dsi_panel_S6E3FA3_AMS559NK01_FHD";
		label = "ss_dsi_panel_S6E3FA3_AMS559NK01_FHD";
		/*qcom,mdss-dsi-panel-controller = <&mdss_dsi0>;*/
		qcom,mdss-dsi-bpp = <24>;
/*		qcom,mdss-dsi-panel-destination = "display_1";*/
/*		qcom,cont-splash-enabled;*/
		qcom,mdss-dsi-panel-width = <1080>;
		qcom,mdss-dsi-panel-height = <1920>;
		qcom,mdss-dsi-t-clk-pre = <0x30>; /*48*/
		qcom,mdss-dsi-t-clk-post = <0x0D>; /*13*/
		qcom,mdss-dsi-panel-framerate = <60>;
		qcom,mdss-dsi-panel-clockrate = <850000000>; /*850.29M*/
		qcom,mdss-dsi-panel-timings = [e2 36 24 00 66 68 28 38 2a 03 04 00];

		qcom,mdss-dsi-h-pulse-width = <12>;
		qcom,mdss-dsi-h-back-porch = <36>;
		qcom,mdss-dsi-h-front-porch = <92>;
		qcom,mdss-dsi-h-sync-skew = <0>;
		qcom,mdss-dsi-v-pulse-width = <2>;
		qcom,mdss-dsi-v-back-porch = <7>;
		qcom,mdss-dsi-v-front-porch = <7>;

		qcom,mdss-dsi-h-left-border = <0>;
		qcom,mdss-dsi-h-right-border = <0>;
		qcom,mdss-dsi-v-top-border = <0>;
		qcom,mdss-dsi-v-bottom-border = <0>;
		qcom,mdss-dsi-underflow-color = <0xFF>;
		qcom,mdss-dsi-border-color = <0>;
		qcom,mdss-dsi-bl-pmic-control-type = "bl_ctrl_dcs";

		qcom,mdss-dsi-bl-min-level = <0>;
		qcom,mdss-dsi-bl-max-level = <365>;
		qcom,mdss-brightness-max-level = <365>;
		qcom,mdss-dsi-interleave-mode = <0>;
		qcom,mdss-dsi-panel-type = "dsi_cmd_mode";

		qcom,mdss-dsi-te-check-enable;
		qcom,mdss-dsi-te-using-te-pin;
		qcom,mdss-dsi-te-pin-select = <1>;

		qcom,mdss-dsi-te-dcs-command = <1>;
		qcom,mdss-dsi-wr-mem-start = <0x2C>;
		qcom,mdss-dsi-wr-mem-continue = <0x3C>;

		/* CMD mode panel doesn't need below stuff */
		qcom,mdss-dsi-h-sync-pulse= <0>;
		/*qcom,mdss-dsi-hfp-power-mode=*/
		/*qcom,mdss-dsi-hbp-power-mode=*/
		/*qcom,mdss-dsi-hsa-power-mode=*/
		/*qcom,mdss-dsi-last-line-interleave=*/
		qcom,mdss-dsi-bllp-eof-power-mode;
		qcom,mdss-dsi-bllp-power-mode;
		qcom,mdss-dsi-traffic-mode= "burst_mode";

		qcom,mdss-dsi-pixel-packing = "loose";

		qcom,mdss-dsi-virtual-channel-id = <0>;
		qcom,mdss-dsi-color-order = "rgb_swap_rgb";
		qcom,mdss-dsi-lane-0-state;
		qcom,mdss-dsi-lane-1-state;
		qcom,mdss-dsi-lane-2-state;
		qcom,mdss-dsi-lane-3-state;

		qcom,mdss-dsi-stream = <0>;
		qcom,mdss-dsi-mdp-trigger = "none";
		qcom,mdss-dsi-dma-trigger = "trigger_sw";

		qcom,mdss-dsi-off-command-state = "dsi_hs_mode";

		qcom,mdss-pan-physical-width-dimension = <75>;
		qcom,mdss-pan-physical-height-dimension = <132>;

		qcom,mdss-dsi-reset-sequence = <1 5>, <0 5>, <1 10>;

		/* S6E3FA3(LDI) Does not support Partial Update */
		/*qcom,partial-update-enabled;*/
		/*qcom,panel-roi-alignment=<8 8 1 1 1 1>;*/
		/*qcom,mdss-dsi-horizontal-line-idle*/

		qcom,mdss-dsi-lp11-init;
		qcom,mdss-dsi-init-delay-us = <1000>;

		qcom,mdss-dsi-rx-eot-ignore;
		qcom,mdss-dsi-tx-eot-append;
		qcom,ulps-enabled;

		/*qcom,mdss-dsi-panel-status-command=*/
		/*qcom,mdss-dsi-panel-status-command-mode="dsi_lp_mode";*/
		qcom,esd-check-enabled;
		qcom,mdss-dsi-panel-status-check-mode="reg_read_irq";
		/*qcom,mdss-dsi-panel-status-value = <1>;*/
		qcom,mdss-dsi-panel-status-irq-trigger1="rising";
		qcom,mdss-dsi-panel-status-irq-trigger2="falling";

		qcom,dynamic-mode-switch-enabled;
		qcom,dynamic-mode-switch-type = "dynamic-resolution-switch-immediate";
		/*qcom,dynamic-mode-switch-enabled*/
		/*qcom,video-to-cmd-mode-switch-commands=*/
		/*qcom,cmd-to-video-mode-switch-commands=*/

		qcom,mdss-dsi-off-command=[
			05 01 00 00 0A 00 02 28 00	/* wait 10ms(0x0A) */
			05 01 00 00 96 00 02 10 00	/* wait 150ms(0x96) */
		];
		qcom,adjust-timer-wakeup-ms = <1>;

/*
 * ************************************************************************************************************************************
 *
 *
 *			Below  parameters are samsung dependent thigs
 *
 *
 * ************************************************************************************************************************************
 */
		samsung,support_multires;

 		samsung,support_panel_max = <1>;
		samsung,hw-config = "single_dsi";
		samsung,panel-lpm-enable;

		samsung,display_on_tx_cmds_revA = [
			05 01 00 00 0A 00 02 29 00 /* wait 10ms */
			05 01 00 00 00 00 02 13 00];

		samsung,display_off_tx_cmds_revA = [05 01 00 00 14 00 02 28 00];

		samsung,level1_key_enable_tx_cmds_revA = [
			29 01 00 00 00 00 03 F0 5A 5A
		];
		samsung,level1_key_disable_tx_cmds_revA = [
			29 01 00 00 00 00 03 F0 A5 A5
		];
		samsung,level2_key_enable_tx_cmds_revA = [
			29 00 00 00 00 00 03 F0 5A 5A
			29 01 00 00 00 00 03 FC 5A 5A
		];
		samsung,level2_key_disable_tx_cmds_revA = [
			29 00 00 00 00 00 03 F0 A5 A5
			29 01 00 00 00 00 03 FC A5 A5
		];

		samsung,packet_size_tx_cmds_revA = [
			37 01 00 00 00 00 02 07 00
		];

		/*
		 * First parameters can be changed
		 * by function of samsung_nv_read()
		 * because of that means offset of
		 * read position
		 */
		samsung,reg_read_pos_tx_cmds_revA = [
			15 01 00 00 00 00 02 B0 00
		];

		/*
		 * ************************************************************************************************************************
		 *	 06 01 00 00 00 00 01 c8 07 21
		 *	READ 0xC8 SIZE 0x07 OFFSET 0x21
		 * ************************************************************************************************************************
		 */
		samsung,smart_dimming_mtp_rx_cmds_revA = [ 06 01 00 00 00 00 01 c8 23 00];
		/* the last byte in all read commands will represent READ LENGH */
		samsung,manufacture_id0_rx_cmds_revA = [ 06 01 00 00 00 00 01 da 01 00];
		samsung,manufacture_id1_rx_cmds_revA = [ 06 01 00 00 00 00 01 db 01 00];
		samsung,manufacture_id2_rx_cmds_revA = [ 06 01 00 00 00 00 01 dc 01 00];

		samsung,manufacture_date_rx_cmds_revA = [ 06 01 00 00 00 00 01 c8 04 28];	/* read C8 41~44th , 40=0x28*/
		samsung,ddi_id_rx_cmds_revA = [ 06 01 00 00 00 00 01 d6 05 00];	/* read D6 1~5th */
		samsung,cell_id_rx_cmds_revA = [ 06 01 00 00 00 00 01 C8 07 28]; /* read C8 41th~47th */
		samsung,octa_id_rx_cmds_revA = [06 01 00 00 00 00 01 C9 14 01];  // read C9 2th~21th
		samsung,mtp_read_sysfs_rx_cmds_revA = [ 06 01 00 00 00 00 01 01 01 01];

		samsung,mdnie_read_rx_cmds_revA	= [ 06 01 00 00 00 00 01 A1 04 00];

		samsung,ldi_debug0_rx_cmds_revA 	= [06 01 00 00 00 00 01 0A 01 00];
		samsung,ldi_debug1_rx_cmds_revA 	= [06 01 00 00 00 00 01 ED 01 00];
		samsung,ldi_debug2_rx_cmds_revA 	= [06 01 00 00 00 00 01 EE 01 00];
		samsung,ldi_debug3_rx_cmds_revA 	= [06 01 00 00 00 00 01 0E 01 00];
		samsung,ldi_debug4_rx_cmds_revA 	= [06 01 00 00 00 00 01 05 01 00];
		samsung,ldi_debug5_rx_cmds_revA 	= [06 01 00 00 00 00 01 0F 01 00];

		/*
		 * ************************************************************************************************************************
		 *	 COMMON CMD LIST
		 * ************************************************************************************************************************
		 */

		samsung,gamma_tx_cmds_revA = [
			29 01 00 00 00 00 24 CA				/* 1) Gamma 2.2 Setting */
				01 00 01 00 01 00	/* V255 R,G,B */
				80 80 80			/* V203 R,G,B */
				80 80 80			/* V151 R,G,B */
				80 80 80			/* V87 R,G,B */
				80 80 80			/* V51 R,G,B */
				80 80 80			/* V35 R,G,B */
				80 80 80			/* V23 R,G,B */
				80 80 80			/* V11 R,G,B */
				80 80 80			/*  V3 R,G,B */
				00 00 00			/*  V0 R,G,B */
				00 00				/*  VT R,G,B */
			29 01 00 00 00 00 02 F7 03	/* Gamma, LTPS(AID) update */

			29 01 00 00 00 00 3C		/* dummy for single transmission more 100ns delay */
			00 00 00 00 00 00 00 00 00 00
			00 00 00 00 00 00 00 00 00 00
			00 00 00 00 00 00 00 00 00 00
			00 00 00 00 00 00 00 00 00 00
			00 00 00 00 00 00 00 00 00 00
			00 00 00 00 00 00 00 00 00 00
		];

		/*
		* ************************************************************************************************************************
		*  HBM
		* ************************************************************************************************************************
		*/

		samsung,enter_hbm_lux = <10000>;

		samsung,hbm_rx_cmds_revA = [ 06 01 00 00 00 00 01 B4 21 00];	/* read B4 1th~33th */

		samsung,hbm_gamma_tx_cmds_revA = [
			29 01 00 00 00 00 24 CA		/* 1) Gamma 2.2 Setting */
				01 00 01 00 01 00	/* V255 R,G,B */
				80 80 80			/* V203 R,G,B */
				80 80 80			/* V151 R,G,B */
				80 80 80			/* V87 R,G,B */
				80 80 80			/* V51 R,G,B */
				80 80 80			/* V35 R,G,B */
				80 80 80			/* V23 R,G,B */
				80 80 80			/* V11 R,G,B */
				80 80 80			/*  V3 R,G,B */
				00 00 00			/*  V0 R,G,B */
				00 00				/*  VT R,G,B */
		];

		samsung,hbm_etc_tx_cmds_revA = [
			29 01 00 00 00 00 03 B2 00 10		/* AID set : AOR 0% */
			29 01 00 00 00 00 18 B6 BC 0A 00 00 00 00 00 03 55 54
						20 00 00 09 99 9F 7F 01 12 10
						00 0C 02 						/* MPS/ELVSS */
			29 01 00 00 00 00 02 B8 00			/* TEST */
			29 01 00 00 00 00 05 B5 50 99 14 0A  	/* 1th : 0x50 32frame avg, 2th : 0x7F start point 50%, 4th: 0x0A ACL 8% */
			29 01 00 00 00 00 02 55 02				/* ACL ON */
			29 01 00 00 00 00 02 F7 03			/* Gamma, LTPS(AID) update */
		];


		samsung,hbm_off_tx_cmds_revA = [
			29 01 00 00 00 00 18 B6 BC 0A 00 00 00 00 00 03 55 54
						20 00 00 09 99 9F 7F 01 12 10
						00 0C 02 						/* MPS/ELVSS :to make recover b6 22 para*/
		];

		/*
		 * ************************************************************************************************************************
		 * AID command list and mappings
		 * ************************************************************************************************************************
		 */
		/* bl_level, Index in acl command list */
		samsung,aid_tx_cmds_revA = [
			/*	0	*/29 01 00 00 00 00 03 B2 70 73	/*   2CD */
			/*	1	*/29 01 00 00 00 00 03 B2 70 65 /*   3CD */
			/*	2	*/29 01 00 00 00 00 03 B2 70 55 /*   4CD */
			/*	3	*/29 01 00 00 00 00 03 B2 70 46 /*   5CD */
			/*	4	*/29 01 00 00 00 00 03 B2 70 37 /*   6CD */
			/*	5	*/29 01 00 00 00 00 03 B2 70 27 /*   7CD */
			/*	6	*/29 01 00 00 00 00 03 B2 70 17 /*   8CD */
			/*	7	*/29 01 00 00 00 00 03 B2 70 07 /*   9CD */
			/*	8	*/29 01 00 00 00 00 03 B2 60 F7 /*  10CD */
			/*	9	*/29 01 00 00 00 00 03 B2 60 E7 /*  11CD */
			/*	10	*/29 01 00 00 00 00 03 B2 60 D7 /*  12CD */
			/*	11	*/29 01 00 00 00 00 03 B2 60 D1 /*  13CD */
			/*	12	*/29 01 00 00 00 00 03 B2 60 B7 /*  14CD */
			/*	13	*/29 01 00 00 00 00 03 B2 60 B1 /*  15CD */
			/*	14	*/29 01 00 00 00 00 03 B2 60 A1 /*  16CD */
			/*	15	*/29 01 00 00 00 00 03 B2 60 91 /*  17CD */
			/*	16	*/29 01 00 00 00 00 03 B2 60 71 /*  19CD */
			/*	17	*/29 01 00 00 00 00 03 B2 60 61 /*  20CD */
			/*	18	*/29 01 00 00 00 00 03 B2 60 51 /*  21CD */
			/*	19	*/29 01 00 00 00 00 03 B2 60 42 /*  22CD */
			/*	20	*/29 01 00 00 00 00 03 B2 60 22 /*  24CD */
			/*	21	*/29 01 00 00 00 00 03 B2 60 12 /*  25CD */
			/*	22	*/29 01 00 00 00 00 03 B2 50 F3 /*  27CD */
			/*	23	*/29 01 00 00 00 00 03 B2 50 D3 /*  29CD */
			/*	24	*/29 01 00 00 00 00 03 B2 50 C3 /*  30CD */
			/*	25	*/29 01 00 00 00 00 03 B2 50 A3 /*  32CD */
			/*	26	*/29 01 00 00 00 00 03 B2 50 83 /*  34CD */
			/*	27	*/29 01 00 00 00 00 03 B2 50 53 /*  37CD */
			/*	28	*/29 01 00 00 00 00 03 B2 50 33 /*  39CD */
			/*	29	*/29 01 00 00 00 00 03 B2 50 13 /*  41CD */
			/*	30	*/29 01 00 00 00 00 03 B2 40 E2 /*  44CD */
			/*	31	*/29 01 00 00 00 00 03 B2 40 B2 /*  47CD */
			/*	32	*/29 01 00 00 00 00 03 B2 40 82 /*  50CD */
			/*	33	*/29 01 00 00 00 00 03 B2 40 51 /*  53CD */
			/*	34	*/29 01 00 00 00 00 03 B2 40 17 /*  56CD */
			/*	35	*/29 01 00 00 00 00 03 B2 30 E0 /*  60CD */
			/*	36	*/29 01 00 00 00 00 03 B2 30 95 /*  64CD */
			/*	37	*/29 01 00 00 00 00 03 B2 30 52 /*  68CD */
			/*	38	*/29 01 00 00 00 00 03 B2 30 11 /*  77CD */
			/*	39	*/29 01 00 00 00 00 03 B2 20 C4 /*  77 ~ 183CD*/
			/*	40	*/29 01 00 00 00 00 03 B2 20 67 /* 195CD */
			/*	41	*/29 01 00 00 00 00 03 B2 20 05 /* 207CD */
			/*	42	*/29 01 00 00 00 00 03 B2 10 97 /* 220CD */
			/*	43	*/29 01 00 00 00 00 03 B2 10 25 /* 234CD */
			/*	44	*/29 01 00 00 00 00 03 B2 00 C1 /* 249~365CD */
			/*	45	*/29 01 00 00 00 00 03 B2 00 AF /* 372 CD */
			/*	46	*/29 01 00 00 00 00 03 B2 00 79 /* 380 CD */
			/*	47	*/29 01 00 00 00 00 03 B2 00 6D /* 387 CD */
			/*	48	*/29 01 00 00 00 00 03 B2 00 43 /* 395 CD */
			/*	49	*/29 01 00 00 00 00 03 B2 00 33 /* 403 CD */
			/*	50	*/29 01 00 00 00 00 03 B2 00 21 /* 412 CD */
			/*	51	*/29 01 00 00 00 00 03 B2 00 10 /* 420 CD */
		];


		/* bl_level, Index in acl command list */
		samsung,aid_map_table_revA = <
			2	0		3	1		4	2		5	3		6	4
			7	5		8	6		9	7		10	8		11	9
			12	10		13	11		14	12		15	13		16	14
			17	15		19	16		20	17		21	18		22	19
			24	20		25	21		27	22		29	23		30	24
			32	25		34	26		37	27		39	28		41	29
			44	30		47	31		50	32		53	33		56	34
			60	35		64	36		68	37		72	38		77	39
			82	39		87	39		93	39		98	39		105	39
			111	39		119	39		126	39		134	39		143	39
			152	39		162	39		172	39		183	39		195	40
			207	41		220	42		234	43		249	44		265	44
			282	44		300	44		316	44		333	44		350	44
			357	44		365	44		372	45		380	46		387	47
			395	48		403	49		412	50		420	51
		>;

		samsung,aid_subdivision_tx_cmds_revA = [
			29 01 00 00 00 00 03 B2 70 80
			29 01 00 00 00 00 03 B2 70 7F
			29 01 00 00 00 00 03 B2 70 7D
			29 01 00 00 00 00 03 B2 70 76
			29 01 00 00 00 00 03 B2 70 73
			29 01 00 00 00 00 03 B2 70 71
			29 01 00 00 00 00 03 B2 70 6F
			29 01 00 00 00 00 03 B2 70 6D
			29 01 00 00 00 00 03 B2 70 63
			29 01 00 00 00 00 03 B2 70 61
			29 01 00 00 00 00 03 B2 70 5F
			29 01 00 00 00 00 03 B2 70 5E
			29 01 00 00 00 00 03 B2 70 5D
			29 01 00 00 00 00 03 B2 70 58
			29 01 00 00 00 00 03 B2 70 53
			29 01 00 00 00 00 03 B2 70 4F
			29 01 00 00 00 00 03 B2 70 4D
			29 01 00 00 00 00 03 B2 70 43
			29 01 00 00 00 00 03 B2 70 41
			29 01 00 00 00 00 03 B2 70 3F
			29 01 00 00 00 00 03 B2 70 3E
			29 01 00 00 00 00 03 B2 70 33
			29 01 00 00 00 00 03 B2 70 31
			29 01 00 00 00 00 03 B2 70 2F
			29 01 00 00 00 00 03 B2 70 2E
			29 01 00 00 00 00 03 B2 70 23
			29 01 00 00 00 00 03 B2 70 21
			29 01 00 00 00 00 03 B2 70 1F
			29 01 00 00 00 00 03 B2 70 1E
			29 01 00 00 00 00 03 B2 70 13
			29 01 00 00 00 00 03 B2 70 11
			29 01 00 00 00 00 03 B2 70 0F
			29 01 00 00 00 00 03 B2 70 0E
			29 01 00 00 00 00 03 B2 70 0D
			29 01 00 00 00 00 03 B2 70 03
			29 01 00 00 00 00 03 B2 70 01
			29 01 00 00 00 00 03 B2 60 FF
			29 01 00 00 00 00 03 B2 60 FD
			29 01 00 00 00 00 03 B2 60 F3
			29 01 00 00 00 00 03 B2 60 F1
			29 01 00 00 00 00 03 B2 60 EF
			29 01 00 00 00 00 03 B2 60 ED
			29 01 00 00 00 00 03 B2 60 E1
			29 01 00 00 00 00 03 B2 60 DE
			29 01 00 00 00 00 03 B2 60 DD
			29 01 00 00 00 00 03 B2 60 CF
			29 01 00 00 00 00 03 B2 60 CD
			29 01 00 00 00 00 03 B2 60 C0
			29 01 00 00 00 00 03 B2 60 B3
			29 01 00 00 00 00 03 B2 60 AB
			29 01 00 00 00 00 03 B2 60 A3
			29 01 00 00 00 00 03 B2 60 9B
			29 01 00 00 00 00 03 B2 60 94
			29 01 00 00 00 00 03 B2 60 85
			29 01 00 00 00 00 03 B2 60 76
			29 01 00 00 00 00 03 B2 60 6B
			29 01 00 00 00 00 03 B2 60 61
			29 01 00 00 00 00 03 B2 60 5C
			29 01 00 00 00 00 03 B2 60 58
			29 01 00 00 00 00 03 B2 60 50
			29 01 00 00 00 00 03 B2 60 48
			29 01 00 00 00 00 03 B2 60 39
			29 01 00 00 00 00 03 B2 60 2A
			29 01 00 00 00 00 03 B2 60 20
			29 01 00 00 00 00 03 B2 60 17
			29 01 00 00 00 00 03 B2 60 06
			29 01 00 00 00 00 03 B2 50 F4
			29 01 00 00 00 00 03 B2 50 E8
			29 01 00 00 00 00 03 B2 50 DD
			29 01 00 00 00 00 03 B2 50 D0
			29 01 00 00 00 00 03 B2 50 C3
			29 01 00 00 00 00 03 B2 50 B5
			29 01 00 00 00 00 03 B2 50 A6
			29 01 00 00 00 00 03 B2 50 94
			29 01 00 00 00 00 03 B2 50 83
			29 01 00 00 00 00 03 B2 50 6B
			29 01 00 00 00 00 03 B2 50 53
			29 01 00 00 00 00 03 B2 50 43
			29 01 00 00 00 00 03 B2 50 33
			29 01 00 00 00 00 03 B2 50 23
			29 01 00 00 00 00 03 B2 50 13
			29 01 00 00 00 00 03 B2 40 FA
			29 01 00 00 00 00 03 B2 40 E2
			29 01 00 00 00 00 03 B2 40 CA
			29 01 00 00 00 00 03 B2 40 B2
			29 01 00 00 00 00 03 B2 40 99
			29 01 00 00 00 00 03 B2 40 81
			29 01 00 00 00 00 03 B2 40 68
			29 01 00 00 00 00 03 B2 40 4E
			29 01 00 00 00 00 03 B2 40 34
			29 01 00 00 00 00 03 B2 40 1A
			29 01 00 00 00 00 03 B2 30 FA
			29 01 00 00 00 00 03 B2 30 DA
			29 01 00 00 00 00 03 B2 30 B8
			29 01 00 00 00 00 03 B2 30 95
			29 01 00 00 00 00 03 B2 30 72
			29 01 00 00 00 00 03 B2 30 4F
			29 01 00 00 00 00 03 B2 30 29
			29 01 00 00 00 00 03 B2 30 02
			29 01 00 00 00 00 03 B2 20 FD
			29 01 00 00 00 00 03 B2 20 D5
			29 01 00 00 00 00 03 B2 20 FA
			29 01 00 00 00 00 03 B2 20 D5
			29 01 00 00 00 00 03 B2 20 F8
			29 01 00 00 00 00 03 B2 20 D5
			29 01 00 00 00 00 03 B2 20 FC
			29 01 00 00 00 00 03 B2 20 D5
			29 01 00 00 00 00 03 B2 20 F4
			29 01 00 00 00 00 03 B2 20 D5
			29 01 00 00 00 00 03 B2 20 FE
			29 01 00 00 00 00 03 B2 20 D5
			29 01 00 00 00 00 03 B2 20 F6
			29 01 00 00 00 00 03 B2 20 D5
			29 01 00 00 00 00 03 B2 20 FE
			29 01 00 00 00 00 03 B2 20 D5
			29 01 00 00 00 00 03 B2 20 F7
			29 01 00 00 00 00 03 B2 20 D5
			29 01 00 00 00 00 03 B2 20 F9
			29 01 00 00 00 00 03 B2 20 D5
			29 01 00 00 00 00 03 B2 20 FB
			29 01 00 00 00 00 03 B2 20 D5
			29 01 00 00 00 00 03 B2 20 F9
			29 01 00 00 00 00 03 B2 20 D5
			29 01 00 00 00 00 03 B2 20 FB
			29 01 00 00 00 00 03 B2 20 D5
			29 01 00 00 00 00 03 B2 20 F8
			29 01 00 00 00 00 03 B2 20 D5
			29 01 00 00 00 00 03 B2 20 FA
			29 01 00 00 00 00 03 B2 20 D5
			29 01 00 00 00 00 03 B2 20 C5
			29 01 00 00 00 00 03 B2 20 B6
			29 01 00 00 00 00 03 B2 20 A6
			29 01 00 00 00 00 03 B2 20 96
			29 01 00 00 00 00 03 B2 20 86
			29 01 00 00 00 00 03 B2 20 77
			29 01 00 00 00 00 03 B2 20 67
			29 01 00 00 00 00 03 B2 20 59
			29 01 00 00 00 00 03 B2 20 4B
			29 01 00 00 00 00 03 B2 20 3D
			29 01 00 00 00 00 03 B2 20 2F
			29 01 00 00 00 00 03 B2 20 21
			29 01 00 00 00 00 03 B2 20 13
			29 01 00 00 00 00 03 B2 20 05
			29 01 00 00 00 00 03 B2 10 F7
			29 01 00 00 00 00 03 B2 10 E8
			29 01 00 00 00 00 03 B2 10 DA
			29 01 00 00 00 00 03 B2 10 CC
			29 01 00 00 00 00 03 B2 10 BE
			29 01 00 00 00 00 03 B2 10 AF
			29 01 00 00 00 00 03 B2 10 A1
			29 01 00 00 00 00 03 B2 10 91
			29 01 00 00 00 00 03 B2 10 82
			29 01 00 00 00 00 03 B2 10 73
			29 01 00 00 00 00 03 B2 10 63
			29 01 00 00 00 00 03 B2 10 53
			29 01 00 00 00 00 03 B2 10 44
			29 01 00 00 00 00 03 B2 10 35
			29 01 00 00 00 00 03 B2 10 25
			29 01 00 00 00 00 03 B2 10 48
			29 01 00 00 00 00 03 B2 10 3B
			29 01 00 00 00 00 03 B2 10 2E
			29 01 00 00 00 00 03 B2 10 21
			29 01 00 00 00 00 03 B2 10 15
			29 01 00 00 00 00 03 B2 10 08
			29 01 00 00 00 00 03 B2 00 FB
			29 01 00 00 00 00 03 B2 00 EE
			29 01 00 00 00 00 03 B2 10 4A
			29 01 00 00 00 00 03 B2 10 3E
			29 01 00 00 00 00 03 B2 10 33
			29 01 00 00 00 00 03 B2 10 27
			29 01 00 00 00 00 03 B2 10 1C
			29 01 00 00 00 00 03 B2 10 10
			29 01 00 00 00 00 03 B2 10 05
			29 01 00 00 00 00 03 B2 00 F9
			29 01 00 00 00 00 03 B2 00 EE
			29 01 00 00 00 00 03 B2 10 49
			29 01 00 00 00 00 03 B2 10 3E
			29 01 00 00 00 00 03 B2 10 33
			29 01 00 00 00 00 03 B2 10 27
			29 01 00 00 00 00 03 B2 10 1C
			29 01 00 00 00 00 03 B2 10 10
			29 01 00 00 00 00 03 B2 10 05
			29 01 00 00 00 00 03 B2 00 F9
			29 01 00 00 00 00 03 B2 00 EE
			29 01 00 00 00 00 03 B2 10 4A
			29 01 00 00 00 00 03 B2 10 40
			29 01 00 00 00 00 03 B2 10 36
			29 01 00 00 00 00 03 B2 10 2B
			29 01 00 00 00 00 03 B2 10 21
			29 01 00 00 00 00 03 B2 10 17
			29 01 00 00 00 00 03 B2 10 0D
			29 01 00 00 00 00 03 B2 10 02
			29 01 00 00 00 00 03 B2 00 F8
			29 01 00 00 00 00 03 B2 00 EE
			29 01 00 00 00 00 03 B2 10 3A
			29 01 00 00 00 00 03 B2 10 2F
			29 01 00 00 00 00 03 B2 10 24
			29 01 00 00 00 00 03 B2 10 19
			29 01 00 00 00 00 03 B2 10 0E
			29 01 00 00 00 00 03 B2 10 04
			29 01 00 00 00 00 03 B2 00 F9
			29 01 00 00 00 00 03 B2 00 EE
			29 01 00 00 00 00 03 B2 10 3B
			29 01 00 00 00 00 03 B2 10 32
			29 01 00 00 00 00 03 B2 10 28
			29 01 00 00 00 00 03 B2 10 1E
			29 01 00 00 00 00 03 B2 10 15
			29 01 00 00 00 00 03 B2 10 0B
			29 01 00 00 00 00 03 B2 10 01
			29 01 00 00 00 00 03 B2 00 F8
			29 01 00 00 00 00 03 B2 00 EE
			29 01 00 00 00 00 03 B2 10 38
			29 01 00 00 00 00 03 B2 10 2E
			29 01 00 00 00 00 03 B2 10 25
			29 01 00 00 00 00 03 B2 10 1C
			29 01 00 00 00 00 03 B2 10 13
			29 01 00 00 00 00 03 B2 10 0A
			29 01 00 00 00 00 03 B2 10 00
			29 01 00 00 00 00 03 B2 00 F7
			29 01 00 00 00 00 03 B2 00 EE
			29 01 00 00 00 00 03 B2 10 07
			29 01 00 00 00 00 03 B2 00 FF
			29 01 00 00 00 00 03 B2 00 F6
			29 01 00 00 00 00 03 B2 00 EE
			29 01 00 00 00 00 03 B2 10 0A
			29 01 00 00 00 00 03 B2 10 01
			29 01 00 00 00 00 03 B2 00 F7
			29 01 00 00 00 00 03 B2 00 EE
			29 01 00 00 00 00 03 B2 00 DF
			29 01 00 00 00 00 03 B2 00 D1
			29 01 00 00 00 00 03 B2 00 C2
			29 01 00 00 00 00 03 B2 00 B2
			29 01 00 00 00 00 03 B2 00 A3
			29 01 00 00 00 00 03 B2 00 94
			29 01 00 00 00 00 03 B2 00 84
			29 01 00 00 00 00 03 B2 00 7E
			29 01 00 00 00 00 03 B2 00 79
			29 01 00 00 00 00 03 B2 00 73
			29 01 00 00 00 00 03 B2 00 6D
			29 01 00 00 00 00 03 B2 00 61
			29 01 00 00 00 00 03 B2 00 55
			29 01 00 00 00 00 03 B2 00 49
			29 01 00 00 00 00 03 B2 00 3D
			29 01 00 00 00 00 03 B2 00 31
			29 01 00 00 00 00 03 B2 00 27
			29 01 00 00 00 00 03 B2 00 1E
			29 01 00 00 00 00 03 B2 00 14
			29 01 00 00 00 00 03 B2 00 34
			29 01 00 00 00 00 03 B2 00 29
			29 01 00 00 00 00 03 B2 00 1F
			29 01 00 00 00 00 03 B2 00 14
			29 01 00 00 00 00 03 B2 00 2F
			29 01 00 00 00 00 03 B2 00 26
			29 01 00 00 00 00 03 B2 00 1D
			29 01 00 00 00 00 03 B2 00 14
			29 01 00 00 00 00 03 B2 00 14
		];

		/*
		 * ************************************************************************************************************************
		 * ACL command list and mappings
		 * ************************************************************************************************************************
		 */

		samsung,acl_on_tx_cmds_revA = [
			29 01 00 00 00 00 05 B5 50 7F 14 14  /* 1th : 0x50 32frame avg, 2th : 0x7F start point 50%, 4th: 0x12 ACL 15% */
			29 01 00 00 00 00 02 55 02	/* ACL ON */
		];

		samsung,acl_percent_tx_cmds_revA = [
			29 01 00 00 00 00 05 B5 50 7F 14 0A  /* 1th : 0x50 32frame avg, 2th : 0x7F start point 50%, 4th: 0x0A ACL 8% */
			29 01 00 00 00 00 05 B5 50 7F 14 14  /* 1th : 0x50 32frame avg, 2th : 0x7F start point 50%, 4th: 0x14 ACL 15% */
		];

		samsung,acl_off_tx_cmds_revA = [
			29 01 00 00 00 00 05 B5 40 7F 14 00  /* 1th : 0x50 32frame avg, 2th : 0x7F start point 50%, 4th: don't care */
			29 01 00 00 00 00 02 55 00	 /* ACL OFF */
		];

		/* bl_level , Index in acl command list */
		samsung,acl_map_table_revA =  <
			2	1		3	1		4	1		5	1		6	1
			7	1		8	1		9	1		10	1		11	1
			12	1		13	1		14	1		15	1		16	1
			17	1		19	1		20	1		21	1		22	1
			24	1		25	1		27	1		29	1		30	1
			32	1		34	1		37	1		39	1		41	1
			44	1		47	1		50	1		53	1		56	1
			60	1		64	1		68	1		72	1		77	1
			82	1		87	1		93	1		98	1		105	1
			111	1		119	1		126	1		134	1		143	1
			152	1		162	1		172	1		183	1		195	1
			207	1		220	1		234	1		249	1		265	1
			282	1		300	1		316	1		333	1		350	1
			357	1		365	1		372	1		380	1		387	1
			395	1		403	1		412	1		420	1
		>;

		/*
		* ************************************************************************************************************************
		* ELVSS command list and mappings
		* ************************************************************************************************************************
		*/

		samsung,elvss_rx_cmds_revA = [ 06 01 00 00 00 00 01 b6 02 15];	/* read B6 22th~23 , 21=0x15*/

		samsung,elvss_lowtemp_tx_cmds_revA = [
			29 01 00 00 00 00 02 B8 19 /* TEST */
		];	/* Low Temperature Command: default */

		samsung,elvss_high_tx_cmds_revA = [
			29 01 00 00 00 00 03 B6 BC 0A /* 0  420CD ~ 412CD */
			29 01 00 00 00 00 03 B6 BC 0B /* 1  403CD ~ 365CD */
			29 01 00 00 00 00 03 B6 BC 0C /* 2  357CD ~ 350CD */
			29 01 00 00 00 00 03 B6 BC 0D /* 3  333CD */
			29 01 00 00 00 00 03 B6 BC 0E /* 4  316CD ~ 300CD */
			29 01 00 00 00 00 03 B6 BC 0F /* 5  282CD */
			29 01 00 00 00 00 03 B6 BC 10 /* 6  265CD */
			29 01 00 00 00 00 03 B6 BC 11 /* 7  249CD ~ 183CD */
			29 01 00 00 00 00 03 B6 BC 13 /* 8  172CD ~ 162CD */
			29 01 00 00 00 00 03 B6 BC 14 /* 9  152CD ~ 143CD */
			29 01 00 00 00 00 03 B6 BC 15 /* 10 134CD ~ 126CD */
			29 01 00 00 00 00 03 B6 BC 16 /* 11 119CD ~ 111CD */
			29 01 00 00 00 00 03 B6 BC 17 /* 12 105CD ~ 93CD */
			29 01 00 00 00 00 03 B6 BC 18 /* 13 87CD ~ 41CD */
			29 01 00 00 00 00 03 B6 AC 18 /* 14 39CD ~ 15CD */
			29 01 00 00 00 00 03 B6 AC 16 /* 15 14CD */
			29 01 00 00 00 00 03 B6 AC 14 /* 16 13CD */
			29 01 00 00 00 00 03 B6 AC 12 /* 17 12CD */
			29 01 00 00 00 00 03 B6 AC 11 /* 18 11CD */
			29 01 00 00 00 00 03 B6 AC 10 /* 19 10CD */
			29 01 00 00 00 00 03 B6 AC 0F /* 20 9CD */
			29 01 00 00 00 00 03 B6 AC 0E /* 21 8CD */
			29 01 00 00 00 00 03 B6 AC 0D /* 22 7CD */
			29 01 00 00 00 00 03 B6 AC 0C /* 23 6CD */
			29 01 00 00 00 00 03 B6 AC 0B /* 24 5D */
			29 01 00 00 00 00 03 B6 AC 0B /* 25 4D */
			29 01 00 00 00 00 03 B6 AC 0B /* 26 3D */
			29 01 00 00 00 00 03 B6 AC 0B /* 27 2D */
		];

		samsung,elvss_mid_tx_cmds_revA = [
			29 01 00 00 00 00 03 B6 BC 0A /* 0  420CD ~ 412CD */
			29 01 00 00 00 00 03 B6 BC 0B /* 1  403CD ~ 365CD */
			29 01 00 00 00 00 03 B6 BC 0C /* 2  357CD ~ 350CD */
			29 01 00 00 00 00 03 B6 BC 0D /* 3  333CD */
			29 01 00 00 00 00 03 B6 BC 0E /* 4  316CD ~ 300CD */
			29 01 00 00 00 00 03 B6 BC 0F /* 5  282CD */
			29 01 00 00 00 00 03 B6 BC 10 /* 6  265CD */
			29 01 00 00 00 00 03 B6 BC 11 /* 7  249CD ~ 183CD */
			29 01 00 00 00 00 03 B6 BC 13 /* 8  172CD ~ 162CD */
			29 01 00 00 00 00 03 B6 BC 14 /* 9  152CD ~ 143CD */
			29 01 00 00 00 00 03 B6 BC 15 /* 10 134CD ~ 126CD */
			29 01 00 00 00 00 03 B6 BC 16 /* 11 119CD ~ 111CD */
			29 01 00 00 00 00 03 B6 BC 17 /* 12 105CD ~ 93CD */
			29 01 00 00 00 00 03 B6 BC 18 /* 13 87CD ~ 41CD */
			29 01 00 00 00 00 03 B6 AC 18 /* 14 39CD ~ 15CD */
			29 01 00 00 00 00 03 B6 AC 17 /* 15 14CD */
			29 01 00 00 00 00 03 B6 AC 17 /* 16 13CD */
			29 01 00 00 00 00 03 B6 AC 17 /* 17 12CD */
			29 01 00 00 00 00 03 B6 AC 16 /* 18 11CD */
			29 01 00 00 00 00 03 B6 AC 16 /* 19 10CD */
			29 01 00 00 00 00 03 B6 AC 16 /* 20 9CD */
			29 01 00 00 00 00 03 B6 AC 15 /* 21 8CD */
			29 01 00 00 00 00 03 B6 AC 15 /* 22 7CD */
			29 01 00 00 00 00 03 B6 AC 15 /* 23 6CD */
			29 01 00 00 00 00 03 B6 AC 14 /* 24 5D */
			29 01 00 00 00 00 03 B6 AC 14 /* 25 4D */
			29 01 00 00 00 00 03 B6 AC 14 /* 26 3D */
			29 01 00 00 00 00 03 B6 AC 14 /* 27 2D */
		];

		samsung,elvss_low_tx_cmds_revA = [
			29 01 00 00 00 00 03 B6 BC 0A /* 0  420CD ~ 412CD */
			29 01 00 00 00 00 03 B6 BC 0B /* 1  403CD ~ 365CD */
			29 01 00 00 00 00 03 B6 BC 0C /* 2  357CD ~ 350CD */
			29 01 00 00 00 00 03 B6 BC 0D /* 3  333CD */
			29 01 00 00 00 00 03 B6 BC 0E /* 4  316CD ~ 300CD */
			29 01 00 00 00 00 03 B6 BC 0F /* 5  282CD */
			29 01 00 00 00 00 03 B6 BC 10 /* 6  265CD */
			29 01 00 00 00 00 03 B6 BC 11 /* 7  249CD ~ 183CD */
			29 01 00 00 00 00 03 B6 BC 13 /* 8  172CD ~ 162CD */
			29 01 00 00 00 00 03 B6 BC 14 /* 9  152CD ~ 143CD */
			29 01 00 00 00 00 03 B6 BC 15 /* 10 134CD ~ 126CD */
			29 01 00 00 00 00 03 B6 BC 16 /* 11 119CD ~ 111CD */
			29 01 00 00 00 00 03 B6 BC 17 /* 12 105CD ~ 93CD */
			29 01 00 00 00 00 03 B6 BC 18 /* 13 87CD ~ 41CD */
			29 01 00 00 00 00 03 B6 AC 18 /* 14 39CD ~ 15CD */
			29 01 00 00 00 00 03 B6 AC 18 /* 15 14CD */
			29 01 00 00 00 00 03 B6 AC 18 /* 16 13CD */
			29 01 00 00 00 00 03 B6 AC 18 /* 17 12CD */
			29 01 00 00 00 00 03 B6 AC 18 /* 18 11CD */
			29 01 00 00 00 00 03 B6 AC 18 /* 19 10CD */
			29 01 00 00 00 00 03 B6 AC 18 /* 20 9CD */
			29 01 00 00 00 00 03 B6 AC 18 /* 21 8CD */
			29 01 00 00 00 00 03 B6 AC 18 /* 22 7CD */
			29 01 00 00 00 00 03 B6 AC 18 /* 23 6CD */
			29 01 00 00 00 00 03 B6 AC 18 /* 24 5D */
			29 01 00 00 00 00 03 B6 AC 18 /* 25 4D */
			29 01 00 00 00 00 03 B6 AC 18 /* 26 3D */
			29 01 00 00 00 00 03 B6 AC 18 /* 27 2D */
		];

		/* bl_level, Index in elvss command list */
		samsung,smart_acl_elvss_map_table_revA = <
			2	27		3	26		4	25		5	24		6	23
			7	22		8	21		9	20		10	19		11	18
			12	17		13	16		14	15		15	14		16	14
			17	14		19	14		20	14		21	14		22	14
			24	14		25	14		27	14		29	14		30	14
			32	14		34	14		37	14		39	14		41	13
			44	13		47	13		50	13		53	13		56	13
			60	13		64	13		68	13		72	13		77	13
			82	13		87	13		93	12		98	12		105	12
			111	11		119	11		126	10		134	10		143	9
			152	9		162	8		172	8		183	7		195	7
			207	7		220	7		234	7		249	7		265	6
			282	5		300	4		316	4		333	3		350	2
			357	2		365	1		372	1		380	1		387	1
			395	1		403	1		412	0		420	0
		>;

		/*
		 * ************************************************************************************************************************
		 * candela to index mappings
		 * ************************************************************************************************************************
		 */
		samsung,candela_map_table_revA = <
		/*<idx><PMSL range> <candella> *//*linear map*/
			0	0	0	2
			1	1	4	3
			2	5	8	4
			3	9	12	5
			4	13	16	6
			5	17	20	7
			6	21	24	8
			7	25	28	9
			8	29	32	10
			9	33	36	11
			10	37	40	12
			11	41	43	13
			12	44	46	14
			13	47	48	15
			14	49	50	16
			15	51	52	17
			16	53	54	19
			17	55	56	20 /* dimming*/
			18	57	58	21
			19	59	60	22
			20	61	62	24
			21	63	64	25
			22	65	66	27
			23	67	68	29
			24	69	70	30
			25	71	72	32
			26	73	74	34
			27	75	76	37
			28	77	78	39
			29	79	80	41
			30	81	82	44
			31	83	84	47
			32	85	86	50
			33	87	88	53
			34	89	90	56
			35	91	92	60
			36	93	94	64
			37	95	96	68
			38	97	98	72
			39	99	100	77
			40	101	102	82
			41	103	104	87
			42	105	106	93
			43	107	108	98
			44	109	110	105
			45	111	112	111
			46	113	114	119
			47	115	116	126
			48	117	118	134
			49	119	120	143
			50	121	122	152
			51	123	124	162
			52	125	126	172
			53	127	128	183 /* default */
			54	129	135	195
			55	136	142	207
			56	143	149	220
			57	150	157	234
			58	158	165	249
			59	166	174	265
			60	175	183	282
			61	184	193	300
			62	194	201	316
			63	202	210	333
			64	211	219	350
			65	220	223	357
			66	224	227	365
			67	228	230	372
			68	231	234	380
			69	235	238	387
			70	239	242	395
			71	243	246	403
			72	247	250	412
			73	251	255	420
		>;

		samsung,hbm_candela_map_table_revA = <
			0	282	295	465	6
			1	296	309	488	7
			2	310	323	510	8
			3	324	336	533	9
			4	337	350	555	10
			5	351	364	578	11
			6	365	365	600	12
		>;

		/*
		 * ************************************************************************************************************************
		 * C10P ALPM/HLPM
		 * ************************************************************************************************************************
		 */

		samsung,alpm_on_tx_cmds_revA = [
			29 01 00 00 00 00 03 F0 5A 5A						/* TEST KEY Enable */
			29 01 00 00 00 00 03 FC 5A 5A						/* TEST KEY Enable */

			29 01 00 00 00 00 05 BB 54 00 07 14         		/* HLPM(60cd:0x74 / 2cd:0x54) / ALPM(60cd:0xE4 / 2cd:0xC4)  ALPM Mode On */
			29 01 00 00 00 00 02 53 03							/* ALPM/HLPM 60nit On */
			29 01 00 00 00 00 28 FD 		                    /* LTPS_EQ settings*/
				A1 20 08 04 44 00 8C							/* 0x8C : HLPM / 0x0C : ALPM */
				07 00 00 FF 00 0A AA 0A
				AA 0A AA 00 00 00 00 00
				00 00 00 5A 80 57 65 9E
				95 A5 04 55 05 01 01 01
			29 01 00 00 01 00 02 F7 03						    /* Gamma, LTPS(AID) update */

			29 01 00 00 00 00 03 F0 A5 A5
			29 01 00 00 00 00 03 FC A5 A5
		];

		samsung,alpm_off_tx_cmds_revA = [
			29 01 00 00 00 00 03 FC 5A 5A		/* TEST KEY Enable */
			29 01 00 00 00 00 03 F0 5A 5A		/* TEST KEY Enable */

			05 01 00 00 14 00 02 28 00			/* display off wait 20ms */
												/* image write for normal mode */
			29 01 00 00 00 00 02 53 00			/* alpm off */
			29 01 00 00 00 00 26 FD 			/* SRC_LOAD_EN setting */
				A1 20 08 04 44 00 0C 07
				00 00 FF 00 0A AA 0A AA
				0A AA 00 00 00 00 00 00
				00 00 5A 80 57 65 9E 95
				A5 04 55 05 00

			29 01 00 00 00 00 03 F0 A5 A5                /* TEST KEY Disable */
			29 01 00 00 00 00 03 FC A5 A5                /* TEST KEY Disable */
		];

		samsung,lpm_2nit_tx_cmds_revA =  [29 01 00 00 14 00 02 53 03];       /* HLPM/ALPM 2nit On*/
		samsung,lpm_60nit_tx_cmds_revA = [29 01 00 00 14 00 02 53 02];		 /* HLPM/ALPM 60nit On*/

		samsung,lpm_ctrl_alpm_2nit_tx_cmds_revA =  [29 01 00 00 00 00 05 BB C4 00 07 30];
		samsung,lpm_ctrl_alpm_60nit_tx_cmds_revA = [29 01 00 00 00 00 05 BB 84 00 07 30];

		samsung,lpm_ctrl_hlpm_2nit_tx_cmds_revA =  [29 01 00 00 00 00 05 BB 54 00 07 60];
		samsung,lpm_ctrl_hlpm_60nit_tx_cmds_revA = [29 01 00 00 00 00 05 BB 14 00 07 60];

		samsung,lpm_ctrl_alpm_aod_off_tx_cmds_revA = [
			29 01 00 00 00 00 03 F0 5A 5A	/* TEST KEY Enable */
			29 01 00 00 00 00 02 BB 00		/* AOD off */
			29 01 00 00 00 00 03 F0 A5 A5	/* TEST KEY Disable */
		];

		samsung,lpm_ctrl_alpm_aod_on_tx_cmds_revA = [
			29 01 00 00 00 00 03 F0 5A 5A	/* TEST KEY Enable */
			29 01 00 00 00 00 02 BB 01		/* AOD on */
			29 01 00 00 00 00 03 F0 A5 A5	/* TEST KEY Disable */
		];

		/*
		* ************************************************************************************************************************
		* Multi. Resolution
		* ************************************************************************************************************************
		*/

		samsung,panel_multires_fhd_revA = [

			/* OMOK Disable */
			29 00 00 00 00 00 03 FC 5A 5A  /* TEST KEY Enable */
			29 00 00 00 00 00 02 BA 01
			29 00 00 00 00 00 05 2A 00 00 04 37
			29 00 00 00 00 00 05 2B 00 00 07 7F
			29 01 00 00 00 00 03 FC A5 A5  /* TEST KEY Disable */
		];

		samsung,panel_multires_hd_revA = [

			/* OMOK Enable */
			29 00 00 00 00 00 03 FC 5A 5A		/* TEST KEY Enable */
			29 00 00 00 00 00 02 BA 00
			29 00 00 00 00 00 05 2A 00 00 02 CF
			29 00 00 00 00 00 05 2B 00 00 04 FF
			29 01 00 00 00 00 03 FC A5 A5		/* TEST KEY Disable */
		];

		/*
		* ************************************************************************************************************************
		* MULTI_RESOLUTION (DSC configs were moved all to below timing set)
		* (C10P does not support MULTI_RESOLUTION, only FHD.)
		* ************************************************************************************************************************
		*/

		qcom,mdss-dsi-display-timings {
			fhd {
				qcom,mdss-dsi-timing-default;

				qcom,mdss-dsi-panel-width = <1080>;
				qcom,mdss-dsi-panel-height = <1920>;
				qcom,mdss-dsi-t-clk-pre = <0x30>; /*48*/
				qcom,mdss-dsi-t-clk-post = <0x0D>; /*13*/
				qcom,mdss-dsi-panel-framerate = <60>;
				qcom,mdss-dsi-panel-timings = [e2 36 24 00 66 68 28 38 2a 03 04 00];
				qcom,mdss-dsi-panel-timings-phy-v2 = [
					23 1f 07 09 05 03 04 a0
					23 1f 07 09 05 03 04 a0
					23 1f 07 09 05 03 04 a0
					23 1f 07 09 05 03 04 a0
					23 19 08 08 05 03 04 a0
				];
				qcom,mdss-dsi-h-pulse-width = <12>;
				qcom,mdss-dsi-h-back-porch = <36>;
				qcom,mdss-dsi-h-front-porch = <92>;
				qcom,mdss-dsi-h-sync-skew = <0>;
				qcom,mdss-dsi-v-pulse-width = <2>;
				qcom,mdss-dsi-v-back-porch = <7>;
				qcom,mdss-dsi-v-front-porch = <7>;

				/*qcom,mdss-dsi-timing-switch-command; use samsung,panel_multires_XXX instead*/
				/*qcom,mdss-dsi-timing-switch-command-state;*/

				qcom,mdss-dsi-on-command= [
					05 01 00 00 14 00 02 11 00			/* Sleep out, wait 20ms(0x14) */

					/* Partial Mode On */
					05 01 00 00 00 00 02 12 00

					/* Partial area setting */
					29 01 00 00 00 00 05 30 07 7E 07 7F

					/* FFC setting*/
					29 01 00 00 00 00 03 F0 5A 5A		/* TEST KEY Enable */
					29 01 00 00 00 00 10 CE 29 D0 58 C3 4B 38 06 03
											00 FF 0A 3F 3F 3F 3F
					29 01 00 00 00 00 03 F0 A5 A5

					/*Common Setting*/
					/* TE Vsync On */
					29 01 00 00 00 00 02 35 00

					/* AVC setting */
					29 01 00 00 00 00 03 FC 5A 5A		/* TEST KEY Enable */
					29 01 00 00 00 00 20 FD A1 20 08 04 44 00 0C 07
							    00 00 FF 00 0A AA 0A AA
							    0A AA 00 00 00 00 00 00
							    00 00 5A 80 57 65 9E
					29 01 00 00 00 00 03 FC A5 A5

					/* PCD Setting */
					29 01 00 00 00 00 03 F0 5A 5A		/* TEST KEY Enable */
					29 01 00 00 00 00 02 CC 4C
					29 01 00 00 00 00 03 F0 A5 A5

					/* ERR_FG Setting */
					29 01 00 00 00 00 03 F0 5A 5A		/* TEST KEY Enable */
					29 01 00 00 00 00 02 ED 44
					29 01 00 00 00 00 03 F0 A5 A5

					/* Brightness condition set */
					29 01 00 00 00 00 03 F0 5A 5A		/* TEST KEY Enable */
					29 01 00 00 00 00 24 CA				/* 1) Gamma 2.2 Setting */
						01 00 01 00 01 00	/* V255 R,G,B */
						80 80 80			/* V203 R,G,B */
						80 80 80			/* V151 R,G,B */
						80 80 80			/* V87 R,G,B */
						80 80 80			/* V51 R,G,B */
						80 80 80			/* V35 R,G,B */
						80 80 80			/* V23 R,G,B */
						80 80 80			/* V11 R,G,B */
						80 80 80			/*  V3 R,G,B */
						00 00 00			/*  V0 R,G,B */
						00 00				/*  VT R,G,B */
					29 01 00 00 00 00 03 B2 00 10		/* AID set : AOR 0% */
					29 01 00 00 00 00 03 B6 BC 0A		/* CAPS ELVSS Set(ACL ON : 0x8C) */
					29 01 00 00 00 00 02 F7 03			/* Gamma, LTPS(AID) update */
					29 01 00 00 50 00 03 F0 A5 A5		/* TEST KEY Disable */

					/* Memory Access */
					05 01 00 00 00 00 02 2C 00
					05 01 00 00 00 00 02 3C 00

					/* OMOK Disable */
					29 01 00 00 00 00 03 FC 5A 5A  /* TEST KEY Enable */
					29 01 00 00 00 00 02 BA 01
					29 01 00 00 00 00 05 2A 00 00 04 37
					29 01 00 00 00 00 05 2B 00 00 07 7F
					29 01 00 00 00 00 03 FC A5 A5  /* TEST KEY Disable */
				];

				qcom,mdss-dsi-on-command-state = "dsi_lp_mode";
			};
		};
	};
};
