/* Copyright (c) 2012, Samsung Electronics Corporation. All rights reserved.
 *
 * This program is free software; you can redistribute it and/or modify
 * it under the terms of the GNU General Public License version 2 and
 * only version 2 as published by the Free Software Foundation.
 *
 * This program is distributed in the hope that it will be useful,
 * but WITHOUT ANY WARRANTY; without even the implied warranty of
 * MERCHANTABILITY or FITNESS FOR A PARTICULAR PURPOSE.  See the
 * GNU General Public License for more details.
 */

&mdss_mdp {
	ss_dsi_panel_S6E3HA6_AMS622MR01_WQHD: ss_dsi_panel_S6E3HA6_AMS622MR01_WQHD {
		/*
		* ************************************************************************************************************************
		*  IRC
		* ************************************************************************************************************************
		*/
		samsung,pac_irc_subdivision_tx_cmds_revA = [
			29 01 00 00 00 00 15 B8 0D F0 2E 24 46 BD 33 69 12 7A E0 00 00 00 00 00 00 00 00 00  /* 0 */
			29 01 00 00 00 00 15 B8 0D F0 2E 24 46 BD 33 69 12 7A E0 00 00 00 00 00 00 00 00 00  /* 1 */
			29 01 00 00 00 00 15 B8 0D F0 2E 24 46 BD 33 69 12 7A E0 00 00 00 00 00 00 00 00 00  /* 2 */
			29 01 00 00 00 00 15 B8 0D F0 2E 24 46 BD 33 69 12 7A E0 00 00 00 00 00 00 00 00 00  /* 3 */
			29 01 00 00 00 00 15 B8 0D F0 2E 24 46 BD 33 69 12 7A E0 00 00 00 00 00 00 00 00 00  /* 4 */
			29 01 00 00 00 00 15 B8 0D F0 2E 24 46 BD 33 69 12 7A E0 00 00 00 00 00 00 00 00 00  /* 5 */
			29 01 00 00 00 00 15 B8 0D F0 2E 24 46 BD 33 69 12 7A E0 00 00 00 00 00 00 00 00 00  /* 6 */
			29 01 00 00 00 00 15 B8 0D F0 2E 24 46 BD 33 69 12 7A E0 00 00 00 00 00 00 00 00 00  /* 7 */
			29 01 00 00 00 00 15 B8 0D F0 2E 24 46 BD 33 69 12 7A E0 00 00 00 00 00 00 00 00 00  /* 8 */
			29 01 00 00 00 00 15 B8 0D F0 2E 24 46 BD 33 69 12 7A E0 00 00 00 00 00 00 00 00 00  /* 9 */
			29 01 00 00 00 00 15 B8 0D F0 2E 24 46 BD 33 69 12 7A E0 00 00 00 00 00 00 00 00 00  /* 10 */
			29 01 00 00 00 00 15 B8 0D F0 2E 24 46 BD 33 69 12 7A E0 00 00 00 00 00 00 00 00 00  /* 11 */
			29 01 00 00 00 00 15 B8 0D F0 2E 24 46 BD 33 69 12 7A E0 00 00 00 00 00 00 00 00 00  /* 12 */
			29 01 00 00 00 00 15 B8 0D F0 2E 24 46 BD 33 69 12 7A E0 00 00 00 00 00 00 00 00 00  /* 13 */
			29 01 00 00 00 00 15 B8 0D F0 2E 24 46 BD 33 69 12 7A E0 00 00 00 00 00 00 00 00 00  /* 14 */
			29 01 00 00 00 00 15 B8 0D F0 2E 24 46 BD 33 69 12 7A E0 00 00 00 00 00 00 00 00 00  /* 15 */
			29 01 00 00 00 00 15 B8 0D F0 2E 24 46 BD 33 69 12 7A E0 00 00 00 00 00 00 00 00 00  /* 16 */
			29 01 00 00 00 00 15 B8 0D F0 2E 24 46 BD 33 69 12 7A E0 00 00 00 00 00 00 00 00 00  /* 17 */
			29 01 00 00 00 00 15 B8 0D F0 2E 24 46 BD 33 69 12 7A E0 00 00 00 00 00 00 00 00 00  /* 18 */
			29 01 00 00 00 00 15 B8 0D F0 2E 24 46 BD 33 69 12 7A E0 00 00 00 00 00 00 00 00 00  /* 19 */
			29 01 00 00 00 00 15 B8 0D F0 2E 24 46 BD 33 69 12 7A E0 00 00 00 00 00 00 00 00 00  /* 20 */
			29 01 00 00 00 00 15 B8 0D F0 2E 24 46 BD 33 69 12 7A E0 00 00 00 00 00 00 00 00 00  /* 21 */
			29 01 00 00 00 00 15 B8 0D F0 2E 24 46 BD 33 69 12 7A E0 00 00 00 00 00 00 00 00 00  /* 22 */
			29 01 00 00 00 00 15 B8 0D F0 2E 24 46 BD 33 69 12 7A E0 00 00 00 00 00 00 00 00 00  /* 23 */
			29 01 00 00 00 00 15 B8 0D F0 2E 24 46 BD 33 69 12 7A E0 00 00 00 00 00 00 00 00 00  /* 24 */
			29 01 00 00 00 00 15 B8 0D F0 2E 24 46 BD 33 69 12 7A E0 00 00 00 00 00 00 00 00 00  /* 25 */
			29 01 00 00 00 00 15 B8 0D F0 2E 24 46 BD 33 69 12 7A E0 00 00 00 00 00 00 00 00 00  /* 26 */
			29 01 00 00 00 00 15 B8 0D F0 2E 24 46 BD 33 69 12 7A E0 00 00 00 00 00 00 00 00 00  /* 27 */
			29 01 00 00 00 00 15 B8 0D F0 2E 24 46 BD 33 69 12 7A E0 00 00 00 00 00 00 00 00 00  /* 28 */
			29 01 00 00 00 00 15 B8 0D F0 2E 24 46 BD 33 69 12 7A E0 00 00 00 00 00 00 00 00 00  /* 29 */
			29 01 00 00 00 00 15 B8 0D F0 2E 24 46 BD 33 69 12 7A E0 00 00 00 00 00 00 00 00 00  /* 30 */
			29 01 00 00 00 00 15 B8 0D F0 2E 24 46 BD 33 69 12 7A E0 00 00 00 00 00 00 00 00 00  /* 31 */
			29 01 00 00 00 00 15 B8 0D F0 2E 24 46 BD 33 69 12 7A E0 00 00 00 00 00 00 00 00 00  /* 32 */
			29 01 00 00 00 00 15 B8 0D F0 2E 24 46 BD 33 69 12 7A E0 00 00 00 00 00 00 00 00 00  /* 33 */
			29 01 00 00 00 00 15 B8 0D F0 2E 24 46 BD 33 69 12 7A E0 00 00 00 00 00 00 00 00 00  /* 34 */
			29 01 00 00 00 00 15 B8 0D F0 2E 24 46 BD 33 69 12 7A E0 00 00 00 00 00 00 00 00 00  /* 35 */
			29 01 00 00 00 00 15 B8 0D F0 2E 24 46 BD 33 69 12 7A E0 00 00 00 00 00 00 00 00 00  /* 36 */
			29 01 00 00 00 00 15 B8 0D F0 2E 24 46 BD 33 69 12 7A E0 00 00 00 00 00 00 00 00 00  /* 37 */
			29 01 00 00 00 00 15 B8 0D F0 2E 24 46 BD 33 69 12 7A E0 00 00 00 00 00 00 00 00 00  /* 38 */
			29 01 00 00 00 00 15 B8 0D F0 2E 24 46 BD 33 69 12 7A E0 00 00 00 00 00 00 00 00 00  /* 39 */
			29 01 00 00 00 00 15 B8 0D F0 2E 24 46 BD 33 69 12 7A E0 00 00 00 00 00 00 00 00 00  /* 40 */
			29 01 00 00 00 00 15 B8 0D F0 2E 24 46 BD 33 69 12 7A E0 00 00 00 00 00 00 00 00 00  /* 41 */
			29 01 00 00 00 00 15 B8 0D F0 2E 24 46 BD 33 69 12 7A E0 00 00 00 00 00 00 00 00 00  /* 42 */
			29 01 00 00 00 00 15 B8 0D F0 2E 24 46 BD 33 69 12 7A E0 00 00 00 00 00 00 00 00 00  /* 43 */
			29 01 00 00 00 00 15 B8 0D F0 2E 24 46 BD 33 69 12 7A E0 00 00 00 00 00 00 00 00 00  /* 44 */
			29 01 00 00 00 00 15 B8 0D F0 2E 24 46 BD 33 69 12 7A E0 00 00 00 00 00 00 00 00 00  /* 45 */
			29 01 00 00 00 00 15 B8 0D F0 2E 24 46 BD 33 69 12 7A E0 00 00 00 00 00 00 00 00 00  /* 46 */
			29 01 00 00 00 00 15 B8 0D F0 2E 24 46 BD 33 69 12 7A E0 00 00 00 00 00 00 00 00 00  /* 47 */
			29 01 00 00 00 00 15 B8 0D F0 2E 24 46 BD 33 69 12 7A E0 00 00 00 00 00 00 00 00 00  /* 48 */
			29 01 00 00 00 00 15 B8 0D F0 2E 24 46 BD 33 69 12 7A E0 00 00 00 00 00 00 00 00 00  /* 49 */
			29 01 00 00 00 00 15 B8 0D F0 2E 24 46 BD 33 69 12 7A E0 00 00 00 00 00 00 00 00 00  /* 50 */
			29 01 00 00 00 00 15 B8 0D F0 2E 24 46 BD 33 69 12 7A E0 00 00 00 00 00 00 00 00 00  /* 51 */
			29 01 00 00 00 00 15 B8 0D F0 2E 24 46 BD 33 69 12 7A E0 00 00 00 00 00 00 00 00 00  /* 52 */
			29 01 00 00 00 00 15 B8 0D F0 2E 24 46 BD 33 69 12 7A E0 00 00 00 00 00 00 00 00 00  /* 53 */
			29 01 00 00 00 00 15 B8 0D F0 2E 24 46 BD 33 69 12 7A E0 00 00 00 00 00 00 00 00 00  /* 54 */
			29 01 00 00 00 00 15 B8 0D F0 2E 24 46 BD 33 69 12 7A E0 00 00 00 00 00 00 00 00 00  /* 55 */
			29 01 00 00 00 00 15 B8 0D F0 2E 24 46 BD 33 69 12 7A E0 02 02 02 01 01 01 01 00 01  /* 56 */
			29 01 00 00 00 00 15 B8 0D F0 2E 24 46 BD 33 69 12 7A E0 02 02 02 01 01 01 01 00 01  /* 57 */
			29 01 00 00 00 00 15 B8 0D F0 2E 24 46 BD 33 69 12 7A E0 02 02 02 01 01 01 01 01 01  /* 58 */
			29 01 00 00 00 00 15 B8 0D F0 2E 24 46 BD 33 69 12 7A E0 02 02 02 01 01 01 01 01 01  /* 59 */
			29 01 00 00 00 00 15 B8 0D F0 2E 24 46 BD 33 69 12 7A E0 02 02 02 01 01 01 01 01 01  /* 60 */
			29 01 00 00 00 00 15 B8 0D F0 2E 24 46 BD 33 69 12 7A E0 02 02 02 01 01 01 01 01 01  /* 61 */
			29 01 00 00 00 00 15 B8 0D F0 2E 24 46 BD 33 69 12 7A E0 02 02 02 01 01 01 01 01 01  /* 62 */
			29 01 00 00 00 00 15 B8 0D F0 2E 24 46 BD 33 69 12 7A E0 02 02 02 01 01 01 01 01 01  /* 63 */
			29 01 00 00 00 00 15 B8 0D F0 2E 24 46 BD 33 69 12 7A E0 02 02 02 01 01 01 01 01 01  /* 64 */
			29 01 00 00 00 00 15 B8 0D F0 2E 24 46 BD 33 69 12 7A E0 02 02 02 01 01 01 01 01 01  /* 65 */
			29 01 00 00 00 00 15 B8 0D F0 2E 24 46 BD 33 69 12 7A E0 02 02 02 01 01 01 01 01 01  /* 66 */
			29 01 00 00 00 00 15 B8 0D F0 2E 24 46 BD 33 69 12 7A E0 02 02 02 01 01 01 01 01 01  /* 67 */
			29 01 00 00 00 00 15 B8 0D F0 2E 24 46 BD 33 69 12 7A E0 02 02 02 01 01 01 01 01 01  /* 68 */
			29 01 00 00 00 00 15 B8 0D F0 2E 24 46 BD 33 69 12 7A E0 03 02 03 00 01 00 01 01 01  /* 69 */
			29 01 00 00 00 00 15 B8 0D F0 2E 24 46 BD 33 69 12 7A E0 03 02 03 00 01 00 01 01 01  /* 70 */
			29 01 00 00 00 00 15 B8 0D F0 2E 24 46 BD 33 69 12 7A E0 03 02 03 00 01 00 01 01 01  /* 71 */
			29 01 00 00 00 00 15 B8 0D F0 2E 24 46 BD 33 69 12 7A E0 03 03 03 00 00 00 01 01 01  /* 72 */
			29 01 00 00 00 00 15 B8 0D F0 2E 24 46 BD 33 69 12 7A E0 03 03 03 01 00 01 00 01 00  /* 73 */
			29 01 00 00 00 00 15 B8 0D F0 2E 24 46 BD 33 69 12 7A E0 03 03 03 01 00 01 00 01 00  /* 74 */
			29 01 00 00 00 00 15 B8 0D F0 2E 24 46 BD 33 69 12 7A E0 03 03 03 01 00 01 01 01 01  /* 75 */
			29 01 00 00 00 00 15 B8 0D F0 2E 24 46 BD 33 69 12 7A E0 03 03 03 01 01 01 01 00 01  /* 76 */
			29 01 00 00 00 00 15 B8 0D F0 2E 24 46 BD 33 69 12 7A E0 03 03 03 01 01 01 01 00 01  /* 77 */
			29 01 00 00 00 00 15 B8 0D F0 2E 24 46 BD 33 69 12 7A E0 03 03 03 01 01 01 01 00 01  /* 78 */
			29 01 00 00 00 00 15 B8 0D F0 2E 24 46 BD 33 69 12 7A E0 03 03 03 01 01 01 01 01 01  /* 79 */
			29 01 00 00 00 00 15 B8 0D F0 2E 24 46 BD 33 69 12 7A E0 03 03 03 01 01 01 01 01 01  /* 80 */
			29 01 00 00 00 00 15 B8 0D F0 2E 24 46 BD 33 69 12 7A E0 03 03 03 01 01 01 01 01 01  /* 81 */
			29 01 00 00 00 00 15 B8 0D F0 2E 24 46 BD 33 69 12 7A E0 03 03 03 01 01 01 01 01 01  /* 82 */
			29 01 00 00 00 00 15 B8 0D F0 2E 24 46 BD 33 69 12 7A E0 03 03 03 01 01 01 01 01 01  /* 83 */
			29 01 00 00 00 00 15 B8 0D F0 2E 24 46 BD 33 69 12 7A E0 03 03 03 01 01 01 01 01 01  /* 84 */
			29 01 00 00 00 00 15 B8 0D F0 2E 24 46 BD 33 69 12 7A E0 03 03 03 01 01 01 01 01 01  /* 85 */
			29 01 00 00 00 00 15 B8 0D F0 2E 24 46 BD 33 69 12 7A E0 03 03 03 01 01 01 01 01 01  /* 86 */
			29 01 00 00 00 00 15 B8 0D F0 2E 24 46 BD 33 69 12 7A E0 03 03 03 01 01 01 01 01 01  /* 87 */
			29 01 00 00 00 00 15 B8 0D F0 2E 24 46 BD 33 69 12 7A E0 03 03 03 01 01 01 01 01 01  /* 88 */
			29 01 00 00 00 00 15 B8 0D F0 2E 24 46 BD 33 69 12 7A E0 03 03 03 01 01 01 01 01 01  /* 89 */
			29 01 00 00 00 00 15 B8 0D F0 2E 24 46 BD 33 69 12 7A E0 03 03 03 01 01 01 01 01 01  /* 90 */
			29 01 00 00 00 00 15 B8 0D F0 2E 24 46 BD 33 69 12 7A E0 03 03 03 01 01 01 01 01 01  /* 91 */
			29 01 00 00 00 00 15 B8 0D F0 2E 24 46 BD 33 69 12 7A E0 03 03 03 01 01 01 01 01 01  /* 92 */
			29 01 00 00 00 00 15 B8 0D F0 2E 24 46 BD 33 69 12 7A E0 03 03 03 01 01 01 01 01 01  /* 93 */
			29 01 00 00 00 00 15 B8 0D F0 2E 24 46 BD 33 69 12 7A E0 03 03 03 01 01 01 01 01 01  /* 94 */
			29 01 00 00 00 00 15 B8 0D F0 2E 24 46 BD 33 69 12 7A E0 03 03 03 01 01 01 02 01 02  /* 95 */
			29 01 00 00 00 00 15 B8 0D F0 2E 24 46 BD 33 69 12 7A E0 03 03 03 01 01 01 02 01 02  /* 96 */
			29 01 00 00 00 00 15 B8 0D F0 2E 24 46 BD 33 69 12 7A E0 03 03 03 01 01 01 02 01 02  /* 97 */
			29 01 00 00 00 00 15 B8 0D F0 2E 24 46 BD 33 69 12 7A E0 03 03 03 02 01 02 01 01 01  /* 98 */
			29 01 00 00 00 00 15 B8 0D F0 2E 24 46 BD 33 69 12 7A E0 03 03 03 02 01 02 01 01 01  /* 99 */
			29 01 00 00 00 00 15 B8 0D F0 2E 24 46 BD 33 69 12 7A E0 03 03 03 02 01 02 01 02 01  /* 100 */
			29 01 00 00 00 00 15 B8 0D F0 2E 24 46 BD 33 69 12 7A E0 03 03 03 02 01 02 01 02 01  /* 101 */
			29 01 00 00 00 00 15 B8 0D F0 2E 24 46 BD 33 69 12 7A E0 04 03 04 01 02 01 01 01 01  /* 102 */
			29 01 00 00 00 00 15 B8 0D F0 2E 24 46 BD 33 69 12 7A E0 04 03 04 01 02 01 01 01 01  /* 103 */
			29 01 00 00 00 00 15 B8 0D F0 2E 24 46 BD 33 69 12 7A E0 04 03 04 01 02 01 01 01 01  /* 104 */
			29 01 00 00 00 00 15 B8 0D F0 2E 24 46 BD 33 69 12 7A E0 04 03 04 01 02 01 01 01 01  /* 105 */
			29 01 00 00 00 00 15 B8 0D F0 2E 24 46 BD 33 69 12 7A E0 04 04 04 01 01 01 01 01 01  /* 106 */
			29 01 00 00 00 00 15 B8 0D F0 2E 24 46 BD 33 69 12 7A E0 04 04 04 01 01 01 01 01 01  /* 107 */
			29 01 00 00 00 00 15 B8 0D F0 2E 24 46 BD 33 69 12 7A E0 04 04 04 01 01 01 01 01 01  /* 108 */
			29 01 00 00 00 00 15 B8 0D F0 2E 24 46 BD 33 69 12 7A E0 04 04 04 01 01 01 01 01 01  /* 109 */
			29 01 00 00 00 00 15 B8 0D F0 2E 24 46 BD 33 69 12 7A E0 04 04 04 01 01 01 01 01 01  /* 110 */
			29 01 00 00 00 00 15 B8 0D F0 2E 24 46 BD 33 69 12 7A E0 04 04 04 01 01 01 02 01 02  /* 111 */
			29 01 00 00 00 00 15 B8 0D F0 2E 24 46 BD 33 69 12 7A E0 04 04 04 01 01 01 02 01 02  /* 112 */
			29 01 00 00 00 00 15 B8 0D F0 2E 24 46 BD 33 69 12 7A E0 04 04 04 01 01 01 02 01 02  /* 113 */
			29 01 00 00 00 00 15 B8 0D F0 2E 24 46 BD 33 69 12 7A E0 04 04 04 01 01 01 02 02 02  /* 114 */
			29 01 00 00 00 00 15 B8 0D F0 2E 24 46 BD 33 69 12 7A E0 04 04 04 01 01 01 02 02 02  /* 115 */
			29 01 00 00 00 00 15 B8 0D F0 2E 24 46 BD 33 69 12 7A E0 04 04 04 02 01 02 01 02 01  /* 116 */
			29 01 00 00 00 00 15 B8 0D F0 2E 24 46 BD 33 69 12 7A E0 04 04 04 02 01 02 01 02 01  /* 117 */
			29 01 00 00 00 00 15 B8 0D F0 2E 24 46 BD 33 69 12 7A E0 04 04 04 02 01 02 01 02 01  /* 118 */
			29 01 00 00 00 00 15 B8 0D F0 2E 24 46 BD 33 69 12 7A E0 04 04 04 02 01 02 01 02 01  /* 119 */
			29 01 00 00 00 00 15 B8 0D F0 2E 24 46 BD 33 69 12 7A E0 04 04 04 02 01 02 01 02 01  /* 120 */
			29 01 00 00 00 00 15 B8 0D F0 2E 24 46 BD 33 69 12 7A E0 04 04 04 02 02 02 01 01 01  /* 121 */
			29 01 00 00 00 00 15 B8 0D F0 2E 24 46 BD 33 69 12 7A E0 04 04 04 02 02 02 01 01 01  /* 122 */
			29 01 00 00 00 00 15 B8 0D F0 2E 24 46 BD 33 69 12 7A E0 04 04 04 02 02 02 01 01 01  /* 123 */
			29 01 00 00 00 00 15 B8 0D F0 2E 24 46 BD 33 69 12 7A E0 04 04 04 02 02 02 01 01 01  /* 124 */
			29 01 00 00 00 00 15 B8 0D F0 2E 24 46 BD 33 69 12 7A E0 04 04 04 02 02 02 01 01 01  /* 125 */
			29 01 00 00 00 00 15 B8 0D F0 2E 24 46 BD 33 69 12 7A E0 04 04 04 02 02 02 01 01 01  /* 126 */
			29 01 00 00 00 00 15 B8 0D F0 2E 24 46 BD 33 69 12 7A E0 04 04 04 02 02 02 01 01 01  /* 127 */
			29 01 00 00 00 00 15 B8 0D F0 2E 24 46 BD 33 69 12 7A E0 04 04 04 02 02 02 02 01 02  /* 128 */
			29 01 00 00 00 00 15 B8 0D F0 2E 24 46 BD 33 69 12 7A E0 05 04 05 01 02 01 02 01 02  /* 129 */
			29 01 00 00 00 00 15 B8 0D F0 2E 24 46 BD 33 69 12 7A E0 05 04 05 01 02 01 02 01 02  /* 130 */
			29 01 00 00 00 00 15 B8 0D F0 2E 24 46 BD 33 69 12 7A E0 05 04 05 01 02 01 02 01 02  /* 131 */
			29 01 00 00 00 00 15 B8 0D F0 2E 24 46 BD 33 69 12 7A E0 05 04 05 01 02 01 02 01 02  /* 132 */
			29 01 00 00 00 00 15 B8 0D F0 2E 24 46 BD 33 69 12 7A E0 05 04 05 01 02 01 02 01 02  /* 133 */
			29 01 00 00 00 00 15 B8 0D F0 2E 24 46 BD 33 69 12 7A E0 05 05 05 01 01 01 02 01 02  /* 134 */
			29 01 00 00 00 00 15 B8 0D F0 2E 24 46 BD 33 69 12 7A E0 05 05 05 01 01 01 02 02 02  /* 135 */
			29 01 00 00 00 00 15 B8 0D F0 2E 24 46 BD 33 69 12 7A E0 05 05 05 01 01 01 02 02 02  /* 136 */
			29 01 00 00 00 00 15 B8 0D F0 2E 24 46 BD 33 69 12 7A E0 05 05 05 01 01 01 02 02 02  /* 137 */
			29 01 00 00 00 00 15 B8 0D F0 2E 24 46 BD 33 69 12 7A E0 05 05 05 02 01 02 01 02 01  /* 138 */
			29 01 00 00 00 00 15 B8 0D F0 2E 24 46 BD 33 69 12 7A E0 05 05 05 02 01 02 01 02 01  /* 139 */
			29 01 00 00 00 00 15 B8 0D F0 2E 24 46 BD 33 69 12 7A E0 05 05 05 02 01 02 01 02 01  /* 140 */
			29 01 00 00 00 00 15 B8 0D F0 2E 24 46 BD 33 69 12 7A E0 05 05 05 02 02 02 02 01 02  /* 141 */
			29 01 00 00 00 00 15 B8 0D F0 2E 24 46 BD 33 69 12 7A E0 05 05 05 02 02 02 02 01 02  /* 142 */
			29 01 00 00 00 00 15 B8 0D F0 2E 24 46 BD 33 69 12 7A E0 05 05 05 02 02 02 02 01 02  /* 143 */
			29 01 00 00 00 00 15 B8 0D F0 2E 24 46 BD 33 69 12 7A E0 05 05 05 02 02 02 02 01 02  /* 144 */
			29 01 00 00 00 00 15 B8 0D F0 2E 24 46 BD 33 69 12 7A E0 05 05 05 02 02 02 02 01 02  /* 145 */
			29 01 00 00 00 00 15 B8 0D F0 2E 24 46 BD 33 69 12 7A E0 05 05 05 02 02 02 02 01 02  /* 146 */
			29 01 00 00 00 00 15 B8 0D F0 2E 24 46 BD 33 69 12 7A E0 05 05 05 02 02 02 02 01 02  /* 147 */
			29 01 00 00 00 00 15 B8 0D F0 2E 24 46 BD 33 69 12 7A E0 05 05 05 02 02 02 02 02 02  /* 148 */
			29 01 00 00 00 00 15 B8 0D F0 2E 24 46 BD 33 69 12 7A E0 05 05 05 02 02 02 02 02 02  /* 149 */
			29 01 00 00 00 00 15 B8 0D F0 2E 24 46 BD 33 69 12 7A E0 05 05 05 02 02 02 02 02 02  /* 150 */
			29 01 00 00 00 00 15 B8 0D F0 2E 24 46 BD 33 69 12 7A E0 05 05 05 02 02 02 02 02 02  /* 151 */
			29 01 00 00 00 00 15 B8 0D F0 2E 24 46 BD 33 69 12 7A E0 06 05 06 01 02 01 02 02 02  /* 152 */
			29 01 00 00 00 00 15 B8 0D F0 2E 24 46 BD 33 69 12 7A E0 06 05 06 01 02 01 02 02 02  /* 153 */
			29 01 00 00 00 00 15 B8 0D F0 2E 24 46 BD 33 69 12 7A E0 06 05 06 02 02 02 01 02 01  /* 154 */
			29 01 00 00 00 00 15 B8 0D F0 2E 24 46 BD 33 69 12 7A E0 06 05 06 02 02 02 01 02 01  /* 155 */
			29 01 00 00 00 00 15 B8 0D F0 2E 24 46 BD 33 69 12 7A E0 06 06 06 02 01 02 02 02 02  /* 156 */
			29 01 00 00 00 00 15 B8 0D F0 2E 24 46 BD 33 69 12 7A E0 06 06 06 02 01 02 02 02 02  /* 157 */
			29 01 00 00 00 00 15 B8 0D F0 2E 24 46 BD 33 69 12 7A E0 06 06 06 02 02 02 02 01 02  /* 158 */
			29 01 00 00 00 00 15 B8 0D F0 2E 24 46 BD 33 69 12 7A E0 06 06 06 02 02 02 02 01 02  /* 159 */
			29 01 00 00 00 00 15 B8 0D F0 2E 24 46 BD 33 69 12 7A E0 06 06 06 02 02 02 02 02 02  /* 160 */
			29 01 00 00 00 00 15 B8 0D F0 2E 24 46 BD 33 69 12 7A E0 06 06 06 02 02 02 02 02 02  /* 161 */
			29 01 00 00 00 00 15 B8 0D F0 2E 24 46 BD 33 69 12 7A E0 06 06 06 02 02 02 02 02 02  /* 162 */
			29 01 00 00 00 00 15 B8 0D F0 2E 24 46 BD 33 69 12 7A E0 06 06 06 02 02 02 02 02 02  /* 163 */
			29 01 00 00 00 00 15 B8 0D F0 2E 24 46 BD 33 69 12 7A E0 06 06 06 02 02 02 02 02 02  /* 164 */
			29 01 00 00 00 00 15 B8 0D F0 2E 24 46 BD 33 69 12 7A E0 06 06 06 02 02 02 02 02 02  /* 165 */
			29 01 00 00 00 00 15 B8 0D F0 2E 24 46 BD 33 69 12 7A E0 06 06 06 02 02 02 02 02 02  /* 166 */
			29 01 00 00 00 00 15 B8 0D F0 2E 24 46 BD 33 69 12 7A E0 06 06 06 02 02 02 02 02 02  /* 167 */
			29 01 00 00 00 00 15 B8 0D F0 2E 24 46 BD 33 69 12 7A E0 06 06 06 02 02 02 02 02 02  /* 168 */
			29 01 00 00 00 00 15 B8 0D F0 2E 24 46 BD 33 69 12 7A E0 06 06 06 02 02 02 03 02 03  /* 169 */
			29 01 00 00 00 00 15 B8 0D F0 2E 24 46 BD 33 69 12 7A E0 06 06 06 02 02 02 03 02 03  /* 170 */
			29 01 00 00 00 00 15 B8 0D F0 2E 24 46 BD 33 69 12 7A E0 06 06 06 02 02 02 03 02 03  /* 171 */
			29 01 00 00 00 00 15 B8 0D F0 2E 24 46 BD 33 69 12 7A E0 06 06 06 03 02 03 02 02 02  /* 172 */
			29 01 00 00 00 00 15 B8 0D F0 2E 24 46 BD 33 69 12 7A E0 06 06 06 03 02 03 02 02 02  /* 173 */
			29 01 00 00 00 00 15 B8 0D F0 2E 24 46 BD 33 69 12 7A E0 06 06 06 03 02 03 02 02 02  /* 174 */
			29 01 00 00 00 00 15 B8 0D F0 2E 24 46 BD 33 69 12 7A E0 07 06 07 02 02 02 02 02 02  /* 175 */
			29 01 00 00 00 00 15 B8 0D F0 2E 24 46 BD 33 69 12 7A E0 07 06 07 02 02 02 02 03 02  /* 176 */
			29 01 00 00 00 00 15 B8 0D F0 2E 24 46 BD 33 69 12 7A E0 07 06 07 02 03 02 02 02 02  /* 177 */
			29 01 00 00 00 00 15 B8 0D F0 2E 24 46 BD 33 69 12 7A E0 07 06 07 02 03 02 02 02 02  /* 178 */
			29 01 00 00 00 00 15 B8 0D F0 2E 24 46 BD 33 69 12 7A E0 07 07 07 02 02 02 02 02 02  /* 179 */
			29 01 00 00 00 00 15 B8 0D F0 2E 24 46 BD 33 69 12 7A E0 07 07 07 02 02 02 02 02 02  /* 180 */
			29 01 00 00 00 00 15 B8 0D F0 2E 24 46 BD 33 69 12 7A E0 07 07 07 02 02 02 02 02 02  /* 181 */
			29 01 00 00 00 00 15 B8 0D F0 2E 24 46 BD 33 69 12 7A E0 07 07 07 02 02 02 03 02 03  /* 182 */
			29 01 00 00 00 00 15 B8 0D F0 2E 24 46 BD 33 69 12 7A E0 07 07 07 02 02 02 03 02 03  /* 183 */
			29 01 00 00 00 00 15 B8 0D F0 2E 24 46 BD 33 69 12 7A E0 07 07 07 02 02 02 03 02 03  /* 184 */
			29 01 00 00 00 00 15 B8 0D F0 2E 24 46 BD 33 69 12 7A E0 07 07 07 02 02 02 03 02 03  /* 185 */
			29 01 00 00 00 00 15 B8 0D F0 2E 24 46 BD 33 69 12 7A E0 07 07 07 02 02 02 03 02 03  /* 186 */
			29 01 00 00 00 00 15 B8 0D F0 2E 24 46 BD 33 69 12 7A E0 07 07 07 03 02 03 02 02 02  /* 187 */
			29 01 00 00 00 00 15 B8 0D F0 2E 24 46 BD 33 69 12 7A E0 07 07 07 03 02 03 02 03 02  /* 188 */
			29 01 00 00 00 00 15 B8 0D F0 2E 24 46 BD 33 69 12 7A E0 07 07 07 03 02 03 02 03 02  /* 189 */
			29 01 00 00 00 00 15 B8 0D F0 2E 24 46 BD 33 69 12 7A E0 07 07 07 03 02 03 02 03 02  /* 190 */
			29 01 00 00 00 00 15 B8 0D F0 2E 24 46 BD 33 69 12 7A E0 07 07 07 03 03 03 02 02 02  /* 191 */
			29 01 00 00 00 00 15 B8 0D F0 2E 24 46 BD 33 69 12 7A E0 07 07 07 03 03 03 03 02 03  /* 192 */
			29 01 00 00 00 00 15 B8 0D F0 2E 24 46 BD 33 69 12 7A E0 08 07 08 02 03 02 03 02 03  /* 193 */
			29 01 00 00 00 00 15 B8 0D F0 2E 24 46 BD 33 69 12 7A E0 08 07 08 02 03 02 03 02 03  /* 194 */
			29 01 00 00 00 00 15 B8 0D F0 2E 24 46 BD 33 69 12 7A E0 08 07 08 02 03 02 03 02 03  /* 195 */
			29 01 00 00 00 00 15 B8 0D F0 2E 24 46 BD 33 69 12 7A E0 08 08 08 02 02 02 03 02 03  /* 196 */
			29 01 00 00 00 00 15 B8 0D F0 2E 24 46 BD 33 69 12 7A E0 08 08 08 02 02 02 03 03 03  /* 197 */
			29 01 00 00 00 00 15 B8 0D F0 2E 24 46 BD 33 69 12 7A E0 08 08 08 03 02 03 02 03 02  /* 198 */
			29 01 00 00 00 00 15 B8 0D F0 2E 24 46 BD 33 69 12 7A E0 08 08 08 03 02 03 02 03 02  /* 199 */
			29 01 00 00 00 00 15 B8 0D F0 2E 24 46 BD 33 69 12 7A E0 08 08 08 03 02 03 02 03 02  /* 200 */
			29 01 00 00 00 00 15 B8 0D F0 2E 24 46 BD 33 69 12 7A E0 08 08 08 03 02 03 02 03 02  /* 201 */
			29 01 00 00 00 00 15 B8 0D F0 2E 24 46 BD 33 69 12 7A E0 08 08 08 03 02 03 03 03 03  /* 202 */
			29 01 00 00 00 00 15 B8 0D F0 2E 24 46 BD 33 69 12 7A E0 08 08 08 03 03 03 03 02 03  /* 203 */
			29 01 00 00 00 00 15 B8 0D F0 2E 24 46 BD 33 69 12 7A E0 08 08 08 03 03 03 03 02 03  /* 204 */
			29 01 00 00 00 00 15 B8 0D F0 2E 24 46 BD 33 69 12 7A E0 08 08 08 03 03 03 03 02 03  /* 205 */
			29 01 00 00 00 00 15 B8 0D F0 2E 24 46 BD 33 69 12 7A E0 08 08 08 03 03 03 03 02 03  /* 206 */
			29 01 00 00 00 00 15 B8 0D F0 2E 24 46 BD 33 69 12 7A E0 08 08 08 03 03 03 03 02 03  /* 207 */
			29 01 00 00 00 00 15 B8 0D F0 2E 24 46 BD 33 69 12 7A E0 08 08 08 03 03 03 03 03 03  /* 208 */
			29 01 00 00 00 00 15 B8 0D F0 2E 24 46 BD 33 69 12 7A E0 08 08 08 03 03 03 03 03 03  /* 209 */
			29 01 00 00 00 00 15 B8 0D F0 2E 24 46 BD 33 69 12 7A E0 09 08 09 02 03 02 03 03 03  /* 210 */
			29 01 00 00 00 00 15 B8 0D F0 2E 24 46 BD 33 69 12 7A E0 09 08 09 02 03 02 03 03 03  /* 211 */
			29 01 00 00 00 00 15 B8 0D F0 2E 24 46 BD 33 69 12 7A E0 09 08 09 03 03 03 02 03 02  /* 212 */
			29 01 00 00 00 00 15 B8 0D F0 2E 24 46 BD 33 69 12 7A E0 09 08 09 03 03 03 03 03 03  /* 213 */
			29 01 00 00 00 00 15 B8 0D F0 2E 24 46 BD 33 69 12 7A E0 09 08 09 03 03 03 03 03 03  /* 214 */
			29 01 00 00 00 00 15 B8 0D F0 2E 24 46 BD 33 69 12 7A E0 09 09 09 03 02 03 03 03 03  /* 215 */
			29 01 00 00 00 00 15 B8 0D F0 2E 24 46 BD 33 69 12 7A E0 09 09 09 03 03 03 03 02 03  /* 216 */
			29 01 00 00 00 00 15 B8 0D F0 2E 24 46 BD 33 69 12 7A E0 09 09 09 03 03 03 03 02 03  /* 217 */
			29 01 00 00 00 00 15 B8 0D F0 2E 24 46 BD 33 69 12 7A E0 09 09 09 03 03 03 03 03 03  /* 218 */
			29 01 00 00 00 00 15 B8 0D F0 2E 24 46 BD 33 69 12 7A E0 09 09 09 03 03 03 03 03 03  /* 219 */
			29 01 00 00 00 00 15 B8 0D F0 2E 24 46 BD 33 69 12 7A E0 09 09 09 03 03 03 03 03 03  /* 220 */
			29 01 00 00 00 00 15 B8 0D F0 2E 24 46 BD 33 69 12 7A E0 09 09 09 03 03 03 04 03 04  /* 221 */
			29 01 00 00 00 00 15 B8 0D F0 2E 24 46 BD 33 69 12 7A E0 09 09 09 04 03 04 03 03 03  /* 222 */
			29 01 00 00 00 00 15 B8 0D F0 2E 24 46 BD 33 69 12 7A E0 09 09 09 04 03 04 03 03 03  /* 223 */
			29 01 00 00 00 00 15 B8 0D F0 2E 24 46 BD 33 69 12 7A E0 0A 09 0A 03 03 03 03 03 03  /* 224 */
			29 01 00 00 00 00 15 B8 0D F0 2E 24 46 BD 33 69 12 7A E0 0A 09 0A 03 03 03 03 03 03  /* 225 */
			29 01 00 00 00 00 15 B8 0D F0 2E 24 46 BD 33 69 12 7A E0 0A 09 0A 03 04 03 03 03 03  /* 226 */
			29 01 00 00 00 00 15 B8 0D F0 2E 24 46 BD 33 69 12 7A E0 0A 09 0A 03 04 03 03 03 03  /* 227 */
			29 01 00 00 00 00 15 B8 0D F0 2E 24 46 BD 33 69 12 7A E0 0A 0A 0A 03 03 03 04 03 04  /* 228 */
			29 01 00 00 00 00 15 B8 0D F0 2E 24 46 BD 33 69 12 7A E0 0A 0A 0A 03 03 03 04 03 04  /* 229 */
			29 01 00 00 00 00 15 B8 0D F0 2E 24 46 BD 33 69 12 7A E0 0A 0A 0A 03 03 03 04 03 04  /* 230 */
			29 01 00 00 00 00 15 B8 0D F0 2E 24 46 BD 33 69 12 7A E0 0A 0A 0A 04 03 04 03 03 03  /* 231 */
			29 01 00 00 00 00 15 B8 0D F0 2E 24 46 BD 33 69 12 7A E0 0A 0A 0A 04 03 04 03 03 03  /* 232 */
			29 01 00 00 00 00 15 B8 0D F0 2E 24 46 BD 33 69 12 7A E0 0A 0A 0A 04 03 04 03 04 03  /* 233 */
			29 01 00 00 00 00 15 B8 0D F0 2E 24 46 BD 33 69 12 7A E0 0A 0A 0A 04 03 04 03 04 03  /* 234 */
			29 01 00 00 00 00 15 B8 0D F0 2E 24 46 BD 33 69 12 7A E0 0A 0A 0A 04 03 04 03 04 03  /* 235 */
			29 01 00 00 00 00 15 B8 0D F0 2E 24 46 BD 33 69 12 7A E0 0B 0A 0B 03 04 03 04 03 04  /* 236 */
			29 01 00 00 00 00 15 B8 0D F0 2E 24 46 BD 33 69 12 7A E0 0B 0A 0B 03 04 03 04 03 04  /* 237 */
			29 01 00 00 00 00 15 B8 0D F0 2E 24 46 BD 33 69 12 7A E0 0B 0A 0B 03 04 03 04 03 04  /* 238 */
			29 01 00 00 00 00 15 B8 0D F0 2E 24 46 BD 33 69 12 7A E0 0B 0A 0B 03 04 03 04 03 04  /* 239 */
			29 01 00 00 00 00 15 B8 0D F0 2E 24 46 BD 33 69 12 7A E0 0B 0B 0B 04 03 04 03 03 03  /* 240 */
			29 01 00 00 00 00 15 B8 0D F0 2E 24 46 BD 33 69 12 7A E0 0B 0B 0B 04 03 04 03 04 03  /* 241 */
			29 01 00 00 00 00 15 B8 0D F0 2E 24 46 BD 33 69 12 7A E0 0B 0B 0B 04 03 04 03 04 03  /* 242 */
			29 01 00 00 00 00 15 B8 0D F0 2E 24 46 BD 33 69 12 7A E0 0B 0B 0B 04 03 04 04 04 04  /* 243 */
			29 01 00 00 00 00 15 B8 0D F0 2E 24 46 BD 33 69 12 7A E0 0B 0B 0B 04 04 04 04 03 04  /* 244 */
			29 01 00 00 00 00 15 B8 0D F0 2E 24 46 BD 33 69 12 7A E0 0B 0B 0B 04 04 04 04 03 04  /* 245 */
			29 01 00 00 00 00 15 B8 0D F0 2E 24 46 BD 33 69 12 7A E0 0B 0B 0B 04 04 04 04 03 04  /* 246 */
			29 01 00 00 00 00 15 B8 0D F0 2E 24 46 BD 33 69 12 7A E0 0C 0B 0C 03 04 03 04 03 04  /* 247 */
			29 01 00 00 00 00 15 B8 0D F0 2E 24 46 BD 33 69 12 7A E0 0C 0B 0C 04 04 04 03 04 03  /* 248 */
			29 01 00 00 00 00 15 B8 0D F0 2E 24 46 BD 33 69 12 7A E0 0C 0B 0C 04 04 04 04 04 04  /* 249 */
			29 01 00 00 00 00 15 B8 0D F0 2E 24 46 BD 33 69 12 7A E0 0C 0B 0C 04 04 04 04 04 04  /* 250 */
			29 01 00 00 00 00 15 B8 0D F0 2E 24 46 BD 33 69 12 7A E0 0C 0B 0C 04 04 04 04 04 04  /* 251 */
			29 01 00 00 00 00 15 B8 0D F0 2E 24 46 BD 33 69 12 7A E0 0C 0C 0C 04 03 04 04 04 04  /* 252 */
			29 01 00 00 00 00 15 B8 0D F0 2E 24 46 BD 33 69 12 7A E0 0C 0C 0C 04 04 04 04 03 04  /* 253 */
			29 01 00 00 00 00 15 B8 0D F0 2E 24 46 BD 33 69 12 7A E0 0C 0C 0C 04 04 04 04 04 04  /* 254 */
			29 01 00 00 00 00 15 B8 0D F0 2E 24 46 BD 33 69 12 7A E0 0C 0C 0C 05 04 05 04 04 04  /* 255 */
			29 01 00 00 00 00 15 B8 0D F0 2E 24 46 BD 33 69 12 7A E0 0C 0C 0C 05 04 05 04 04 04  /* 256 */
			29 01 00 00 00 00 15 B8 0D F0 2E 24 46 BD 33 69 12 7A E0 0D 0C 0D 04 04 04 04 04 04  /* 257 */
			29 01 00 00 00 00 15 B8 0D F0 2E 24 46 BD 33 69 12 7A E0 0D 0C 0D 04 04 04 04 04 04  /* 258 */
			29 01 00 00 00 00 15 B8 0D F0 2E 24 46 BD 33 69 12 7A E0 0D 0C 0D 04 05 04 04 04 04  /* 259 */
			29 01 00 00 00 00 15 B8 0D F0 2E 24 46 BD 33 69 12 7A E0 0D 0D 0D 04 04 04 05 04 05  /* 260 */
			29 01 00 00 00 00 15 B8 0D F0 2E 24 46 BD 33 69 12 7A E0 0D 0D 0D 04 04 04 05 04 05  /* 261 */
			29 01 00 00 00 00 15 B8 0D F0 2E 24 46 BD 33 69 12 7A E0 0D 0D 0D 05 04 05 04 04 04  /* 262 */
			29 01 00 00 00 00 15 B8 0D F0 2E 24 46 BD 33 69 12 7A E0 0D 0D 0D 05 04 05 04 04 04  /* 263 */
			29 01 00 00 00 00 15 B8 0D F0 2E 24 46 BD 33 69 12 7A E0 0D 0D 0D 05 04 05 05 05 05  /* 264 */
			29 01 00 00 00 00 15 B8 0D F0 2E 24 46 BD 33 69 12 7A E0 0E 0D 0E 04 05 04 05 04 05  /* 265 */
			29 01 00 00 00 00 15 B8 0D F0 2E 24 46 BD 33 69 12 7A E0 0E 0D 0E 04 05 04 05 04 05  /* 266 */
			29 01 00 00 00 00 15 B8 0D F0 2E 24 46 BD 33 69 12 7A E0 0E 0D 0E 04 05 04 05 04 05  /* 267 */
			29 01 00 00 00 00 15 B8 0D F0 2E 24 46 BD 33 69 12 7A E0 0E 0D 0E 05 05 05 04 04 04  /* 268 */
			29 01 00 00 00 00 15 B8 0D F0 2E 24 46 BD 33 69 12 7A E0 0E 0E 0E 05 04 05 05 05 05  /* 269 */
			29 01 00 00 00 00 15 B8 0D F0 2E 24 46 BD 33 69 12 7A E0 0E 0E 0E 05 04 05 05 05 05  /* 270 */
			29 01 00 00 00 00 15 B8 0D F0 2E 24 46 BD 33 69 12 7A E0 0E 0E 0E 05 04 05 05 05 05  /* 271 */
			29 01 00 00 00 00 15 B8 0D F0 2E 24 46 BD 33 69 12 7A E0 0E 0E 0E 05 05 05 05 04 05  /* 272 */
			29 01 00 00 00 00 15 B8 0D F0 2E 24 46 BD 33 69 12 7A E0 0F 0E 0F 04 05 04 05 04 05  /* 273 */
			29 01 00 00 00 00 15 B8 0D F0 2E 24 46 BD 33 69 12 7A E0 0F 0E 0F 05 05 05 05 05 05  /* 274 */
			29 01 00 00 00 00 15 B8 0D F0 2E 24 46 BD 33 69 12 7A E0 0F 0E 0F 05 05 05 05 05 05  /* 275 */
			29 01 00 00 00 00 15 B8 0D F0 2E 24 46 BD 33 69 12 7A E0 0F 0E 0F 05 05 05 05 05 05  /* 276 */
			29 01 00 00 00 00 15 B8 0D F0 2E 24 46 BD 33 69 12 7A E0 0F 0F 0F 05 04 05 05 05 05  /* 277 */
			29 01 00 00 00 00 15 B8 0D F0 2E 24 46 BD 33 69 12 7A E0 0F 0F 0F 05 05 05 05 04 05  /* 278 */
			29 01 00 00 00 00 15 B8 0D F0 2E 24 46 BD 33 69 12 7A E0 0F 0F 0F 05 05 05 06 05 06  /* 279 */
			29 01 00 00 00 00 15 B8 0D F0 2E 24 46 BD 33 69 12 7A E0 0F 0F 0F 06 05 06 05 05 05  /* 280 */
			29 01 00 00 00 00 15 B8 0D F0 2E 24 46 BD 33 69 12 7A E0 10 0F 10 05 05 05 05 05 05  /* 281 */
			29 01 00 00 00 00 15 B8 0D F0 2E 24 46 BD 33 69 12 7A E0 10 0F 10 05 05 05 05 05 05  /* 282 */
			29 01 00 00 00 00 15 B8 0D F0 2E 24 46 BD 33 69 12 7A E0 10 0F 10 05 05 05 06 05 06  /* 283 */
			29 01 00 00 00 00 15 B8 0D F0 2E 24 46 BD 33 69 12 7A E0 10 0F 10 05 06 05 06 05 06  /* 284 */
			29 01 00 00 00 00 15 B8 0D F0 2E 24 46 BD 33 69 12 7A E0 10 10 10 06 05 06 05 05 05  /* 285 */
			29 01 00 00 00 00 15 B8 0D F0 2E 24 46 BD 33 69 12 7A E0 10 10 10 06 05 06 05 05 05  /* 286 */
			29 01 00 00 00 00 15 B8 0D F0 2E 24 46 BD 33 69 12 7A E0 10 10 10 06 05 06 06 05 06  /* 287 */
			29 01 00 00 00 00 15 B8 0D F0 2E 24 46 BD 33 69 12 7A E0 11 10 11 05 05 05 06 06 06  /* 288 */
			29 01 00 00 00 00 15 B8 0D F0 2E 24 46 BD 33 69 12 7A E0 11 10 11 05 06 05 06 05 06  /* 289 */
			29 01 00 00 00 00 15 B8 0D F0 2E 24 46 BD 33 69 12 7A E0 11 10 11 06 06 06 05 05 05  /* 290 */
			29 01 00 00 00 00 15 B8 0D F0 2E 24 46 BD 33 69 12 7A E0 11 10 11 06 06 06 06 05 06  /* 291 */
			29 01 00 00 00 00 15 B8 0D F0 2E 24 46 BD 33 69 12 7A E0 11 11 11 06 05 06 06 06 06  /* 292 */
			29 01 00 00 00 00 15 B8 0D F0 2E 24 46 BD 33 69 12 7A E0 11 11 11 06 05 06 06 06 06  /* 293 */
			29 01 00 00 00 00 15 B8 0D F0 2E 24 46 BD 33 69 12 7A E0 12 11 12 05 06 05 06 05 06  /* 294 */
			29 01 00 00 00 00 15 B8 0D F0 2E 24 46 BD 33 69 12 7A E0 12 11 12 06 06 06 06 05 06  /* 295 */
			29 01 00 00 00 00 15 B8 0D F0 2E 24 46 BD 33 69 12 7A E0 12 11 12 06 06 06 06 06 06  /* 296 */
			29 01 00 00 00 00 15 B8 0D F0 2E 24 46 BD 33 69 12 7A E0 12 11 12 06 06 06 06 06 06  /* 297 */
			29 01 00 00 00 00 15 B8 0D F0 2E 24 46 BD 33 69 12 7A E0 12 12 12 06 05 06 06 06 06  /* 298 */
			29 01 00 00 00 00 15 B8 0D F0 2E 24 46 BD 33 69 12 7A E0 12 12 12 06 06 06 07 05 07  /* 299 */
			29 01 00 00 00 00 15 B8 0D F0 2E 24 46 BD 33 69 12 7A E0 12 12 12 07 06 07 06 06 06  /* 300 */
			29 01 00 00 00 00 15 B8 0D F0 2E 24 46 BD 33 69 12 7A E0 13 12 13 06 06 06 06 06 06  /* 301 */
			29 01 00 00 00 00 15 B8 0D F0 2E 24 46 BD 33 69 12 7A E0 13 12 13 06 06 06 06 06 06  /* 302 */
			29 01 00 00 00 00 15 B8 0D F0 2E 24 46 BD 33 69 12 7A E0 13 12 13 06 07 06 07 05 07  /* 303 */
			29 01 00 00 00 00 15 B8 0D F0 2E 24 46 BD 33 69 12 7A E0 13 13 13 07 06 07 06 06 06  /* 304 */
			29 01 00 00 00 00 15 B8 0D F0 2E 24 46 BD 33 69 12 7A E0 13 13 13 07 06 07 06 06 06  /* 305 */
			29 01 00 00 00 00 15 B8 0D F0 2E 24 46 BD 33 69 12 7A E0 14 13 14 06 06 06 07 06 07  /* 306 */
			29 01 00 00 00 00 15 B8 0D F0 2E 24 46 BD 33 69 12 7A E0 14 13 14 06 06 06 07 07 07  /* 307 */
			29 01 00 00 00 00 15 B8 0D F0 2E 24 46 BD 33 69 12 7A E0 14 13 14 07 07 07 06 06 06  /* 308 */
			29 01 00 00 00 00 15 B8 0D F0 2E 24 46 BD 33 69 12 7A E0 14 13 14 07 07 07 06 06 06  /* 309 */
			29 01 00 00 00 00 15 B8 0D F0 2E 24 46 BD 33 69 12 7A E0 14 13 14 07 07 07 07 06 07  /* 310 */
			29 01 00 00 00 00 15 B8 0D F0 2E 24 46 BD 33 69 12 7A E0 14 14 14 07 06 07 07 07 07  /* 311 */
			29 01 00 00 00 00 15 B8 0D F0 2E 24 46 BD 33 69 12 7A E0 14 14 14 07 06 07 07 07 07  /* 312 */
			29 01 00 00 00 00 15 B8 0D F0 2E 24 46 BD 33 69 12 7A E0 15 14 15 07 07 07 07 06 07  /* 313 */
			29 01 00 00 00 00 15 B8 0D F0 2E 24 46 BD 33 69 12 7A E0 15 14 15 07 07 07 07 06 07  /* 314 */
			29 01 00 00 00 00 15 B8 0D F0 2E 24 46 BD 33 69 12 7A E0 15 14 15 07 07 07 07 07 07  /* 315 */
			29 01 00 00 00 00 15 B8 0D F0 2E 24 46 BD 33 69 12 7A E0 15 14 15 07 07 07 07 07 07  /* 316 */
			29 01 00 00 00 00 15 B8 0D F0 2E 24 46 BD 33 69 12 7A E0 15 15 15 08 07 08 07 06 07  /* 317 */
			29 01 00 00 00 00 15 B8 0D F0 2E 24 46 BD 33 69 12 7A E0 16 15 16 07 07 07 07 07 07  /* 318 */
			29 01 00 00 00 00 15 B8 0D F0 2E 24 46 BD 33 69 12 7A E0 16 15 16 07 07 07 08 07 08  /* 319 */
			29 01 00 00 00 00 15 B8 0D F0 2E 24 46 BD 33 69 12 7A E0 16 15 16 07 07 07 08 07 08  /* 320 */
			29 01 00 00 00 00 15 B8 0D F0 2E 24 46 BD 33 69 12 7A E0 16 16 16 08 07 08 07 07 07  /* 321 */
			29 01 00 00 00 00 15 B8 0D F0 2E 24 46 BD 33 69 12 7A E0 16 16 16 08 07 08 08 07 08  /* 322 */
			29 01 00 00 00 00 15 B8 0D F0 2E 24 46 BD 33 69 12 7A E0 17 16 17 07 07 07 08 07 08  /* 323 */
			29 01 00 00 00 00 15 B8 0D F0 2E 24 46 BD 33 69 12 7A E0 17 16 17 07 07 07 08 08 08  /* 324 */
			29 01 00 00 00 00 15 B8 0D F0 2E 24 46 BD 33 69 12 7A E0 17 16 17 08 08 08 07 07 07  /* 325 */
			29 01 00 00 00 00 15 B8 0D F0 2E 24 46 BD 33 69 12 7A E0 17 16 17 08 08 08 08 07 08  /* 326 */
			29 01 00 00 00 00 15 B8 0D F0 2E 24 46 BD 33 69 12 7A E0 17 17 17 08 07 08 08 08 08  /* 327 */
			29 01 00 00 00 00 15 B8 0D F0 2E 24 46 BD 33 69 12 7A E0 18 17 18 07 07 07 08 08 08  /* 328 */
			29 01 00 00 00 00 15 B8 0D F0 2E 24 46 BD 33 69 12 7A E0 18 17 18 08 08 08 08 07 08  /* 329 */
			29 01 00 00 00 00 15 B8 0D F0 2E 24 46 BD 33 69 12 7A E0 18 17 18 08 08 08 08 08 08  /* 330 */
			29 01 00 00 00 00 15 B8 0D F0 2E 24 46 BD 33 69 12 7A E0 18 17 18 08 08 08 09 08 09  /* 331 */
			29 01 00 00 00 00 15 B8 0D F0 2E 24 46 BD 33 69 12 7A E0 18 18 18 09 08 09 08 07 08  /* 332 */
			29 01 00 00 00 00 15 B8 0D F0 2E 24 46 BD 33 69 12 7A E0 19 18 19 08 08 08 08 08 08  /* 333 */
			29 01 00 00 00 00 15 B8 0D F0 2E 24 46 BD 33 69 12 7A E0 19 18 19 08 08 08 09 08 09  /* 334 */
			29 01 00 00 00 00 15 B8 0D F0 2E 24 46 BD 33 69 12 7A E0 19 18 19 09 09 09 08 08 08  /* 335 */
			29 01 00 00 00 00 15 B8 0D F0 2E 24 46 BD 33 69 12 7A E0 19 19 19 09 08 09 09 08 09  /* 336 */
			29 01 00 00 00 00 15 B8 0D F0 2E 24 46 BD 33 69 12 7A E0 1A 19 1A 08 08 08 09 08 09  /* 337 */
			29 01 00 00 00 00 15 B8 0D F0 2E 24 46 BD 33 69 12 7A E0 1A 19 1A 09 08 09 08 09 08  /* 338 */
			29 01 00 00 00 00 15 B8 0D F0 2E 24 46 BD 33 69 12 7A E0 1A 19 1A 09 09 09 09 08 09  /* 339 */
			29 01 00 00 00 00 15 B8 0D F0 2E 24 46 BD 33 69 12 7A E0 1A 19 1A 09 09 09 09 08 09  /* 340 */
			29 01 00 00 00 00 15 B8 0D F0 2E 24 46 BD 33 69 12 7A E0 1A 1A 1A 09 08 09 09 09 09  /* 341 */
			29 01 00 00 00 00 15 B8 0D F0 2E 24 46 BD 33 69 12 7A E0 1B 1A 1B 09 09 09 09 08 09  /* 342 */
			29 01 00 00 00 00 15 B8 0D F0 2E 24 46 BD 33 69 12 7A E0 1B 1A 1B 09 09 09 09 08 09  /* 343 */
			29 01 00 00 00 00 15 B8 0D F0 2E 24 46 BD 33 69 12 7A E0 1B 1A 1B 09 09 09 0A 09 0A  /* 344 */
			29 01 00 00 00 00 15 B8 0D F0 2E 24 46 BD 33 69 12 7A E0 1B 1B 1B 0A 08 0A 09 09 09  /* 345 */
			29 01 00 00 00 00 15 B8 0D F0 2E 24 46 BD 33 69 12 7A E0 1C 1B 1C 09 09 09 09 08 09  /* 346 */
			29 01 00 00 00 00 15 B8 0D F0 2E 24 46 BD 33 69 12 7A E0 1C 1B 1C 09 09 09 0A 09 0A  /* 347 */
			29 01 00 00 00 00 15 B8 0D F0 2E 24 46 BD 33 69 12 7A E0 1C 1B 1C 0A 09 0A 09 09 09  /* 348 */
			29 01 00 00 00 00 15 B8 0D F0 2E 24 46 BD 33 69 12 7A E0 1C 1B 1C 0A 0A 0A 0A 09 0A  /* 349 */
			29 01 00 00 00 00 15 B8 0D F0 2E 24 46 BD 33 69 12 7A E0 1D 1C 1D 09 09 09 0A 09 0A  /* 350 */
			29 01 00 00 00 00 15 B8 0D F0 2E 24 46 BD 33 69 12 7A E0 1D 1C 1D 0A 09 0A 09 09 09  /* 351 */
			29 01 00 00 00 00 15 B8 0D F0 2E 24 46 BD 33 69 12 7A E0 1D 1C 1D 0A 0A 0A 0A 09 0A  /* 352 */
			29 01 00 00 00 00 15 B8 0D F0 2E 24 46 BD 33 69 12 7A E0 1D 1C 1D 0A 0A 0A 0A 09 0A  /* 353 */
			29 01 00 00 00 00 15 B8 0D F0 2E 24 46 BD 33 69 12 7A E0 1E 1D 1E 0A 09 0A 0A 0A 0A  /* 354 */
			29 01 00 00 00 00 15 B8 0D F0 2E 24 46 BD 33 69 12 7A E0 1E 1D 1E 0A 0A 0A 0A 09 0A  /* 355 */
			29 01 00 00 00 00 15 B8 0D F0 2E 24 46 BD 33 69 12 7A E0 1E 1D 1E 0B 0A 0B 0A 0A 0A  /* 356 */
			29 01 00 00 00 00 15 B8 0D F0 2E 24 46 BD 33 69 12 7A E0 1F 1E 1F 0A 0A 0A 0A 09 0A  /* 357 */
			29 01 00 00 00 00 15 B8 0D F0 2E 24 46 BD 33 69 12 7A E0 1F 1E 1F 0A 0A 0A 0B 0A 0B  /* 358 */
			29 01 00 00 00 00 15 B8 0D F0 2E 24 46 BD 33 69 12 7A E0 1F 1E 1F 0B 0A 0B 0A 0A 0A  /* 359 */
			29 01 00 00 00 00 15 B8 0D F0 2E 24 46 BD 33 69 12 7A E0 1F 1E 1F 0B 0B 0B 0B 09 0B  /* 360 */
			29 01 00 00 00 00 15 B8 0D F0 2E 24 46 BD 33 69 12 7A E0 20 1F 20 0A 0A 0A 0B 0A 0B  /* 361 */
			29 01 00 00 00 00 15 B8 0D F0 2E 24 46 BD 33 69 12 7A E0 20 1F 20 0B 0A 0B 0A 0A 0A  /* 362 */
			29 01 00 00 00 00 15 B8 0D F0 2E 24 46 BD 33 69 12 7A E0 20 1F 20 0B 0B 0B 0B 0A 0B  /* 363 */
			29 01 00 00 00 00 15 B8 0D F0 2E 24 46 BD 33 69 12 7A E0 21 1F 21 0A 0B 0A 0B 0A 0B  /* 364 */
			29 01 00 00 00 00 15 B8 0D F0 2E 24 46 BD 33 69 12 7A E0 21 20 21 0B 0A 0B 0B 0B 0B  /* 365 */
			29 01 00 00 00 00 15 B8 0D F0 2E 24 46 BD 33 69 12 7A E0 21 20 21 0B 0B 0B 0B 0A 0B  /* 366 */
			29 01 00 00 00 00 15 B8 0D F0 2E 24 46 BD 33 69 12 7A E0 21 20 21 0C 0B 0C 0B 0B 0B  /* 367 */
			29 01 00 00 00 00 15 B8 0D F0 2E 24 46 BD 33 69 12 7A E0 22 21 22 0B 0B 0B 0B 0A 0B  /* 368 */
			29 01 00 00 00 00 15 B8 0D F0 2E 24 46 BD 33 69 12 7A E0 22 21 22 0B 0B 0B 0C 0B 0C  /* 369 */
			29 01 00 00 00 00 15 B8 0D F0 2E 24 46 BD 33 69 12 7A E0 22 21 22 0C 0B 0C 0B 0B 0B  /* 370 */
			29 01 00 00 00 00 15 B8 0D F0 2E 24 46 BD 33 69 12 7A E0 23 21 23 0B 0C 0B 0C 0B 0C  /* 371 */
			29 01 00 00 00 00 15 B8 0D F0 2E 24 46 BD 33 69 12 7A E0 23 22 23 0C 0B 0C 0B 0B 0B  /* 372 */
			29 01 00 00 00 00 15 B8 0D F0 2E 24 46 BD 33 69 12 7A E0 23 22 23 0C 0C 0C 0C 0B 0C  /* 373 */
			29 01 00 00 00 00 15 B8 0D F0 2E 24 46 BD 33 69 12 7A E0 24 22 24 0C 0C 0C 0B 0B 0B  /* 374 */
			29 01 00 00 00 00 15 B8 0D F0 2E 24 46 BD 33 69 12 7A E0 24 23 24 0C 0B 0C 0C 0C 0C  /* 375 */
			29 01 00 00 00 00 15 B8 0D F0 2E 24 46 BD 33 69 12 7A E0 24 23 24 0C 0C 0C 0D 0B 0D  /* 376 */
			29 01 00 00 00 00 15 B8 0D F0 2E 24 46 BD 33 69 12 7A E0 24 23 24 0D 0C 0D 0C 0C 0C  /* 377 */
			29 01 00 00 00 00 15 B8 0D F0 2E 24 46 BD 33 69 12 7A E0 25 24 25 0C 0C 0C 0D 0B 0D  /* 378 */
			29 01 00 00 00 00 15 B8 0D F0 2E 24 46 BD 33 69 12 7A E0 25 24 25 0D 0C 0D 0C 0C 0C  /* 379 */
			29 01 00 00 00 00 15 B8 0D F0 2E 24 46 BD 33 69 12 7A E0 25 24 25 0D 0C 0D 0D 0C 0D  /* 380 */
			29 01 00 00 00 00 15 B8 0D F0 2E 24 46 BD 33 69 12 7A E0 26 25 26 0D 0C 0D 0C 0C 0C  /* 381 */
			29 01 00 00 00 00 15 B8 0D F0 2E 24 46 BD 33 69 12 7A E0 26 25 26 0D 0C 0D 0D 0C 0D  /* 382 */
			29 01 00 00 00 00 15 B8 0D F0 2E 24 46 BD 33 69 12 7A E0 26 25 26 0D 0D 0D 0D 0C 0D  /* 383 */
			29 01 00 00 00 00 15 B8 0D F0 2E 24 46 BD 33 69 12 7A E0 27 25 27 0D 0D 0D 0D 0C 0D  /* 384 */
			29 01 00 00 00 00 15 B8 0D F0 2E 24 46 BD 33 69 12 7A E0 27 26 27 0D 0D 0D 0E 0C 0E  /* 385 */
			29 01 00 00 00 00 15 B8 0D F0 2E 24 46 BD 33 69 12 7A E0 28 26 28 0D 0D 0D 0D 0C 0D  /* 386 */
			29 01 00 00 00 00 15 B8 0D F0 2E 24 46 BD 33 69 12 7A E0 28 27 28 0D 0D 0D 0E 0C 0E  /* 387 */
			29 01 00 00 00 00 15 B8 0D F0 2E 24 46 BD 33 69 12 7A E0 28 27 28 0E 0D 0E 0D 0D 0D  /* 388 */
			29 01 00 00 00 00 15 B8 0D F0 2E 24 46 BD 33 69 12 7A E0 29 27 29 0D 0D 0D 0E 0D 0E  /* 389 */
			29 01 00 00 00 00 15 B8 0D F0 2E 24 46 BD 33 69 12 7A E0 29 28 29 0E 0D 0E 0E 0D 0E  /* 390 */
			29 01 00 00 00 00 15 B8 0D F0 2E 24 46 BD 33 69 12 7A E0 29 28 29 0E 0D 0E 0E 0D 0E  /* 391 */
			29 01 00 00 00 00 15 B8 0D F0 2E 24 46 BD 33 69 12 7A E0 2A 28 2A 0E 0E 0E 0E 0D 0E  /* 392 */
			29 01 00 00 00 00 15 B8 0D F0 2E 24 46 BD 33 69 12 7A E0 2A 29 2A 0E 0D 0E 0E 0E 0E  /* 393 */
			29 01 00 00 00 00 15 B8 0D F0 2E 24 46 BD 33 69 12 7A E0 2A 29 2A 0F 0E 0F 0E 0D 0E  /* 394 */
			29 01 00 00 00 00 15 B8 0D F0 2E 24 46 BD 33 69 12 7A E0 2B 29 2B 0E 0E 0E 0F 0E 0F  /* 395 */
			29 01 00 00 00 00 15 B8 0D F0 2E 24 46 BD 33 69 12 7A E0 2B 2A 2B 0F 0E 0F 0E 0D 0E  /* 396 */
			29 01 00 00 00 00 15 B8 0D F0 2E 24 46 BD 33 69 12 7A E0 2C 2A 2C 0E 0E 0E 0F 0E 0F  /* 397 */
			29 01 00 00 00 00 15 B8 0D F0 2E 24 46 BD 33 69 12 7A E0 2C 2A 2C 0F 0F 0F 0E 0D 0E  /* 398 */
			29 01 00 00 00 00 15 B8 0D F0 2E 24 46 BD 33 69 12 7A E0 2C 2B 2C 0F 0E 0F 0F 0E 0F  /* 399 */
			29 01 00 00 00 00 15 B8 0D F0 2E 24 46 BD 33 69 12 7A E0 2D 2B 2D 0F 0F 0F 0F 0E 0F  /* 400 */
			29 01 00 00 00 00 15 B8 0D F0 2E 24 46 BD 33 69 12 7A E0 2D 2C 2D 0F 0E 0F 0F 0E 0F  /* 401 */
			29 01 00 00 00 00 15 B8 0D F0 2E 24 46 BD 33 69 12 7A E0 2D 2C 2D 10 0F 10 0F 0E 0F  /* 402 */
			29 01 00 00 00 00 15 B8 0D F0 2E 24 46 BD 33 69 12 7A E0 2E 2C 2E 0F 0F 0F 10 0F 10  /* 403 */
			29 01 00 00 00 00 15 B8 0D F0 2E 24 46 BD 33 69 12 7A E0 2E 2D 2E 10 0F 10 0F 0E 0F  /* 404 */
			29 01 00 00 00 00 15 B8 0D F0 2E 24 46 BD 33 69 12 7A E0 2F 2D 2F 0F 0F 0F 10 0F 10  /* 405 */
			29 01 00 00 00 00 15 B8 0D F0 2E 24 46 BD 33 69 12 7A E0 2F 2D 2F 10 10 10 10 0F 10  /* 406 */
			29 01 00 00 00 00 15 B8 0D F0 2E 24 46 BD 33 69 12 7A E0 2F 2E 2F 10 0F 10 10 0F 10  /* 407 */
			29 01 00 00 00 00 15 B8 0D F0 2E 24 46 BD 33 69 12 7A E0 30 2E 30 10 10 10 10 0F 10  /* 408 */
			29 01 00 00 00 00 15 B8 0D F0 2E 24 46 BD 33 69 12 7A E0 30 2E 30 10 10 10 11 0F 11  /* 409 */
			29 01 00 00 00 00 15 B8 0D F0 2E 24 46 BD 33 69 12 7A E0 30 2F 30 11 10 11 10 0F 10  /* 410 */
			29 01 00 00 00 00 15 B8 0D F0 2E 24 46 BD 33 69 12 7A E0 31 2F 31 10 10 10 11 0F 11  /* 411 */
			29 01 00 00 00 00 15 B8 0D F0 2E 24 46 BD 33 69 12 7A E0 31 30 31 11 10 11 10 0F 10  /* 412 */
			29 01 00 00 00 00 15 B8 0D F0 2E 24 46 BD 33 69 12 7A E0 32 30 32 10 10 10 11 10 11  /* 413 */
			29 01 00 00 00 00 15 B8 0D F0 2E 24 46 BD 33 69 12 7A E0 32 30 32 11 11 11 11 0F 11  /* 414 */
			29 01 00 00 00 00 15 B8 0D F0 2E 24 46 BD 33 69 12 7A E0 32 31 32 11 10 11 11 10 11  /* 415 */
			29 01 00 00 00 00 15 B8 0D F0 2E 24 46 BD 33 69 12 7A E0 33 31 33 11 11 11 11 10 11  /* 416 */
			29 01 00 00 00 00 15 B8 0D F0 2E 24 46 BD 33 69 12 7A E0 33 31 33 11 11 11 12 10 12  /* 417 */
			29 01 00 00 00 00 15 B8 0D F0 2E 24 46 BD 33 69 12 7A E0 34 32 34 11 11 11 11 10 11  /* 418 */
			29 01 00 00 00 00 15 B8 0D F0 2E 24 46 BD 33 69 12 7A E0 34 32 34 11 11 11 12 11 12  /* 419 */
			29 01 00 00 00 00 15 B8 0D F0 2E 24 46 BD 33 69 12 7A E0 34 33 34 12 11 12 12 10 12  /* 420 */
			29 01 00 00 00 00 15 B8 0D F0 2E 24 46 BD 33 69 12 7A E0 35 33 35 12 11 12 11 11 11  /* 421 */
			29 01 00 00 00 00 15 B8 0D F0 2E 24 46 BD 33 69 12 7A E0 35 33 35 12 12 12 12 10 12  /* 422 */
			29 01 00 00 00 00 15 B8 0D F0 2E 24 46 BD 33 69 12 7A E0 36 34 36 12 11 12 12 11 12  /* 423 */
			29 01 00 00 00 00 15 B8 0D F0 2E 24 46 BD 33 69 12 7A E0 36 34 36 12 12 12 12 11 12  /* 424 */
			29 01 00 00 00 00 15 B8 0D F0 2E 24 46 BD 33 69 12 7A E0 36 34 36 13 12 13 12 11 12  /* 425 */
			29 01 00 00 00 00 15 B8 0D F0 2E 24 46 BD 33 69 12 7A E0 37 35 37 12 12 12 12 11 12  /* 426 */
			29 01 00 00 00 00 15 B8 0D F0 2E 24 46 BD 33 69 12 7A E0 37 35 37 13 12 13 12 11 12  /* 427 */
			29 01 00 00 00 00 15 B8 0D F0 2E 24 46 BD 33 69 12 7A E0 37 36 37 13 12 13 13 11 13  /* 428 */
			29 01 00 00 00 00 15 B8 0D F0 2E 24 46 BD 33 69 12 7A E0 38 36 38 13 12 13 12 12 12  /* 429 */
			29 01 00 00 00 00 15 B8 0D F0 2E 24 46 BD 33 69 12 7A E0 38 36 38 13 13 13 13 11 13  /* 430 */
			29 01 00 00 00 00 15 B8 0D F0 2E 24 46 BD 33 69 12 7A E0 39 37 39 13 12 13 13 12 13  /* 431 */
			29 01 00 00 00 00 15 B8 0D F0 2E 24 46 BD 33 69 12 7A E0 39 37 39 13 13 13 13 12 13  /* 432 */
			29 01 00 00 00 00 15 B8 0D F0 2E 24 46 BD 33 69 12 7A E0 39 37 39 14 13 14 13 12 13  /* 433 */
			29 01 00 00 00 00 15 B8 0D F0 2E 24 46 BD 33 69 12 7A E0 3A 38 3A 13 13 13 14 12 14  /* 434 */
			29 01 00 00 00 00 15 B8 0D F0 2E 24 46 BD 33 69 12 7A E0 3A 38 3A 14 13 14 13 12 13  /* 435 */
			29 01 00 00 00 00 15 B8 0D F0 2E 24 46 BD 33 69 12 7A E0 3B 39 3B 13 13 13 14 12 14  /* 436 */
			29 01 00 00 00 00 15 B8 0D F0 2E 24 46 BD 33 69 12 7A E0 3B 39 3B 14 13 14 14 13 14  /* 437 */
			29 01 00 00 00 00 15 B8 0D F0 2E 24 46 BD 33 69 12 7A E0 3B 39 3B 14 14 14 14 12 14  /* 438 */
			29 01 00 00 00 00 15 B8 0D F0 2E 24 46 BD 33 69 12 7A E0 3C 3A 3C 14 13 14 14 13 14  /* 439 */
			29 01 00 00 00 00 15 B8 0D F0 2E 24 46 BD 33 69 12 7A E0 3C 3A 3C 14 14 14 15 13 15  /* 440 */
			29 01 00 00 00 00 15 B8 0D F0 2E 24 46 BD 33 69 12 7A E0 3D 3A 3D 14 14 14 14 13 14  /* 441 */
			29 01 00 00 00 00 15 B8 0D F0 2E 24 46 BD 33 69 12 7A E0 3D 3B 3D 14 14 14 15 13 15  /* 442 */
			29 01 00 00 00 00 15 B8 0D F0 2E 24 46 BD 33 69 12 7A E0 3D 3B 3D 15 14 15 15 13 15  /* 443 */
			29 01 00 00 00 00 15 B8 0D F0 2E 24 46 BD 33 69 12 7A E0 3E 3C 3E 14 14 14 15 13 15  /* 444 */
			29 01 00 00 00 00 15 B8 0D F0 2E 24 46 BD 33 69 12 7A E0 3E 3C 3E 15 14 15 15 14 15  /* 445 */
			29 01 00 00 00 00 15 B8 0D F0 2E 24 46 BD 33 69 12 7A E0 3E 3C 3E 15 15 15 16 13 16  /* 446 */
			29 01 00 00 00 00 15 B8 0D F0 2E 24 46 BD 33 69 12 7A E0 3F 3D 3F 15 14 15 15 14 15  /* 447 */
			29 01 00 00 00 00 15 B8 0D F0 2E 24 46 BD 33 69 12 7A E0 3F 3D 3F 15 15 15 16 14 16  /* 448 */
			29 01 00 00 00 00 15 B8 0D F0 2E 24 46 BD 33 69 12 7A E0 40 3D 40 15 15 15 15 14 15  /* 449 */
			29 01 00 00 00 00 15 B8 0D F0 2E 24 46 BD 33 69 12 7A E0 40 3E 40 16 15 16 15 14 15  /* 450 */
			29 01 00 00 00 00 15 B8 0D F0 2E 24 46 BD 33 69 12 7A E0 40 3E 40 16 15 16 16 15 16  /* 451 */
			29 01 00 00 00 00 15 B8 0D F0 2E 24 46 BD 33 69 12 7A E0 41 3F 41 16 15 16 16 14 16  /* 452 */
			29 01 00 00 00 00 15 B8 0D F0 2E 24 46 BD 33 69 12 7A E0 41 3F 41 16 15 16 16 15 16  /* 453 */
			29 01 00 00 00 00 15 B8 0D F0 2E 24 46 BD 33 69 12 7A E0 42 3F 42 16 16 16 16 15 16  /* 454 */
			29 01 00 00 00 00 15 B8 0D F0 2E 24 46 BD 33 69 12 7A E0 42 40 42 16 15 16 17 15 17  /* 455 */
			29 01 00 00 00 00 15 B8 0D F0 2E 24 46 BD 33 69 12 7A E0 43 40 43 16 16 16 16 15 16  /* 456 */
			29 01 00 00 00 00 15 B8 0D F0 2E 24 46 BD 33 69 12 7A E0 43 41 43 17 16 17 16 15 16  /* 457 */
			29 01 00 00 00 00 15 B8 0D F0 2E 24 46 BD 33 69 12 7A E0 43 41 43 17 16 17 17 15 17  /* 458 */
			29 01 00 00 00 00 15 B8 0D F0 2E 24 46 BD 33 69 12 7A E0 44 41 44 17 17 17 16 15 16  /* 459 */
			29 01 00 00 00 00 15 B8 0D F0 2E 24 46 BD 33 69 12 7A E0 44 42 44 17 16 17 17 16 17  /* 460 */
			29 01 00 00 00 00 15 B8 0D F0 2E 24 46 BD 33 69 12 7A E0 45 42 45 17 17 17 17 15 17  /* 461 */
			29 01 00 00 00 00 15 B8 0D F0 2E 24 46 BD 33 69 12 7A E0 45 43 45 17 16 17 17 16 17  /* 462 */
			29 01 00 00 00 00 15 B8 0D F0 2E 24 46 BD 33 69 12 7A E0 45 43 45 18 17 18 17 15 17  /* 463 */
			29 01 00 00 00 00 15 B8 0D F0 2E 24 46 BD 33 69 12 7A E0 46 43 46 17 17 17 18 16 18  /* 464 */
			29 01 00 00 00 00 15 B8 0D F0 2E 24 46 BD 33 69 12 7A E0 46 44 46 18 17 18 17 16 17  /* 465 */
			29 01 00 00 00 00 15 B8 0D F0 2E 24 46 BD 33 69 12 7A E0 47 44 47 17 17 17 18 16 18  /* 466 */
			29 01 00 00 00 00 15 B8 0D F0 2E 24 46 BD 33 69 12 7A E0 47 45 47 18 17 18 18 16 18  /* 467 */
			29 01 00 00 00 00 15 B8 0D F0 2E 24 46 BD 33 69 12 7A E0 47 45 47 18 17 18 18 17 18  /* 468 */
			29 01 00 00 00 00 15 B8 0D F0 2E 24 46 BD 33 69 12 7A E0 48 45 48 18 18 18 18 16 18  /* 469 */
			29 01 00 00 00 00 15 B8 0D F0 2E 24 46 BD 33 69 12 7A E0 48 46 48 18 17 18 19 17 19  /* 470 */
			29 01 00 00 00 00 15 B8 0D F0 2E 24 46 BD 33 69 12 7A E0 49 46 49 18 18 18 18 17 18  /* 471 */
			29 01 00 00 00 00 15 B8 0D F0 2E 24 46 BD 33 69 12 7A E0 49 47 49 19 17 19 18 17 18  /* 472 */
			29 01 00 00 00 00 15 B8 0D F0 2E 24 46 BD 33 69 12 7A E0 49 47 49 19 18 19 19 17 19  /* 473 */
			29 01 00 00 00 00 15 B8 0D F0 2E 24 46 BD 33 69 12 7A E0 4A 47 4A 19 18 19 18 18 18  /* 474 */
			29 01 00 00 00 00 15 B8 0D F0 2E 24 46 BD 33 69 12 7A E0 4A 48 4A 19 18 19 19 17 19  /* 475 */
			29 01 00 00 00 00 15 B8 0D F0 2E 24 46 BD 33 69 12 7A E0 4B 48 4B 19 18 19 19 18 19  /* 476 */
			29 01 00 00 00 00 15 B8 0D F0 2E 24 46 BD 33 69 12 7A E0 4B 48 4B 19 19 19 19 17 19  /* 477 */
			29 01 00 00 00 00 15 B8 0D F0 2E 24 46 BD 33 69 12 7A E0 4B 49 4B 1A 18 1A 19 18 19  /* 478 */
			29 01 00 00 00 00 15 B8 0D F0 2E 24 46 BD 33 69 12 7A E0 4C 49 4C 19 19 19 1A 18 1A  /* 479 */
			29 01 00 00 00 00 15 B8 0D F0 2E 24 46 BD 33 69 12 7A E0 4C 4A 4C 1A 18 1A 19 18 19  /* 480 */
			29 01 00 00 00 00 15 B8 0D F0 2E 24 46 BD 33 69 12 7A E0 4C 4A 4C 1A 19 1A 1A 18 1A  /* 481 */
			29 01 00 00 00 00 15 B8 0D F0 2E 24 46 BD 33 69 12 7A E0 4D 4A 4D 1A 19 1A 1A 19 1A  /* 482 */
			29 01 00 00 00 00 15 B8 0D F0 2E 24 46 BD 33 69 12 7A E0 4D 4B 4D 1A 19 1A 1A 18 1A  /* 483 */
			29 01 00 00 00 00 15 B8 0D F0 2E 24 46 BD 33 69 12 7A E0 4E 4B 4E 1A 1A 1A 1A 18 1A  /* 484 */
			29 01 00 00 00 00 15 B8 0D F0 2E 24 46 BD 33 69 12 7A E0 4E 4C 4E 1B 19 1B 1A 19 1A  /* 485 */
			29 01 00 00 00 00 15 B8 0D F0 2E 24 46 BD 33 69 12 7A E0 4F 4C 4F 1A 1A 1A 1B 19 1B  /* 486 */
			29 01 00 00 00 00 15 B8 0D F0 2E 24 46 BD 33 69 12 7A E0 4F 4D 4F 1B 19 1B 1B 19 1B  /* 487 */
			29 01 00 00 00 00 15 B8 0D F0 2E 24 46 BD 33 69 12 7A E0 50 4D 50 1B 1A 1B 1A 19 1A  /* 488 */
			29 01 00 00 00 00 15 B8 0D F0 2E 24 46 BD 33 69 12 7A E0 50 4D 50 1B 1B 1B 1B 19 1B  /* 489 */
			29 01 00 00 00 00 15 B8 0D F0 2E 24 46 BD 33 69 12 7A E0 51 4E 51 1B 1A 1B 1B 19 1B  /* 490 */
			29 01 00 00 00 00 15 B8 0D F0 2E 24 46 BD 33 69 12 7A E0 51 4E 51 1B 1B 1B 1B 19 1B  /* 491 */
			29 01 00 00 00 00 15 B8 0D F0 2E 24 46 BD 33 69 12 7A E0 51 4F 51 1C 1A 1C 1B 1A 1B  /* 492 */
			29 01 00 00 00 00 15 B8 0D F0 2E 24 46 BD 33 69 12 7A E0 52 4F 52 1B 1A 1B 1C 1A 1C  /* 493 */
			29 01 00 00 00 00 15 B8 0D F0 2E 24 46 BD 33 69 12 7A E0 52 4F 52 1C 1B 1C 1B 1A 1B  /* 494 */
			29 01 00 00 00 00 15 B8 0D F0 2E 24 46 BD 33 69 12 7A E0 52 50 52 1C 1B 1C 1C 19 1C  /* 495 */
			29 01 00 00 00 00 15 B8 0D F0 2E 24 46 BD 33 69 12 7A E0 53 50 53 1C 1B 1C 1C 1A 1C  /* 496 */
			29 01 00 00 00 00 15 B8 0D F0 2E 24 46 BD 33 69 12 7A E0 53 50 53 1C 1C 1C 1C 1A 1C  /* 497 */
			29 01 00 00 00 00 15 B8 0D F0 2E 24 46 BD 33 69 12 7A E0 54 51 54 1C 1B 1C 1C 1A 1C  /* 498 */
			29 01 00 00 00 00 15 B8 0D F0 2E 24 46 BD 33 69 12 7A E0 54 51 54 1C 1C 1C 1D 1A 1D  /* 499 */
			29 01 00 00 00 00 15 B8 0D F0 2E 24 46 BD 33 69 12 7A E0 55 52 55 1C 1B 1C 1D 1B 1D  /* 500 */
			29 01 00 00 00 00 15 B8 0D F0 2E 24 46 BD 33 69 12 7A E0 55 52 55 1D 1C 1D 1C 1B 1C  /* 501 */
			29 01 00 00 00 00 15 B8 0D F0 2E 24 46 BD 33 69 12 7A E0 55 53 55 1D 1B 1D 1D 1B 1D  /* 502 */
			29 01 00 00 00 00 15 B8 0D F0 2E 24 46 BD 33 69 12 7A E0 56 53 56 1D 1C 1D 1D 1B 1D  /* 503 */
			29 01 00 00 00 00 15 B8 0D F0 2E 24 46 BD 33 69 12 7A E0 56 53 56 1D 1D 1D 1E 1B 1E  /* 504 */
			29 01 00 00 00 00 15 B8 0D F0 2E 24 46 BD 33 69 12 7A E0 57 54 57 1D 1C 1D 1D 1C 1D  /* 505 */
			29 01 00 00 00 00 15 B8 0D F0 2E 24 46 BD 33 69 12 7A E0 57 54 57 1E 1D 1E 1D 1B 1D  /* 506 */
			29 01 00 00 00 00 15 B8 0D F0 2E 24 46 BD 33 69 12 7A E0 58 55 58 1D 1C 1D 1E 1C 1E  /* 507 */
			29 01 00 00 00 00 15 B8 0D F0 2E 24 46 BD 33 69 12 7A E0 58 55 58 1E 1D 1E 1E 1C 1E  /* 508 */
			29 01 00 00 00 00 15 B8 0D F0 2E 24 46 BD 33 69 12 7A E0 59 56 59 1D 1C 1D 1E 1C 1E  /* 509 */
			29 01 00 00 00 00 15 B8 0D F0 2E 24 46 BD 33 69 12 7A E0 59 56 59 1E 1D 1E 1E 1C 1E  /* 510 */
			29 01 00 00 00 00 15 B8 0D F0 2E 24 46 BD 33 69 12 7A E0 59 56 59 1E 1D 1E 1E 1C 1E  /* 511 */
		];

		/*
		* ************************************************************************************************************************
		* AID command list and mappings
		* ************************************************************************************************************************
		*/
		samsung,pac_aid_subdivision_tx_cmds_revA = [
			29 01 00 00 00 00 03 B1 0B 75  /* 0 */
			29 01 00 00 00 00 03 B1 0B 73  /* 1 */
			29 01 00 00 00 00 03 B1 0B 71  /* 2 */
			29 01 00 00 00 00 03 B1 0B 6F  /* 3 */
			29 01 00 00 00 00 03 B1 0B 6D  /* 4 */
			29 01 00 00 00 00 03 B1 0B 63  /* 5 */
			29 01 00 00 00 00 03 B1 0B 61  /* 6 */
			29 01 00 00 00 00 03 B1 0B 5F  /* 7 */
			29 01 00 00 00 00 03 B1 0B 5D  /* 8 */
			29 01 00 00 00 00 03 B1 0B 53  /* 9 */
			29 01 00 00 00 00 03 B1 0B 51  /* 10 */
			29 01 00 00 00 00 03 B1 0B 4F  /* 11 */
			29 01 00 00 00 00 03 B1 0B 4D  /* 12 */
			29 01 00 00 00 00 03 B1 0B 47  /* 13 */
			29 01 00 00 00 00 03 B1 0B 42  /* 14 */
			29 01 00 00 00 00 03 B1 0B 41  /* 15 */
			29 01 00 00 00 00 03 B1 0B 3F  /* 16 */
			29 01 00 00 00 00 03 B1 0B 3D  /* 17 */
			29 01 00 00 00 00 03 B1 0B 39  /* 18 */
			29 01 00 00 00 00 03 B1 0B 33  /* 19 */
			29 01 00 00 00 00 03 B1 0B 31  /* 20 */
			29 01 00 00 00 00 03 B1 0B 2F  /* 21 */
			29 01 00 00 00 00 03 B1 0B 23  /* 22 */
			29 01 00 00 00 00 03 B1 0B 21  /* 23 */
			29 01 00 00 00 00 03 B1 0B 1F  /* 24 */
			29 01 00 00 00 00 03 B1 0B 1D  /* 25 */
			29 01 00 00 00 00 03 B1 0B 13  /* 26 */
			29 01 00 00 00 00 03 B1 0B 11  /* 27 */
			29 01 00 00 00 00 03 B1 0B 0F  /* 28 */
			29 01 00 00 00 00 03 B1 0B 0D  /* 29 */
			29 01 00 00 00 00 03 B1 0B 03  /* 30 */
			29 01 00 00 00 00 03 B1 0B 01  /* 31 */
			29 01 00 00 00 00 03 B1 0A FF  /* 32 */
			29 01 00 00 00 00 03 B1 0A FD  /* 33 */
			29 01 00 00 00 00 03 B1 0A F3  /* 34 */
			29 01 00 00 00 00 03 B1 0A F2  /* 35 */
			29 01 00 00 00 00 03 B1 0A F1  /* 36 */
			29 01 00 00 00 00 03 B1 0A EF  /* 37 */
			29 01 00 00 00 00 03 B1 0A ED  /* 38 */
			29 01 00 00 00 00 03 B1 0A E3  /* 39 */
			29 01 00 00 00 00 03 B1 0A E1  /* 40 */
			29 01 00 00 00 00 03 B1 0A DF  /* 41 */
			29 01 00 00 00 00 03 B1 0A DC  /* 42 */
			29 01 00 00 00 00 03 B1 0A D3  /* 43 */
			29 01 00 00 00 00 03 B1 0A CF  /* 44 */
			29 01 00 00 00 00 03 B1 0A C3  /* 45 */
			29 01 00 00 00 00 03 B1 0A C1  /* 46 */
			29 01 00 00 00 00 03 B1 0A BF  /* 47 */
			29 01 00 00 00 00 03 B1 0A BD  /* 48 */
			29 01 00 00 00 00 03 B1 0A BA  /* 49 */
			29 01 00 00 00 00 03 B1 0A B3  /* 50 */
			29 01 00 00 00 00 03 B1 0A B1  /* 51 */
			29 01 00 00 00 00 03 B1 0A AF  /* 52 */
			29 01 00 00 00 00 03 B1 0A AD  /* 53 */
			29 01 00 00 00 00 03 B1 0A A3  /* 54 */
			29 01 00 00 00 00 03 B1 0A A1  /* 55 */
			29 01 00 00 00 00 03 B1 0A 9E  /* 56 */
			29 01 00 00 00 00 03 B1 0A 93  /* 57 */
			29 01 00 00 00 00 03 B1 0A 91  /* 58 */
			29 01 00 00 00 00 03 B1 0A 8F  /* 59 */
			29 01 00 00 00 00 03 B1 0A 8D  /* 60 */
			29 01 00 00 00 00 03 B1 0A 83  /* 61 */
			29 01 00 00 00 00 03 B1 0A 7F  /* 62 */
			29 01 00 00 00 00 03 B1 0A 7A  /* 63 */
			29 01 00 00 00 00 03 B1 0A 74  /* 64 */
			29 01 00 00 00 00 03 B1 0A 6F  /* 65 */
			29 01 00 00 00 00 03 B1 0A 69  /* 66 */
			29 01 00 00 00 00 03 B1 0A 63  /* 67 */
			29 01 00 00 00 00 03 B1 0A 5D  /* 68 */
			29 01 00 00 00 00 03 B1 0A 58  /* 69 */
			29 01 00 00 00 00 03 B1 0A 52  /* 70 */
			29 01 00 00 00 00 03 B1 0A 4D  /* 71 */
			29 01 00 00 00 00 03 B1 0A 48  /* 72 */
			29 01 00 00 00 00 03 B1 0A 43  /* 73 */
			29 01 00 00 00 00 03 B1 0A 3E  /* 74 */
			29 01 00 00 00 00 03 B1 0A 39  /* 75 */
			29 01 00 00 00 00 03 B1 0A 34  /* 76 */
			29 01 00 00 00 00 03 B1 0A 2F  /* 77 */
			29 01 00 00 00 00 03 B1 0A 28  /* 78 */
			29 01 00 00 00 00 03 B1 0A 22  /* 79 */
			29 01 00 00 00 00 03 B1 0A 1B  /* 80 */
			29 01 00 00 00 00 03 B1 0A 14  /* 81 */
			29 01 00 00 00 00 03 B1 0A 0D  /* 82 */
			29 01 00 00 00 00 03 B1 0A 07  /* 83 */
			29 01 00 00 00 00 03 B1 0A 00  /* 84 */
			29 01 00 00 00 00 03 B1 09 FB  /* 85 */
			29 01 00 00 00 00 03 B1 09 F7  /* 86 */
			29 01 00 00 00 00 03 B1 09 F2  /* 87 */
			29 01 00 00 00 00 03 B1 09 EE  /* 88 */
			29 01 00 00 00 00 03 B1 09 E9  /* 89 */
			29 01 00 00 00 00 03 B1 09 E5  /* 90 */
			29 01 00 00 00 00 03 B1 09 E0  /* 91 */
			29 01 00 00 00 00 03 B1 09 DC  /* 92 */
			29 01 00 00 00 00 03 B1 09 D7  /* 93 */
			29 01 00 00 00 00 03 B1 09 D2  /* 94 */
			29 01 00 00 00 00 03 B1 09 CE  /* 95 */
			29 01 00 00 00 00 03 B1 09 C9  /* 96 */
			29 01 00 00 00 00 03 B1 09 C5  /* 97 */
			29 01 00 00 00 00 03 B1 09 C0  /* 98 */
			29 01 00 00 00 00 03 B1 09 BC  /* 99 */
			29 01 00 00 00 00 03 B1 09 B8  /* 100 */
			29 01 00 00 00 00 03 B1 09 B4  /* 101 */
			29 01 00 00 00 00 03 B1 09 B1  /* 102 */
			29 01 00 00 00 00 03 B1 09 AD  /* 103 */
			29 01 00 00 00 00 03 B1 09 A9  /* 104 */
			29 01 00 00 00 00 03 B1 09 A5  /* 105 */
			29 01 00 00 00 00 03 B1 09 9E  /* 106 */
			29 01 00 00 00 00 03 B1 09 96  /* 107 */
			29 01 00 00 00 00 03 B1 09 8F  /* 108 */
			29 01 00 00 00 00 03 B1 09 87  /* 109 */
			29 01 00 00 00 00 03 B1 09 80  /* 110 */
			29 01 00 00 00 00 03 B1 09 79  /* 111 */
			29 01 00 00 00 00 03 B1 09 71  /* 112 */
			29 01 00 00 00 00 03 B1 09 6A  /* 113 */
			29 01 00 00 00 00 03 B1 09 64  /* 114 */
			29 01 00 00 00 00 03 B1 09 5F  /* 115 */
			29 01 00 00 00 00 03 B1 09 59  /* 116 */
			29 01 00 00 00 00 03 B1 09 53  /* 117 */
			29 01 00 00 00 00 03 B1 09 4E  /* 118 */
			29 01 00 00 00 00 03 B1 09 48  /* 119 */
			29 01 00 00 00 00 03 B1 09 42  /* 120 */
			29 01 00 00 00 00 03 B1 09 41  /* 121 */
			29 01 00 00 00 00 03 B1 09 40  /* 122 */
			29 01 00 00 00 00 03 B1 09 3F  /* 123 */
			29 01 00 00 00 00 03 B1 09 3D  /* 124 */
			29 01 00 00 00 00 03 B1 09 3C  /* 125 */
			29 01 00 00 00 00 03 B1 09 3B  /* 126 */
			29 01 00 00 00 00 03 B1 09 3A  /* 127 */
			29 01 00 00 00 00 03 B1 09 38  /* 128 */
			29 01 00 00 00 00 03 B1 09 37  /* 129 */
			29 01 00 00 00 00 03 B1 09 35  /* 130 */
			29 01 00 00 00 00 03 B1 09 34  /* 131 */
			29 01 00 00 00 00 03 B1 09 32  /* 132 */
			29 01 00 00 00 00 03 B1 09 31  /* 133 */
			29 01 00 00 00 00 03 B1 09 2F  /* 134 */
			29 01 00 00 00 00 03 B1 09 26  /* 135 */
			29 01 00 00 00 00 03 B1 09 1D  /* 136 */
			29 01 00 00 00 00 03 B1 09 14  /* 137 */
			29 01 00 00 00 00 03 B1 09 0B  /* 138 */
			29 01 00 00 00 00 03 B1 09 02  /* 139 */
			29 01 00 00 00 00 03 B1 08 F9  /* 140 */
			29 01 00 00 00 00 03 B1 08 F0  /* 141 */
			29 01 00 00 00 00 03 B1 08 EC  /* 142 */
			29 01 00 00 00 00 03 B1 08 E7  /* 143 */
			29 01 00 00 00 00 03 B1 08 E3  /* 144 */
			29 01 00 00 00 00 03 B1 08 DE  /* 145 */
			29 01 00 00 00 00 03 B1 08 DA  /* 146 */
			29 01 00 00 00 00 03 B1 08 D6  /* 147 */
			29 01 00 00 00 00 03 B1 08 D1  /* 148 */
			29 01 00 00 00 00 03 B1 08 C9  /* 149 */
			29 01 00 00 00 00 03 B1 08 C1  /* 150 */
			29 01 00 00 00 00 03 B1 08 B9  /* 151 */
			29 01 00 00 00 00 03 B1 08 B1  /* 152 */
			29 01 00 00 00 00 03 B1 08 A9  /* 153 */
			29 01 00 00 00 00 03 B1 08 A0  /* 154 */
			29 01 00 00 00 00 03 B1 08 98  /* 155 */
			29 01 00 00 00 00 03 B1 08 90  /* 156 */
			29 01 00 00 00 00 03 B1 08 8A  /* 157 */
			29 01 00 00 00 00 03 B1 08 84  /* 158 */
			29 01 00 00 00 00 03 B1 08 7E  /* 159 */
			29 01 00 00 00 00 03 B1 08 78  /* 160 */
			29 01 00 00 00 00 03 B1 08 71  /* 161 */
			29 01 00 00 00 00 03 B1 08 6B  /* 162 */
			29 01 00 00 00 00 03 B1 08 65  /* 163 */
			29 01 00 00 00 00 03 B1 08 5F  /* 164 */
			29 01 00 00 00 00 03 B1 08 5B  /* 165 */
			29 01 00 00 00 00 03 B1 08 57  /* 166 */
			29 01 00 00 00 00 03 B1 08 53  /* 167 */
			29 01 00 00 00 00 03 B1 08 4E  /* 168 */
			29 01 00 00 00 00 03 B1 08 4B  /* 169 */
			29 01 00 00 00 00 03 B1 08 46  /* 170 */
			29 01 00 00 00 00 03 B1 08 42  /* 171 */
			29 01 00 00 00 00 03 B1 08 3E  /* 172 */
			29 01 00 00 00 00 03 B1 08 37  /* 173 */
			29 01 00 00 00 00 03 B1 08 2F  /* 174 */
			29 01 00 00 00 00 03 B1 08 28  /* 175 */
			29 01 00 00 00 00 03 B1 08 20  /* 176 */
			29 01 00 00 00 00 03 B1 08 18  /* 177 */
			29 01 00 00 00 00 03 B1 08 11  /* 178 */
			29 01 00 00 00 00 03 B1 08 09  /* 179 */
			29 01 00 00 00 00 03 B1 08 01  /* 180 */
			29 01 00 00 00 00 03 B1 07 F9  /* 181 */
			29 01 00 00 00 00 03 B1 07 F2  /* 182 */
			29 01 00 00 00 00 03 B1 07 EA  /* 183 */
			29 01 00 00 00 00 03 B1 07 E2  /* 184 */
			29 01 00 00 00 00 03 B1 07 DA  /* 185 */
			29 01 00 00 00 00 03 B1 07 D3  /* 186 */
			29 01 00 00 00 00 03 B1 07 CB  /* 187 */
			29 01 00 00 00 00 03 B1 07 C3  /* 188 */
			29 01 00 00 00 00 03 B1 07 B8  /* 189 */
			29 01 00 00 00 00 03 B1 07 AE  /* 190 */
			29 01 00 00 00 00 03 B1 07 A3  /* 191 */
			29 01 00 00 00 00 03 B1 07 98  /* 192 */
			29 01 00 00 00 00 03 B1 07 8D  /* 193 */
			29 01 00 00 00 00 03 B1 07 82  /* 194 */
			29 01 00 00 00 00 03 B1 07 78  /* 195 */
			29 01 00 00 00 00 03 B1 07 6D  /* 196 */
			29 01 00 00 00 00 03 B1 07 62  /* 197 */
			29 01 00 00 00 00 03 B1 07 5B  /* 198 */
			29 01 00 00 00 00 03 B1 07 53  /* 199 */
			29 01 00 00 00 00 03 B1 07 4C  /* 200 */
			29 01 00 00 00 00 03 B1 07 45  /* 201 */
			29 01 00 00 00 00 03 B1 07 3D  /* 202 */
			29 01 00 00 00 00 03 B1 07 36  /* 203 */
			29 01 00 00 00 00 03 B1 07 2E  /* 204 */
			29 01 00 00 00 00 03 B1 07 27  /* 205 */
			29 01 00 00 00 00 03 B1 07 1F  /* 206 */
			29 01 00 00 00 00 03 B1 07 17  /* 207 */
			29 01 00 00 00 00 03 B1 07 0F  /* 208 */
			29 01 00 00 00 00 03 B1 07 06  /* 209 */
			29 01 00 00 00 00 03 B1 06 FE  /* 210 */
			29 01 00 00 00 00 03 B1 06 F6  /* 211 */
			29 01 00 00 00 00 03 B1 06 EE  /* 212 */
			29 01 00 00 00 00 03 B1 06 E6  /* 213 */
			29 01 00 00 00 00 03 B1 06 DA  /* 214 */
			29 01 00 00 00 00 03 B1 06 CE  /* 215 */
			29 01 00 00 00 00 03 B1 06 C2  /* 216 */
			29 01 00 00 00 00 03 B1 06 B6  /* 217 */
			29 01 00 00 00 00 03 B1 06 AA  /* 218 */
			29 01 00 00 00 00 03 B1 06 9E  /* 219 */
			29 01 00 00 00 00 03 B1 06 92  /* 220 */
			29 01 00 00 00 00 03 B1 06 86  /* 221 */
			29 01 00 00 00 00 03 B1 06 7A  /* 222 */
			29 01 00 00 00 00 03 B1 06 6F  /* 223 */
			29 01 00 00 00 00 03 B1 06 63  /* 224 */
			29 01 00 00 00 00 03 B1 06 57  /* 225 */
			29 01 00 00 00 00 03 B1 06 4B  /* 226 */
			29 01 00 00 00 00 03 B1 06 3F  /* 227 */
			29 01 00 00 00 00 03 B1 06 34  /* 228 */
			29 01 00 00 00 00 03 B1 06 28  /* 229 */
			29 01 00 00 00 00 03 B1 06 1C  /* 230 */
			29 01 00 00 00 00 03 B1 06 0F  /* 231 */
			29 01 00 00 00 00 03 B1 06 03  /* 232 */
			29 01 00 00 00 00 03 B1 05 F7  /* 233 */
			29 01 00 00 00 00 03 B1 05 EA  /* 234 */
			29 01 00 00 00 00 03 B1 05 DE  /* 235 */
			29 01 00 00 00 00 03 B1 05 D1  /* 236 */
			29 01 00 00 00 00 03 B1 05 C5  /* 237 */
			29 01 00 00 00 00 03 B1 05 B8  /* 238 */
			29 01 00 00 00 00 03 B1 05 AC  /* 239 */
			29 01 00 00 00 00 03 B1 05 9F  /* 240 */
			29 01 00 00 00 00 03 B1 05 92  /* 241 */
			29 01 00 00 00 00 03 B1 05 86  /* 242 */
			29 01 00 00 00 00 03 B1 05 79  /* 243 */
			29 01 00 00 00 00 03 B1 05 6C  /* 244 */
			29 01 00 00 00 00 03 B1 05 5D  /* 245 */
			29 01 00 00 00 00 03 B1 05 4E  /* 246 */
			29 01 00 00 00 00 03 B1 05 3F  /* 247 */
			29 01 00 00 00 00 03 B1 05 2F  /* 248 */
			29 01 00 00 00 00 03 B1 05 20  /* 249 */
			29 01 00 00 00 00 03 B1 05 11  /* 250 */
			29 01 00 00 00 00 03 B1 05 02  /* 251 */
			29 01 00 00 00 00 03 B1 05 1B  /* 252 */
			29 01 00 00 00 00 03 B1 05 0A  /* 253 */
			29 01 00 00 00 00 03 B1 04 F9  /* 254 */
			29 01 00 00 00 00 03 B1 04 E8  /* 255 */
			29 01 00 00 00 00 03 B1 04 D7  /* 256 */
			29 01 00 00 00 00 03 B1 04 C6  /* 257 */
			29 01 00 00 00 00 03 B1 04 B5  /* 258 */
			29 01 00 00 00 00 03 B1 05 14  /* 259 */
			29 01 00 00 00 00 03 B1 05 04  /* 260 */
			29 01 00 00 00 00 03 B1 04 F5  /* 261 */
			29 01 00 00 00 00 03 B1 04 E5  /* 262 */
			29 01 00 00 00 00 03 B1 04 D5  /* 263 */
			29 01 00 00 00 00 03 B1 04 C5  /* 264 */
			29 01 00 00 00 00 03 B1 04 B5  /* 265 */
			29 01 00 00 00 00 03 B1 05 0F  /* 266 */
			29 01 00 00 00 00 03 B1 05 00  /* 267 */
			29 01 00 00 00 00 03 B1 04 F1  /* 268 */
			29 01 00 00 00 00 03 B1 04 E2  /* 269 */
			29 01 00 00 00 00 03 B1 04 D3  /* 270 */
			29 01 00 00 00 00 03 B1 04 C4  /* 271 */
			29 01 00 00 00 00 03 B1 04 B5  /* 272 */
			29 01 00 00 00 00 03 B1 05 0A  /* 273 */
			29 01 00 00 00 00 03 B1 04 FC  /* 274 */
			29 01 00 00 00 00 03 B1 04 ED  /* 275 */
			29 01 00 00 00 00 03 B1 04 DF  /* 276 */
			29 01 00 00 00 00 03 B1 04 D1  /* 277 */
			29 01 00 00 00 00 03 B1 04 C3  /* 278 */
			29 01 00 00 00 00 03 B1 04 B5  /* 279 */
			29 01 00 00 00 00 03 B1 05 18  /* 280 */
			29 01 00 00 00 00 03 B1 05 08  /* 281 */
			29 01 00 00 00 00 03 B1 04 F7  /* 282 */
			29 01 00 00 00 00 03 B1 04 E7  /* 283 */
			29 01 00 00 00 00 03 B1 04 D6  /* 284 */
			29 01 00 00 00 00 03 B1 04 C6  /* 285 */
			29 01 00 00 00 00 03 B1 04 B5  /* 286 */
			29 01 00 00 00 00 03 B1 05 12  /* 287 */
			29 01 00 00 00 00 03 B1 05 02  /* 288 */
			29 01 00 00 00 00 03 B1 04 F3  /* 289 */
			29 01 00 00 00 00 03 B1 04 E3  /* 290 */
			29 01 00 00 00 00 03 B1 04 D4  /* 291 */
			29 01 00 00 00 00 03 B1 04 C4  /* 292 */
			29 01 00 00 00 00 03 B1 04 B5  /* 293 */
			29 01 00 00 00 00 03 B1 05 0D  /* 294 */
			29 01 00 00 00 00 03 B1 04 FE  /* 295 */
			29 01 00 00 00 00 03 B1 04 EF  /* 296 */
			29 01 00 00 00 00 03 B1 04 E1  /* 297 */
			29 01 00 00 00 00 03 B1 04 D2  /* 298 */
			29 01 00 00 00 00 03 B1 04 C4  /* 299 */
			29 01 00 00 00 00 03 B1 04 B5  /* 300 */
			29 01 00 00 00 00 03 B1 05 17  /* 301 */
			29 01 00 00 00 00 03 B1 05 07  /* 302 */
			29 01 00 00 00 00 03 B1 04 F7  /* 303 */
			29 01 00 00 00 00 03 B1 04 E6  /* 304 */
			29 01 00 00 00 00 03 B1 04 D6  /* 305 */
			29 01 00 00 00 00 03 B1 04 C5  /* 306 */
			29 01 00 00 00 00 03 B1 04 B5  /* 307 */
			29 01 00 00 00 00 03 B1 05 03  /* 308 */
			29 01 00 00 00 00 03 B1 04 F6  /* 309 */
			29 01 00 00 00 00 03 B1 04 E9  /* 310 */
			29 01 00 00 00 00 03 B1 04 DC  /* 311 */
			29 01 00 00 00 00 03 B1 04 CF  /* 312 */
			29 01 00 00 00 00 03 B1 04 C2  /* 313 */
			29 01 00 00 00 00 03 B1 04 B5  /* 314 */
			29 01 00 00 00 00 03 B1 05 1B  /* 315 */
			29 01 00 00 00 00 03 B1 05 0A  /* 316 */
			29 01 00 00 00 00 03 B1 04 F9  /* 317 */
			29 01 00 00 00 00 03 B1 04 E8  /* 318 */
			29 01 00 00 00 00 03 B1 04 D7  /* 319 */
			29 01 00 00 00 00 03 B1 04 C6  /* 320 */
			29 01 00 00 00 00 03 B1 04 B5  /* 321 */
			29 01 00 00 00 00 03 B1 05 07  /* 322 */
			29 01 00 00 00 00 03 B1 04 FA  /* 323 */
			29 01 00 00 00 00 03 B1 04 EC  /* 324 */
			29 01 00 00 00 00 03 B1 04 DE  /* 325 */
			29 01 00 00 00 00 03 B1 04 D0  /* 326 */
			29 01 00 00 00 00 03 B1 04 C3  /* 327 */
			29 01 00 00 00 00 03 B1 04 B5  /* 328 */
			29 01 00 00 00 00 03 B1 05 1C  /* 329 */
			29 01 00 00 00 00 03 B1 05 0A  /* 330 */
			29 01 00 00 00 00 03 B1 04 F9  /* 331 */
			29 01 00 00 00 00 03 B1 04 E8  /* 332 */
			29 01 00 00 00 00 03 B1 04 D7  /* 333 */
			29 01 00 00 00 00 03 B1 04 C6  /* 334 */
			29 01 00 00 00 00 03 B1 04 B5  /* 335 */
			29 01 00 00 00 00 03 B1 05 0A  /* 336 */
			29 01 00 00 00 00 03 B1 04 FC  /* 337 */
			29 01 00 00 00 00 03 B1 04 ED  /* 338 */
			29 01 00 00 00 00 03 B1 04 DF  /* 339 */
			29 01 00 00 00 00 03 B1 04 D1  /* 340 */
			29 01 00 00 00 00 03 B1 04 C3  /* 341 */
			29 01 00 00 00 00 03 B1 04 B5  /* 342 */
			29 01 00 00 00 00 03 B1 05 10  /* 343 */
			29 01 00 00 00 00 03 B1 05 01  /* 344 */
			29 01 00 00 00 00 03 B1 04 F2  /* 345 */
			29 01 00 00 00 00 03 B1 04 E3  /* 346 */
			29 01 00 00 00 00 03 B1 04 D3  /* 347 */
			29 01 00 00 00 00 03 B1 04 C4  /* 348 */
			29 01 00 00 00 00 03 B1 04 B5  /* 349 */
			29 01 00 00 00 00 03 B1 05 15  /* 350 */
			29 01 00 00 00 00 03 B1 05 05  /* 351 */
			29 01 00 00 00 00 03 B1 04 F5  /* 352 */
			29 01 00 00 00 00 03 B1 04 E5  /* 353 */
			29 01 00 00 00 00 03 B1 04 D5  /* 354 */
			29 01 00 00 00 00 03 B1 04 C5  /* 355 */
			29 01 00 00 00 00 03 B1 04 B5  /* 356 */
			29 01 00 00 00 00 03 B1 05 0F  /* 357 */
			29 01 00 00 00 00 03 B1 05 00  /* 358 */
			29 01 00 00 00 00 03 B1 04 F1  /* 359 */
			29 01 00 00 00 00 03 B1 04 E2  /* 360 */
			29 01 00 00 00 00 03 B1 04 D3  /* 361 */
			29 01 00 00 00 00 03 B1 04 C4  /* 362 */
			29 01 00 00 00 00 03 B1 04 B5  /* 363 */
			29 01 00 00 00 00 03 B1 05 13  /* 364 */
			29 01 00 00 00 00 03 B1 05 03  /* 365 */
			29 01 00 00 00 00 03 B1 04 F4  /* 366 */
			29 01 00 00 00 00 03 B1 04 E4  /* 367 */
			29 01 00 00 00 00 03 B1 04 D4  /* 368 */
			29 01 00 00 00 00 03 B1 04 C5  /* 369 */
			29 01 00 00 00 00 03 B1 04 B5  /* 370 */
			29 01 00 00 00 00 03 B1 05 0E  /* 371 */
			29 01 00 00 00 00 03 B1 04 FF  /* 372 */
			29 01 00 00 00 00 03 B1 04 F0  /* 373 */
			29 01 00 00 00 00 03 B1 04 E1  /* 374 */
			29 01 00 00 00 00 03 B1 04 D3  /* 375 */
			29 01 00 00 00 00 03 B1 04 C4  /* 376 */
			29 01 00 00 00 00 03 B1 04 B5  /* 377 */
			29 01 00 00 00 00 03 B1 04 E3  /* 378 */
			29 01 00 00 00 00 03 B1 04 D3  /* 379 */
			29 01 00 00 00 00 03 B1 04 C4  /* 380 */
			29 01 00 00 00 00 03 B1 04 B4  /* 381 */
			29 01 00 00 00 00 03 B1 04 A4  /* 382 */
			29 01 00 00 00 00 03 B1 04 95  /* 383 */
			29 01 00 00 00 00 03 B1 04 85  /* 384 */
			29 01 00 00 00 00 03 B1 04 70  /* 385 */
			29 01 00 00 00 00 03 B1 04 5B  /* 386 */
			29 01 00 00 00 00 03 B1 04 45  /* 387 */
			29 01 00 00 00 00 03 B1 04 30  /* 388 */
			29 01 00 00 00 00 03 B1 04 1B  /* 389 */
			29 01 00 00 00 00 03 B1 04 05  /* 390 */
			29 01 00 00 00 00 03 B1 03 F0  /* 391 */
			29 01 00 00 00 00 03 B1 03 DA  /* 392 */
			29 01 00 00 00 00 03 B1 03 C3  /* 393 */
			29 01 00 00 00 00 03 B1 03 AD  /* 394 */
			29 01 00 00 00 00 03 B1 03 96  /* 395 */
			29 01 00 00 00 00 03 B1 03 80  /* 396 */
			29 01 00 00 00 00 03 B1 03 69  /* 397 */
			29 01 00 00 00 00 03 B1 03 53  /* 398 */
			29 01 00 00 00 00 03 B1 03 3B  /* 399 */
			29 01 00 00 00 00 03 B1 03 24  /* 400 */
			29 01 00 00 00 00 03 B1 03 0D  /* 401 */
			29 01 00 00 00 00 03 B1 02 F5  /* 402 */
			29 01 00 00 00 00 03 B1 02 DE  /* 403 */
			29 01 00 00 00 00 03 B1 02 C6  /* 404 */
			29 01 00 00 00 00 03 B1 02 AF  /* 405 */
			29 01 00 00 00 00 03 B1 02 97  /* 406 */
			29 01 00 00 00 00 03 B1 02 7F  /* 407 */
			29 01 00 00 00 00 03 B1 02 68  /* 408 */
			29 01 00 00 00 00 03 B1 02 50  /* 409 */
			29 01 00 00 00 00 03 B1 02 38  /* 410 */
			29 01 00 00 00 00 03 B1 02 21  /* 411 */
			29 01 00 00 00 00 03 B1 02 09  /* 412 */
			29 01 00 00 00 00 03 B1 01 F1  /* 413 */
			29 01 00 00 00 00 03 B1 01 E0  /* 414 */
			29 01 00 00 00 00 03 B1 01 CC  /* 415 */
			29 01 00 00 00 00 03 B1 01 B9  /* 416 */
			29 01 00 00 00 00 03 B1 01 A5  /* 417 */
			29 01 00 00 00 00 03 B1 01 91  /* 418 */
			29 01 00 00 00 00 03 B1 01 7D  /* 419 */
			29 01 00 00 00 00 03 B1 01 69  /* 420 */
			29 01 00 00 00 00 03 B1 01 55  /* 421 */
			29 01 00 00 00 00 03 B1 01 E3  /* 422 */
			29 01 00 00 00 00 03 B1 01 D1  /* 423 */
			29 01 00 00 00 00 03 B1 01 BF  /* 424 */
			29 01 00 00 00 00 03 B1 01 AE  /* 425 */
			29 01 00 00 00 00 03 B1 01 9C  /* 426 */
			29 01 00 00 00 00 03 B1 01 8A  /* 427 */
			29 01 00 00 00 00 03 B1 01 78  /* 428 */
			29 01 00 00 00 00 03 B1 01 67  /* 429 */
			29 01 00 00 00 00 03 B1 01 55  /* 430 */
			29 01 00 00 00 00 03 B1 01 E3  /* 431 */
			29 01 00 00 00 00 03 B1 01 D1  /* 432 */
			29 01 00 00 00 00 03 B1 01 BF  /* 433 */
			29 01 00 00 00 00 03 B1 01 AE  /* 434 */
			29 01 00 00 00 00 03 B1 01 9C  /* 435 */
			29 01 00 00 00 00 03 B1 01 8A  /* 436 */
			29 01 00 00 00 00 03 B1 01 78  /* 437 */
			29 01 00 00 00 00 03 B1 01 67  /* 438 */
			29 01 00 00 00 00 03 B1 01 55  /* 439 */
			29 01 00 00 00 00 03 B1 01 E4  /* 440 */
			29 01 00 00 00 00 03 B1 01 D4  /* 441 */
			29 01 00 00 00 00 03 B1 01 C4  /* 442 */
			29 01 00 00 00 00 03 B1 01 B4  /* 443 */
			29 01 00 00 00 00 03 B1 01 A4  /* 444 */
			29 01 00 00 00 00 03 B1 01 94  /* 445 */
			29 01 00 00 00 00 03 B1 01 85  /* 446 */
			29 01 00 00 00 00 03 B1 01 75  /* 447 */
			29 01 00 00 00 00 03 B1 01 65  /* 448 */
			29 01 00 00 00 00 03 B1 01 55  /* 449 */
			29 01 00 00 00 00 03 B1 01 CA  /* 450 */
			29 01 00 00 00 00 03 B1 01 B9  /* 451 */
			29 01 00 00 00 00 03 B1 01 A9  /* 452 */
			29 01 00 00 00 00 03 B1 01 98  /* 453 */
			29 01 00 00 00 00 03 B1 01 87  /* 454 */
			29 01 00 00 00 00 03 B1 01 76  /* 455 */
			29 01 00 00 00 00 03 B1 01 66  /* 456 */
			29 01 00 00 00 00 03 B1 01 55  /* 457 */
			29 01 00 00 00 00 03 B1 01 CD  /* 458 */
			29 01 00 00 00 00 03 B1 01 BE  /* 459 */
			29 01 00 00 00 00 03 B1 01 AF  /* 460 */
			29 01 00 00 00 00 03 B1 01 A0  /* 461 */
			29 01 00 00 00 00 03 B1 01 91  /* 462 */
			29 01 00 00 00 00 03 B1 01 82  /* 463 */
			29 01 00 00 00 00 03 B1 01 73  /* 464 */
			29 01 00 00 00 00 03 B1 01 64  /* 465 */
			29 01 00 00 00 00 03 B1 01 55  /* 466 */
			29 01 00 00 00 00 03 B1 01 C7  /* 467 */
			29 01 00 00 00 00 03 B1 01 B9  /* 468 */
			29 01 00 00 00 00 03 B1 01 AB  /* 469 */
			29 01 00 00 00 00 03 B1 01 9C  /* 470 */
			29 01 00 00 00 00 03 B1 01 8E  /* 471 */
			29 01 00 00 00 00 03 B1 01 80  /* 472 */
			29 01 00 00 00 00 03 B1 01 72  /* 473 */
			29 01 00 00 00 00 03 B1 01 63  /* 474 */
			29 01 00 00 00 00 03 B1 01 55  /* 475 */
			29 01 00 00 00 00 03 B1 01 7C  /* 476 */
			29 01 00 00 00 00 03 B1 01 6F  /* 477 */
			29 01 00 00 00 00 03 B1 01 62  /* 478 */
			29 01 00 00 00 00 03 B1 01 55  /* 479 */
			29 01 00 00 00 00 03 B1 01 7B  /* 480 */
			29 01 00 00 00 00 03 B1 01 6C  /* 481 */
			29 01 00 00 00 00 03 B1 01 5E  /* 482 */
			29 01 00 00 00 00 03 B1 01 4F  /* 483 */
			29 01 00 00 00 00 03 B1 01 35  /* 484 */
			29 01 00 00 00 00 03 B1 01 1B  /* 485 */
			29 01 00 00 00 00 03 B1 01 01  /* 486 */
			29 01 00 00 00 00 03 B1 00 F1  /* 487 */
			29 01 00 00 00 00 03 B1 00 E0  /* 488 */
			29 01 00 00 00 00 03 B1 00 D0  /* 489 */
			29 01 00 00 00 00 03 B1 00 C0  /* 490 */
			29 01 00 00 00 00 03 B1 00 AE  /* 491 */
			29 01 00 00 00 00 03 B1 00 9C  /* 492 */
			29 01 00 00 00 00 03 B1 00 8A  /* 493 */
			29 01 00 00 00 00 03 B1 00 78  /* 494 */
			29 01 00 00 00 00 03 B1 00 63  /* 495 */
			29 01 00 00 00 00 03 B1 00 4F  /* 496 */
			29 01 00 00 00 00 03 B1 00 3A  /* 497 */
			29 01 00 00 00 00 03 B1 00 26  /* 498 */
			29 01 00 00 00 00 03 B1 00 38  /* 499 */
			29 01 00 00 00 00 03 B1 00 29  /* 500 */
			29 01 00 00 00 00 03 B1 00 1B  /* 501 */
			29 01 00 00 00 00 03 B1 00 0C  /* 502 */
			29 01 00 00 00 00 03 B1 00 3D  /* 503 */
			29 01 00 00 00 00 03 B1 00 2C  /* 504 */
			29 01 00 00 00 00 03 B1 00 1C  /* 505 */
			29 01 00 00 00 00 03 B1 00 0C  /* 506 */
			29 01 00 00 00 00 03 B1 00 36  /* 507 */
			29 01 00 00 00 00 03 B1 00 28  /* 508 */
			29 01 00 00 00 00 03 B1 00 1A  /* 509 */
			29 01 00 00 00 00 03 B1 00 0C  /* 510 */
			29 01 00 00 00 00 03 B1 00 0C  /* 511 */
		];

		samsung,pac_aid_subdivision_tx_cmds_revS = [
			29 01 00 00 00 00 03 B1 0B 70  /* 0 */
			29 01 00 00 00 00 03 B1 0B 6F  /* 1 */
			29 01 00 00 00 00 03 B1 0B 6D  /* 2 */
			29 01 00 00 00 00 03 B1 0B 63  /* 3 */
			29 01 00 00 00 00 03 B1 0B 61  /* 4 */
			29 01 00 00 00 00 03 B1 0B 5F  /* 5 */
			29 01 00 00 00 00 03 B1 0B 5D  /* 6 */
			29 01 00 00 00 00 03 B1 0B 55  /* 7 */
			29 01 00 00 00 00 03 B1 0B 53  /* 8 */
			29 01 00 00 00 00 03 B1 0B 51  /* 9 */
			29 01 00 00 00 00 03 B1 0B 4F  /* 10 */
			29 01 00 00 00 00 03 B1 0B 4D  /* 11 */
			29 01 00 00 00 00 03 B1 0B 43  /* 12 */
			29 01 00 00 00 00 03 B1 0B 41  /* 13 */
			29 01 00 00 00 00 03 B1 0B 3E  /* 14 */
			29 01 00 00 00 00 03 B1 0B 3D  /* 15 */
			29 01 00 00 00 00 03 B1 0B 33  /* 16 */
			29 01 00 00 00 00 03 B1 0B 31  /* 17 */
			29 01 00 00 00 00 03 B1 0B 2F  /* 18 */
			29 01 00 00 00 00 03 B1 0B 2D  /* 19 */
			29 01 00 00 00 00 03 B1 0B 23  /* 20 */
			29 01 00 00 00 00 03 B1 0B 21  /* 21 */
			29 01 00 00 00 00 03 B1 0B 1F  /* 22 */
			29 01 00 00 00 00 03 B1 0B 1D  /* 23 */
			29 01 00 00 00 00 03 B1 0B 13  /* 24 */
			29 01 00 00 00 00 03 B1 0B 11  /* 25 */
			29 01 00 00 00 00 03 B1 0B 0D  /* 26 */
			29 01 00 00 00 00 03 B1 0B 03  /* 27 */
			29 01 00 00 00 00 03 B1 0B 00  /* 28 */
			29 01 00 00 00 00 03 B1 0A FD  /* 29 */
			29 01 00 00 00 00 03 B1 0A F3  /* 30 */
			29 01 00 00 00 00 03 B1 0A F1  /* 31 */
			29 01 00 00 00 00 03 B1 0A EF  /* 32 */
			29 01 00 00 00 00 03 B1 0A ED  /* 33 */
			29 01 00 00 00 00 03 B1 0A E3  /* 34 */
			29 01 00 00 00 00 03 B1 0A E2  /* 35 */
			29 01 00 00 00 00 03 B1 0A E1  /* 36 */
			29 01 00 00 00 00 03 B1 0A DF  /* 37 */
			29 01 00 00 00 00 03 B1 0A DD  /* 38 */
			29 01 00 00 00 00 03 B1 0A D3  /* 39 */
			29 01 00 00 00 00 03 B1 0A D1  /* 40 */
			29 01 00 00 00 00 03 B1 0A CF  /* 41 */
			29 01 00 00 00 00 03 B1 0A CE  /* 42 */
			29 01 00 00 00 00 03 B1 0A C3  /* 43 */
			29 01 00 00 00 00 03 B1 0A C1  /* 44 */
			29 01 00 00 00 00 03 B1 0A BF  /* 45 */
			29 01 00 00 00 00 03 B1 0A BD  /* 46 */
			29 01 00 00 00 00 03 B1 0A B3  /* 47 */
			29 01 00 00 00 00 03 B1 0A B1  /* 48 */
			29 01 00 00 00 00 03 B1 0A AE  /* 49 */
			29 01 00 00 00 00 03 B1 0A A1  /* 50 */
			29 01 00 00 00 00 03 B1 0A A0  /* 51 */
			29 01 00 00 00 00 03 B1 0A 9F  /* 52 */
			29 01 00 00 00 00 03 B1 0A 9D  /* 53 */
			29 01 00 00 00 00 03 B1 0A 93  /* 54 */
			29 01 00 00 00 00 03 B1 0A 91  /* 55 */
			29 01 00 00 00 00 03 B1 0A 8E  /* 56 */
			29 01 00 00 00 00 03 B1 0A 83  /* 57 */
			29 01 00 00 00 00 03 B1 0A 81  /* 58 */
			29 01 00 00 00 00 03 B1 0A 7F  /* 59 */
			29 01 00 00 00 00 03 B1 0A 7D  /* 60 */
			29 01 00 00 00 00 03 B1 0A 78  /* 61 */
			29 01 00 00 00 00 03 B1 0A 73  /* 62 */
			29 01 00 00 00 00 03 B1 0A 70  /* 63 */
			29 01 00 00 00 00 03 B1 0A 6B  /* 64 */
			29 01 00 00 00 00 03 B1 0A 66  /* 65 */
			29 01 00 00 00 00 03 B1 0A 62  /* 66 */
			29 01 00 00 00 00 03 B1 0A 5C  /* 67 */
			29 01 00 00 00 00 03 B1 0A 58  /* 68 */
			29 01 00 00 00 00 03 B1 0A 53  /* 69 */
			29 01 00 00 00 00 03 B1 0A 4E  /* 70 */
			29 01 00 00 00 00 03 B1 0A 49  /* 71 */
			29 01 00 00 00 00 03 B1 0A 44  /* 72 */
			29 01 00 00 00 00 03 B1 0A 3F  /* 73 */
			29 01 00 00 00 00 03 B1 0A 3A  /* 74 */
			29 01 00 00 00 00 03 B1 0A 34  /* 75 */
			29 01 00 00 00 00 03 B1 0A 2F  /* 76 */
			29 01 00 00 00 00 03 B1 0A 2A  /* 77 */
			29 01 00 00 00 00 03 B1 0A 24  /* 78 */
			29 01 00 00 00 00 03 B1 0A 1E  /* 79 */
			29 01 00 00 00 00 03 B1 0A 18  /* 80 */
			29 01 00 00 00 00 03 B1 0A 12  /* 81 */
			29 01 00 00 00 00 03 B1 0A 0C  /* 82 */
			29 01 00 00 00 00 03 B1 0A 06  /* 83 */
			29 01 00 00 00 00 03 B1 0A 00  /* 84 */
			29 01 00 00 00 00 03 B1 09 FB  /* 85 */
			29 01 00 00 00 00 03 B1 09 F5  /* 86 */
			29 01 00 00 00 00 03 B1 09 F0  /* 87 */
			29 01 00 00 00 00 03 B1 09 EA  /* 88 */
			29 01 00 00 00 00 03 B1 09 E5  /* 89 */
			29 01 00 00 00 00 03 B1 09 DF  /* 90 */
			29 01 00 00 00 00 03 B1 09 DA  /* 91 */
			29 01 00 00 00 00 03 B1 09 D5  /* 92 */
			29 01 00 00 00 00 03 B1 09 D1  /* 93 */
			29 01 00 00 00 00 03 B1 09 CC  /* 94 */
			29 01 00 00 00 00 03 B1 09 C8  /* 95 */
			29 01 00 00 00 00 03 B1 09 C3  /* 96 */
			29 01 00 00 00 00 03 B1 09 BF  /* 97 */
			29 01 00 00 00 00 03 B1 09 BA  /* 98 */
			29 01 00 00 00 00 03 B1 09 B5  /* 99 */
			29 01 00 00 00 00 03 B1 09 B1  /* 100 */
			29 01 00 00 00 00 03 B1 09 AC  /* 101 */
			29 01 00 00 00 00 03 B1 09 A8  /* 102 */
			29 01 00 00 00 00 03 B1 09 A3  /* 103 */
			29 01 00 00 00 00 03 B1 09 9F  /* 104 */
			29 01 00 00 00 00 03 B1 09 9A  /* 105 */
			29 01 00 00 00 00 03 B1 09 92  /* 106 */
			29 01 00 00 00 00 03 B1 09 8A  /* 107 */
			29 01 00 00 00 00 03 B1 09 82  /* 108 */
			29 01 00 00 00 00 03 B1 09 7A  /* 109 */
			29 01 00 00 00 00 03 B1 09 72  /* 110 */
			29 01 00 00 00 00 03 B1 09 6A  /* 111 */
			29 01 00 00 00 00 03 B1 09 62  /* 112 */
			29 01 00 00 00 00 03 B1 09 5A  /* 113 */
			29 01 00 00 00 00 03 B1 09 56  /* 114 */
			29 01 00 00 00 00 03 B1 09 53  /* 115 */
			29 01 00 00 00 00 03 B1 09 4F  /* 116 */
			29 01 00 00 00 00 03 B1 09 4B  /* 117 */
			29 01 00 00 00 00 03 B1 09 48  /* 118 */
			29 01 00 00 00 00 03 B1 09 44  /* 119 */
			29 01 00 00 00 00 03 B1 09 40  /* 120 */
			29 01 00 00 00 00 03 B1 09 39  /* 121 */
			29 01 00 00 00 00 03 B1 09 33  /* 122 */
			29 01 00 00 00 00 03 B1 09 2C  /* 123 */
			29 01 00 00 00 00 03 B1 09 25  /* 124 */
			29 01 00 00 00 00 03 B1 09 1E  /* 125 */
			29 01 00 00 00 00 03 B1 09 18  /* 126 */
			29 01 00 00 00 00 03 B1 09 11  /* 127 */
			29 01 00 00 00 00 03 B1 09 0C  /* 128 */
			29 01 00 00 00 00 03 B1 09 08  /* 129 */
			29 01 00 00 00 00 03 B1 09 03  /* 130 */
			29 01 00 00 00 00 03 B1 08 FF  /* 131 */
			29 01 00 00 00 00 03 B1 08 FA  /* 132 */
			29 01 00 00 00 00 03 B1 08 F6  /* 133 */
			29 01 00 00 00 00 03 B1 08 F1  /* 134 */
			29 01 00 00 00 00 03 B1 08 EC  /* 135 */
			29 01 00 00 00 00 03 B1 08 E7  /* 136 */
			29 01 00 00 00 00 03 B1 08 E3  /* 137 */
			29 01 00 00 00 00 03 B1 08 DE  /* 138 */
			29 01 00 00 00 00 03 B1 08 D9  /* 139 */
			29 01 00 00 00 00 03 B1 08 D5  /* 140 */
			29 01 00 00 00 00 03 B1 08 D0  /* 141 */
			29 01 00 00 00 00 03 B1 08 CB  /* 142 */
			29 01 00 00 00 00 03 B1 08 C7  /* 143 */
			29 01 00 00 00 00 03 B1 08 C3  /* 144 */
			29 01 00 00 00 00 03 B1 08 BE  /* 145 */
			29 01 00 00 00 00 03 B1 08 BA  /* 146 */
			29 01 00 00 00 00 03 B1 08 B5  /* 147 */
			29 01 00 00 00 00 03 B1 08 B1  /* 148 */
			29 01 00 00 00 00 03 B1 08 AB  /* 149 */
			29 01 00 00 00 00 03 B1 08 A5  /* 150 */
			29 01 00 00 00 00 03 B1 08 9F  /* 151 */
			29 01 00 00 00 00 03 B1 08 98  /* 152 */
			29 01 00 00 00 00 03 B1 08 92  /* 153 */
			29 01 00 00 00 00 03 B1 08 8C  /* 154 */
			29 01 00 00 00 00 03 B1 08 86  /* 155 */
			29 01 00 00 00 00 03 B1 08 80  /* 156 */
			29 01 00 00 00 00 03 B1 08 7A  /* 157 */
			29 01 00 00 00 00 03 B1 08 74  /* 158 */
			29 01 00 00 00 00 03 B1 08 6E  /* 159 */
			29 01 00 00 00 00 03 B1 08 67  /* 160 */
			29 01 00 00 00 00 03 B1 08 61  /* 161 */
			29 01 00 00 00 00 03 B1 08 5B  /* 162 */
			29 01 00 00 00 00 03 B1 08 55  /* 163 */
			29 01 00 00 00 00 03 B1 08 4F  /* 164 */
			29 01 00 00 00 00 03 B1 08 4B  /* 165 */
			29 01 00 00 00 00 03 B1 08 47  /* 166 */
			29 01 00 00 00 00 03 B1 08 43  /* 167 */
			29 01 00 00 00 00 03 B1 08 3F  /* 168 */
			29 01 00 00 00 00 03 B1 08 3A  /* 169 */
			29 01 00 00 00 00 03 B1 08 36  /* 170 */
			29 01 00 00 00 00 03 B1 08 32  /* 171 */
			29 01 00 00 00 00 03 B1 08 2E  /* 172 */
			29 01 00 00 00 00 03 B1 08 27  /* 173 */
			29 01 00 00 00 00 03 B1 08 20  /* 174 */
			29 01 00 00 00 00 03 B1 08 18  /* 175 */
			29 01 00 00 00 00 03 B1 08 10  /* 176 */
			29 01 00 00 00 00 03 B1 08 08  /* 177 */
			29 01 00 00 00 00 03 B1 08 01  /* 178 */
			29 01 00 00 00 00 03 B1 07 F9  /* 179 */
			29 01 00 00 00 00 03 B1 07 F1  /* 180 */
			29 01 00 00 00 00 03 B1 07 E9  /* 181 */
			29 01 00 00 00 00 03 B1 07 E1  /* 182 */
			29 01 00 00 00 00 03 B1 07 DA  /* 183 */
			29 01 00 00 00 00 03 B1 07 D2  /* 184 */
			29 01 00 00 00 00 03 B1 07 CA  /* 185 */
			29 01 00 00 00 00 03 B1 07 C2  /* 186 */
			29 01 00 00 00 00 03 B1 07 BB  /* 187 */
			29 01 00 00 00 00 03 B1 07 B3  /* 188 */
			29 01 00 00 00 00 03 B1 07 A8  /* 189 */
			29 01 00 00 00 00 03 B1 07 9D  /* 190 */
			29 01 00 00 00 00 03 B1 07 93  /* 191 */
			29 01 00 00 00 00 03 B1 07 88  /* 192 */
			29 01 00 00 00 00 03 B1 07 7D  /* 193 */
			29 01 00 00 00 00 03 B1 07 72  /* 194 */
			29 01 00 00 00 00 03 B1 07 67  /* 195 */
			29 01 00 00 00 00 03 B1 07 5D  /* 196 */
			29 01 00 00 00 00 03 B1 07 52  /* 197 */
			29 01 00 00 00 00 03 B1 07 4A  /* 198 */
			29 01 00 00 00 00 03 B1 07 43  /* 199 */
			29 01 00 00 00 00 03 B1 07 3C  /* 200 */
			29 01 00 00 00 00 03 B1 07 34  /* 201 */
			29 01 00 00 00 00 03 B1 07 2D  /* 202 */
			29 01 00 00 00 00 03 B1 07 26  /* 203 */
			29 01 00 00 00 00 03 B1 07 1E  /* 204 */
			29 01 00 00 00 00 03 B1 07 17  /* 205 */
			29 01 00 00 00 00 03 B1 07 0F  /* 206 */
			29 01 00 00 00 00 03 B1 07 07  /* 207 */
			29 01 00 00 00 00 03 B1 06 FF  /* 208 */
			29 01 00 00 00 00 03 B1 06 F7  /* 209 */
			29 01 00 00 00 00 03 B1 06 EE  /* 210 */
			29 01 00 00 00 00 03 B1 06 E6  /* 211 */
			29 01 00 00 00 00 03 B1 06 DE  /* 212 */
			29 01 00 00 00 00 03 B1 06 D6  /* 213 */
			29 01 00 00 00 00 03 B1 06 CA  /* 214 */
			29 01 00 00 00 00 03 B1 06 BE  /* 215 */
			29 01 00 00 00 00 03 B1 06 B2  /* 216 */
			29 01 00 00 00 00 03 B1 06 A6  /* 217 */
			29 01 00 00 00 00 03 B1 06 9A  /* 218 */
			29 01 00 00 00 00 03 B1 06 8E  /* 219 */
			29 01 00 00 00 00 03 B1 06 82  /* 220 */
			29 01 00 00 00 00 03 B1 06 76  /* 221 */
			29 01 00 00 00 00 03 B1 06 6A  /* 222 */
			29 01 00 00 00 00 03 B1 06 5E  /* 223 */
			29 01 00 00 00 00 03 B1 06 53  /* 224 */
			29 01 00 00 00 00 03 B1 06 47  /* 225 */
			29 01 00 00 00 00 03 B1 06 3B  /* 226 */
			29 01 00 00 00 00 03 B1 06 30  /* 227 */
			29 01 00 00 00 00 03 B1 06 24  /* 228 */
			29 01 00 00 00 00 03 B1 06 18  /* 229 */
			29 01 00 00 00 00 03 B1 06 0A  /* 230 */
			29 01 00 00 00 00 03 B1 05 FB  /* 231 */
			29 01 00 00 00 00 03 B1 05 ED  /* 232 */
			29 01 00 00 00 00 03 B1 05 DE  /* 233 */
			29 01 00 00 00 00 03 B1 05 D0  /* 234 */
			29 01 00 00 00 00 03 B1 05 C2  /* 235 */
			29 01 00 00 00 00 03 B1 05 B3  /* 236 */
			29 01 00 00 00 00 03 B1 05 A5  /* 237 */
			29 01 00 00 00 00 03 B1 05 9B  /* 238 */
			29 01 00 00 00 00 03 B1 05 90  /* 239 */
			29 01 00 00 00 00 03 B1 05 86  /* 240 */
			29 01 00 00 00 00 03 B1 05 7B  /* 241 */
			29 01 00 00 00 00 03 B1 05 71  /* 242 */
			29 01 00 00 00 00 03 B1 05 66  /* 243 */
			29 01 00 00 00 00 03 B1 05 5C  /* 244 */
			29 01 00 00 00 00 03 B1 05 4D  /* 245 */
			29 01 00 00 00 00 03 B1 05 3E  /* 246 */
			29 01 00 00 00 00 03 B1 05 2F  /* 247 */
			29 01 00 00 00 00 03 B1 05 1F  /* 248 */
			29 01 00 00 00 00 03 B1 05 10  /* 249 */
			29 01 00 00 00 00 03 B1 05 01  /* 250 */
			29 01 00 00 00 00 03 B1 04 F2  /* 251 */
			29 01 00 00 00 00 03 B1 05 1B  /* 252 */
			29 01 00 00 00 00 03 B1 05 0A  /* 253 */
			29 01 00 00 00 00 03 B1 04 F9  /* 254 */
			29 01 00 00 00 00 03 B1 04 E8  /* 255 */
			29 01 00 00 00 00 03 B1 04 D7  /* 256 */
			29 01 00 00 00 00 03 B1 04 C6  /* 257 */
			29 01 00 00 00 00 03 B1 04 B5  /* 258 */
			29 01 00 00 00 00 03 B1 05 14  /* 259 */
			29 01 00 00 00 00 03 B1 05 04  /* 260 */
			29 01 00 00 00 00 03 B1 04 F5  /* 261 */
			29 01 00 00 00 00 03 B1 04 E5  /* 262 */
			29 01 00 00 00 00 03 B1 04 D5  /* 263 */
			29 01 00 00 00 00 03 B1 04 C5  /* 264 */
			29 01 00 00 00 00 03 B1 04 B5  /* 265 */
			29 01 00 00 00 00 03 B1 05 0F  /* 266 */
			29 01 00 00 00 00 03 B1 05 00  /* 267 */
			29 01 00 00 00 00 03 B1 04 F1  /* 268 */
			29 01 00 00 00 00 03 B1 04 E2  /* 269 */
			29 01 00 00 00 00 03 B1 04 D3  /* 270 */
			29 01 00 00 00 00 03 B1 04 C4  /* 271 */
			29 01 00 00 00 00 03 B1 04 B5  /* 272 */
			29 01 00 00 00 00 03 B1 05 0A  /* 273 */
			29 01 00 00 00 00 03 B1 04 FC  /* 274 */
			29 01 00 00 00 00 03 B1 04 ED  /* 275 */
			29 01 00 00 00 00 03 B1 04 DF  /* 276 */
			29 01 00 00 00 00 03 B1 04 D1  /* 277 */
			29 01 00 00 00 00 03 B1 04 C3  /* 278 */
			29 01 00 00 00 00 03 B1 04 B5  /* 279 */
			29 01 00 00 00 00 03 B1 05 18  /* 280 */
			29 01 00 00 00 00 03 B1 05 08  /* 281 */
			29 01 00 00 00 00 03 B1 04 F7  /* 282 */
			29 01 00 00 00 00 03 B1 04 E7  /* 283 */
			29 01 00 00 00 00 03 B1 04 D6  /* 284 */
			29 01 00 00 00 00 03 B1 04 C6  /* 285 */
			29 01 00 00 00 00 03 B1 04 B5  /* 286 */
			29 01 00 00 00 00 03 B1 05 12  /* 287 */
			29 01 00 00 00 00 03 B1 05 02  /* 288 */
			29 01 00 00 00 00 03 B1 04 F3  /* 289 */
			29 01 00 00 00 00 03 B1 04 E3  /* 290 */
			29 01 00 00 00 00 03 B1 04 D4  /* 291 */
			29 01 00 00 00 00 03 B1 04 C4  /* 292 */
			29 01 00 00 00 00 03 B1 04 B5  /* 293 */
			29 01 00 00 00 00 03 B1 05 0D  /* 294 */
			29 01 00 00 00 00 03 B1 04 FE  /* 295 */
			29 01 00 00 00 00 03 B1 04 EF  /* 296 */
			29 01 00 00 00 00 03 B1 04 E1  /* 297 */
			29 01 00 00 00 00 03 B1 04 D2  /* 298 */
			29 01 00 00 00 00 03 B1 04 C4  /* 299 */
			29 01 00 00 00 00 03 B1 04 B5  /* 300 */
			29 01 00 00 00 00 03 B1 05 17  /* 301 */
			29 01 00 00 00 00 03 B1 05 07  /* 302 */
			29 01 00 00 00 00 03 B1 04 F7  /* 303 */
			29 01 00 00 00 00 03 B1 04 E6  /* 304 */
			29 01 00 00 00 00 03 B1 04 D6  /* 305 */
			29 01 00 00 00 00 03 B1 04 C5  /* 306 */
			29 01 00 00 00 00 03 B1 04 B5  /* 307 */
			29 01 00 00 00 00 03 B1 05 03  /* 308 */
			29 01 00 00 00 00 03 B1 04 F6  /* 309 */
			29 01 00 00 00 00 03 B1 04 E9  /* 310 */
			29 01 00 00 00 00 03 B1 04 DC  /* 311 */
			29 01 00 00 00 00 03 B1 04 CF  /* 312 */
			29 01 00 00 00 00 03 B1 04 C2  /* 313 */
			29 01 00 00 00 00 03 B1 04 B5  /* 314 */
			29 01 00 00 00 00 03 B1 05 1B  /* 315 */
			29 01 00 00 00 00 03 B1 05 0A  /* 316 */
			29 01 00 00 00 00 03 B1 04 F9  /* 317 */
			29 01 00 00 00 00 03 B1 04 E8  /* 318 */
			29 01 00 00 00 00 03 B1 04 D7  /* 319 */
			29 01 00 00 00 00 03 B1 04 C6  /* 320 */
			29 01 00 00 00 00 03 B1 04 B5  /* 321 */
			29 01 00 00 00 00 03 B1 05 07  /* 322 */
			29 01 00 00 00 00 03 B1 04 FA  /* 323 */
			29 01 00 00 00 00 03 B1 04 EC  /* 324 */
			29 01 00 00 00 00 03 B1 04 DE  /* 325 */
			29 01 00 00 00 00 03 B1 04 D0  /* 326 */
			29 01 00 00 00 00 03 B1 04 C3  /* 327 */
			29 01 00 00 00 00 03 B1 04 B5  /* 328 */
			29 01 00 00 00 00 03 B1 05 1C  /* 329 */
			29 01 00 00 00 00 03 B1 05 0A  /* 330 */
			29 01 00 00 00 00 03 B1 04 F9  /* 331 */
			29 01 00 00 00 00 03 B1 04 E8  /* 332 */
			29 01 00 00 00 00 03 B1 04 D7  /* 333 */
			29 01 00 00 00 00 03 B1 04 C6  /* 334 */
			29 01 00 00 00 00 03 B1 04 B5  /* 335 */
			29 01 00 00 00 00 03 B1 05 0A  /* 336 */
			29 01 00 00 00 00 03 B1 04 FC  /* 337 */
			29 01 00 00 00 00 03 B1 04 ED  /* 338 */
			29 01 00 00 00 00 03 B1 04 DF  /* 339 */
			29 01 00 00 00 00 03 B1 04 D1  /* 340 */
			29 01 00 00 00 00 03 B1 04 C3  /* 341 */
			29 01 00 00 00 00 03 B1 04 B5  /* 342 */
			29 01 00 00 00 00 03 B1 05 10  /* 343 */
			29 01 00 00 00 00 03 B1 05 01  /* 344 */
			29 01 00 00 00 00 03 B1 04 F2  /* 345 */
			29 01 00 00 00 00 03 B1 04 E3  /* 346 */
			29 01 00 00 00 00 03 B1 04 D3  /* 347 */
			29 01 00 00 00 00 03 B1 04 C4  /* 348 */
			29 01 00 00 00 00 03 B1 04 B5  /* 349 */
			29 01 00 00 00 00 03 B1 05 15  /* 350 */
			29 01 00 00 00 00 03 B1 05 05  /* 351 */
			29 01 00 00 00 00 03 B1 04 F5  /* 352 */
			29 01 00 00 00 00 03 B1 04 E5  /* 353 */
			29 01 00 00 00 00 03 B1 04 D5  /* 354 */
			29 01 00 00 00 00 03 B1 04 C5  /* 355 */
			29 01 00 00 00 00 03 B1 04 B5  /* 356 */
			29 01 00 00 00 00 03 B1 05 0F  /* 357 */
			29 01 00 00 00 00 03 B1 05 00  /* 358 */
			29 01 00 00 00 00 03 B1 04 F1  /* 359 */
			29 01 00 00 00 00 03 B1 04 E2  /* 360 */
			29 01 00 00 00 00 03 B1 04 D3  /* 361 */
			29 01 00 00 00 00 03 B1 04 C4  /* 362 */
			29 01 00 00 00 00 03 B1 04 B5  /* 363 */
			29 01 00 00 00 00 03 B1 05 13  /* 364 */
			29 01 00 00 00 00 03 B1 05 03  /* 365 */
			29 01 00 00 00 00 03 B1 04 F4  /* 366 */
			29 01 00 00 00 00 03 B1 04 E4  /* 367 */
			29 01 00 00 00 00 03 B1 04 D4  /* 368 */
			29 01 00 00 00 00 03 B1 04 C5  /* 369 */
			29 01 00 00 00 00 03 B1 04 B5  /* 370 */
			29 01 00 00 00 00 03 B1 05 0E  /* 371 */
			29 01 00 00 00 00 03 B1 04 FF  /* 372 */
			29 01 00 00 00 00 03 B1 04 F0  /* 373 */
			29 01 00 00 00 00 03 B1 04 E1  /* 374 */
			29 01 00 00 00 00 03 B1 04 D3  /* 375 */
			29 01 00 00 00 00 03 B1 04 C4  /* 376 */
			29 01 00 00 00 00 03 B1 04 B5  /* 377 */
			29 01 00 00 00 00 03 B1 04 E3  /* 378 */
			29 01 00 00 00 00 03 B1 04 D3  /* 379 */
			29 01 00 00 00 00 03 B1 04 C4  /* 380 */
			29 01 00 00 00 00 03 B1 04 B4  /* 381 */
			29 01 00 00 00 00 03 B1 04 A4  /* 382 */
			29 01 00 00 00 00 03 B1 04 95  /* 383 */
			29 01 00 00 00 00 03 B1 04 85  /* 384 */
			29 01 00 00 00 00 03 B1 04 70  /* 385 */
			29 01 00 00 00 00 03 B1 04 5B  /* 386 */
			29 01 00 00 00 00 03 B1 04 45  /* 387 */
			29 01 00 00 00 00 03 B1 04 30  /* 388 */
			29 01 00 00 00 00 03 B1 04 1B  /* 389 */
			29 01 00 00 00 00 03 B1 04 05  /* 390 */
			29 01 00 00 00 00 03 B1 03 F0  /* 391 */
			29 01 00 00 00 00 03 B1 03 DA  /* 392 */
			29 01 00 00 00 00 03 B1 03 C3  /* 393 */
			29 01 00 00 00 00 03 B1 03 AD  /* 394 */
			29 01 00 00 00 00 03 B1 03 96  /* 395 */
			29 01 00 00 00 00 03 B1 03 80  /* 396 */
			29 01 00 00 00 00 03 B1 03 69  /* 397 */
			29 01 00 00 00 00 03 B1 03 53  /* 398 */
			29 01 00 00 00 00 03 B1 03 3B  /* 399 */
			29 01 00 00 00 00 03 B1 03 24  /* 400 */
			29 01 00 00 00 00 03 B1 03 0D  /* 401 */
			29 01 00 00 00 00 03 B1 02 F5  /* 402 */
			29 01 00 00 00 00 03 B1 02 DE  /* 403 */
			29 01 00 00 00 00 03 B1 02 C6  /* 404 */
			29 01 00 00 00 00 03 B1 02 AF  /* 405 */
			29 01 00 00 00 00 03 B1 02 97  /* 406 */
			29 01 00 00 00 00 03 B1 02 7F  /* 407 */
			29 01 00 00 00 00 03 B1 02 68  /* 408 */
			29 01 00 00 00 00 03 B1 02 50  /* 409 */
			29 01 00 00 00 00 03 B1 02 38  /* 410 */
			29 01 00 00 00 00 03 B1 02 21  /* 411 */
			29 01 00 00 00 00 03 B1 02 09  /* 412 */
			29 01 00 00 00 00 03 B1 01 F1  /* 413 */
			29 01 00 00 00 00 03 B1 01 E0  /* 414 */
			29 01 00 00 00 00 03 B1 01 CC  /* 415 */
			29 01 00 00 00 00 03 B1 01 B9  /* 416 */
			29 01 00 00 00 00 03 B1 01 A5  /* 417 */
			29 01 00 00 00 00 03 B1 01 91  /* 418 */
			29 01 00 00 00 00 03 B1 01 7D  /* 419 */
			29 01 00 00 00 00 03 B1 01 69  /* 420 */
			29 01 00 00 00 00 03 B1 01 55  /* 421 */
			29 01 00 00 00 00 03 B1 01 E3  /* 422 */
			29 01 00 00 00 00 03 B1 01 D1  /* 423 */
			29 01 00 00 00 00 03 B1 01 BF  /* 424 */
			29 01 00 00 00 00 03 B1 01 AE  /* 425 */
			29 01 00 00 00 00 03 B1 01 9C  /* 426 */
			29 01 00 00 00 00 03 B1 01 8A  /* 427 */
			29 01 00 00 00 00 03 B1 01 78  /* 428 */
			29 01 00 00 00 00 03 B1 01 67  /* 429 */
			29 01 00 00 00 00 03 B1 01 55  /* 430 */
			29 01 00 00 00 00 03 B1 01 E3  /* 431 */
			29 01 00 00 00 00 03 B1 01 D1  /* 432 */
			29 01 00 00 00 00 03 B1 01 BF  /* 433 */
			29 01 00 00 00 00 03 B1 01 AE  /* 434 */
			29 01 00 00 00 00 03 B1 01 9C  /* 435 */
			29 01 00 00 00 00 03 B1 01 8A  /* 436 */
			29 01 00 00 00 00 03 B1 01 78  /* 437 */
			29 01 00 00 00 00 03 B1 01 67  /* 438 */
			29 01 00 00 00 00 03 B1 01 55  /* 439 */
			29 01 00 00 00 00 03 B1 01 E4  /* 440 */
			29 01 00 00 00 00 03 B1 01 D4  /* 441 */
			29 01 00 00 00 00 03 B1 01 C4  /* 442 */
			29 01 00 00 00 00 03 B1 01 B4  /* 443 */
			29 01 00 00 00 00 03 B1 01 A4  /* 444 */
			29 01 00 00 00 00 03 B1 01 94  /* 445 */
			29 01 00 00 00 00 03 B1 01 85  /* 446 */
			29 01 00 00 00 00 03 B1 01 75  /* 447 */
			29 01 00 00 00 00 03 B1 01 65  /* 448 */
			29 01 00 00 00 00 03 B1 01 55  /* 449 */
			29 01 00 00 00 00 03 B1 01 CA  /* 450 */
			29 01 00 00 00 00 03 B1 01 B9  /* 451 */
			29 01 00 00 00 00 03 B1 01 A9  /* 452 */
			29 01 00 00 00 00 03 B1 01 98  /* 453 */
			29 01 00 00 00 00 03 B1 01 87  /* 454 */
			29 01 00 00 00 00 03 B1 01 76  /* 455 */
			29 01 00 00 00 00 03 B1 01 66  /* 456 */
			29 01 00 00 00 00 03 B1 01 55  /* 457 */
			29 01 00 00 00 00 03 B1 01 CD  /* 458 */
			29 01 00 00 00 00 03 B1 01 BE  /* 459 */
			29 01 00 00 00 00 03 B1 01 AF  /* 460 */
			29 01 00 00 00 00 03 B1 01 A0  /* 461 */
			29 01 00 00 00 00 03 B1 01 91  /* 462 */
			29 01 00 00 00 00 03 B1 01 82  /* 463 */
			29 01 00 00 00 00 03 B1 01 73  /* 464 */
			29 01 00 00 00 00 03 B1 01 64  /* 465 */
			29 01 00 00 00 00 03 B1 01 55  /* 466 */
			29 01 00 00 00 00 03 B1 01 C7  /* 467 */
			29 01 00 00 00 00 03 B1 01 B9  /* 468 */
			29 01 00 00 00 00 03 B1 01 AB  /* 469 */
			29 01 00 00 00 00 03 B1 01 9C  /* 470 */
			29 01 00 00 00 00 03 B1 01 8E  /* 471 */
			29 01 00 00 00 00 03 B1 01 80  /* 472 */
			29 01 00 00 00 00 03 B1 01 72  /* 473 */
			29 01 00 00 00 00 03 B1 01 63  /* 474 */
			29 01 00 00 00 00 03 B1 01 55  /* 475 */
			29 01 00 00 00 00 03 B1 01 7C  /* 476 */
			29 01 00 00 00 00 03 B1 01 6F  /* 477 */
			29 01 00 00 00 00 03 B1 01 62  /* 478 */
			29 01 00 00 00 00 03 B1 01 55  /* 479 */
			29 01 00 00 00 00 03 B1 01 7B  /* 480 */
			29 01 00 00 00 00 03 B1 01 6C  /* 481 */
			29 01 00 00 00 00 03 B1 01 5E  /* 482 */
			29 01 00 00 00 00 03 B1 01 4F  /* 483 */
			29 01 00 00 00 00 03 B1 01 35  /* 484 */
			29 01 00 00 00 00 03 B1 01 1B  /* 485 */
			29 01 00 00 00 00 03 B1 01 01  /* 486 */
			29 01 00 00 00 00 03 B1 00 F1  /* 487 */
			29 01 00 00 00 00 03 B1 00 E0  /* 488 */
			29 01 00 00 00 00 03 B1 00 D0  /* 489 */
			29 01 00 00 00 00 03 B1 00 C0  /* 490 */
			29 01 00 00 00 00 03 B1 00 AE  /* 491 */
			29 01 00 00 00 00 03 B1 00 9C  /* 492 */
			29 01 00 00 00 00 03 B1 00 8A  /* 493 */
			29 01 00 00 00 00 03 B1 00 78  /* 494 */
			29 01 00 00 00 00 03 B1 00 63  /* 495 */
			29 01 00 00 00 00 03 B1 00 4F  /* 496 */
			29 01 00 00 00 00 03 B1 00 3A  /* 497 */
			29 01 00 00 00 00 03 B1 00 26  /* 498 */
			29 01 00 00 00 00 03 B1 00 38  /* 499 */
			29 01 00 00 00 00 03 B1 00 29  /* 500 */
			29 01 00 00 00 00 03 B1 00 1B  /* 501 */
			29 01 00 00 00 00 03 B1 00 0C  /* 502 */
			29 01 00 00 00 00 03 B1 00 3D  /* 503 */
			29 01 00 00 00 00 03 B1 00 2C  /* 504 */
			29 01 00 00 00 00 03 B1 00 1C  /* 505 */
			29 01 00 00 00 00 03 B1 00 0C  /* 506 */
			29 01 00 00 00 00 03 B1 00 36  /* 507 */
			29 01 00 00 00 00 03 B1 00 28  /* 508 */
			29 01 00 00 00 00 03 B1 00 1A  /* 509 */
			29 01 00 00 00 00 03 B1 00 0C  /* 510 */
			29 01 00 00 00 00 03 B1 00 0C  /* 511 */
		];

		/*
		* ************************************************************************************************************************
		* candela to index mappings
		* ************************************************************************************************************************
		*/
		samsung,pac_candela_map_table_revA = <
/*<scaled idx> <idx>  <from>  <end> <cd> <interpolation cd>*/
			0	0	0		0		2	2
			1	1	1		100 	3	2
			2	1	101 	200 	3	2
			3	1	201 	300 	3	2
			4	1	301 	400 	3	3
			5	1	401 	500 	3	3
			6	1	501 	600 	3	3
			7	1	601 	700 	3	3
			8	2	701 	800 	4	3
			9	2	801 	900 	4	3
			10	2	901 	1000	4	3
			11	2	1001	1100	4	4
			12	2	1101	1200	4	4
			13	2	1201	1300	4	4
			14	2	1301	1400	4	4
			15	3	1401	1500	5	4
			16	3	1501	1600	5	4
			17	3	1601	1700	5	4
			18	3	1701	1800	5	5
			19	3	1801	1900	5	5
			20	3	1901	2000	5	5
			21	3	2001	2100	5	5
			22	4	2101	2200	6	5
			23	4	2201	2300	6	5
			24	4	2301	2400	6	5
			25	4	2401	2500	6	6
			26	4	2501	2600	6	6
			27	4	2601	2700	6	6
			28	4	2701	2800	6	6
			29	5	2801	2900	7	6
			30	5	2901	3000	7	6
			31	5	3001	3100	7	6
			32	5	3101	3200	7	7
			33	5	3201	3300	7	7
			34	5	3301	3400	7	7
			35	5	3401	3500	7	7
			36	6	3501	3557	8	7
			37	6	3558	3614	8	7
			38	6	3615	3671	8	7
			39	6	3672	3729	8	8
			40	6	3730	3786	8	8
			41	6	3787	3843	8	8
			42	6	3844	3900	8	8
			43	7	3901	3971	9	8
			44	7	3972	4043	9	8
			45	7	4044	4114	9	8
			46	7	4115	4186	9	9
			47	7	4187	4257	9	9
			48	7	4258	4329	9	9
			49	7	4330	4400	9	9
			50	8	4401	4471	10	9
			51	8	4472	4543	10	9
			52	8	4544	4614	10	9
			53	8	4615	4686	10	10
			54	8	4687	4757	10	10
			55	8	4758	4829	10	10
			56	8	4830	4900	10	10
			57	9	4901	4971	11	10
			58	9	4972	5043	11	10
			59	9	5044	5114	11	10
			60	9	5115	5186	11	11
			61	9	5187	5257	11	11
			62	9	5258	5329	11	11
			63	9	5330	5400	11	11
			64	10	5401	5471	12	11
			65	10	5472	5543	12	11
			66	10	5544	5614	12	11
			67	10	5615	5686	12	12
			68	10	5687	5757	12	12
			69	10	5758	5829	12	12
			70	10	5830	5900	12	12
			71	11	5901	5971	13	12
			72	11	5972	6043	13	12
			73	11	6044	6114	13	12
			74	11	6115	6186	13	13
			75	11	6187	6257	13	13
			76	11	6258	6329	13	13
			77	11	6330	6400	13	13
			78	12	6401	6457	14	13
			79	12	6458	6514	14	13
			80	12	6515	6571	14	13
			81	12	6572	6629	14	14
			82	12	6630	6686	14	14
			83	12	6687	6743	14	14
			84	12	6744	6800	14	14
			85	13	6801	6843	15	14
			86	13	6844	6886	15	14
			87	13	6887	6929	15	14
			88	13	6930	6971	15	15
			89	13	6972	7014	15	15
			90	13	7015	7057	15	15
			91	13	7058	7100	15	15
			92	14	7101	7143	16	15
			93	14	7144	7186	16	15
			94	14	7187	7229	16	15
			95	14	7230	7271	16	16
			96	14	7272	7314	16	16
			97	14	7315	7357	16	16
			98	14	7358	7400	16	16
			99	15	7401	7443	17	16
			100 15	7444	7486	17	16
			101 15	7487	7529	17	16
			102 15	7530	7571	17	17
			103 15	7572	7614	17	17
			104 15	7615	7657	17	17
			105 15	7658	7700	17	17
			106 16	7701	7738	19	17
			107 16	7739	7775	19	18
			108 16	7776	7813	19	18
			109 16	7814	7850	19	18
			110 16	7851	7888	19	18
			111 16	7889	7925	19	19
			112 16	7926	7963	19	19
			113 16	7964	8000	19	19
			114 17	8001	8043	20	19
			115 17	8044	8086	20	19
			116 17	8087	8129	20	19
			117 17	8130	8171	20	20
			118 17	8172	8214	20	20
			119 17	8215	8257	20	20
			120 17	8258	8300	20	20
			121 18	8301	8343	21	20
			122 18	8344	8386	21	20
			123 18	8387	8429	21	20
			124 18	8430	8471	21	21
			125 18	8472	8514	21	21
			126 18	8515	8557	21	21
			127 18	8558	8600	21	21
			128 19	8601	8643	22	21
			129 19	8644	8686	22	21
			130 19	8687	8729	22	21
			131 19	8730	8771	22	22
			132 19	8772	8814	22	22
			133 19	8815	8857	22	22
			134 19	8858	8900	22	22
			135 20	8901	8943	24	22
			136 20	8944	8986	24	23
			137 20	8987	9029	24	23
			138 20	9030	9071	24	23
			139 20	9072	9114	24	23
			140 20	9115	9157	24	24
			141 20	9158	9200	24	24
			142 21	9201	9243	25	24
			143 21	9244	9286	25	24
			144 21	9287	9329	25	24
			145 21	9330	9371	25	25
			146 21	9372	9414	25	25
			147 21	9415	9457	25	25
			148 21	9458	9500	25	25
			149 22	9501	9538	27	25
			150 22	9539	9575	27	26
			151 22	9576	9613	27	26
			152 22	9614	9650	27	26
			153 22	9651	9688	27	26
			154 22	9689	9725	27	27
			155 22	9726	9763	27	27
			156 22	9764	9800	27	27
			157 23	9801	9838	29	27
			158 23	9839	9875	29	28
			159 23	9876	9913	29	28
			160 23	9914	9950	29	28
			161 23	9951	9988	29	28
			162 23	9989	10025	29	29
			163 23	10026	10063	29	29
			164 23	10064	10100	29	29
			165 24	10101	10138	30	29
			166 24	10139	10175	30	29
			167 24	10176	10213	30	29
			168 24	10214	10250	30	30
			169 24	10251	10288	30	30
			170 24	10289	10325	30	30
			171 24	10326	10363	30	30
			172 24	10364	10400	30	30
			173 25	10401	10438	32	30
			174 25	10439	10475	32	31
			175 25	10476	10513	32	31
			176 25	10514	10550	32	31
			177 25	10551	10588	32	31
			178 25	10589	10625	32	32
			179 25	10626	10663	32	32
			180 25	10664	10700	32	32
			181 26	10701	10738	34	32
			182 26	10739	10775	34	33
			183 26	10776	10813	34	33
			184 26	10814	10850	34	33
			185 26	10851	10888	34	33
			186 26	10889	10925	34	34
			187 26	10926	10963	34	34
			188 26	10964	11000	34	34
			189 27	11001	11033	37	34
			190 27	11034	11067	37	35
			191 27	11068	11100	37	35
			192 27	11101	11133	37	35
			193 27	11134	11167	37	36
			194 27	11168	11200	37	36
			195 27	11201	11233	37	36
			196 27	11234	11267	37	37
			197 27	11268	11300	37	37
			198 28	11301	11338	39	37
			199 28	11339	11375	39	38
			200 28	11376	11413	39	38
			201 28	11414	11450	39	38
			202 28	11451	11488	39	38
			203 28	11489	11525	39	39
			204 28	11526	11563	39	39
			205 28	11564	11600	39	39
			206 29	11601	11638	41	39
			207 29	11639	11675	41	40
			208 29	11676	11713	41	40
			209 29	11714	11750	41	40
			210 29	11751	11788	41	40
			211 29	11789	11825	41	41
			212 29	11826	11863	41	41
			213 29	11864	11900	41	41
			214 30	11901	11938	44	41
			215 30	11939	11975	44	42
			216 30	11976	12013	44	42
			217 30	12014	12050	44	43
			218 30	12051	12088	44	43
			219 30	12089	12125	44	43
			220 30	12126	12163	44	44
			221 30	12164	12200	44	44
			222 31	12201	12238	47	44
			223 31	12239	12275	47	45
			224 31	12276	12313	47	45
			225 31	12314	12350	47	46
			226 31	12351	12388	47	46
			227 31	12389	12425	47	46
			228 31	12426	12463	47	47
			229 31	12464	12500	47	47
			230 32	12501	12538	50	47
			231 32	12539	12575	50	48
			232 32	12576	12613	50	48
			233 32	12614	12650	50	49
			234 32	12651	12688	50	49
			235 32	12689	12725	50	49
			236 32	12726	12763	50	50
			237 32	12764	12800	50	50
			238 33	12801	12829	53	50
			239 33	12830	12857	53	51
			240 33	12858	12886	53	51
			241 33	12887	12914	53	52
			242 33	12915	12943	53	52
			243 33	12944	12971	53	53
			244 33	12972	13000	53	53
			245 34	13001	13029	56	53
			246 34	13030	13057	56	54
			247 34	13058	13086	56	54
			248 34	13087	13114	56	55
			249 34	13115	13143	56	55
			250 34	13144	13171	56	56
			251 34	13172	13200	56	56
			252 35	13201	13229	60	57
			253 35	13230	13257	60	57
			254 35	13258	13286	60	58
			255 35	13287	13314	60	58
			256 35	13315	13343	60	59
			257 35	13344	13371	60	59
			258 35	13372	13400	60	60
			259 36	13401	13429	64	61
			260 36	13430	13457	64	61
			261 36	13458	13486	64	62
			262 36	13487	13514	64	62
			263 36	13515	13543	64	63
			264 36	13544	13571	64	63
			265 36	13572	13600	64	64
			266 37	13601	13629	68	65
			267 37	13630	13657	68	65
			268 37	13658	13686	68	66
			269 37	13687	13714	68	66
			270 37	13715	13743	68	67
			271 37	13744	13771	68	67
			272 37	13772	13800	68	68
			273 38	13801	13829	72	69
			274 38	13830	13857	72	69
			275 38	13858	13886	72	70
			276 38	13887	13914	72	70
			277 38	13915	13943	72	71
			278 38	13944	13971	72	71
			279 38	13972	14000	72	72
			280 39	14001	14029	77	73
			281 39	14030	14057	77	73
			282 39	14058	14086	77	74
			283 39	14087	14114	77	75
			284 39	14115	14143	77	76
			285 39	14144	14171	77	76
			286 39	14172	14200	77	77
			287 40	14201	14229	82	78
			288 40	14230	14257	82	78
			289 40	14258	14286	82	79
			290 40	14287	14314	82	80
			291 40	14315	14343	82	81
			292 40	14344	14371	82	81
			293 40	14372	14400	82	82
			294 41	14401	14429	87	83
			295 41	14430	14457	87	83
			296 41	14458	14486	87	84
			297 41	14487	14514	87	85
			298 41	14515	14543	87	86
			299 41	14544	14571	87	86
			300 41	14572	14600	87	87
			301 42	14601	14629	93	88
			302 42	14630	14657	93	89
			303 42	14658	14686	93	90
			304 42	14687	14714	93	90
			305 42	14715	14743	93	91
			306 42	14744	14771	93	92
			307 42	14772	14800	93	93
			308 43	14801	14829	98	94
			309 43	14830	14857	98	94
			310 43	14858	14886	98	95
			311 43	14887	14914	98	96
			312 43	14915	14943	98	97
			313 43	14944	14971	98	97
			314 43	14972	15000	98	98
			315 44	15001	15029	105 99
			316 44	15030	15057	105 100
			317 44	15058	15086	105 101
			318 44	15087	15114	105 102
			319 44	15115	15143	105 103
			320 44	15144	15171	105 104
			321 44	15172	15200	105 105
			322 45	15201	15229	111 106
			323 45	15230	15257	111 107
			324 45	15258	15286	111 108
			325 45	15287	15314	111 108
			326 45	15315	15343	111 109
			327 45	15344	15371	111 110
			328 45	15372	15400	111 111
			329 46	15401	15429	119 112
			330 46	15430	15457	119 113
			331 46	15458	15486	119 114
			332 46	15487	15514	119 116
			333 46	15515	15543	119 117
			334 46	15544	15571	119 118
			335 46	15572	15600	119 119
			336 47	15601	15629	126 120
			337 47	15630	15657	126 121
			338 47	15658	15686	126 122
			339 47	15687	15714	126 123
			340 47	15715	15743	126 124
			341 47	15744	15771	126 125
			342 47	15772	15800	126 126
			343 48	15801	15829	134 127
			344 48	15830	15857	134 128
			345 48	15858	15886	134 129
			346 48	15887	15914	134 131
			347 48	15915	15943	134 132
			348 48	15944	15971	134 133
			349 48	15972	16000	134 134
			350 49	16001	16029	143 135
			351 49	16030	16057	143 137
			352 49	16058	16086	143 138
			353 49	16087	16114	143 139
			354 49	16115	16143	143 140
			355 49	16144	16171	143 142
			356 49	16172	16200	143 143
			357 50	16201	16229	152 144
			358 50	16230	16257	152 146
			359 50	16258	16286	152 147
			360 50	16287	16314	152 148
			361 50	16315	16343	152 149
			362 50	16344	16371	152 151
			363 50	16372	16400	152 152
			364 51	16401	16429	162 153
			365 51	16430	16457	162 155
			366 51	16458	16486	162 156
			367 51	16487	16514	162 158
			368 51	16515	16543	162 159
			369 51	16544	16571	162 161
			370 51	16572	16600	162 162
			371 52	16601	16629	172 163
			372 52	16630	16657	172 165
			373 52	16658	16686	172 166
			374 52	16687	16714	172 168
			375 52	16715	16743	172 169
			376 52	16744	16771	172 171
			377 52	16772	16800	172 172
			378 53	16801	16829	183 174
			379 53	16830	16857	183 175
			380 53	16858	16886	183 177
			381 53	16887	16914	183 178
			382 53	16915	16943	183 180
			383 53	16944	16971	183 181
			384 53	16972	17000	183 183
			385 54	17001	17057	195 185
			386 54	17058	17114	195 186
			387 54	17115	17171	195 188
			388 54	17172	17229	195 190
			389 54	17230	17286	195 192
			390 54	17287	17343	195 193
			391 54	17344	17400	195 195
			392 55	17401	17457	207 197
			393 55	17458	17514	207 198
			394 55	17515	17571	207 200
			395 55	17572	17629	207 202
			396 55	17630	17686	207 204
			397 55	17687	17743	207 205
			398 55	17744	17800	207 207
			399 56	17801	17857	220 209
			400 56	17858	17914	220 211
			401 56	17915	17971	220 213
			402 56	17972	18029	220 214
			403 56	18030	18086	220 216
			404 56	18087	18143	220 218
			405 56	18144	18200	220 220
			406 57	18201	18250	234 222
			407 57	18251	18300	234 224
			408 57	18301	18350	234 225
			409 57	18351	18400	234 227
			410 57	18401	18450	234 229
			411 57	18451	18500	234 231
			412 57	18501	18550	234 232
			413 57	18551	18600	234 234
			414 58	18601	18650	249 236
			415 58	18651	18700	249 238
			416 58	18701	18750	249 240
			417 58	18751	18800	249 242
			418 58	18801	18850	249 243
			419 58	18851	18900	249 245
			420 58	18901	18950	249 247
			421 58	18951	19000	249 249
			422 59	19001	19044	265 251
			423 59	19045	19089	265 253
			424 59	19090	19133	265 254
			425 59	19134	19178	265 256
			426 59	19179	19222	265 258
			427 59	19223	19267	265 260
			428 59	19268	19311	265 261
			429 59	19312	19356	265 263
			430 59	19357	19400	265 265
			431 60	19401	19444	282 267
			432 60	19445	19489	282 269
			433 60	19490	19533	282 271
			434 60	19534	19578	282 273
			435 60	19579	19622	282 274
			436 60	19623	19667	282 276
			437 60	19668	19711	282 278
			438 60	19712	19756	282 280
			439 60	19757	19800	282 282
			440 61	19801	19860	300 284
			441 61	19861	19920	300 286
			442 61	19921	19980	300 287
			443 61	19981	20040	300 289
			444 61	20041	20100	300 291
			445 61	20101	20160	300 293
			446 61	20161	20220	300 295
			447 61	20221	20280	300 296
			448 61	20281	20340	300 298
			449 61	20341	20400	300 300
			450 62	20401	20463	316 302
			451 62	20464	20525	316 304
			452 62	20526	20588	316 306
			453 62	20589	20650	316 308
			454 62	20651	20713	316 310
			455 62	20714	20775	316 312
			456 62	20776	20838	316 314
			457 62	20839	20900	316 316
			458 63	20901	20956	333 318
			459 63	20957	21011	333 320
			460 63	21012	21067	333 322
			461 63	21068	21122	333 324
			462 63	21123	21178	333 325
			463 63	21179	21233	333 327
			464 63	21234	21289	333 329
			465 63	21290	21344	333 331
			466 63	21345	21400	333 333
			467 64	21401	21456	350 335
			468 64	21457	21511	350 337
			469 64	21512	21567	350 339
			470 64	21568	21622	350 341
			471 64	21623	21678	350 342
			472 64	21679	21733	350 344
			473 64	21734	21789	350 346
			474 64	21790	21844	350 348
			475 64	21845	21900	350 350
			476 65	21901	22000	357 352
			477 65	22001	22100	357 354
			478 65	22101	22200	357 355
			479 65	22201	22300	357 357
			480 66	22301	22400	365 359
			481 66	22401	22500	365 361
			482 66	22501	22600	365 363
			483 66	22601	22700	365 365
			484 67	22701	22800	372 367
			485 67	22801	22900	372 370
			486 67	22901	23000	372 372
			487 68	23001	23100	380 374
			488 68	23101	23200	380 376
			489 68	23201	23300	380 378
			490 68	23301	23400	380 380
			491 69	23401	23500	387 382
			492 69	23501	23600	387 384
			493 69	23601	23700	387 385
			494 69	23701	23800	387 387
			495 70	23801	23900	395 389
			496 70	23901	24000	395 391
			497 70	24001	24100	395 393
			498 70	24101	24200	395 395
			499 71	24201	24300	403 397
			500 71	24301	24400	403 399
			501 71	24401	24500	403 401
			502 71	24501	24600	403 403
			503 72	24601	24700	412 405
			504 72	24701	24800	412 408
			505 72	24801	24900	412 410
			506 72	24901	25000	412 412
			507 73	25001	25100	420 414
			508 73	25101	25200	420 416
			509 73	25201	25300	420 418
			510 73	25301	25400	420 420
			511 73	25401	25500	420 420
		>;

		samsung,pac_hbm_candela_map_table_revA = <
			0	28200	29500	465		6
			1	29501	30900	488		7
			2	30901	32300	510		8
			3	32301	33600	533		9
			4	33601	35000	555		10
			5	35001	36400	578		11
			6	36401	36500	600		12
		>;
	};
};
