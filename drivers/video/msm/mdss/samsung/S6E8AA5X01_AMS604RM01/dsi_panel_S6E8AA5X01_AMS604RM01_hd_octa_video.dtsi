/* Copyright (c) 2013-2014, The Linux Foundation. All rights reserved.
 *
 * This program is free software; you can redistribute it and/or modify
 * it under the terms of the GNU General Public License version 2 and
 * only version 2 as published by the Free Software Foundation.
 *
 * This program is distributed in the hope that it will be useful,
 * but WITHOUT ANY WARRANTY; without even the implied warranty of
 * MERCHANTABILITY or FITNESS FOR A PARTICULAR PURPOSE.  See the
 * GNU General Public License for more details.
 */

/*---------------------------------------------------------------------------
 * This file is autogenerated file using gcdb parser. Please do not edit it.
 * Update input XML file to add a new entry or update variable in this file
 * VERSION = "1.0"
 *---------------------------------------------------------------------------*/
&mdss_mdp {
	ss_dsi_panel_S6E8AA5X01_AMS604RM01_HD: ss_dsi_panel_S6E8AA5X01_AMS604RM01_HD {
		#define default_elvss 00 00 00 00 00 00 00 00 00 C0 00 0A AA 22 12 03 33 21 10
		qcom,mdss-dsi-panel-name = "ss_dsi_panel_S6E8AA5X01_AMS604RM01_HD";
		qcom,mdss-dsi-panel-controller = <&mdss_dsi0>;
		qcom,mdss-dsi-panel-width = <720>;
		qcom,mdss-dsi-panel-height = <1480>;
		qcom,mdss-dsi-bpp = <24>;
		qcom,mdss-dsi-panel-destination = "display_1";

		qcom,mdss-dsi-panel-timings-phy-v2 = [
			1F 1B 05 06 03 03 04 a0
			1F 1B 05 06 03 03 04 a0
			1F 1B 05 06 03 03 04 a0
			1F 1B 05 06 03 03 04 a0
			1F 10 04 06 03 03 04 a0];

		qcom,mdss-dsi-on-command= [
			05 01 00 00 14 00 02 11 00		/* Sleep out, wait 20ms(0x14) */

			/* Brightness condition set */
			29 01 00 00 00 00 03 F0 5A 5A		/* TEST KEY Enable */
			29 01 00 00 00 00 22 CA			/* 1) Gamma 2.2 Setting */
				01 00 01 00 01 00		/* V255 R,G,B */
				80 80 80			/* V203 R,G,B */
				80 80 80			/* V151 R,G,B */
				80 80 80			/* V87 R,G,B */
				80 80 80			/* V51 R,G,B */
				80 80 80			/* V35 R,G,B */
				80 80 80			/* V23 R,G,B */
				80 80 80			/* V11 R,G,B */
				80 80 80			/*  V3 R,G,B */
				00 00 00			/*  VT R,G,B */
			29 01 00 00 00 00 03 B2 00 10		/* AID set : AOR 0% */
			29 01 00 00 00 00 02 F7 03		/* Gamma, LTPS(AID) update */
			29 01 00 00 00 00 03 F0 A5 A5

			/* Pentile setting */
			29 01 00 00 00 00 03 F0 5A 5A		/* TEST KEY Enable */
			29 01 00 00 00 00 04 C0 D8 D8 00
			29 01 00 00 00 00 03 F0 A5 A5

			/* PCD Setting */
			29 01 00 00 00 00 03 F0 5A 5A		/* TEST KEY Enable */
			29 01 00 00 00 00 02 CC 4C 			/* high active*/
			29 01 00 00 00 00 03 F0 A5 A5

			/* Error Flag Setting */
			29 01 00 00 00 00 03 F0 5A 5A		/* TEST KEY Enable */
			29 01 00 00 00 00 05 E7 ED C7 23 67
			29 01 00 00 00 00 03 F0 A5 A5

			/* Display control Setting */
			29 01 00 00 00 00 03 F0 5A 5A		/* TEST KEY Enable */
			29 01 00 00 00 00 05 F2 0A 0E B9 01
			29 01 00 00 78 00 03 F0 A5 A5		/* TEST KEY Disable */
		];

		qcom,mdss-dsi-off-command=[
			05 01 00 00 00 00 02 28 00
			05 01 00 00 78 00 02 10 00	/* wait 120ms */
		];

		qcom,cont-splash-enabled;
		qcom,mdss-dsi-force-clock-lane-hs;

		qcom,mdss-dsi-t-clk-pre = <0x21>;
		qcom,mdss-dsi-t-clk-post = <0x0A>;

		qcom,mdss-dsi-h-pulse-width = <12>;
		qcom,mdss-dsi-h-back-porch = <20>;
		qcom,mdss-dsi-h-front-porch = <172>;
		qcom,mdss-dsi-h-sync-skew = <0>;

		qcom,mdss-dsi-v-pulse-width = <5>;
		qcom,mdss-dsi-v-back-porch = <5>;
		qcom,mdss-dsi-v-front-porch = <14>;

		qcom,mdss-dsi-h-left-border = <0>;
		qcom,mdss-dsi-h-right-border = <0>;
		qcom,mdss-dsi-v-top-border = <0>;
		qcom,mdss-dsi-v-bottom-border = <0>;

		qcom,mdss-dsi-panel-clockrate = <500290000>;

		qcom,mdss-dsi-underflow-color = <0xFF>;
		qcom,mdss-dsi-border-color = <0>;

		qcom,mdss-dsi-bl-pmic-control-type = "bl_ctrl_dcs";

		qcom,mdss-dsi-bl-min-level = <1>;
		qcom,mdss-dsi-bl-max-level = <365>;
		qcom,mdss-brightness-max-level = <365>;

		/*qcom,mdss-dsi-interleave-mode = <0>; */
		qcom,mdss-dsi-panel-type = "dsi_video_mode";

		/*qcom,mdss-dsi-te-check-enable;*/
		/*qcom,mdss-dsi-te-using-te-pin;*/
		/*qcom,mdss-dsi-te-pin-select = <1>;*/

		/*qcom,mdss-dsi-te-dcs-command = <1>;*/
		/*qcom,mdss-dsi-wr-mem-start = <0x2C>;*/
		/*qcom,mdss-dsi-wr-mem-continue = <0x3C>;*/

		/* CMD mode panel doesn't need below stuff */
		/*qcom,mdss-dsi-h-sync-pulse;*/
		/*qcom,mdss-dsi-hfp-power-mode=*/
		/*qcom,mdss-dsi-hbp-power-mode=*/
		qcom,mdss-dsi-hsa-power-mode;
		/*qcom,mdss-dsi-last-line-interleave=*/
		qcom,mdss-dsi-bllp-eof-power-mode;
		qcom,mdss-dsi-bllp-power-mode;
		qcom,mdss-dsi-traffic-mode= "burst_mode";
		qcom,mdss-dsi-pixel-packing = "loose";
		qcom,mdss-dsi-virtual-channel-id = <0>;
		qcom,mdss-dsi-color-order = "rgb_swap_rgb";
		qcom,mdss-dsi-lane-0-state;
		qcom,mdss-dsi-lane-1-state;
		qcom,mdss-dsi-lane-2-state;
		qcom,mdss-dsi-lane-3-state;
		qcom,mdss-dsi-lane-map = "lane_map_0123";

		qcom,mdss-dsi-stream = <0>;
		qcom,mdss-dsi-mdp-trigger = "none";
		qcom,mdss-dsi-dma-trigger = "trigger_sw";
		qcom,mdss-dsi-panel-framerate = <60>;

		qcom,mdss-dsi-on-command-state = "dsi_lp_mode";
		qcom,mdss-dsi-off-command-state = "dsi_hs_mode";

		qcom,mdss-pan-physical-width-dimension = <67>;
		qcom,mdss-pan-physical-height-dimension = <138>;

		qcom,mdss-dsi-panel-mode-gpio-state = "invalid";

		qcom,mdss-dsi-reset-sequence = <1 20>, <0 20>, <1 20>;

		qcom,mdss-dsi-lp11-init;
		qcom,mdss-dsi-init-delay-us = <2000>;//
		qcom,mdss-dsi-rx-eot-ignore;
		qcom,mdss-dsi-tx-eot-append;

		/*qcom,ulps-enabled*/
		/*qcom,mdss-dsi-panel-status-command=*/
		/*qcom,mdss-dsi-panel-status-command-mode="dsi_lp_mode";*/
		qcom,esd-check-enabled;
		qcom,mdss-dsi-panel-status-check-mode="reg_read_irq";
		qcom,mdss-dsi-panel-status-value = <1>;
		/*qcom,mdss-dsi-panel-status-irq-trigger1="rising";*/
		/*qcom,mdss-dsi-panel-status-irq-trigger2="rising";*/
		qcom,mdss-dsi-panel-status-read-length = <1>;
		/*qcom,dynamic-mode-switch-enabled*/
		/*qcom,video-to-cmd-mode-switch-commands=*/
		/*qcom,cmd-to-video-mode-switch-commands=*/
/*
 * ************************************************************************************************************************************
 *
 *
 *			Below  parameters are samsung dependent thigs
 *
 *
 * ************************************************************************************************************************************
 */
		samsung,support_panel_max = <1>;
		samsung,hw-config = "single_dsi";
		/*samsung,support_mdnie_lite;*/
		samsung,support_factory_panel_swap;

		samsung,mdss-power-on-reset-delay-us = <3000>;

		samsung,display_on_tx_cmds_revA = [05 01 00 00 00 00 02 29 00];
		samsung,display_off_tx_cmds_revA = [05 01 00 00 00 00 02 28 00];

		samsung,level1_key_enable_tx_cmds_revA = [
			29 01 00 00 00 00 03 F0 5A 5A
		];
		samsung,level1_key_disable_tx_cmds_revA = [
			29 01 00 00 00 00 03 F0 A5 A5
		];
		samsung,level2_key_enable_tx_cmds_revA = [
			29 00 00 00 00 00 03 F0 5A 5A
			29 01 00 00 00 00 03 FC 5A 5A
		];
		samsung,level2_key_disable_tx_cmds_revA = [
			29 00 00 00 00 00 03 F0 A5 A5
			29 01 00 00 00 00 03 FC A5 A5
		];

		samsung,packet_size_tx_cmds_revA = [
			37 01 00 00 00 00 02 07 00
		];

		/*
		 * First parameters can be changed
		 * by function of samsung_nv_read()
		 * because of that means offset of
		 * read position
		 */
		samsung,reg_read_pos_tx_cmds_revA = [
			15 01 00 00 00 00 02 B0 00
		];

		/*
		 * ************************************************************************************************************************
		 *	 06 01 00 00 00 00 01 c8 07 21
		 *	READ 0xC8 SIZE 0x07 OFFSET 0x21
		 * ************************************************************************************************************************
		 */
		samsung,smart_dimming_mtp_rx_cmds_revA = [ 06 01 00 00 00 00 01 c8 21 00];
		/* the last byte in all read commands will represent READ LENGH */
		samsung,manufacture_id0_rx_cmds_revA = [ 06 01 00 00 00 00 01 DA 01 00];
		samsung,manufacture_id1_rx_cmds_revA = [ 06 01 00 00 00 00 01 DB 01 00];
		samsung,manufacture_id2_rx_cmds_revA = [ 06 01 00 00 00 00 01 DC 01 00];

		samsung,manufacture_date_rx_cmds_revA = [ 06 01 00 00 00 00 01 C8 02 28];	/* read C8 41~42th , 40=0x28*/
		/* Manufacture code is not supported for this panel */
		/* samsung,ddi_id_rx_cmds_revA = [ 06 01 00 00 00 00 01 d6 05 00];*/		/* read D6 1~5th *///
		samsung,cell_id_rx_cmds_revA = [ 06 01 00 00 00 00 01 C8 07 28];		/* read C8 41~47th, 40=0x28 */
		samsung,mtp_read_sysfs_rx_cmds_revA = [ 06 01 00 00 00 00 01 01 01 01];

		samsung,elvss_rx_cmds_revA = [ 06 01 00 00 00 00 01 B6 02 15];		/* read B6 22, 23th , 21=0x15*/
		samsung,mdnie_read_rx_cmds_revA	= [ 06 01 00 00 00 00 01 A1 04 00];

		/* samsung,ldi_debug0_rx_cmds_revA = [06 01 00 00 00 00 01 0A 01 00]; */
		/* samsung,ldi_debug1_rx_cmds_revA = [06 01 00 00 00 00 01 0E 01 00]; */
		/* samsung,ldi_debug2_rx_cmds_revA = [06 01 00 00 00 00 01 EA 08 00]; */

		samsung,octa_id_rx_cmds_revA = [06 01 00 00 00 00 01 C9 14 01];  // read C9 2th~21th

		/*
		 * ************************************************************************************************************************
		 *	 COMMON CMD LIST
		 * ************************************************************************************************************************
		 */

		#define test_default 38 00 00 40 44 00 38
		samsung,elvss_lowtemp_tx_cmds_revA = [
			29 01 00 00 00 00 09 B8 test_default 19
		];	/* Low Temperature Command */

		samsung,elvss_lowtemp2_tx_cmds_revA = [
			29 01 00 00 00 00 02 B0 15
			29 01 00 00 00 00 02 B6 00
		];	/* Low Temperature Command: default */

		samsung,gamma_tx_cmds_revA = [
			29 01 00 00 00 00 22 CA	/* 1) Gamma 2.2 Setting */
				01 00 01 00 01 00	/* V255 R,G,B */
				80 80 80		/* V203 R,G,B */
				80 80 80		/* V151 R,G,B */
				80 80 80		/* V87 R,G,B */
				80 80 80		/* V51 R,G,B */
				80 80 80		/* V35 R,G,B */
				80 80 80		/* V23 R,G,B */
				80 80 80		/* V11 R,G,B */
				80 80 80		/*  V3 R,G,B */
				00 00 00		/*  VT R,G,B */
			29 01 00 00 00 00 02 00 00
			29 01 00 00 00 00 02 F7 03	/* Gamma, LTPS(AID) update */
		];

		/*
		* ************************************************************************************************************************
		*  HBM
		* ************************************************************************************************************************
		*/
		//samsung,enter_hbm_lux = <10000>;

		samsung,hbm_rx_cmds_revA  = [ 06 01 00 00 00 00 01 B4 1F 00];	/* read B4 1th~4th */
		samsung,hbm2_rx_cmds_revA = [ 06 01 00 00 00 00 01 B4 1D 04];	/* read B4 5th~33th */

		samsung,hbm_gamma_tx_cmds_revA = [
			29 01 00 00 00 00 22 CA
				01 00 01 00 01 00
				80 80 80
				80 80 80
				80 80 80
				80 80 80
				80 80 80
				80 80 80
				80 80 80
				80 80 80
				00 00 00
			29 01 00 00 00 00 03 B2 00 10		// AID set : AOR 10%
			29 01 00 00 00 00 02 F7 03
		];

		samsung,hbm_etc_tx_cmds_revA = [		// HBM interpolation: 465~578 + 600 nit
			29 01 00 00 00 00 03 B2 00 10		// AID set : AOR 0%
			29 01 00 00 00 00 05 B5
						50	/* 32 Frame Avg. at ACL on */
						99	/* 0x99 → Start Point 60%, 0x7F → Start Point 50% */
						14	/* Default Value */
						0B	/* ACL 8% */
			29 01 00 00 00 00 17 B6
						 BC 04 default_elvss 00		// HBM ELVSS
			29 01 00 00 00 00 02 55 02		// ACL ON
			29 01 00 00 00 00 02 F7 03		// Gamma, LTPS(AID) update
		];

		samsung,hbm_off_tx_cmds_revA = [
			29 01 00 00 00 00 02 53 00		/* HBM Off */
		];

		/*
		 * ************************************************************************************************************************
		 * AID command list and mappings
		 * ************************************************************************************************************************
		 */
		/* bl_level, Index in acl command list */
		samsung,aid_tx_cmds_revA = [
			29 01 00 00 00 00 03 B2	05 AD	/*  5   CD :    0   */
			29 01 00 00 00 00 03 B2	05 9E	/*  6   CD :    1   */
			29 01 00 00 00 00 03 B2	05 90	/*  7   CD :    2   */
			29 01 00 00 00 00 03 B2	05 8A	/*  8   CD :    3   */
			29 01 00 00 00 00 03 B2	05 7C	/*  9   CD :    4   */
			29 01 00 00 00 00 03 B2	05 6E	/*  10  CD :    5   */
			29 01 00 00 00 00 03 B2	05 60	/*  11  CD :    6   */
			29 01 00 00 00 00 03 B2	05 50	/*  12  CD :    7   */
			29 01 00 00 00 00 03 B2	05 4B	/*  13  CD :    8   */
			29 01 00 00 00 00 03 B2	05 3D	/*  14  CD :    9   */
			29 01 00 00 00 00 03 B2	05 2F	/*  15  CD :    10  */
			29 01 00 00 00 00 03 B2	05 20	/*  16  CD :    11  */
			29 01 00 00 00 00 03 B2	05 1A	/*  17  CD :    12  */
			29 01 00 00 00 00 03 B2	04 FD	/*  19  CD :    13  */
			29 01 00 00 00 00 03 B2	04 F1	/*  20  CD :    14  */
			29 01 00 00 00 00 03 B2	04 DF	/*  21  CD :    15  */
			29 01 00 00 00 00 03 B2	04 CE	/*  22  CD :    16  */
			29 01 00 00 00 00 03 B2	04 B0	/*  24  CD :    17  */
			29 01 00 00 00 00 03 B2	04 9F	/*  25  CD :    18  */
			29 01 00 00 00 00 03 B2	04 7E	/*  27  CD :    19  */
			29 01 00 00 00 00 03 B2	04 5E	/*  29  CD :    20  */
			29 01 00 00 00 00 03 B2	04 4D	/*  30  CD :    21  */
			29 01 00 00 00 00 03 B2	04 2C	/*  32  CD :    22  */
			29 01 00 00 00 00 03 B2	04 00	/*  34  CD :    23  */
			29 01 00 00 00 00 03 B2	03 DA	/*  37  CD :    24  */
			29 01 00 00 00 00 03 B2	03 BC	/*  39  CD :    25  */
			29 01 00 00 00 00 03 B2	03 9B	/*  41  CD :    26  */
			29 01 00 00 00 00 03 B2	03 6D	/*  44  CD :    27  */
			29 01 00 00 00 00 03 B2	03 40	/*  47  CD :    28  */
			29 01 00 00 00 00 03 B2	03 10	/*  50  CD :    29  */
			29 01 00 00 00 00 03 B2	02 E9	/*  53  CD :    30  */
			29 01 00 00 00 00 03 B2	02 BA	/*  56  CD :    31  */
			29 01 00 00 00 00 03 B2	02 7C	/*  60  CD :    32  */
			29 01 00 00 00 00 03 B2	02 3C	/*  64  CD :    33  */
			29 01 00 00 00 00 03 B2	02 25	/*  68  CD :    34  */
			29 01 00 00 00 00 03 B2	02 25	/*  72  CD :    35  */
			29 01 00 00 00 00 03 B2	02 25	/*  77  CD :    36  */
			29 01 00 00 00 00 03 B2	02 25	/*  82  CD :    37  */
			29 01 00 00 00 00 03 B2	02 25	/*  87  CD :    38  */
			29 01 00 00 00 00 03 B2	02 25	/*  93  CD :    39  */
			29 01 00 00 00 00 03 B2	02 25	/*  98  CD :    40  */
			29 01 00 00 00 00 03 B2	02 25	/*  105 CD :    41  */
			29 01 00 00 00 00 03 B2	02 25	/*  111 CD :    42  */
			29 01 00 00 00 00 03 B2	02 20	/*  119 CD :    43  */
			29 01 00 00 00 00 03 B2	01 EA	/*  126 CD :    44  */
			29 01 00 00 00 00 03 B2	01 9C	/*  134 CD :    45  */
			29 01 00 00 00 00 03 B2	01 50	/*  143 CD :    46  */
			29 01 00 00 00 00 03 B2	01 00	/*  152 CD :    47  */
			29 01 00 00 00 00 03 B2	00 AA	/*  162 CD :    48  */
			29 01 00 00 00 00 03 B2	00 51	/*  172 CD :    49  */
			29 01 00 00 00 00 03 B2	00 10	/*  183 CD :    50  */
			29 01 00 00 00 00 03 B2	00 10	/*  195 CD :    51  */
			29 01 00 00 00 00 03 B2	00 10	/*  207 CD :    52  */
			29 01 00 00 00 00 03 B2	00 10	/*  220 CD :    53  */
			29 01 00 00 00 00 03 B2	00 10	/*  234 CD :    54  */
			29 01 00 00 00 00 03 B2	00 10	/*  249 CD :    55  */
			29 01 00 00 00 00 03 B2	00 10	/*  265 CD :    56  */
			29 01 00 00 00 00 03 B2	00 10	/*  282 CD :    57  */
			29 01 00 00 00 00 03 B2	00 10	/*  300 CD :    58  */
			29 01 00 00 00 00 03 B2	00 10	/*  316 CD :    59  */
			29 01 00 00 00 00 03 B2	00 10	/*  333 CD :    60  */
			29 01 00 00 00 00 03 B2	00 10	/*  360 CD :    61  */
		];

		samsung,aid_subdivision_tx_cmds_revA = [
			29 01 00 00 00 00 03 B2 05 AD /* 0 */
			29 01 00 00 00 00 03 B2 05 A9 /* 1 */
			29 01 00 00 00 00 03 B2 05 A5 /* 2 */
			29 01 00 00 00 00 03 B2 05 A2 /* 3 */
			29 01 00 00 00 00 03 B2 05 9E /* 4 */
			29 01 00 00 00 00 03 B2 05 9B /* 5 */
			29 01 00 00 00 00 03 B2 05 97 /* 6 */
			29 01 00 00 00 00 03 B2 05 93 /* 7 */
			29 01 00 00 00 00 03 B2 05 90 /* 8 */
			29 01 00 00 00 00 03 B2 05 8E /* 9 */
			29 01 00 00 00 00 03 B2 05 8D /* 10 */
			29 01 00 00 00 00 03 B2 05 8B /* 11 */
			29 01 00 00 00 00 03 B2 05 8A /* 12 */
			29 01 00 00 00 00 03 B2 05 87 /* 13 */
			29 01 00 00 00 00 03 B2 05 83 /* 14 */
			29 01 00 00 00 00 03 B2 05 7F /* 15 */
			29 01 00 00 00 00 03 B2 05 7C /* 16 */
			29 01 00 00 00 00 03 B2 05 79 /* 17 */
			29 01 00 00 00 00 03 B2 05 75 /* 18 */
			29 01 00 00 00 00 03 B2 05 71 /* 19 */
			29 01 00 00 00 00 03 B2 05 6E /* 20 */
			29 01 00 00 00 00 03 B2 05 6B /* 21 */
			29 01 00 00 00 00 03 B2 05 67 /* 22 */
			29 01 00 00 00 00 03 B2 05 63 /* 23 */
			29 01 00 00 00 00 03 B2 05 60 /* 24 */
			29 01 00 00 00 00 03 B2 05 5C /* 25 */
			29 01 00 00 00 00 03 B2 05 58 /* 26 */
			29 01 00 00 00 00 03 B2 05 54 /* 27 */
			29 01 00 00 00 00 03 B2 05 50 /* 28 */
			29 01 00 00 00 00 03 B2 05 4F /* 29 */
			29 01 00 00 00 00 03 B2 05 4E /* 30 */
			29 01 00 00 00 00 03 B2 05 4C /* 31 */
			29 01 00 00 00 00 03 B2 05 4B /* 32 */
			29 01 00 00 00 00 03 B2 05 47 /* 33 */
			29 01 00 00 00 00 03 B2 05 44 /* 34 */
			29 01 00 00 00 00 03 B2 05 40 /* 35 */
			29 01 00 00 00 00 03 B2 05 3D /* 36 */
			29 01 00 00 00 00 03 B2 05 3A /* 37 */
			29 01 00 00 00 00 03 B2 05 36 /* 38 */
			29 01 00 00 00 00 03 B2 05 32 /* 39 */
			29 01 00 00 00 00 03 B2 05 2F /* 40 */
			29 01 00 00 00 00 03 B2 05 27 /* 41 */
			29 01 00 00 00 00 03 B2 05 20 /* 42 */
			29 01 00 00 00 00 03 B2 05 1D /* 43 */
			29 01 00 00 00 00 03 B2 05 1A /* 44 */
			29 01 00 00 00 00 03 B2 05 0C /* 45 */
			29 01 00 00 00 00 03 B2 04 FD /* 46 */
			29 01 00 00 00 00 03 B2 04 F7 /* 47 */
			29 01 00 00 00 00 03 B2 04 F1 /* 48 */
			29 01 00 00 00 00 03 B2 04 E8 /* 49 */
			29 01 00 00 00 00 03 B2 04 DF /* 50 */
			29 01 00 00 00 00 03 B2 04 D7 /* 51 */
			29 01 00 00 00 00 03 B2 04 CE /* 52 */
			29 01 00 00 00 00 03 B2 04 BF /* 53 */
			29 01 00 00 00 00 03 B2 04 B0 /* 54 */
			29 01 00 00 00 00 03 B2 04 A8 /* 55 */
			29 01 00 00 00 00 03 B2 04 9F /* 56 */
			29 01 00 00 00 00 03 B2 04 8F /* 57 */
			29 01 00 00 00 00 03 B2 04 7E /* 58 */
			29 01 00 00 00 00 03 B2 04 6E /* 59 */
			29 01 00 00 00 00 03 B2 04 5E /* 60 */
			29 01 00 00 00 00 03 B2 04 56 /* 61 */
			29 01 00 00 00 00 03 B2 04 4D /* 62 */
			29 01 00 00 00 00 03 B2 04 3D /* 63 */
			29 01 00 00 00 00 03 B2 04 2C /* 64 */
			29 01 00 00 00 00 03 B2 04 16 /* 65 */
			29 01 00 00 00 00 03 B2 04 00 /* 66 */
			29 01 00 00 00 00 03 B2 03 ED /* 67 */
			29 01 00 00 00 00 03 B2 03 DA /* 68 */
			29 01 00 00 00 00 03 B2 03 CB /* 69 */
			29 01 00 00 00 00 03 B2 03 BC /* 70 */
			29 01 00 00 00 00 03 B2 03 AC /* 71 */
			29 01 00 00 00 00 03 B2 03 9B /* 72 */
			29 01 00 00 00 00 03 B2 03 84 /* 73 */
			29 01 00 00 00 00 03 B2 03 6D /* 74 */
			29 01 00 00 00 00 03 B2 03 57 /* 75 */
			29 01 00 00 00 00 03 B2 03 40 /* 76 */
			29 01 00 00 00 00 03 B2 03 28 /* 77 */
			29 01 00 00 00 00 03 B2 03 10 /* 78 */
			29 01 00 00 00 00 03 B2 02 FC /* 79 */
			29 01 00 00 00 00 03 B2 02 E9 /* 80 */
			29 01 00 00 00 00 03 B2 02 D1 /* 81 */
			29 01 00 00 00 00 03 B2 02 BA /* 82 */
			29 01 00 00 00 00 03 B2 02 9B /* 83 */
			29 01 00 00 00 00 03 B2 02 7C /* 84 */
			29 01 00 00 00 00 03 B2 02 5C /* 85 */
			29 01 00 00 00 00 03 B2 02 3C /* 86 */
			29 01 00 00 00 00 03 B2 02 41 /* 87 */
			29 01 00 00 00 00 03 B2 02 25 /* 88 */
			29 01 00 00 00 00 03 B2 02 3F /* 89 */
			29 01 00 00 00 00 03 B2 02 25 /* 90 */
			29 01 00 00 00 00 03 B2 02 44 /* 91 */
			29 01 00 00 00 00 03 B2 02 25 /* 92 */
			29 01 00 00 00 00 03 B2 02 42 /* 93 */
			29 01 00 00 00 00 03 B2 02 25 /* 94 */
			29 01 00 00 00 00 03 B2 02 40 /* 95 */
			29 01 00 00 00 00 03 B2 02 25 /* 96 */
			29 01 00 00 00 00 03 B2 02 44 /* 97 */
			29 01 00 00 00 00 03 B2 02 25 /* 98 */
			29 01 00 00 00 00 03 B2 02 3D /* 99 */
			29 01 00 00 00 00 03 B2 02 25 /* 100 */
			29 01 00 00 00 00 03 B2 02 45 /* 101 */
			29 01 00 00 00 00 03 B2 02 25 /* 102 */
			29 01 00 00 00 00 03 B2 02 3F /* 103 */
			29 01 00 00 00 00 03 B2 02 25 /* 104 */
			29 01 00 00 00 00 03 B2 02 40 /* 105 */
			29 01 00 00 00 00 03 B2 02 20 /* 106 */
			29 01 00 00 00 00 03 B2 02 05 /* 107 */
			29 01 00 00 00 00 03 B2 01 EA /* 108 */
			29 01 00 00 00 00 03 B2 01 D0 /* 109 */
			29 01 00 00 00 00 03 B2 01 B6 /* 110 */
			29 01 00 00 00 00 03 B2 01 9C /* 111 */
			29 01 00 00 00 00 03 B2 01 83 /* 112 */
			29 01 00 00 00 00 03 B2 01 69 /* 113 */
			29 01 00 00 00 00 03 B2 01 50 /* 114 */
			29 01 00 00 00 00 03 B2 01 35 /* 115 */
			29 01 00 00 00 00 03 B2 01 1B /* 116 */
			29 01 00 00 00 00 03 B2 01 00 /* 117 */
			29 01 00 00 00 00 03 B2 00 E3 /* 118 */
			29 01 00 00 00 00 03 B2 00 C7 /* 119 */
			29 01 00 00 00 00 03 B2 00 AA /* 120 */
			29 01 00 00 00 00 03 B2 00 94 /* 121 */
			29 01 00 00 00 00 03 B2 00 7E /* 122 */
			29 01 00 00 00 00 03 B2 00 67 /* 123 */
			29 01 00 00 00 00 03 B2 00 51 /* 124 */
			29 01 00 00 00 00 03 B2 00 53 /* 125 */
			29 01 00 00 00 00 03 B2 00 3D /* 126 */
			29 01 00 00 00 00 03 B2 00 26 /* 127 */
			29 01 00 00 00 00 03 B2 00 10 /* 128 */
			29 01 00 00 00 00 03 B2 00 63 /* 129 */
			29 01 00 00 00 00 03 B2 00 5B /* 130 */
			29 01 00 00 00 00 03 B2 00 53 /* 131 */
			29 01 00 00 00 00 03 B2 00 4A /* 132 */
			29 01 00 00 00 00 03 B2 00 42 /* 133 */
			29 01 00 00 00 00 03 B2 00 3A /* 134 */
			29 01 00 00 00 00 03 B2 00 31 /* 135 */
			29 01 00 00 00 00 03 B2 00 29 /* 136 */
			29 01 00 00 00 00 03 B2 00 21 /* 137 */
			29 01 00 00 00 00 03 B2 00 18 /* 138 */
			29 01 00 00 00 00 03 B2 00 10 /* 139 */
			29 01 00 00 00 00 03 B2 00 5E /* 140 */
			29 01 00 00 00 00 03 B2 00 57 /* 141 */
			29 01 00 00 00 00 03 B2 00 4F /* 142 */
			29 01 00 00 00 00 03 B2 00 47 /* 143 */
			29 01 00 00 00 00 03 B2 00 3F /* 144 */
			29 01 00 00 00 00 03 B2 00 37 /* 145 */
			29 01 00 00 00 00 03 B2 00 2F /* 146 */
			29 01 00 00 00 00 03 B2 00 27 /* 147 */
			29 01 00 00 00 00 03 B2 00 20 /* 148 */
			29 01 00 00 00 00 03 B2 00 18 /* 149 */
			29 01 00 00 00 00 03 B2 00 10 /* 150 */
			29 01 00 00 00 00 03 B2 00 60 /* 151 */
			29 01 00 00 00 00 03 B2 00 58 /* 152 */
			29 01 00 00 00 00 03 B2 00 50 /* 153 */
			29 01 00 00 00 00 03 B2 00 48 /* 154 */
			29 01 00 00 00 00 03 B2 00 40 /* 155 */
			29 01 00 00 00 00 03 B2 00 38 /* 156 */
			29 01 00 00 00 00 03 B2 00 30 /* 157 */
			29 01 00 00 00 00 03 B2 00 28 /* 158 */
			29 01 00 00 00 00 03 B2 00 20 /* 159 */
			29 01 00 00 00 00 03 B2 00 18 /* 160 */
			29 01 00 00 00 00 03 B2 00 10 /* 161 */
			29 01 00 00 00 00 03 B2 00 61 /* 162 */
			29 01 00 00 00 00 03 B2 00 59 /* 163 */
			29 01 00 00 00 00 03 B2 00 51 /* 164 */
			29 01 00 00 00 00 03 B2 00 49 /* 165 */
			29 01 00 00 00 00 03 B2 00 41 /* 166 */
			29 01 00 00 00 00 03 B2 00 38 /* 167 */
			29 01 00 00 00 00 03 B2 00 30 /* 168 */
			29 01 00 00 00 00 03 B2 00 28 /* 169 */
			29 01 00 00 00 00 03 B2 00 20 /* 170 */
			29 01 00 00 00 00 03 B2 00 18 /* 171 */
			29 01 00 00 00 00 03 B2 00 10 /* 172 */
			29 01 00 00 00 00 03 B2 00 61 /* 173 */
			29 01 00 00 00 00 03 B2 00 59 /* 174 */
			29 01 00 00 00 00 03 B2 00 51 /* 175 */
			29 01 00 00 00 00 03 B2 00 49 /* 176 */
			29 01 00 00 00 00 03 B2 00 41 /* 177 */
			29 01 00 00 00 00 03 B2 00 39 /* 178 */
			29 01 00 00 00 00 03 B2 00 31 /* 179 */
			29 01 00 00 00 00 03 B2 00 28 /* 180 */
			29 01 00 00 00 00 03 B2 00 20 /* 181 */
			29 01 00 00 00 00 03 B2 00 18 /* 182 */
			29 01 00 00 00 00 03 B2 00 10 /* 183 */
			29 01 00 00 00 00 03 B2 00 62 /* 184 */
			29 01 00 00 00 00 03 B2 00 59 /* 185 */
			29 01 00 00 00 00 03 B2 00 51 /* 186 */
			29 01 00 00 00 00 03 B2 00 49 /* 187 */
			29 01 00 00 00 00 03 B2 00 41 /* 188 */
			29 01 00 00 00 00 03 B2 00 39 /* 189 */
			29 01 00 00 00 00 03 B2 00 31 /* 190 */
			29 01 00 00 00 00 03 B2 00 28 /* 191 */
			29 01 00 00 00 00 03 B2 00 20 /* 192 */
			29 01 00 00 00 00 03 B2 00 18 /* 193 */
			29 01 00 00 00 00 03 B2 00 10 /* 194 */
			29 01 00 00 00 00 03 B2 00 62 /* 195 */
			29 01 00 00 00 00 03 B2 00 5B /* 196 */
			29 01 00 00 00 00 03 B2 00 53 /* 197 */
			29 01 00 00 00 00 03 B2 00 4C /* 198 */
			29 01 00 00 00 00 03 B2 00 44 /* 199 */
			29 01 00 00 00 00 03 B2 00 3D /* 200 */
			29 01 00 00 00 00 03 B2 00 35 /* 201 */
			29 01 00 00 00 00 03 B2 00 2E /* 202 */
			29 01 00 00 00 00 03 B2 00 26 /* 203 */
			29 01 00 00 00 00 03 B2 00 1F /* 204 */
			29 01 00 00 00 00 03 B2 00 17 /* 205 */
			29 01 00 00 00 00 03 B2 00 10 /* 206 */
			29 01 00 00 00 00 03 B2 00 62 /* 207 */
			29 01 00 00 00 00 03 B2 00 5A /* 208 */
			29 01 00 00 00 00 03 B2 00 53 /* 209 */
			29 01 00 00 00 00 03 B2 00 4B /* 210 */
			29 01 00 00 00 00 03 B2 00 44 /* 211 */
			29 01 00 00 00 00 03 B2 00 3D /* 212 */
			29 01 00 00 00 00 03 B2 00 35 /* 213 */
			29 01 00 00 00 00 03 B2 00 2E /* 214 */
			29 01 00 00 00 00 03 B2 00 26 /* 215 */
			29 01 00 00 00 00 03 B2 00 1F /* 216 */
			29 01 00 00 00 00 03 B2 00 17 /* 217 */
			29 01 00 00 00 00 03 B2 00 10 /* 218 */
			29 01 00 00 00 00 03 B2 00 54 /* 219 */
			29 01 00 00 00 00 03 B2 00 4E /* 220 */
			29 01 00 00 00 00 03 B2 00 47 /* 221 */
			29 01 00 00 00 00 03 B2 00 40 /* 222 */
			29 01 00 00 00 00 03 B2 00 39 /* 223 */
			29 01 00 00 00 00 03 B2 00 32 /* 224 */
			29 01 00 00 00 00 03 B2 00 2B /* 225 */
			29 01 00 00 00 00 03 B2 00 24 /* 226 */
			29 01 00 00 00 00 03 B2 00 1E /* 227 */
			29 01 00 00 00 00 03 B2 00 17 /* 228 */
			29 01 00 00 00 00 03 B2 00 10 /* 229 */
			29 01 00 00 00 00 03 B2 00 56 /* 230 */
			29 01 00 00 00 00 03 B2 00 4F /* 231 */
			29 01 00 00 00 00 03 B2 00 49 /* 232 */
			29 01 00 00 00 00 03 B2 00 43 /* 233 */
			29 01 00 00 00 00 03 B2 00 3C /* 234 */
			29 01 00 00 00 00 03 B2 00 36 /* 235 */
			29 01 00 00 00 00 03 B2 00 30 /* 236 */
			29 01 00 00 00 00 03 B2 00 29 /* 237 */
			29 01 00 00 00 00 03 B2 00 23 /* 238 */
			29 01 00 00 00 00 03 B2 00 1D /* 239 */
			29 01 00 00 00 00 03 B2 00 16 /* 240 */
			29 01 00 00 00 00 03 B2 00 10 /* 241 */
			29 01 00 00 00 00 03 B2 00 77 /* 242 */
			29 01 00 00 00 00 03 B2 00 6E /* 243 */
			29 01 00 00 00 00 03 B2 00 66 /* 244 */
			29 01 00 00 00 00 03 B2 00 5D /* 245 */
			29 01 00 00 00 00 03 B2 00 55 /* 246 */
			29 01 00 00 00 00 03 B2 00 4C /* 247 */
			29 01 00 00 00 00 03 B2 00 43 /* 248 */
			29 01 00 00 00 00 03 B2 00 3B /* 249 */
			29 01 00 00 00 00 03 B2 00 32 /* 250 */
			29 01 00 00 00 00 03 B2 00 2A /* 251 */
			29 01 00 00 00 00 03 B2 00 21 /* 252 */
			29 01 00 00 00 00 03 B2 00 19 /* 253 */
			29 01 00 00 00 00 03 B2 00 10 /* 254 */
			29 01 00 00 00 00 03 B2 00 10 /* 255 */

		];

		/* bl_level, Index in acl command list */
		samsung,aid_map_table_revA = <
			5	0		6	1		7	2		8	3		9	4
			10	5		11	6		12	7		13	8		14	9
			15	10		16	11		17	12		19	13		20	14
			21	15		22	16		24	17		25	18		27	19
			29	20		30	21		32	22		34	23		37	24
			39	25		41	26		44	27		47	28		50	29
			53	30		56	31		60	32		64	33		68	34
			72	35		77	36		83	37		87	38		93	39
			98	40		105 41		111	42		119	43		126	44
			134	45		143	46		152	47		162	48		172	49
			183	50		195	51		207	52		220	53		234	54
			249	55		265	56		282	57		300	58		316	59
			333	60		360	61
			>;

		/*
		 * ************************************************************************************************************************
		 * ACL command list and mappings
		 * ************************************************************************************************************************
		 */
		samsung,acl_on_tx_cmds_revA = [
			29 01 00 00 00 00 02 55 02		/* ACL 15%(default) ON */
		];

		/* ACL Concept
		 * ACL Start Point
		 *		50% : Brightness level(0~255)
		 *		60% : HBM Interpolation, HBM(256 ~ 365)
		 * ACL Ratio
		 *		OFF : Max, HBM Interpolation, HBM(255~365) &&
		 *			Gallery, *#0*# receiver, Color blanace app)
		 *		 8% : HBM Interpolation, HBM(256~265) && Other apps
		 *		15% : MAX(255) && Other Apps
		 *		15% : Brightness level(0~254)
		 *		OFF : HMD
		 *
		 * Combination of ACL commands
		 *		1. Start Point 60%, ACL  8% -> HBM, HBM Interpolation level 256~365
		 *		2. Start Point 50%, ACL 15% -> level 0 ~ 255
		 */

		samsung,acl_percent_tx_cmds_revA = [
			29 01 00 00 00 00 05 B5
						50	/* 32 Frame Avg. at ACL on */
						99	/* 0x99 → Start Point 60%, 0x7F → Start Point 50% */
						14	/* Default Value */
						0B	/* ACL 8% */
			29 01 00 00 00 00 05 B5
						50	/* 32 Frame Avg. at ACL on */
						7F	/* 0x99 → Start Point 60%, 0x7F → Start Point 50% */
						14	/* Default Value */
						14	/* ACL 15% */
		];

		samsung,acl_off_tx_cmds_revA = [
			29 01 00 00 00 00 05 B5 40 7F 14 14	/* 16 Frame Avg. */
			29 01 00 00 00 00 02 55 00	/* ACL OFF */
		];

		/* bl_level , Index in acl command list */
		samsung,acl_map_table_revA =  <
			5	1		6	1		7	1		8	1		9	1
			10	1		11	1		12	1		13	1		14	1
			15	1		16	1		17	1		19	1		20	1
			21	1		22	1		24	1		25	1		27	1
			29	1		30	1		32	1		34	1		37	1
			39	1		41	1		44	1		47	1		50	1
			53	1		56	1		60	1		64	1		68	1
			72	1		77	1		83	1		87	1		93	1
			98	1		105	1		111	1		119	1		126	1
			134	1		143	1		152	1		162	1		172	1
			183	1		195	1		207	1		220	1		234	1
			249	1		265	1		282	1		300	1		316	1
			333	1		360	1
		>;

		/*
		 * ************************************************************************************************************************
		 * SMART ACL(ACL On) ELVSS command list and mappings
		 * ************************************************************************************************************************
		 */
		samsung,elvss_high_tx_cmds_revA = [
			/* 29 01 00 00 00 00 17 B6
			   BC - MPS_CON
			   04 - ELVSS_DIM_OFFSET(Different value depends on the temperature)
			   default_elvss - Default value that are offer by the OP Code
			   00 - ELVSS_CAL_OFFSET(OTP vealue of 22th para of B6h)
			 */
			29 01 00 00 00 00 17 B6 BC 04 default_elvss 00 /* 0  360CD */
			29 01 00 00 00 00 17 B6 BC 06 default_elvss 00 /* 1  333CD */
			29 01 00 00 00 00 17 B6 BC 07 default_elvss 00 /* 2  316CD */
			29 01 00 00 00 00 17 B6 BC 08 default_elvss 00 /* 3  300CD */
			29 01 00 00 00 00 17 B6 BC 0A default_elvss 00 /* 4  282CD */
			29 01 00 00 00 00 17 B6 BC 0B default_elvss 00 /* 5  265CD */
			29 01 00 00 00 00 17 B6 BC 0C default_elvss 00 /* 6  249CD */
			29 01 00 00 00 00 17 B6 BC 0D default_elvss 00 /* 7  234CD */
			29 01 00 00 00 00 17 B6 BC 0E default_elvss 00 /* 8  220CD */
			29 01 00 00 00 00 17 B6 BC 0F default_elvss 00 /* 9  207CD */
			29 01 00 00 00 00 17 B6 BC 10 default_elvss 00 /* 10 195CD */
			29 01 00 00 00 00 17 B6 BC 11 default_elvss 00 /* 11 183CD */
			29 01 00 00 00 00 17 B6 BC 12 default_elvss 00 /* 12 172CD */
			29 01 00 00 00 00 17 B6 BC 13 default_elvss 00 /* 13 143CD ~ 162CD */
			29 01 00 00 00 00 17 B6 BC 14 default_elvss 00 /* 14 119CD ~ 134CD */
			29 01 00 00 00 00 17 B6 BC 15 default_elvss 00 /* 15 105CD ~ 111CD */
			29 01 00 00 00 00 17 B6 BC 16 default_elvss 00 /* 16 98CD */
			29 01 00 00 00 00 17 B6 BC 17 default_elvss 00 /* 17 41CD ~ 93CD */
			29 01 00 00 00 00 17 B6 AC 16 default_elvss 00 /* 18 34CD ~ 39CD */
			29 01 00 00 00 00 17 B6 AC 14 default_elvss 00 /* 19 32CD */
			29 01 00 00 00 00 17 B6 AC 12 default_elvss 00 /* 20 30CD */
			29 01 00 00 00 00 17 B6 AC 10 default_elvss 00 /* 21 29CD */
			29 01 00 00 00 00 17 B6 AC 0E default_elvss 00 /* 22 27CD */
			29 01 00 00 00 00 17 B6 AC 0C default_elvss 00 /* 23 25CD */
			29 01 00 00 00 00 17 B6 AC 0A default_elvss 00 /* 24 24CD */
			29 01 00 00 00 00 17 B6 AC 08 default_elvss 00 /* 25 22CD */
			29 01 00 00 00 00 17 B6 AC 06 default_elvss 00 /* 26 21CD */
			29 01 00 00 00 00 17 B6 AC 04 default_elvss 00 /* 27 5CD ~ 20CD */
		];

		samsung,elvss_mid_tx_cmds_revA = [
			29 01 00 00 00 00 17 B6 BC 04 default_elvss 00 /* 0  360CD */
			29 01 00 00 00 00 17 B6 BC 06 default_elvss 00 /* 1  333CD */
			29 01 00 00 00 00 17 B6 BC 07 default_elvss 00 /* 2  316CD */
			29 01 00 00 00 00 17 B6 BC 08 default_elvss 00 /* 3  300CD */
			29 01 00 00 00 00 17 B6 BC 0A default_elvss 00 /* 4  282CD */
			29 01 00 00 00 00 17 B6 BC 0B default_elvss 00 /* 5  265CD */
			29 01 00 00 00 00 17 B6 BC 0C default_elvss 00 /* 6  249CD */
			29 01 00 00 00 00 17 B6 BC 0D default_elvss 00 /* 7  234CD */
			29 01 00 00 00 00 17 B6 BC 0E default_elvss 00 /* 8  220CD */
			29 01 00 00 00 00 17 B6 BC 0F default_elvss 00 /* 9  207CD */
			29 01 00 00 00 00 17 B6 BC 10 default_elvss 00 /* 10 195CD */
			29 01 00 00 00 00 17 B6 BC 11 default_elvss 00 /* 11 183CD */
			29 01 00 00 00 00 17 B6 BC 12 default_elvss 00 /* 12 172CD */
			29 01 00 00 00 00 17 B6 BC 13 default_elvss 00 /* 13 143CD ~ 162CD */
			29 01 00 00 00 00 17 B6 BC 14 default_elvss 00 /* 14 119CD ~ 134CD */
			29 01 00 00 00 00 17 B6 BC 15 default_elvss 00 /* 15 105CD ~ 111CD */
			29 01 00 00 00 00 17 B6 BC 16 default_elvss 00 /* 16 98CD */
			29 01 00 00 00 00 17 B6 BC 17 default_elvss 00 /* 17 41CD ~ 93CD */
			29 01 00 00 00 00 17 B6 AC 16 default_elvss 00 /* 18 34CD ~ 39CD */
			29 01 00 00 00 00 17 B6 AC 14 default_elvss 00 /* 19 32CD */
			29 01 00 00 00 00 17 B6 AC 12 default_elvss 00 /* 20 30CD */
			29 01 00 00 00 00 17 B6 AC 10 default_elvss 00 /* 21 29CD */
			29 01 00 00 00 00 17 B6 AC 0E default_elvss 00 /* 22 27CD */
			29 01 00 00 00 00 17 B6 AC 0C default_elvss 00 /* 23 25CD */
			29 01 00 00 00 00 17 B6 AC 0A default_elvss 00 /* 24 24CD */
			29 01 00 00 00 00 17 B6 AC 08 default_elvss 00 /* 25 22CD */
			29 01 00 00 00 00 17 B6 AC 08 default_elvss 00 /* 26 21CD */
			29 01 00 00 00 00 17 B6 AC 08 default_elvss 00 /* 27 5CD ~ 20CD */
		];

		samsung,elvss_low_tx_cmds_revA = [
			29 01 00 00 00 00 17 B6 BC 04 default_elvss 00 /* 0  360CD */
			29 01 00 00 00 00 17 B6 BC 06 default_elvss 00 /* 1  333CD */
			29 01 00 00 00 00 17 B6 BC 07 default_elvss 00 /* 2  316CD */
			29 01 00 00 00 00 17 B6 BC 08 default_elvss 00 /* 3  300CD */
			29 01 00 00 00 00 17 B6 BC 0A default_elvss 00 /* 4  282CD */
			29 01 00 00 00 00 17 B6 BC 0B default_elvss 00 /* 5  265CD */
			29 01 00 00 00 00 17 B6 BC 0C default_elvss 00 /* 6  249CD */
			29 01 00 00 00 00 17 B6 BC 0D default_elvss 00 /* 7  234CD */
			29 01 00 00 00 00 17 B6 BC 0E default_elvss 00 /* 8  220CD */
			29 01 00 00 00 00 17 B6 BC 0F default_elvss 00 /* 9  207CD */
			29 01 00 00 00 00 17 B6 BC 10 default_elvss 00 /* 10 195CD */
			29 01 00 00 00 00 17 B6 BC 11 default_elvss 00 /* 11 183CD */
			29 01 00 00 00 00 17 B6 BC 12 default_elvss 00 /* 12 172CD */
			29 01 00 00 00 00 17 B6 BC 13 default_elvss 00 /* 13 143CD ~ 162CD */
			29 01 00 00 00 00 17 B6 BC 14 default_elvss 00 /* 14 119CD ~ 134CD */
			29 01 00 00 00 00 17 B6 BC 15 default_elvss 00 /* 15 105CD ~ 111CD */
			29 01 00 00 00 00 17 B6 BC 16 default_elvss 00 /* 16 98CD */
			29 01 00 00 00 00 17 B6 BC 17 default_elvss 00 /* 17 41CD ~ 93CD */
			29 01 00 00 00 00 17 B6 AC 16 default_elvss 00 /* 18 34CD ~ 39CD */
			29 01 00 00 00 00 17 B6 AC 14 default_elvss 00 /* 19 32CD */
			29 01 00 00 00 00 17 B6 AC 12 default_elvss 00 /* 20 30CD */
			29 01 00 00 00 00 17 B6 AC 10 default_elvss 00 /* 21 29CD */
			29 01 00 00 00 00 17 B6 AC 0F default_elvss 00 /* 22 27CD */
			29 01 00 00 00 00 17 B6 AC 0F default_elvss 00 /* 23 25CD */
			29 01 00 00 00 00 17 B6 AC 0F default_elvss 00 /* 24 24CD */
			29 01 00 00 00 00 17 B6 AC 0F default_elvss 00 /* 25 22CD */
			29 01 00 00 00 00 17 B6 AC 0F default_elvss 00 /* 26 21CD */
			29 01 00 00 00 00 17 B6 AC 0F default_elvss 00 /* 27 5CD ~ 20CD */
		];
		/* bl_level, Index in elvss command list */
		samsung,smart_acl_elvss_map_table_revA = <
			5	27		6	27		7	27		8	27		9	27
			10	27		11	27		12	27		13	27		14	27
			15	27		16	27		17	27		19	27		20	27
			21	26		22	25		24	24		25	23		27	22
			29	21		30	20		32	19		34	18		37	18
			39	18		41	17		44	17		47	17		50	17
			53	17		56	17		60	17		64	17		68	17
			72	17		77	17		83	17		87	17		93	17
			98	16		105	15		111	15		119	14		126	14
			134	14		143	13		152	13		162	13		172	12
			183	11		195	10		207	9		220	8		234	7
			249	6		265	5		282	4		300	3		316	2
			333	1		360	0
		>;

		/*
		 * ************************************************************************************************************************
		 * candela to index mappings
		 * ************************************************************************************************************************
		 */
	samsung,candela_map_table_revA = <
		/*<idx>	<from>	<till>		<candella> */
			0		0		0		5
			1		1		4		6
			2		5		8		7
			3		9		12		8
			4		13		16		9
			5		17		20		10
			6		21		24		11
			7		25		28		12
			8		29		32		13
			9		33		36		14
			10		37		40		15
			11		41		42		16
			12		43		44		17
			13		45		46		19
			14		47		48		20
			15		49		50		21
			16		51		52		22
			17		53		54		24
			18		55		56		25
			19		57		58		27
			20		59		60		29
			21		61		62		30
			22		63		64		32
			23		65		66		34
			24		67		68		37
			25		69		70		39
			26		71		72		41
			27		73		74		44
			28		75		76		47
			29		77		78		50
			30		79		80		53
			31		81		82		56
			32		83		84		60
			33		85		86		64
			34		87		88		68
			35		89		90		72
			36		91		92		77
			37		93		94		82
			38		95		96		87
			39		97		98		93
			40		99		100		98
			41		101		102		105
			42		103		104		111
			43		105		106		119
			44		107		108		126
			45		109		111		134
			46		112		114		143
			47		115		117		152
			48		118		120		162
			49		121		124		172
			50		125		128		183
			51		129		139		195
			52		140		150		207
			53		151		161		220
			54		162		172		234
			55		173		183		249
			56		184		194		265
			57		195		206		282
			58		207		218		300
			59		219		229		316
			60		230		241		333
			61		242		255		360
		>;

		samsung,hbm_candela_map_table_revA = <
			0	268	271	378	6
			1	272	285	395	7
			2	286	299	413	8
			3	300	313	430	9
			4	314	326	448	10
			5	327	340	465	11
			6	341	354	483	12
			7	355	355	500	13
		>;
	};
};
