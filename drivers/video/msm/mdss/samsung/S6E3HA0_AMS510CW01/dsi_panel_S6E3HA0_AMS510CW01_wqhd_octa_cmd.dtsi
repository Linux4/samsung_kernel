/* Copyright (c) 2012, Samsung Electronics Corporation. All rights reserved.
 *
 * This program is free software; you can redistribute it and/or modify
 * it under the terms of the GNU General Public License version 2 and
 * only version 2 as published by the Free Software Foundation.
 *
 * This program is distributed in the hope that it will be useful,
 * but WITHOUT ANY WARRANTY; without even the implied warranty of
 * MERCHANTABILITY or FITNESS FOR A PARTICULAR PURPOSE.  See the
 * GNU General Public License for more details.
 */

&mdss_mdp {
	ss_dsi_panel_S6E3HA0_AMS510CW01_WQHD_0: ss_dsi_panel_S6E3HA0_AMS510CW01_WQHD_0 {
		qcom,mdss-dsi-panel-name = "samsung,mdss-amoled-dual_dsi-panel0";
		label = "ss_dsi_panel_S6E3HA0_AMS510CW01_WQHD_0";

		qcom,mdss-dsi-panel-controller = <&mdss_dsi0>;

		qcom,mdss-dsi-panel-width = <720>;
		qcom,mdss-dsi-panel-height = <2560>;
		qcom,mdss-dsi-bpp = <24>;
		qcom,mdss-dsi-panel-destination = "display_1";

		qcom,enable-gpio = <&pma8084_gpios 6 0>;

		qcom,mdss-dsi-panel-timings = [FA 4B 41 00 66 81 34 4B 41 03 04 A0];

		qcom,mdss-dsi-off-command=[
			05 01 00 00 0A 00 02 28 00	/* wait 10ms(0x0A) */
			05 01 00 00 78 00 02 10 00	/* wait 120ms(0x78) */
		];

		qcom,cont-splash-enabled;
		qcom,cmd-sync-wait-broadcast;
		/*qcom,cmd-sync-wait-trigger;*/ /*SYNC UP WITH DSI1*/
		/*qcom,mdss-dsi-fbc-enable=*/
		/*qcom,mdss-dsi-fbc-bpp=*/
		/*qcom,mdss-dsi-fbc-packing=*/
		/*qcom,mdss-dsi-fbc-quant-error=*/
		/*qcom,mdss-dsi-fbc-bias=*/
		/*qcom,mdss-dsi-fbc-pat-mode=*/
		/*qcom,mdss-dsi-fbc-vlc-mode=*/
		/*qcom,mdss-dsi-fbc-bflc-mode=*/
		/*qcom,mdss-dsi-fbc-h-line-budget=*/
		/*qcom,mdss-dsi-fbc-budget-ctrl=*/
		/*qcom,mdss-dsi-fbc-block-budget=*/
		/*qcom,mdss-dsi-fbc-lossless-threshold=*/
		/*qcom,mdss-dsi-fbc-lossy-threshold=*/
		/*qcom,mdss-dsi-fbc-rgb-threshold=*/
		/*qcom,mdss-dsi-fbc-lossy-mode-idx=*/

		qcom,mdss-dsi-h-back-porch = <108>;
		qcom,mdss-dsi-h-front-porch = <15>;
		qcom,mdss-dsi-h-pulse-width = <212>;
		qcom,mdss-dsi-h-sync-skew = <0>;
		qcom,mdss-dsi-v-back-porch = <9>;
		qcom,mdss-dsi-v-front-porch = <2>;
		qcom,mdss-dsi-v-pulse-width = <7>;

		qcom,mdss-dsi-h-left-border = <0>;
		qcom,mdss-dsi-h-right-border = <0>;
		qcom,mdss-dsi-v-top-border = <0>;
		qcom,mdss-dsi-v-bottom-border = <0>;

		qcom,mdss-dsi-underflow-color = <0xFF>;
		qcom,mdss-dsi-border-color = <0>;

		/*qcom,mdss-dsi-pan-enable-dynamic-fps=*/
		/*qcom,mdss-dsi-pan-fps-update=*/

		qcom,mdss-dsi-bl-pmic-control-type = "bl_ctrl_dcs";
		/*qcom,mdss-dsi-bl-pmic-bank-select=*/
		/*qcom,mdss-dsi-bl-pmic-pwm-frequency=*/
		/*qcom,mdss-dsi-pwm-gpio=*/

		qcom,mdss-dsi-bl-min-level = <1>;
		qcom,mdss-dsi-bl-max-level = <255>;
		qcom,mdss-brightness-max-level = <255>;
		qcom,mdss-dsi-interleave-mode = <0>;
		qcom,mdss-dsi-panel-type = "dsi_cmd_mode";

		/*qcom,mdss-dsi-te-check-enable; */
		qcom,mdss-dsi-te-using-te-pin;
		qcom,mdss-dsi-te-pin-select = <1>;

		qcom,mdss-dsi-te-dcs-command = <1>;
		qcom,mdss-dsi-wr-mem-start = <0x2C>;
		qcom,mdss-dsi-wr-mem-continue = <0x3C>;

		/* CMD mode panel doesn't need below stuff */
		/*qcom,mdss-dsi-h-sync-pulse=*/
		/*qcom,mdss-dsi-hfp-power-mode=*/
		/*qcom,mdss-dsi-hbp-power-mode=*/
		/*qcom,mdss-dsi-hsa-power-mode=*/
		/*qcom,mdss-dsi-last-line-interleave=*/
		/*qcom,mdss-dsi-bllp-eof-power-mode=*/
		/*qcom,mdss-dsi-bllp-power-mode=*/
		/*qcom,mdss-dsi-traffic-mode=*/

		qcom,mdss-dsi-pixel-packing = "loose";

		qcom,mdss-dsi-virtual-channel-id = <0>;
		qcom,mdss-dsi-color-order = "rgb_swap_rgb";
		qcom,mdss-dsi-lane-0-state;
		qcom,mdss-dsi-lane-1-state;
		qcom,mdss-dsi-lane-2-state;
		qcom,mdss-dsi-lane-3-state;
		qcom,mdss-dsi-lane-map = "lane_map_0123";

		qcom,mdss-dsi-t-clk-pre = <0x30>;
		qcom,mdss-dsi-t-clk-post = <0x04>;

		qcom,mdss-dsi-stream = <0>;
		qcom,mdss-dsi-mdp-trigger = "none";
		qcom,mdss-dsi-dma-trigger = "trigger_sw";
		qcom,mdss-dsi-panel-framerate = <60>;
		qcom,mdss-dsi-panel-clockrate = <898000000>;
		qcom,mdss-dsi-on-command-state = "dsi_lp_mode";
		qcom,mdss-dsi-off-command-state = "dsi_hs_mode";

		qcom,mdss-pan-physical-width-dimension = <65>;
		qcom,mdss-pan-physical-height-dimension = <115>;

		qcom,mdss-dsi-panel-mode-gpio-state = "invalid";

		/*qcom,mdss-tear-check-disable*/
		/*qcom,mdss-tear-check-sync-cfg-height=*/
		/*qcom,mdss-tear-check-sync-init-val=*/
		/*qcom,mdss-tear-check-sync-threshold-start=*/
		/*qcom,mdss-tear-check-sync-threshold-continue=*/
		/*qcom,mdss-tear-check-start-pos=*/
		/*qcom,mdss-tear-check-rd-ptr-trigger-intr=*/
		/*qcom,mdss-tear-check-frame-rate=*/

		qcom,mdss-dsi-reset-sequence = <1 10>, <0 10>, <1 10>;
		qcom,partial-update-enabled;
		qcom,partial-update-roi-merge;
		qcom,panel-roi-alignment = <8 8 1 1 1 2>;
		/*qcom,mdss-dsi-horizontal-line-idle*/

		qcom,mdss-dsi-lp11-init;
		qcom,mdss-dsi-init-delay-us = <1000>;

		qcom,mdss-dsi-rx-eot-ignore;
		qcom,mdss-dsi-tx-eot-append;

		/*qcom,ulps-enabled*/
		/*qcom,panel-roi-alignment=<8 8 1 1 1 2>;*/
		/*qcom,esd-check-enabled*/
		/*qcom,mdss-dsi-panel-status-command=*/
		/*qcom,mdss-dsi-panel-status-command-mode="dsi_lp_mode";*/
		/*qcom,mdss-dsi-panel-status-check-mode="reg_read";*/
		/*qcom,mdss-dsi-panel-status-value=<1>;*/
		/*qcom,dynamic-mode-switch-enabled*/
		/*qcom,video-to-cmd-mode-switch-commands=*/
		/*qcom,cmd-to-video-mode-switch-commands=*/
	};

	ss_dsi_panel_S6E3HA0_AMS510CW01_WQHD_1: ss_dsi_panel_S6E3HA0_AMS510CW01_WQHD_1 {
		qcom,mdss-dsi-panel-name = "samsung,mdss-amoled-dual_dsi-panel1";
		label = "ss_dsi_panel_S6E3HA0_AMS510CW01_WQHD_1";

		qcom,mdss-dsi-panel-controller = <&mdss_dsi1>;

		qcom,mdss-dsi-panel-width = <720>;
		qcom,mdss-dsi-panel-height = <2560>;
		qcom,mdss-dsi-bpp = <24>;
		qcom,mdss-dsi-panel-destination = "display_2";

               qcom,enable-gpio = <&pma8084_gpios 6 0>;

		qcom,mdss-dsi-panel-timings = [FA 4B 41 00 66 81 34 4B 41 03 04 A0];

		qcom,mdss-dsi-on-command= [
			29 01 00 00 00 00 03 F0 5A 5A 		/* TEST KEY Enable */

			29 01 00 00 00 00 03 FC 5A 5A
			29 01 00 00 00 00 05 FF 00 00 20 00
			29 01 00 00 00 00 03 FC A5 A5

			05 01 00 00 14 00 02 11 00 			/* Sleep out, wait 20ms(0x14) */

			/* Brightness condition set */
			29 01 00 00 00 00 22				/* Gamma 2.2 Setting */
				CA 01 00 01 00 01 00 80
				80 80 80 80 80 80 80 80
				80 80 80 80 80 80 80 80
				80 80 80 80 80 80 80 00
				00 00
			29 01 00 00 00 00 03 B2 01 03		/* AID 10% */
			29 01 00 00 00 00 03 B6 88 04		/* ELVSS Setting */

			29 01 00 00 00 00 15				/* CAPS ELVSS Set */
				B6 98 04 00 00 00 00
				00 03 55 54 20
				00 0B BB BF 0F
				01 22 22 10
			29 01 00 00 00 00 02 B5 41			/* 16 frame Averaging (0x41) */

			23 01 00 00 01 00 02 F7 03			/* update */
			23 01 00 00 00 00 02 F7 00			/* update */

			/* TE OUT (Vsync) */
			23 01 00 00 00 00 02 35 00			/* TE Vsync ON */

			/* Touch Hsync, Vsync */
			29 01 00 00 00 00 03 FC 5A 5A
			29 01 00 00 00 00 04 BD 85 02 16	/* Touch Hsync Enable */
			29 01 00 00 00 00 02 FF 02			/* Touch Vsync Enable */
			29 01 00 00 00 00 03 FC A5 A5

			/* Pentile setting */
			29 01 00 00 78 00 05 C0 30 00 D8 D8	/* wait 120ms(0x78) */

			05 01 00 00 00 00 02 2C 00 			/* Memory Access */
			05 01 00 00 00 00 02 3C 00

			29 01 00 00 00 00 03 F0 A5 A5		/* TEST KEY key Disable  */
		];

		qcom,mdss-dsi-off-command=[
			05 01 00 00 0A 00 02 28 00	/* wait 10ms(0x0A) */
			05 01 00 00 78 00 02 10 00	/* wait 120ms(0x78) */
		];

		qcom,cont-splash-enabled;
		qcom,cmd-sync-wait-broadcast;
		qcom,cmd-sync-wait-trigger; /*SYNC UP WITH DSI1*/
		/*qcom,mdss-dsi-fbc-enable=*/
		/*qcom,mdss-dsi-fbc-bpp=*/
		/*qcom,mdss-dsi-fbc-packing=*/
		/*qcom,mdss-dsi-fbc-quant-error=*/
		/*qcom,mdss-dsi-fbc-bias=*/
		/*qcom,mdss-dsi-fbc-pat-mode=*/
		/*qcom,mdss-dsi-fbc-vlc-mode=*/
		/*qcom,mdss-dsi-fbc-bflc-mode=*/
		/*qcom,mdss-dsi-fbc-h-line-budget=*/
		/*qcom,mdss-dsi-fbc-budget-ctrl=*/
		/*qcom,mdss-dsi-fbc-block-budget=*/
		/*qcom,mdss-dsi-fbc-lossless-threshold=*/
		/*qcom,mdss-dsi-fbc-lossy-threshold=*/
		/*qcom,mdss-dsi-fbc-rgb-threshold=*/
		/*qcom,mdss-dsi-fbc-lossy-mode-idx=*/

		qcom,mdss-dsi-h-back-porch = <108>;
		qcom,mdss-dsi-h-front-porch = <15>;
		qcom,mdss-dsi-h-pulse-width = <212>;
		qcom,mdss-dsi-h-sync-skew = <0>;
		qcom,mdss-dsi-v-back-porch = <9>;
		qcom,mdss-dsi-v-front-porch = <2>;
		qcom,mdss-dsi-v-pulse-width = <7>;

		qcom,mdss-dsi-h-left-border = <0>;
		qcom,mdss-dsi-h-right-border = <0>;
		qcom,mdss-dsi-v-top-border = <0>;
		qcom,mdss-dsi-v-bottom-border = <0>;

		qcom,mdss-dsi-underflow-color = <0xFF>;
		qcom,mdss-dsi-border-color = <0>;

		/*qcom,mdss-dsi-pan-enable-dynamic-fps=*/
		/*qcom,mdss-dsi-pan-fps-update=*/

		qcom,mdss-dsi-bl-pmic-control-type = "bl_ctrl_dcs";
		/*qcom,mdss-dsi-bl-pmic-bank-select=*/
		/*qcom,mdss-dsi-bl-pmic-pwm-frequency=*/
		/*qcom,mdss-dsi-pwm-gpio=*/

		qcom,mdss-dsi-bl-min-level = <1>;
		qcom,mdss-dsi-bl-max-level = <255>;
		qcom,mdss-brightness-max-level = <255>;
		qcom,mdss-dsi-interleave-mode = <0>;
		qcom,mdss-dsi-panel-type = "dsi_cmd_mode";

		/*qcom,mdss-dsi-te-check-enable*/
		qcom,mdss-dsi-te-using-te-pin = <1>;
		qcom,mdss-dsi-te-pin-select = <1>;

		qcom,mdss-dsi-te-dcs-command = <1>;
		qcom,mdss-dsi-wr-mem-start = <0x2C>;
		qcom,mdss-dsi-wr-mem-continue = <0x3C>;

		/* CMD mode panel doesn't need below stuff */
		/*qcom,mdss-dsi-h-sync-pulse=*/
		/*qcom,mdss-dsi-hfp-power-mode=*/
		/*qcom,mdss-dsi-hbp-power-mode=*/
		/*qcom,mdss-dsi-hsa-power-mode=*/
		/*qcom,mdss-dsi-last-line-interleave=*/
		/*qcom,mdss-dsi-bllp-eof-power-mode=*/
		/*qcom,mdss-dsi-bllp-power-mode=*/
		/*qcom,mdss-dsi-traffic-mode=*/

		qcom,mdss-dsi-pixel-packing = "loose";

		qcom,mdss-dsi-virtual-channel-id = <0>;
		qcom,mdss-dsi-color-order = "rgb_swap_rgb";
		qcom,mdss-dsi-lane-0-state;
		qcom,mdss-dsi-lane-1-state;
		qcom,mdss-dsi-lane-2-state;
		qcom,mdss-dsi-lane-3-state;
		qcom,mdss-dsi-lane-map = "lane_map_0123";

		qcom,mdss-dsi-t-clk-pre = <0x30>;
		qcom,mdss-dsi-t-clk-post = <0x04>;

		qcom,mdss-dsi-stream = <0>;
		qcom,mdss-dsi-mdp-trigger = "none";
		qcom,mdss-dsi-dma-trigger = "trigger_sw";
		qcom,mdss-dsi-panel-framerate = <60>;
		qcom,mdss-dsi-panel-clockrate = <898000000>;
		qcom,mdss-dsi-on-command-state = "dsi_lp_mode";
		qcom,mdss-dsi-off-command-state = "dsi_hs_mode";

		qcom,mdss-pan-physical-width-dimension = <65>;
		qcom,mdss-pan-physical-height-dimension = <115>;

		qcom,mdss-dsi-panel-mode-gpio-state = "invalid";

		/*qcom,mdss-tear-check-disable*/
		/*qcom,mdss-tear-check-sync-cfg-height=*/
		/*qcom,mdss-tear-check-sync-init-val=*/
		/*qcom,mdss-tear-check-sync-threshold-start=*/
		/*qcom,mdss-tear-check-sync-threshold-continue=*/
		/*qcom,mdss-tear-check-start-pos=*/
		/*qcom,mdss-tear-check-rd-ptr-trigger-intr=*/
		/*qcom,mdss-tear-check-frame-rate=*/

		qcom,mdss-dsi-reset-sequence = <1 10>, <0 10>, <1 10>;
		qcom,partial-update-enabled;
		qcom,partial-update-roi-merge;
		qcom,panel-roi-alignment = <8 8 1 1 1 1>;
		/*qcom,mdss-dsi-horizontal-line-idle*/

		qcom,mdss-dsi-lp11-init;
		qcom,mdss-dsi-init-delay-us = <1000>;

		qcom,mdss-dsi-rx-eot-ignore;
		qcom,mdss-dsi-tx-eot-append;

		/*qcom,ulps-enabled*/
		/*qcom,panel-roi-alignment=<8 8 1 1 1 2>;*/
		/*qcom,esd-check-enabled*/
		/*qcom,mdss-dsi-panel-status-command=*/
		/*qcom,mdss-dsi-panel-status-command-mode="dsi_lp_mode";*/
		/*qcom,mdss-dsi-panel-status-check-mode="reg_read";*/
		/*qcom,mdss-dsi-panel-status-value=<1>;*/
		/*qcom,dynamic-mode-switch-enabled*/
		/*qcom,video-to-cmd-mode-switch-commands=*/
		/*qcom,cmd-to-video-mode-switch-commands=*/

/*
 * ************************************************************************************************************************************
 *
 *
 *			Below  parameters are samsung dependent thigs
 *
 *
 * ************************************************************************************************************************************
 */
 		samsung,support_panel_max = <2>;  // Real panel is 1, but define as 2 (Because of lcd_type, window_type's problem)

		/*
		 * ************************************************************************************************************************
		 *   APLPM
		 * ************************************************************************************************************************
		 */
		samsung,alpm_on_tx_cmds_revL = [
			05 01 00 00 14 00 02 28 00			/* display off wait 20ms */

			/* image write for APLM mode */

			29 01 00 00 00 00 03 F0 5A 5A 		/* TEST KEY Enable */
			29 01 00 00 00 00 55 CB 			/* ALPM 30Hz LPTS timming */
			18 51 01 00 00 01 23 00 00 D2
			04 00 D2 01 00 00 41 8F 14 8F
			00 00 00 00 01 00 00 00 00 00
			00 D2 01 00 00 82 00 00 C0 00
			00 00 E0 00 00 00 E0 E0 ED E0
			63 02 04 05 00 00 00 00 00 00
			00 00 00 00 0B 00 0F 0E 04 05
			00 D3 01 01 D3 72 48 72 48 72
			48 01 04 01
			29 01 00 00 01 00 02 F7 03
			29 01 00 00 01 00 02 F7 00
			29 01 00 00 00 00 03 BB 00 00		/* Frame Freq 30Hz */
			29 01 00 00 00 00 03 F0 A5 A5		/* TEST KEY key Disable  */

			29 01 00 00 00 00 05 30 00 00 00 00	/** user set partial area **/

			29 01 00 00 00 00 02 12 00			/* partial mode on */
			29 01 00 00 14 00 02 39 00			/* idel mode on wait 20ms */

			/*				29 01 00 00 00 00 02 29 00*/			/* display on */
		];
		samsung,alpm_off_tx_cmds_revL = [
			05 01 00 00 14 00 02 28 00			/* display off wait 20ms */

			/* image write for normal mode */

			29 01 00 00 00 00 02 38 00			/* idel Mode off */
			29 01 00 00 00 00 02 13 00			/* normal mode on */

			29 01 00 00 00 00 03 F0 5A 5A		/* TEST KEY Enable */
			29 01 00 00 00 00 55 CB				/* ALPM 30Hz LPTS timming */
			18 51 01 00 00 01 23 00 00 D2
			04 00 D2 01 00 00 41 8F 14 8F
			00 00 00 00 01 00 00 00 00 00
			00 D2 01 00 00 82 00 00 C0 00
			00 00 E0 00 00 00 E0 E0 E1 E0
			63 02 04 05 00 00 00 00 00 00
			00 00 00 00 0B 00 0F 0E 04 05
			00 D3 01 01 D3 72 48 72 48 72
			48 01 01 01
			29 01 00 00 01 00 02 F7 03
			29 01 00 00 01 00 02 F7 00
			29 01 00 00 14 00 03 F0 A5 A5		/* TEST KEY key Disable wait 20ms */

			/*			29 01 00 00 00 00 02 29 00*/			/* display on */
		];

		/*
		the last byte in read commands  represent READ LENGH,
		like below  READ LENGH = 0x21
		*/
		samsung,level1_key_enable_tx_cmds_revL = [
			29 01 00 00 00 00 03 F0 5A 5A
		];
	 	samsung,level1_key_disable_tx_cmds_revL = [
			29 01 00 00 00 00 03 F0 A5 A5
		];
	 	samsung,level2_key_enable_tx_cmds_revL = [
			29 00 00 00 00 00 03 F0 5A 5A
			29 01 00 00 00 00 03 fc 5a 5a
		];
	 	samsung,level2_key_disable_tx_cmds_revL = [
			29 00 00 00 00 00 03 F0 A5 A5
			29 01 00 00 00 00 03 fc A5 A5
		];

		samsung,packet_size_tx_cmds_revA = [
			37 01 00 00 00 00 02 07 00
		];

		samsung,reg_read_pos_tx_cmds_revA = [
			15 01 00 00 00 00 02 B0 00
		];

		samsung,smart_dimming_mtp_rx_cmds_revL = [ 06 01 00 00 00 00 01 c8 21 00];
		samsung,hbm_rx_cmds_revL = [ 06 01 00 00 00 00 01 c8 07 21];	/* read C8 34~40th , 33=0x21*/
		samsung,hbm2_rx_cmds_revL = [ 06 01 00 00 00 00 01 c8 0F 48];	/* read C8 73~87th , 72=0x48*/
		samsung,mdnie_read_rx_cmds_revL	= [ 06 01 00 00 00 00 01 A1 04 00];
		samsung,elvss_rx_cmds_revL = [ 06 01 00 00 00 00 01 b6 01 14];	/* read C6 21th , 20=0x14*/

		/* the last byte in all read commands will represent READ LENGH */
		samsung,manufacture_id0_rx_cmds_revL = [ 06 01 00 00 00 00 01 da 01 00];
		samsung,manufacture_id1_rx_cmds_revL = [ 06 01 00 00 00 00 01 db 01 00];
		samsung,manufacture_id2_rx_cmds_revL = [ 06 01 00 00 00 00 01 dc 01 00];

		samsung,manufacture_date_rx_cmds_revL = [ 06 01 00 00 00 00 01 c8 02 28];	/* read C8 41~42th , 40=0x28*/

		samsung,ddi_id_rx_cmds_revL = [ 06 01 00 00 00 00 01 d6 05 00];	/* read D6 1~5th */

		samsung,ldi_debug0_rx_cmds_revL = [06 01 00 00 00 00 01 0A 01 00];
		samsung,ldi_debug1_rx_cmds_revL = [06 01 00 00 00 00 01 0E 01 00];
		samsung,ldi_debug2_rx_cmds_revL = [06 01 00 00 00 00 01 EA 08 00];

		samsung,ldi_fps_change_tx_cmds_revL = [
			29 01 00 00 00 00 02 B0 1A    /* Global Para. (27para) */
			29 01 00 00 00 00 02 D7 00
		];

		samsung,ldi_fps_rx_cmds_revL = [06 01 00 00 00 00 01 D7 01 1A]; /* read D7 27th , 27=0x1B*/

		samsung,mtp_read_sysfs_rx_cmds_revL = [ 06 01 00 00 00 00 01 00 00 00];

		samsung,display_on_tx_cmds_revL = [05 01 00 00 32 00 02 29 00];
		samsung,display_off_tx_cmds_revL = [05 01 00 00 32 00 02 28 00];

		samsung,elvss_lowtemp_tx_cmds_revL = [
			29 01 00 00 00 00 02 B0 05
			29 01 00 00 00 00 02 B8 00
		];	/* Low Temperature Command */

		samsung,elvss_lowtemp2_tx_cmds_revL = [
			29 01 00 00 00 00 02 B0 14
			29 01 00 00 00 00 02 B6 00
		];	/* Low Temperature Command: default */

		samsung,gamma_tx_cmds_revL = [
			29 01 00 00 00 00 22            /* Brightness Condition Set - Gamma 2.2 Setting*/
			CA 01 00 01 00 01 00 80
			80 80 80 80 80 80 80 80
			80 80 80 80 80 80 80 80
			80 80 80 80 80 80 80 00
			00 00
			29 01 00 00 01 00 02 F7 03		/* Gamma, LTPS(AID) update */

			29 01 00 00 00 00 3C		/* dummy for single transmission more 100ns delay */
			00 00 00 00 00 00 00 00 00 00
			00 00 00 00 00 00 00 00 00 00
			00 00 00 00 00 00 00 00 00 00
			00 00 00 00 00 00 00 00 00 00
			00 00 00 00 00 00 00 00 00 00
			00 00 00 00 00 00 00 00 00 00
			
			29 01 00 00 00 00 02 F7 00		/* Gamma, LTPS(AID) update */
		];

		samsung,hbm_gamma_tx_cmds_revL = [
			29 01 00 00 00 00 22            /* Brightness Condition Set for HBM - Gamma 2.2 Setting*/
			CA 01 00 01 00 01 00 80
			80 80 80 80 80 80 80 80
			80 80 80 80 80 80 80 80
			80 80 80 80 80 80 80 00
			00 00
		];

		samsung,hbm_etc_tx_cmds_revL = [
			29 01 00 00 00 00 03 B2 00 0A					/* AID 0% */
			29 01 00 00 00 00 16 B6 						/* HBM ELVSS Setting */
			88 04 00 00 00 00
			00 03 55 54 20
			00 0B BB BF 0F
			01 22 22 10 00
			29 01 00 00 00 00 02 B5 51	   					/* 0x51 : 32 frame Averaging */
			29 01 00 00 00 00 02 55 02	   					/* RE(low) & ACL */
			29 01 00 00 01 00 02 F7 03 						/* Gamma, LTPS(AID) update, delay 1ms */

			29 01 00 00 00 00 3C		/* dummy for single transmission more 100ns delay */
			00 00 00 00 00 00 00 00 00 00
			00 00 00 00 00 00 00 00 00 00
			00 00 00 00 00 00 00 00 00 00
			00 00 00 00 00 00 00 00 00 00
			00 00 00 00 00 00 00 00 00 00
			00 00 00 00 00 00 00 00 00 00

			29 01 00 00 00 00 02 F7 00 						/* Gamma, LTPS(AID) update */
		];

		samsung,panel_ldi_vdd_read_cmds_revA = [
							06 01 00 00 00 00 01 D7 01 18];

		samsung,panel_ldi_vddm_read_cmds_revA = [
							06 01 00 00 00 00 01 D7 01 19];

		samsung,panel_ldi_vdd_offset_write_cmds_revA = [
							29 01 00 00 00 00 03 FC 5A 5A
							29 01 00 00 00 00 05 FF 00 00 40 00
							29 01 00 00 00 00 02 B0 18
							29 01 00 00 00 00 02 D7 00
							29 01 00 00 00 00 02 FE A0
							29 01 00 00 00 00 02 FE 20
							29 01 00 00 00 00 03 FC A5 A5];

		samsung,panel_ldi_vddm_offset_write_cmds_revA = [
							29 01 00 00 00 00 03 FC 5A 5A
							29 01 00 00 00 00 02 B0 19
							29 01 00 00 00 00 02 D7 00
							29 01 00 00 00 00 02 FE A0
							29 01 00 00 00 00 02 FE 20
							29 01 00 00 00 00 03 FC A5 A5];

		/*
		* ************************************************************************************************************************
		* AID command list and mappings
		* ************************************************************************************************************************
		*/
		samsung,aid_tx_cmds_revL = [
			29 01 00 00 00 00 03 B2 09 e0 /* 0  samsung_brightness_aor_ 2cd_97.8 */
			29 01 00 00 00 00 03 B2 09 cc /* 1  samsung_brightness_aor_ 3cd_90.5 */
			29 01 00 00 00 00 03 B2 09 bb /* 2  samsung_brightness_aor_ 4cd_90.5 */
			29 01 00 00 00 00 03 B2 09 a6 /* 3  samsung_brightness_aor_ 5cd_90.5 */
			29 01 00 00 00 00 03 B2 09 93 /* 4  samsung_brightness_aor_ 6cd_95.0 */
			29 01 00 00 00 00 03 B2 09 7e /* 5  samsung_brightness_aor_ 7cd_94.1 */
			29 01 00 00 00 00 03 B2 09 6b /* 6  samsung_brightness_aor_ 8cd_93.2 */
			29 01 00 00 00 00 03 B2 09 57 /* 7  samsung_brightness_aor_ 9cd_92.3 */
			29 01 00 00 00 00 03 B2 09 43 /* 8  samsung_brightness_aor_10d_91.4 */
			29 01 00 00 00 00 03 B2 09 2f /* 9  samsung_brightness_aor_11cd_90.5 */
			29 01 00 00 00 00 03 B2 09 1b /* 10 samsung_brightness_aor_12cd_89.5 */
			29 01 00 00 00 00 03 B2 09 06 /* 11 samsung_brightness_aor_13cd_88.7 */
			29 01 00 00 00 00 03 B2 08 f2 /* 12 samsung_brightness_aor_14cd_87.8 */
			29 01 00 00 00 00 03 B2 08 de /* 13 samsung_brightness_aor_15cd_86.8 */
			29 01 00 00 00 00 03 B2 08 cb /* 14 samsung_brightness_aor_16cd_85.9 */
			29 01 00 00 00 00 03 B2 08 b7 /* 15 samsung_brightness_aor_17cd_84.9 */
			29 01 00 00 00 00 03 B2 08 8e /* 16 samsung_brightness_aor_19cd_84.0 */
			29 01 00 00 00 00 03 B2 08 7b /* 17 samsung_brightness_aor_20cd_82.1 */
			29 01 00 00 00 00 03 B2 08 65 /* 18 samsung_brightness_aor_21cd_81.1 */
			29 01 00 00 00 00 03 B2 08 51 /* 19 samsung_brightness_aor_22cd_80.3 */
			29 01 00 00 00 00 03 B2 08 29 /* 20 samsung_brightness_aor_24cd_79.3 */
			29 01 00 00 00 00 03 B2 08 14 /* 21 samsung_brightness_aor_25cd_78.0 */
			29 01 00 00 00 00 03 B2 07 ea /* 22 samsung_brightness_aor_27cd_76.5 */
			29 01 00 00 00 00 03 B2 07 c2 /* 23 samsung_brightness_aor_29cd_74.6 */
			29 01 00 00 00 00 03 B2 07 ac /* 24 samsung_brightness_aor_30cd_72.6 */
			29 01 00 00 00 00 03 B2 07 83 /* 25 samsung_brightness_aor_32cd_71.5 */
			29 01 00 00 00 00 03 B2 07 59 /* 26 samsung_brightness_aor_34cd_69.6 */
			29 01 00 00 00 00 03 B2 07 1a /* 27 samsung_brightness_aor_37cd_67.9 */
			29 01 00 00 00 00 03 B2 06 f1 /* 28 samsung_brightness_aor_39cd_64.8 */
			29 01 00 00 00 00 03 B2 06 c6 /* 29 samsung_brightness_aor_41cd_62.9 */
			29 01 00 00 00 00 03 B2 06 88 /* 30 samsung_brightness_aor_44cd_61.0 */
			29 01 00 00 00 00 03 B2 06 48 /* 31 samsung_brightness_aor_47cd_58.0 */
			29 01 00 00 00 00 03 B2 06 07 /* 32 samsung_brightness_aor_50cd_55.0 */
			29 01 00 00 00 00 03 B2 05 c7 /* 33 samsung_brightness_aor_53cd_52.4 */
			29 01 00 00 00 00 03 B2 05 85 /* 34 samsung_brightness_aor_56cd_49.1 */
			29 01 00 00 00 00 03 B2 05 30 /* 35 samsung_brightness_aor_60cd_46.0 */
			29 01 00 00 00 00 03 B2 04 d8 /* 36 samsung_brightness_aor_64cd_42.2 */
			29 01 00 00 00 00 03 B2 04 81 /* 37 samsung_brightness_aor_68cd_40.4 */
			29 01 00 00 00 00 03 B2 04 29 /* 38 samsung_brightness_aor_72cd_36.7 */
			29 01 00 00 00 00 03 B2 03 c5 /* 39 samsung_brightness_aor_77_183cd_32.2 */
			29 01 00 00 00 00 03 B2 03 4a /* 40 samsung_brightness_aor_195cd_27.0 */
			29 01 00 00 00 00 03 B2 02 cc /* 41 samsung_brightness_aor_207cd_21.5 */
			29 01 00 00 00 00 03 B2 02 44 /* 42 samsung_brightness_aor_220cd_15.8 */
			29 01 00 00 00 00 03 B2 01 ae /* 43 samsung_brightness_aor_234cd_9.5  */
			29 01 00 00 00 00 03 B2 01 03 /* 44 samsung_brightness_aor_249_350cd_2.8 */
		];

		/* bl_level, Index in acl command list */
		samsung,aid_map_table_revL = <
			2	0
			4	2		5	3		6	4		8	6		9	7
			10	8		12	10		13	11		15	13		16	14
			17	15		19	16		20	17		21	18		24	20
			25	21		27	22		29	23		30	24		32	25
			34	26		37	27		39	28		41	29		44	30
			47	31		50	32		53	33		56	34		60	35
			64	36		68	37		72	38		77	39		82	39
			87	39		93	39		98	39		105	39		111	39
			119	39		126	39		134	39		143	39		152	39
			162	39		172	39		183	39		195	40		207	41
			220	42		234	43		249	44		265	44		282	44
			300	44		316	44		333	44		350	44
		>;

		/*
		* ************************************************************************************************************************
		* ACL command list and mappings
		* ************************************************************************************************************************
		*/
		samsung,acl_on_tx_cmds_revL = [29 01 00 00 00 00 02 B5 51]; /* ACL on, B5 <- 0x51 */


		samsung,acl_percent_tx_cmds_revL = [
			29 01 00 00 00 00 02 55 00
			29 01 00 00 00 00 02 55 01		/* ACL 30% */
			29 01 00 00 00 00 02 55 02		/* default ACL 15% */
			29 01 00 00 00 00 02 55 03
		];	/* ACL 50% */

		samsung,acl_off_tx_cmds_revL = [
			29 01 00 00 00 00 02 B5 41   /* ACL OFF - 41 (16Frame Averaging) */
			29 01 00 00 00 00 02 55 00
		];/*off, b5<-0x41*/

		/* bl_level , Index in acl command list */
		samsung,acl_map_table_revL =  <
			2	2
			4	2		5	2		6	2		8	2		9	2
			10	2		12	2		13	2		15	2		16	2
			17	2		19	2		20	2		21	2		24	2
			25	2		27	2		29	2		30	2		32	2
			34	2		37	2		39	2		41	2		44	2
			47	2		50	2		53	2		56	2		60	2
			64	2		68	2		72	2		77	2		82	2
			87	2		93	2		98	2		105	2		111	2
			119	2		126	2		134	2		143	2		152	2
			162	2		172	2		183	2		195	2		207	2
			220	2		234	2		249	2		265	2		282	2
			300	2		316	2		333	2		350	2
		>;
		/*
		* ************************************************************************************************************************
		* ELVSS(ACL Off) command list and mappings
		* ************************************************************************************************************************
		*/
		samsung,elvss_tx_cmds_revL = [
			29 01 00 00 00 00 03 b6 88 0F /* 0 */
			29 01 00 00 00 00 03 b6 88 0F /* 1 */
			29 01 00 00 00 00 03 b6 88 0E /* 2 */
			29 01 00 00 00 00 03 b6 88 0E /* 3 */
			29 01 00 00 00 00 03 b6 88 0E /* 4 */
			29 01 00 00 00 00 03 b6 88 0D /* 5 */
			29 01 00 00 00 00 03 b6 88 0D /* 6 */
			29 01 00 00 00 00 03 b6 88 0C /* 7 */
			29 01 00 00 00 00 03 b6 88 0C /* 8 */
			29 01 00 00 00 00 03 b6 88 0B /* 9 */
			29 01 00 00 00 00 03 b6 88 0B /* 10 */
			29 01 00 00 00 00 03 b6 88 0A /* 11 */
			29 01 00 00 00 00 03 b6 88 09 /* 12 */
			29 01 00 00 00 00 03 b6 88 09 /* 13 */
			29 01 00 00 00 00 03 b6 88 09 /* 14 */
			29 01 00 00 00 00 03 b6 88 09 /* 15 */
			29 01 00 00 00 00 03 b6 88 09 /* 16 */
			29 01 00 00 00 00 03 b6 88 09 /* 17 */
			29 01 00 00 00 00 03 b6 88 09 /* 18 */
			29 01 00 00 00 00 03 b6 88 09 /* 19 */
			29 01 00 00 00 00 03 b6 88 08 /* 20 */
			29 01 00 00 00 00 03 b6 88 07 /* 21 */
			29 01 00 00 00 00 03 b6 88 07 /* 22 */
			29 01 00 00 00 00 03 b6 88 06 /* 23 */
			29 01 00 00 00 00 03 b6 88 05 /* 24 */
			29 01 00 00 00 00 03 b6 88 04 /* 25 */
		];

		/*
		* ************************************************************************************************************************
		* SMART ACL(ACL On) ELVSS command list and mappings
		* ************************************************************************************************************************
		*/
		samsung,smart_acl_elvss_tx_cmds_revL = [
			29 01 00 00 00 00 03 b6 88 0F /* 0 */
			29 01 00 00 00 00 03 b6 88 0F /* 1 */
			29 01 00 00 00 00 03 b6 88 0E /* 2 */
			29 01 00 00 00 00 03 b6 88 0E /* 3 */
			29 01 00 00 00 00 03 b6 88 0E /* 4 */
			29 01 00 00 00 00 03 b6 88 0D /* 5 */
			29 01 00 00 00 00 03 b6 88 0D /* 6 */
			29 01 00 00 00 00 03 b6 88 0C /* 7 */
			29 01 00 00 00 00 03 b6 88 0C /* 8 */
			29 01 00 00 00 00 03 b6 88 0B /* 9 */
			29 01 00 00 00 00 03 b6 88 0B /* 10 */
			29 01 00 00 00 00 03 b6 88 0A /* 11 */
			29 01 00 00 00 00 03 b6 88 09 /* 12 */
			29 01 00 00 00 00 03 b6 88 09 /* 13 */
			29 01 00 00 00 00 03 b6 88 09 /* 14 */
			29 01 00 00 00 00 03 b6 88 09 /* 15 */
			29 01 00 00 00 00 03 b6 88 09 /* 16 */
			29 01 00 00 00 00 03 b6 88 09 /* 17 */
			29 01 00 00 00 00 03 b6 88 09 /* 18 */
			29 01 00 00 00 00 03 b6 88 09 /* 19 */
			29 01 00 00 00 00 03 b6 88 08 /* 20 */
			29 01 00 00 00 00 03 b6 88 07 /* 21 */
			29 01 00 00 00 00 03 b6 88 07 /* 22 */
			29 01 00 00 00 00 03 b6 88 06 /* 23 */
			29 01 00 00 00 00 03 b6 88 05 /* 24 */
			29 01 00 00 00 00 03 b6 88 04 /* 25 */
		];

		/* bl_level, Index in elvss command list */
		samsung,smart_acl_elvss_map_table_revL = <
			2	0
			4	0		5	0		6	0		8	0		9	0
			10	0		12	0		13	0		15	0		16	0
			17	0		19	0		20	0		21	0		24	0
			25	0 		27	0		29	0		30	0		32	0
			34	0		37	0		39	0		41	0		44	0
			47	0 		50	0		53	0		56	0		60	0
			64	0		68	0		72	0		77	0		82	1
			87	2		93	3		98	4		105 	5		111	6
			119 	7		126	8		134	9		143	10		152	11
			162 	12		172	13		183	14		195	15		207	16
			220 	17		234	18		249	19		265	20		282	21
			300 	22		316	23		333	24		350	25
		>;
		/*
		* ************************************************************************************************************************
		* candela to index mappings
		* ************************************************************************************************************************
		*/
		samsung,candela_map_table_revL = <
		/*<idx>	  <from>  <till> <candella> */
			0	2	2	2
			1	3	3	4
			2	4	4	5
			3	5	5	6
			4	6	6	8
			5	7	7	9
			6	8	8	10
			7	9	9	12
			8	10	10	13
			9	11	11	15
			10	12	12	16
			11	13	13	17
			12	14	14	19
			13	15	15	20
			14	16	16	21
			15	17	17	24
			16	18	18	25
			17	19	19	27
			18	20	21	29
			19	22	23	30
			20	24	24	32
			21	25	26	34
			22	27	28	37
			23	29	29	39
			24	30	32	41
			25	33	34	44
			26	35	36	47
			27	37	38	50
			28	39	40	53
			29	41	43	56
			30	44	46	60
			31	47	49	64
			32	50	52	68
			33	53	56	72
			34	57	59	77
			35	60	63	82
			36	64	67	87
			37	68	71	93
			38	72	76	98
			39	77	80	105
			40	81	86	111
			41	87	91	119
			42	92	97	126
			43	98	104	134
			44	105	110	143
			45	111	118	152
			46	119	125	162
			47	126	133	172
			48	134	142	183
			49	143	150	195
			50	151	160	207
			51	161	170	220
			52	171	181	234
			53	182	193	249
			54	194	205	265
			55	206	218	282
			56	219	230	300
			57	231	242	316
			58	243	254	333
			59	255	255	350
		>;
	};
};
