/* Copyright (c) 2012, Samsung Electronics Corporation. All rights reserved.
 *
 * This program is free software; you can redistribute it and/or modify
 * it under the terms of the GNU General Public License version 2 and
 * only version 2 as published by the Free Software Foundation.
 *
 * This program is distributed in the hope that it will be useful,
 * but WITHOUT ANY WARRANTY; without even the implied warranty of
 * MERCHANTABILITY or FITNESS FOR A PARTICULAR PURPOSE.  See the
 * GNU General Public License for more details.
 */

&mdss_mdp {
	ss_dsi_panel_S6E3HA2_AMS801HK01_QXGA: ss_dsi_panel_S6E3HA2_AMS801HK01_QXGA {
		qcom,mdss-dsi-panel-name = "ss_dsi_panel_S6E3HA2_AMS801HK01_QXGA";
		label = "ss_dsi_panel_S6E3HA2_AMS801HK01_QXGA";
		qcom,mdss-dsi-panel-width = <768>;
		qcom,mdss-dsi-panel-height = <2048>;
		qcom,mdss-dsi-bpp = <24>;
		qcom,mdss-dsi-panel-timings = [FB 3C 2A 00 70 74 2E 40 33 03 04 00];

		qcom,mdss-dsi-on-command= [
			05 01 00 00 05 00 02 11 00		/* Sleep out, wait 5ms */

			29 00 00 00 00 00 03 F0 5A 5A		/* TEST KEY1 Enable */
			29 01 00 00 78 00 02 F2 63			/* DUAL DSI ,hsync timing: 453, wait 120 ms */
			29 01 00 00 00 00 03 F0 A5 A5           /* TEST KEY1 key Disable  */
 
			29 01 00 00 32 00 03 F0 5A 5A           /* TEST KEY1 Enable, wait 50 ms */
			29 01 00 00 28 00 03 B8 30 B9        	/* ELVDD set, wait 40 ms */
			29 00 00 00 00 00 03 B8 30 00        	/*SWIRE OFF*/
			29 01 00 00 00 00 03 F0 A5 A5		/* TEST KEY1 key Disable  */

			29 00 00 00 00 00 03 F0 5A 5A		/* TEST KEY1 Enable */
			29 00 00 00 00 00 06 B9 10 07 FF 00 09			/* Setting */
			29 01 00 00 00 00 03 F0 A5 A5		/* TEST KEY1 key Disable  */

			29 00 00 00 00 00 02 35 00			/* TE Vsync ON */

			29 00 00 00 00 00 03 F0 5A 5A		/* TEST KEY1 Enable */
			29 00 00 00 00 00 07 BD 11 01 02 16 02 16			/* TSP TE ON */
			29 00 00 00 00 00 05 C0 00 0F D8 D8	/* Pentile setting */

			29 00 00 00 00 00 03 FC 5A 5A		/* TEST2 KEY enable */
			29 00 00 00 00 00 02 B0 20
			29 00 00 00 00 00 02 FE 08			/* POC setting*/
			29 00 00 00 00 00 03 FC A5 A5		/* TEST2 KEY Disable */

			29 00 00 00 00 00 02 ED 44			/* ERR_FG setting */

			29 00 00 00 00 00 05 2A 00 00 05 FF			/* Column address set*/
			29 00 00 00 00 00 05 2B 00 00 07 FF			/* Row address set*/

			29 00 00 00 00 00 24				/* Brightness condition set */
				CA
				01 00 01 00 01 00
				80 80 80
				80 80 80
				80 80 80
				80 80 80
				80 80 80
				80 80 80
				80 80 80
				80 80 80
				00 00 00
				00 00

			29 00 00 00 00 00 03 B2 0A 00		/* A0R 0% */
			29 00 00 00 00 00 03 B6 9C 0D		/* ELVSS Setting:CAPS ON : acl off */
			29 00 00 00 00 00 03 F4 AB 21		/* VINT set */
			29 00 00 00 00 00 02 B5 40			/* CAPS ON : 16 frame avg. at acl off */
			29 00 00 00 00 00 02 55 00			/* acl off */

			29 01 00 00 01 00 02 F7 03			/* Gamma, LTPS(AID) update wait more 100ns */
			29 00 00 00 00 00 02 F7 00

			29 01 00 00 00 00 03 F0 A5 A5		/* TEST KEY key Disable  */
		];

		qcom,mdss-dsi-off-command=[
			05 01 00 00 00 00 02 28 00
			05 01 00 00 78 00 02 10 00	/* wait 120ms(0x78) */
		];

/*		qcom,cont-splash-enabled;*/
		qcom,dcs-cmd-by-left;
		/*qcom,cmd-sync-wait-broadcast;*/
		/*qcom,cmd-sync-wait-trigger;*/
		/*qcom,mdss-dsi-fbc-enable=*/
		/*qcom,mdss-dsi-fbc-bpp=*/
		/*qcom,mdss-dsi-fbc-packing=*/
		/*qcom,mdss-dsi-fbc-quant-error=*/
		/*qcom,mdss-dsi-fbc-bias=*/
		/*qcom,mdss-dsi-fbc-pat-mode=*/
		/*qcom,mdss-dsi-fbc-vlc-mode=*/
		/*qcom,mdss-dsi-fbc-bflc-mode=*/
		/*qcom,mdss-dsi-fbc-h-line-budget=*/
		/*qcom,mdss-dsi-fbc-budget-ctrl=*/
		/*qcom,mdss-dsi-fbc-block-budget=*/
		/*qcom,mdss-dsi-fbc-lossless-threshold=*/
		/*qcom,mdss-dsi-fbc-lossy-threshold=*/
		/*qcom,mdss-dsi-fbc-rgb-threshold=*/
		/*qcom,mdss-dsi-fbc-lossy-mode-idx=*/

		qcom,mdss-dsi-h-back-porch = <108>;
		qcom,mdss-dsi-h-front-porch = <212>;
		qcom,mdss-dsi-h-pulse-width = <16>;
		qcom,mdss-dsi-h-sync-skew = <0>;
		qcom,mdss-dsi-v-back-porch = <5>;
		qcom,mdss-dsi-v-front-porch = <11>;
		qcom,mdss-dsi-v-pulse-width = <2>;

		qcom,mdss-dsi-h-left-border = <0>;
		qcom,mdss-dsi-h-right-border = <0>;
		qcom,mdss-dsi-v-top-border = <0>;
		qcom,mdss-dsi-v-bottom-border = <0>;

		qcom,mdss-dsi-underflow-color = <0xFF>;
		qcom,mdss-dsi-border-color = <0>;

		/*qcom,mdss-dsi-pan-enable-dynamic-fps=*/
		/*qcom,mdss-dsi-pan-fps-update=*/

		qcom,mdss-dsi-bl-pmic-control-type = "bl_ctrl_dcs";
		/*qcom,mdss-dsi-bl-pmic-bank-select=*/
		/*qcom,mdss-dsi-bl-pmic-pwm-frequency=*/
		/*qcom,mdss-dsi-pwm-gpio=*/

		qcom,mdss-dsi-bl-min-level = <1>;
		qcom,mdss-dsi-bl-max-level = <354>;
		qcom,mdss-brightness-max-level = <354>;
		qcom,mdss-dsi-interleave-mode = <0>;
		qcom,mdss-dsi-panel-type = "dsi_cmd_mode";

		/*qcom,mdss-dsi-te-check-enable; */
		qcom,mdss-dsi-te-using-te-pin;
		qcom,mdss-dsi-te-pin-select = <1>;

		qcom,mdss-dsi-te-dcs-command = <1>;
		qcom,mdss-dsi-wr-mem-start = <0x2C>;
		qcom,mdss-dsi-wr-mem-continue = <0x3C>;

		/* CMD mode panel doesn't need below stuff */
		/*qcom,mdss-dsi-h-sync-pulse=*/
		/*qcom,mdss-dsi-hfp-power-mode=*/
		/*qcom,mdss-dsi-hbp-power-mode=*/
		/*qcom,mdss-dsi-hsa-power-mode=*/
		/*qcom,mdss-dsi-last-line-interleave=*/
		/*qcom,mdss-dsi-bllp-eof-power-mode=*/
		/*qcom,mdss-dsi-bllp-power-mode=*/
		/*qcom,mdss-dsi-traffic-mode=*/

		qcom,mdss-dsi-pixel-packing = "loose";

		qcom,mdss-dsi-virtual-channel-id = <0>;
		qcom,mdss-dsi-color-order = "rgb_swap_rgb";
		qcom,mdss-dsi-lane-0-state;
		qcom,mdss-dsi-lane-1-state;
		qcom,mdss-dsi-lane-2-state;
		qcom,mdss-dsi-lane-3-state;
		qcom,mdss-dsi-lane-map = "lane_map_0123";

		qcom,mdss-dsi-t-clk-pre = <0x2E>;
		qcom,mdss-dsi-t-clk-post = <0x02>;

		qcom,mdss-dsi-stream = <0>;
		qcom,mdss-dsi-mdp-trigger = "none";
		qcom,mdss-dsi-dma-trigger = "trigger_sw";
		qcom,mdss-dsi-panel-framerate = <60>;
		/*qcom,mdss-dsi-panel-clockrate = <980500000>;*/
		qcom,mdss-dsi-on-command-state = "dsi_lp_mode";
		qcom,mdss-dsi-off-command-state = "dsi_hs_mode";

		qcom,mdss-pan-physical-width-dimension = <122>;
		qcom,mdss-pan-physical-height-dimension = <163>;

		qcom,mdss-dsi-panel-mode-gpio-state = "invalid";

		/*qcom,mdss-tear-check-disable*/
		/*qcom,mdss-tear-check-sync-cfg-height = <2576>;*/
		/*qcom,mdss-tear-check-sync-init-val=*/
		/*qcom,mdss-tear-check-sync-threshold-start=*/
		/*qcom,mdss-tear-check-sync-threshold-continue=*/
		/*qcom,mdss-tear-check-start-pos=*/
		/*qcom,mdss-tear-check-rd-ptr-trigger-intr=*/
		/*qcom,mdss-tear-check-frame-rate=*/

		qcom,mdss-dsi-reset-sequence = <1 5>, <0 5>, <1 5>;
/*		qcom,partial-update-enabled;*/
/*		qcom,partial-update-roi-merge;*/
/*		qcom,panel-roi-alignment=<8 8 1 1 1 2>;*/
		/*qcom,mdss-dsi-horizontal-line-idle*/

		qcom,mdss-dsi-lp11-init;
		qcom,mdss-dsi-init-delay-us = <1000>;

		qcom,mdss-dsi-rx-eot-ignore;
		qcom,mdss-dsi-tx-eot-append;

		/*qcom,ulps-enabled;*/
		/*qcom,suspend-ulps-enabled;*/
		/*qcom,esd-check-enabled*/
		/*qcom,mdss-dsi-panel-status-command=*/
		/*qcom,mdss-dsi-panel-status-command-mode="dsi_lp_mode";*/
		/*qcom,mdss-dsi-panel-status-check-mode="reg_read";*/
		/*qcom,mdss-dsi-panel-status-value=<1>;*/
		/*qcom,dynamic-mode-switch-enabled*/
		/*qcom,video-to-cmd-mode-switch-commands=*/
		/*qcom,cmd-to-video-mode-switch-commands=*/

/*
* ************************************************************************************************************************************
*
*
*			Below  parameters are samsung dependent thigs
*
*
* ************************************************************************************************************************************
*/
		samsung,mdss-power-on-reset-delay-us = <10000>;
		samsung,enter_hbm_lux = <10000>;
		samsung,support_panel_max = <1>;
		samsung,hw-config = "split_dsi";
		samsung,dsi-lp11-init;

		/*
		 * ************************************************************************************************************************
		 *   APLPM
		 * ************************************************************************************************************************
		 */
		samsung,alpm_on_tx_cmds_revA = [
			29 01 00 00 00 00 03 F0 5A 5A		/* TEST KEY Enable */
			05 01 00 00 14 00 02 28 00			/* display off wait 20ms */

			29 01 00 00 14 00 02 53 23			/* alpm on wait 20ms */

			29 01 00 00 01 00 02 F7 03		/* Gamma, LTPS(AID) update */
			29 01 00 00 00 00 02 F7 00
			29 01 00 00 00 00 03 F0 A5 A5
		];
		samsung,alpm_off_tx_cmds_revA = [
			29 01 00 00 00 00 03 F0 5A 5A		/* TEST KEY Disable */
			05 01 00 00 14 00 02 28 00			/* display off wait 20ms */

			/* image write for normal mode */

			29 01 00 00 14 00 02 53 00			/* alpm off */
			29 01 00 00 01 00 02 F7 03		/* Gamma, LTPS(AID) update */
			29 01 00 00 00 00 02 F7 00
			29 01 00 00 00 00 03 F0 A5 A5
		];

		/*
		the last byte in read commands	represent READ LENGH,
		like below  READ LENGH = 0x21
		*/
		samsung,level1_key_enable_tx_cmds_revA = [
			29 01 00 00 00 00 03 F0 5A 5A
		];
		samsung,level1_key_disable_tx_cmds_revA = [
			29 01 00 00 00 00 03 F0 A5 A5
		];
		samsung,level2_key_enable_tx_cmds_revA = [
			29 01 00 00 00 00 03 F2 5A 5A
		];
		samsung,level2_key_disable_tx_cmds_revA = [
			29 01 00 00 00 00 03 F2 A5 A5
		];

		samsung,packet_size_tx_cmds_revA = [
			37 01 00 00 00 00 02 07 00
		];

		samsung,reg_read_pos_tx_cmds_revA = [
			15 01 00 00 00 00 02 B0 00
		];

		samsung,smart_dimming_mtp_rx_cmds_revA = [ 06 01 00 00 00 00 01 c8 23 00];
		samsung,hbm_rx_cmds_revA = [ 06 01 00 00 00 00 01 c8 07 21];	/* read C8 34~40th , 33=0x21*/ /*not needed :joann*/
		samsung,hbm2_rx_cmds_revA = [ 06 01 00 00 00 00 01 c8 0F 48];	/* read C8 73~87th , 72=0x48*//*not needed :joann*/
		samsung,mdnie_read_rx_cmds_revA = [ 06 01 00 00 00 00 01 A1 04 00];
		samsung,elvss_rx_cmds_revA = [ 06 01 00 00 00 00 01 b6 01 15];	/* read C6 22th , 21=0x15*/

		/* the last byte in all read commands will represent READ LENGH */
		samsung,manufacture_read_pre_tx_cmds_revA = [
			05 01 00 00 05 00 01 11
			29 01 00 00 00 00 03 F0 5A 5A

			29 01 00 00 78 00 02 F2 63	/* DUAL DSI */
		];

		samsung,manufacture_id0_rx_cmds_revA = [ 06 01 00 00 00 00 01 da 01 00];
		samsung,manufacture_id1_rx_cmds_revA = [ 06 01 00 00 00 00 01 db 01 00];
		samsung,manufacture_id2_rx_cmds_revA = [ 06 01 00 00 00 00 01 dc 01 00];

		samsung,manufacture_date_rx_cmds_revA = [ 06 01 00 00 00 00 01 c8 04 28];	/* read C8 41~44th , 40=0x28*/

		samsung,ddi_id_rx_cmds_revA = [ 06 01 00 00 00 00 01 d6 05 00]; /* read D6 1~5th */

		samsung,ldi_fps_change_tx_cmds_revA = [
			29 00 00 00 00 00 03 F0 5A 5A
			29 00 00 00 00 00 03 FC 5A 5A
			29 00 00 00 00 00 04 F2 63 41 C5	/* C5 => hsync timing: 453*/
			29 00 00 00 00 00 03 F0 A5 A5
			29 01 00 00 00 00 03 FC A5 A5
		];

		samsung,ldi_fps_rx_cmds_revA = [06 01 00 00 00 00 01 D7 01 1A]; /* read D7 27th , 27=0x1B*/

		samsung,mtp_read_sysfs_rx_cmds_revA = [ 06 01 00 00 00 00 01 00 00 00];

		samsung,display_on_tx_cmds_revA = [05 01 00 00 32 00 02 29 00];
		samsung,display_off_tx_cmds_revA = [05 01 00 00 32 00 02 28 00];

		samsung,elvss_lowtemp_tx_cmds_revA = [
			29 01 00 00 00 00 02 B0 07
			29 01 00 00 00 00 02 B8 00
		];	/* Low Temperature Command */

		samsung,elvss_lowtemp2_tx_cmds_revA = [
			29 01 00 00 00 00 02 B0 15
			29 01 00 00 00 00 02 B6 00
		];	/* Low Temperature Command: default */

		samsung,gamma_tx_cmds_revA = [
			29 01 00 00 00 00 24		/* Brightness Condition Set - Gamma 2.2 Setting*/
			CA 01 00 01 00 01 00 80
			80 80 80 80 80 80 80 80
			80 80 80 80 80 80 80 80
			80 80 80 80 80 80 80 00
			00 00 00 00
			29 01 00 00 00 00 02 F7 03		/* Gamma, LTPS(AID) update */

			29 01 00 00 00 00 3C		/* dummy for single transmission more 100ns delay */
			00 00 00 00 00 00 00 00 00 00
			00 00 00 00 00 00 00 00 00 00
			00 00 00 00 00 00 00 00 00 00
			00 00 00 00 00 00 00 00 00 00
			00 00 00 00 00 00 00 00 00 00
			00 00 00 00 00 00 00 00 00 00

			29 01 00 00 00 00 02 F7 00
		];

		samsung,hbm_gamma_tx_cmds_revA = [
			29 01 00 00 00 00 24		/* Brightness Condition Set - Gamma 2.2 Setting*/
			CA 01 00 01 00 01 00 80
			80 80 80 80 80 80 80 80
			80 80 80 80 80 80 80 80
			80 80 80 80 80 80 80 00
			00 00 00 00
		];

		samsung,hbm_etc_tx_cmds_revA = [
			29 01 00 00 00 00 03 B6 9C 0D		/* ELVSS Setting */
			15 01 00 00 00 00 02 B5 50		/* 32 frame avg.*/
			29 01 00 00 00 00 03 F4 AB 21		/* VINT set*/
			15 01 00 00 00 00 02 53 C0		/* HBM on*/
		];
		samsung,hbm_off_tx_cmds_revA = [
			15 01 00 00 00 00 02 53 00		/* HBM off*/
		];

		/*
		* ************************************************************************************************************************
		* AID command list and mappings
		* ************************************************************************************************************************
		*/
		samsung,aid_tx_cmds_revA = [
			29 01 00 00 00 00 03 B2 F3 70  /* 98.59% 2CD 0 */
			29 01 00 00 00 00 03 B2 E4 70  /* 97.87% 3CD 1 */
			29 01 00 00 00 00 03 B2 D5 70  /* 97.14% 4CD 2 */
			29 01 00 00 00 00 03 B2 C7 70  /* 96.46% 5CD 3 */
			29 01 00 00 00 00 03 B2 B7 70  /* 95.69% 6CD 4 */
			29 01 00 00 00 00 03 B2 A8 70  /* 94.96% 7CD 5 */
			29 01 00 00 00 00 03 B2 98 70  /* 94.19% 8CD 6 */
			29 01 00 00 00 00 03 B2 89 70  /* 93.46% 9CD 7 */
			29 01 00 00 00 00 03 B2 7A 70  /* 92.73% 10CD 8 */
			29 01 00 00 00 00 03 B2 6B 70  /* 92.01% 11CD 9 */
			29 01 00 00 00 00 03 B2 5A 70  /* 91.18% 12CD 10 */
			29 01 00 00 00 00 03 B2 4D 70  /* 90.55% 13CD 11 */
			29 01 00 00 00 00 03 B2 3C 70  /* 89.73% 14CD 12 */
			29 01 00 00 00 00 03 B2 2C 70  /* 88.95% 15CD 13 */
			29 01 00 00 00 00 03 B2 1D 70  /* 88.23% 16CD 14 */
			29 01 00 00 00 00 03 B2 0D 70  /* 87.45% 17CD 15 */
			29 01 00 00 00 00 03 B2 EE 60  /* 85.95% 19CD 16 */
			29 01 00 00 00 00 03 B2 DD 60  /* 85.13% 20CD 17 */
			29 01 00 00 00 00 03 B2 CD 60  /* 84.35% 21CD 18 */
			29 01 00 00 00 00 03 B2 BD 60  /* 83.58% 22CD 19 */
			29 01 00 00 00 00 03 B2 9C 60  /* 81.98% 24CD 20 */
			29 01 00 00 00 00 03 B2 8A 60  /* 81.10% 25CD 21 */
			29 01 00 00 00 00 03 B2 6A 60  /* 79.55% 27CD 22 */
			29 01 00 00 00 00 03 B2 48 60  /* 77.91% 29CD 23 */
			29 01 00 00 00 00 03 B2 38 60  /* 77.13% 30CD 24 */
			29 01 00 00 00 00 03 B2 16 60  /* 75.48% 32CD 25 */
			29 01 00 00 00 00 03 B2 F5 50  /* 73.89% 34CD 26 */
			29 01 00 00 00 00 03 B2 C0 50  /* 71.32% 37CD 27 */
			29 01 00 00 00 00 03 B2 9E 50  /* 69.67% 39CD 28 */
			29 01 00 00 00 00 03 B2 7A 50  /* 67.93% 41CD 29 */
			29 01 00 00 00 00 03 B2 47 50  /* 65.46% 44CD 30 */
			29 01 00 00 00 00 03 B2 0F 50  /* 62.74% 47CD 31 */
			29 01 00 00 00 00 03 B2 D6 40  /* 59.98% 50CD 32 */
			29 01 00 00 00 00 03 B2 A1 40  /* 57.41% 53CD 33 */
			29 01 00 00 00 00 03 B2 66 40  /* 54.55% 56CD 34 */
			29 01 00 00 00 00 03 B2 1A 40  /* 50.87% 60CD 35 */
			29 01 00 00 00 00 03 B2 D0 30  /* 47.29% 64CD 36 */
			29 01 00 00 00 00 03 B2 87 30  /* 43.75% 68CD 37 */
			29 01 00 00 00 00 03 B2 3D 30  /* 40.16% 72CD 38 */
			29 01 00 00 00 00 03 B2 DF 20  /* 35.61% 77CD 39 */
			29 01 00 00 00 00 03 B2 DF 20  /* 35.61% 82CD 40 */
			29 01 00 00 00 00 03 B2 DF 20  /* 35.61% 87CD 41 */
			29 01 00 00 00 00 03 B2 DF 20  /* 35.61% 93CD 42 */
			29 01 00 00 00 00 03 B2 DF 20  /* 35.61% 98CD 43 */
			29 01 00 00 00 00 03 B2 DF 20  /* 35.61% 105CD 44 */
			29 01 00 00 00 00 03 B2 DF 20  /* 35.61% 111CD 45 */
			29 01 00 00 00 00 03 B2 DF 20  /* 35.61% 119CD 46 */
			29 01 00 00 00 00 03 B2 DF 20  /* 35.61% 126CD 47 */
			29 01 00 00 00 00 03 B2 DF 20  /* 35.61% 134CD 48 */
			29 01 00 00 00 00 03 B2 DF 20  /* 35.61% 143CD 49 */
			29 01 00 00 00 00 03 B2 DF 20  /* 35.61% 152CD 50 */
			29 01 00 00 00 00 03 B2 DF 20  /* 35.61% 162CD 51 */
			29 01 00 00 00 00 03 B2 DF 20  /* 35.61% 172CD 52 */
			29 01 00 00 00 00 03 B2 DF 20  /* 35.61% 183CD 53 */
			29 01 00 00 00 00 03 B2 6E 20  /* 30.14% 195CD 54 */
			29 01 00 00 00 00 03 B2 FE 10  /* 24.71% 207CD 55 */
			29 01 00 00 00 00 03 B2 81 10  /* 18.65% 220CD 56 */
			29 01 00 00 00 00 03 B2 F6 00  /* 11.92% 234CD 57 */
			29 01 00 00 00 00 03 B2 67 00  /* 4.99% 249CD 58 */
			29 01 00 00 00 00 03 B2 67 00  /* 4.99% 265CD 59 */
			29 01 00 00 00 00 03 B2 67 00  /* 4.99% 282CD 60 */
			29 01 00 00 00 00 03 B2 67 00  /* 4.99% 300CD 61 */
			29 01 00 00 00 00 03 B2 67 00  /* 4.99% 316CD 62 */
			29 01 00 00 00 00 03 B2 67 00  /* 4.99% 333CD 63 */
			29 01 00 00 00 00 03 B2 67 00  /* 4.99% 360CD 64 */
		];

		/* bl_level, Index in acl command list */
		samsung,aid_map_table_revA = <
			2	0		3	1		4	2		5	3		6	4
			7	5		8	6		9	7		10	8		11	9
			12	10		13	11		14	12		15	13		16	14
			17	15		19	16		20	17		21	18		22	19
			24	20		25	21		27	22		29	23		30	24
			32	25		34	26		37	27		39	28		41	29
			44	30		47	31		50	32		53	33		56	34
			60	35		64	36		68	37		72	38		77	39
			82	40		87	41		93	42		98	43		105	44
			111	45		119	46		126	47		134	48		143	49
			152	50		162	51		172	52		183	53		195	54
			207	55		220	56		234	57		249	58		265	59
			282	60		300	61		316	62		333	63		360	64
		>;

		/*
		* ************************************************************************************************************************
		* ACL command list and mappings
		* ************************************************************************************************************************
		*/
		samsung,acl_on_tx_cmds_revA = [29 01 00 00 00 00 02 B5 50]; /* ACL on, B5 <- 0x51 */

		samsung,acl_percent_tx_cmds_revA = [
			29 01 00 00 00 00 02 55 00
			29 01 00 00 00 00 02 55 01
			29 01 00 00 00 00 02 55 02	/* default ACL 8% */
			29 01 00 00 00 00 02 55 03
		];	/* ACL 50% */

		samsung,acl_off_tx_cmds_revA = [
			29 01 00 00 00 00 02 B5 40   /* ACL OFF - 41 (16Frame Averaging) */
			29 01 00 00 00 00 02 55 00
		];/*off, b5<-0x41*/

		/* bl_level , Index in acl command list */
		samsung,acl_map_table_revA =  <
			2	2		3	2		4	2		5	2		6	2
			7	2		8	2		9	2		10	2		11	2
			12	2		13	2		14	2		15	2		16	2
			17	2		19	2		20	2		21	2		22	2
			24	2		25	2		27	2		29	2		30	2
			32	2		34	2		37	2		39	2		41	2
			44	2		47	2		50	2		53	2		56	2
			60	2		64	2		68	2		72	2		77	2
			82	2		87	2		93	2		98	2		105	2
			111	2		119	2		126	2		134	2		143	2
			152	2		162	2		172	2		183	2		195	2
			207	2		220	2		234	2		249	2		265	2
			282	2		300	2		316	2		333	2		360	2
		>;
		/*
		* ************************************************************************************************************************
		* ELVSS(ACL Off) command list and mappings
		* ************************************************************************************************************************
		*/
		samsung,elvss_tx_cmds_revA = [
			29 01 00 00 00 00 03 b6 9C  0D /* 360CD 0 */
			29 01 00 00 00 00 03 b6 9C  0E /* 333CD 1 */
			29 01 00 00 00 00 03 b6 9C  0F /* 316CD 2 */
			29 01 00 00 00 00 03 b6 9C  10 /* 282~300CD 3 */
			29 01 00 00 00 00 03 b6 9C  12 /* 265CD 4 */
			29 01 00 00 00 00 03 b6 9C  13 /* 234~249CD 5 */
			29 01 00 00 00 00 03 b6 9C  14 /* 183~220CD 6 */
			29 01 00 00 00 00 03 b6 9C  15 /* 172CD 7 */
			29 01 00 00 00 00 03 b6 9C  16 /* 162CD 8 */
			29 01 00 00 00 00 03 b6 9C  17 /* 143~152CD 9 */
			29 01 00 00 00 00 03 b6 9C  18 /* 126~134CD 10 */
			29 01 00 00 00 00 03 b6 9C  19 /* 60~119CD 11 */
			29 01 00 00 00 00 03 b6 9C  18 /* 56CD 12 */
			29 01 00 00 00 00 03 b6 9C  17 /* 50~53CD 13 */
			29 01 00 00 00 00 03 b6 9C  16 /* 47CD 14 */
			29 01 00 00 00 00 03 b6 9C  15 /* 41~44CD 15 */
			29 01 00 00 00 00 03 b6 9C  14 /* 37~39CD 16 */
			29 01 00 00 00 00 03 b6 9C  13 /* 30~34CD 17 */
			29 01 00 00 00 00 03 b6 9C  12 /* 25~29CD 18 */
			29 01 00 00 00 00 03 b6 9C  11 /* 20~24CD 19 */
			29 01 00 00 00 00 03 b6 9C  10 /* 15~19CD 20 */
			29 01 00 00 00 00 03 b6 9C  0F /* 10~14CD 21 */
			29 01 00 00 00 00 03 b6 9C  0E /* 5~9CD 22 */
			29 01 00 00 00 00 03 b6 9C  0D /* 2~4CD 23 */
		];

		/*
		* ************************************************************************************************************************
		* SMART ACL(ACL On) ELVSS command list and mappings
		* ************************************************************************************************************************
		*/

		/* 0xB6 address second parameter value*/
		samsung,smart_acl_elvss_tx_cmds_revA = [
			29 01 00 00 00 00 03 b6 9C  0D /* 360CD 0 */
			29 01 00 00 00 00 03 b6 9C  0E /* 333CD 1 */
			29 01 00 00 00 00 03 b6 9C  0F /* 316CD 2 */
			29 01 00 00 00 00 03 b6 9C  10 /* 282~300CD 3 */
			29 01 00 00 00 00 03 b6 9C  12 /* 265CD 4 */
			29 01 00 00 00 00 03 b6 9C  13 /* 234~249CD 5 */
			29 01 00 00 00 00 03 b6 9C  14 /* 183~220CD 6 */
			29 01 00 00 00 00 03 b6 9C  15 /* 172CD 7 */
			29 01 00 00 00 00 03 b6 9C  16 /* 162CD 8 */
			29 01 00 00 00 00 03 b6 9C  17 /* 143~152CD 9 */
			29 01 00 00 00 00 03 b6 9C  18 /* 126~134CD 10 */
			29 01 00 00 00 00 03 b6 9C  19 /* 60~119CD 11 */
			29 01 00 00 00 00 03 b6 9C  18 /* 56CD 12 */
			29 01 00 00 00 00 03 b6 9C  17 /* 50~53CD 13 */
			29 01 00 00 00 00 03 b6 9C  16 /* 47CD 14 */
			29 01 00 00 00 00 03 b6 9C  15 /* 41~44CD 15 */
			29 01 00 00 00 00 03 b6 8C  14 /* 37~39CD 16 */
			29 01 00 00 00 00 03 b6 8C  13 /* 30~34CD 17 */
			29 01 00 00 00 00 03 b6 8C  12 /* 25~29CD 18 */
			29 01 00 00 00 00 03 b6 8C  11 /* 20~24CD 19 */
			29 01 00 00 00 00 03 b6 8C  10 /* 15~19CD 20 */
			29 01 00 00 00 00 03 b6 8C  0F /* 10~14CD 21 */
			29 01 00 00 00 00 03 b6 8C  0E /* 5~9CD 22 */
			29 01 00 00 00 00 03 b6 8C  0D /* 2~4CD 23 */
		];

		/* bl_level, Index in elvss command list */
		samsung,smart_acl_elvss_map_table_revA = <
			2	23		3	23		4	23		5	22		6	22
			7	22		8	22		9	22		10	21		11	21
			12	21		13	21		14	21		15	20		16	20
			17	20		19	20		20	19		21	19		22	19
			24	19		25	18		27	18		29	18		30	17
			32	17		34	17		37	16		39	16		41	15
			44	15		47	14		50	13		53	13		56	12
			60	11		64	11		68	11		72	11		77	11
			82	11		87	11		93	11		98	11		105	11
			111	11		119	11		126	10		134	10		143	9
			152	9		162	8		172	7		183	6		195	6
			207	6		220	6		234	5		249	5		265	4
			282	3		300	3		316	2		333	1		360	0
		>;
		/*
		* ************************************************************************************************************************
		* candela to index mappings
		* ************************************************************************************************************************
		*/
		samsung,candela_map_table_revA = <
		/*<idx>   <from>  <till> <candella> */
			0	1	2	2
			1	3	3	3
			2	4	4	4
			3	5	5	5
			4	6	6	6
			5	7	7	7
			6	8	8	8
			7	9	9	9
			8	10	10	10
			9	11	11	11
			10	12	12	12
			11	13	13	13
			12	14	14	14
			13	15	15	15
			14	16	16	16
			15	17	17	17
			16	18	18	19
			17	19	19	20
			18	20	20	21
			19	21	21	22
			20	22	22	24
			21	23	23	25
			22	24	24	27
			23	25	25	29
			24	26	26	30
			25	27	27	32
			26	28	28	34
			27	29	29	37
			28	30	30	39
			29	31	32	41
			30	33	34	44
			31	35	36	47
			32	37	38	50
			33	39	40	53
			34	41	42	56
			35	43	45	60
			36	46	48	64
			37	49	51	68
			38	52	54	72
			39	55	57	77
			40	58	60	82
			41	61	64	87
			42	65	68	93
			43	69	72	98
			44	73	77	105
			45	78	81	111
			46	82	87	119
			47	88	92	126
			48	93	98	134
			49	99	105	143
			50	106	111	152
			51	112	119	162
			52	120	126	172
			53	127	134	183
			54	135	143	195
			55	144	151	207
			56	152	161	220
			57	162	171	234
			58	172	182	249
			59	183	194	265
			60	195	206	282
			61	207	220	300
			62	221	231	316
			63	232	243	333
			64	244	255	360
		>;

		/* HMT */

		/*samsung,hmt_enabled;*/

		samsung,hmt_aid_tx_cmds_revA = [
			29 01 00 00 00 00 07 B2 03 12 03 00 00 00	/* 20cd */
			29 01 00 00 00 00 07 B2 03 12 03 00 00 00	/* 21cd */
			29 01 00 00 00 00 07 B2 03 12 03 00 00 00	/* 22cd */
			29 01 00 00 00 00 07 B2 03 12 03 00 00 00	/* 23cd */
			29 01 00 00 00 00 07 B2 03 12 03 00 00 00	/* 25cd */
			29 01 00 00 00 00 07 B2 03 12 03 00 00 00	/* 27cd */
			29 01 00 00 00 00 07 B2 03 12 03 00 00 00	/* 29cd */
			29 01 00 00 00 00 07 B2 03 12 03 00 00 00	/* 31cd */
			29 01 00 00 00 00 07 B2 03 12 03 00 00 00	/* 33cd */
			29 01 00 00 00 00 07 B2 03 12 03 00 00 00	/* 35cd */
			29 01 00 00 00 00 07 B2 03 12 03 00 00 00	/* 37cd */
			29 01 00 00 00 00 07 B2 03 12 03 00 00 00	/* 39cd */
			29 01 00 00 00 00 07 B2 03 12 03 00 00 00	/* 41cd */
			29 01 00 00 00 00 07 B2 03 12 03 00 00 00	/* 44cd */
			29 01 00 00 00 00 07 B2 03 12 03 00 00 00	/* 47cd */
			29 01 00 00 00 00 07 B2 03 12 03 00 00 00	/* 50cd */
			29 01 00 00 00 00 07 B2 03 12 03 00 00 00	/* 53cd */
			29 01 00 00 00 00 07 B2 03 12 03 00 00 00	/* 56cd */
			29 01 00 00 00 00 07 B2 03 12 03 00 00 00	/* 60cd */
			29 01 00 00 00 00 07 B2 03 12 03 00 00 00	/* 64cd */
			29 01 00 00 00 00 07 B2 03 12 03 00 00 00	/* 68cd */
			29 01 00 00 00 00 07 B2 03 12 03 00 00 00	/* 72cd */
			29 01 00 00 00 00 07 B2 03 13 04 00 00 00	/* 77cd */
			29 01 00 00 00 00 07 B2 03 13 04 00 00 00	/* 82cd */
			29 01 00 00 00 00 07 B2 03 13 04 00 00 00	/* 87cd */
			29 01 00 00 00 00 07 B2 03 13 04 00 00 00	/* 93cd */
			29 01 00 00 00 00 07 B2 03 13 04 00 00 00	/* 99cd */
			29 01 00 00 00 00 07 B2 03 13 04 00 00 00	/* 105cd */
		];

		/* bl_level, Index in acl command list */
		samsung,hmt_reverse_aid_map_table_revA = <
			20 0
			21 1
			22 2
			23 3
			25 4
			27 5
			29 6
			31 7
			33 8
			35 9
			37 10
			39 11
			41 12
			44 13
			47 14
			50 15
			53 16
			56 17
			60 18
			64 19
			68 20
			72 21
			77 22
			82 23
			87 24
			93 25
			99 26
			105 27
		>;

		samsung,hmt_candela_map_table_revA = <
		/*<idx>   <from>  <till> <candella> */
			0	0	9	20
			1	10	19	21
			2	20	29	22
			3	30	39	23
			4	40	49	25
			5	50	59	27
			6	60	68	29
			7	69	77	31
			8	78	86	33
			9	87	95	35
			10	96	104	37
			11	105	113	39
			12	114	122	41
			13	123	131	44
			14	132	140	47
			15	141	149	50
			16	150	158	53
			17	159	167	56
			18	168	176	60
			19	177	185	64
			20	186	194	68
			21	195	203	72
			22	204	212	77
			23	213	221	82
			24	222	230	87
			25	231	239	93
			26	240	248	99
			27	249	255	105
		>;

		samsung,hmt_150cd_rx_cmds_revA = [06 01 00 00 00 00 01 B4 1E 01];	/* read B4 2~31th , 1=0x01*/

		samsung,hmt_gamma_tx_cmds_revA = [
			29 01 00 00 00 00 24
				CA 01 00 01 00 01 00 80
				80 80 80 80 80 80 80 80
				80 80 80 80 80 80 80 80
				80 80 80 80 80 80 80 00
				00 00 00 00
			29 01 00 00 00 00 02 F7 03		/* Gamma, LTPS(AID) update */

			29 01 00 00 00 00 3C		/* dummy for single transmission more 100ns delay */
			00 00 00 00 00 00 00 00 00 00
			00 00 00 00 00 00 00 00 00 00
			00 00 00 00 00 00 00 00 00 00
			00 00 00 00 00 00 00 00 00 00
			00 00 00 00 00 00 00 00 00 00
			00 00 00 00 00 00 00 00 00 00

			29 01 00 00 00 00 02 F7 00
		];

		samsung,hmt_elvss_tx_cmds_revA = [
				29 01 00 00 00 00 03 B6 00 0A
		];

		samsung,hmt_vint_tx_cmds_revA = [
				29 01 00 00 00 00 03 F4 8B 21
		];

		samsung,hmt_enable_tx_cmds_revA = [
				29 01 00 00 00 00 03 F0 5A 5A
				29 01 00 00 00 00 02 B0 03
				29 01 00 00 00 00 03 F2 0A 06
				29 01 00 00 00 00 02 B0 05
				29 01 00 00 00 00 02 B2 00
				29 01 00 00 00 00 02 B0 06
				29 01 00 00 00 00 02 F3 10
				29 01 00 00 00 00 05 2B 00 00 09 FF
				29 01 00 00 00 00 03 F0 A5 A5
			];

		samsung,hmt_disable_tx_cmds_revA = [
				29 01 00 00 00 00 03 F0 5A 5A
				29 01 00 00 00 00 02 B0 03
				29 01 00 00 00 00 03 F2 06 0A
				29 01 00 00 00 00 02 B0 05
				29 01 00 00 00 00 02 B2 40
				29 01 00 00 00 00 02 F7 03

				29 01 00 00 00 00 3C		/* dummy for single transmission more 100ns delay */
				00 00 00 00 00 00 00 00 00 00
				00 00 00 00 00 00 00 00 00 00
				00 00 00 00 00 00 00 00 00 00
				00 00 00 00 00 00 00 00 00 00
				00 00 00 00 00 00 00 00 00 00
				00 00 00 00 00 00 00 00 00 00

				29 01 00 00 00 00 02 F7 00
				29 01 00 00 00 00 03 F0 A5 A5
			];
		samsung,hmt_reverse_enable_tx_cmds_revA = [
				29 01 00 00 00 00 03 F0 5A 5A
				29 01 00 00 00 00 02 B0 09
				29 01 00 00 00 00 02 CB 0B
				29 01 00 00 00 00 02 B0 0F
				29 01 00 00 00 00 02 CB 09
				29 01 00 00 00 00 02 B0 1D
				29 01 00 00 00 00 02 CB 10
				29 01 00 00 00 00 02 B0 3D
				29 01 00 00 00 00 02 CB 0C
				29 01 00 00 00 00 02 F7 03

				29 01 00 00 00 00 3C		/* dummy for single transmission more 100ns delay */
				00 00 00 00 00 00 00 00 00 00
				00 00 00 00 00 00 00 00 00 00
				00 00 00 00 00 00 00 00 00 00
				00 00 00 00 00 00 00 00 00 00
				00 00 00 00 00 00 00 00 00 00
				00 00 00 00 00 00 00 00 00 00

				29 01 00 00 00 00 02 F7 00
				29 01 00 00 00 00 03 F0 A5 A5
			];
		samsung,hmt_reverse_disable_tx_cmds_revA = [
				29 01 00 00 00 00 03 F0 5A 5A
				29 01 00 00 00 00 02 B0 09
				29 01 00 00 00 00 02 CB 09
				29 01 00 00 00 00 02 B0 0F
				29 01 00 00 00 00 02 CB 05
				29 01 00 00 00 00 02 B0 3D
				29 01 00 00 00 00 02 CB 0B
				29 01 00 00 00 00 02 F7 03

				29 01 00 00 00 00 3C		/* dummy for single transmission more 100ns delay */
				00 00 00 00 00 00 00 00 00 00
				00 00 00 00 00 00 00 00 00 00
				00 00 00 00 00 00 00 00 00 00
				00 00 00 00 00 00 00 00 00 00
				00 00 00 00 00 00 00 00 00 00
				00 00 00 00 00 00 00 00 00 00

				29 01 00 00 00 00 02 F7 00
				29 01 00 00 00 00 03 F0 A5 A5
			];
		samsung,hbm_candela_map_table_revA = <
			0	354	354	500	6
		>;
	};
};
