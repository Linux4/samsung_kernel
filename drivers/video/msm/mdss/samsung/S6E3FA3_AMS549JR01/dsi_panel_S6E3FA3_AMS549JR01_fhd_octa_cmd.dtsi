/* Copyright (c) 2013-2014, The Linux Foundation. All rights reserved.
 *
 * This program is free software; you can redistribute it and/or modify
 * it under the terms of the GNU General Public License version 2 and
 * only version 2 as published by the Free Software Foundation.
 *
 * This program is distributed in the hope that it will be useful,
 * but WITHOUT ANY WARRANTY; without even the implied warranty of
 * MERCHANTABILITY or FITNESS FOR A PARTICULAR PURPOSE.  See the
 * GNU General Public License for more details.
 */

/*---------------------------------------------------------------------------
 * This file is autogenerated file using gcdb parser. Please do not edit it.
 * Update input XML file to add a new entry or update variable in this file
 * VERSION = "1.0"
 *---------------------------------------------------------------------------*/
&mdss_mdp {
	dsi_samsung_fhd: ss_dsi_panel_S6E3FA3_AMS549JR01_FHD {
		qcom,mdss-dsi-panel-name = "ss_dsi_panel_S6E3FA3_AMS549JR01_FHD";
		qcom,mdss-dsi-panel-controller = <&mdss_dsi0>;
		qcom,mdss-dsi-panel-width = <1080>;
		qcom,mdss-dsi-panel-height = <1920>;
		qcom,mdss-dsi-bpp = <24>;
		qcom,mdss-dsi-panel-destination = "display_1";

		qcom,mdss-dsi-panel-timings = [E6 38 26 00 68 6E 2A 46 2C 03 04 00];

		qcom,mdss-dsi-on-command= [
			05 01 00 00 14 00 02 11 00			/* Sleep out, wait 20ms(0x14) */

			/* TE Vsync On */
			29 01 00 00 00 00 02 35 00

			/* AVC setting */
			29 01 00 00 00 00 03 FC 5A 5A
			29 01 00 00 00 00 02 B0 1E
			29 01 00 00 00 00 02 FD 94
			29 01 00 00 00 00 03 FC A5 A5

			/* PCD Setting */
			29 01 00 00 00 00 03 FC 5A 5A
			29 01 00 00 00 00 02 CC 4C
			29 01 00 00 00 00 03 FC A5 A5

			/* ERR_FG Setting */
			29 01 00 00 00 00 03 FC 5A 5A
			29 01 00 00 00 00 02 ED 44
			29 01 00 00 00 00 03 FC A5 A5

			/* Brightness condition set */
			29 01 00 00 00 00 03 F0 5A 5A
			29 01 00 00 00 00 24 CA
				01 00 01 00 01 00
				80 80 80
				80 80 80
				80 80 80
				80 80 80
				80 80 80
				80 80 80
				80 80 80
				80 80 80
				00 00 00
				00 00
			29 01 00 00 00 00 03 B2 00 10		/* AID set : AOR 0% */
			29 01 00 00 00 00 03 B6 BC 04		/* CAPS & ELVSS Set */
			29 01 00 00 00 00 02 F7 03		/* Gamma, LTPS(AID) update */
			29 01 00 00 00 00 02 F7 00		/* Gamma, LTPS(AID) Disable */
			29 01 00 00 50 00 03 F0 A5 A5		/* TEST KEY Disable */

			/* Memory Access */
			05 01 00 00 00 00 02 2C 00
			05 01 00 00 00 00 02 3C 00
		];

		qcom,mdss-dsi-off-command=[
			05 01 00 00 0A 00 02 28 00	/* wait 10ms(0x0A) */
			05 01 00 00 96 00 02 10 00	/* wait 150ms(0x96) */
		];

		qcom,cont-splash-enabled;
		qcom,mdss-dsi-force-clk-lane-hs;
		/*qcom,cmd-sync-wait-broadcast;*/
		/*qcom,cmd-sync-wait-trigger;*/
		/*qcom,mdss-dsi-fbc-enable=*/
		/*qcom,mdss-dsi-fbc-bpp=*/
		/*qcom,mdss-dsi-fbc-packing=*/
		/*qcom,mdss-dsi-fbc-quant-error=*/
		/*qcom,mdss-dsi-fbc-bias=*/
		/*qcom,mdss-dsi-fbc-pat-mode=*/
		/*qcom,mdss-dsi-fbc-vlc-mode=*/
		/*qcom,mdss-dsi-fbc-bflc-mode=*/
		/*qcom,mdss-dsi-fbc-h-line-budget=*/
		/*qcom,mdss-dsi-fbc-budget-ctrl=*/
		/*qcom,mdss-dsi-fbc-block-budget=*/
		/*qcom,mdss-dsi-fbc-lossless-threshold=*/
		/*qcom,mdss-dsi-fbc-lossy-threshold=*/
		/*qcom,mdss-dsi-fbc-rgb-threshold=*/
		/*qcom,mdss-dsi-fbc-lossy-mode-idx=*/

		qcom,mdss-dsi-h-back-porch = <36>;
		qcom,mdss-dsi-h-front-porch = <160>;
		qcom,mdss-dsi-h-pulse-width = <12>;
		qcom,mdss-dsi-h-sync-skew = <0>;
		qcom,mdss-dsi-v-back-porch = <7>;
		qcom,mdss-dsi-v-front-porch = <7>;
		qcom,mdss-dsi-v-pulse-width = <2>;

		qcom,mdss-dsi-h-left-border = <0>;
		qcom,mdss-dsi-h-right-border = <0>;
		qcom,mdss-dsi-v-top-border = <0>;
		qcom,mdss-dsi-v-bottom-border = <0>;

		qcom,mdss-dsi-underflow-color = <0xFF>;
		qcom,mdss-dsi-border-color = <0>;

		/*qcom,mdss-dsi-pan-enable-dynamic-fps=*/
		/*qcom,mdss-dsi-pan-fps-update=*/

		qcom,mdss-dsi-bl-pmic-control-type = "bl_ctrl_dcs";
		/*qcom,mdss-dsi-bl-pmic-bank-select=*/
		/*qcom,mdss-dsi-bl-pmic-pwm-frequency=*/
		/*qcom,mdss-dsi-pwm-gpio=*/

		qcom,mdss-dsi-bl-min-level = <0>;
		qcom,mdss-dsi-bl-max-level = <255>;
		qcom,mdss-brightness-max-level = <255>;
		qcom,mdss-dsi-interleave-mode = <0>;
		qcom,mdss-dsi-panel-type = "dsi_cmd_mode";

		qcom,mdss-dsi-te-check-enable;
		qcom,mdss-dsi-te-using-te-pin;
		qcom,mdss-dsi-te-pin-select = <1>;

		qcom,mdss-dsi-te-dcs-command = <1>;
		qcom,mdss-dsi-wr-mem-start = <0x2C>;
		qcom,mdss-dsi-wr-mem-continue = <0x3C>;

		/* CMD mode panel doesn't need below stuff */
		qcom,mdss-dsi-h-sync-pulse= <0>;
		/*qcom,mdss-dsi-hfp-power-mode=*/
		/*qcom,mdss-dsi-hbp-power-mode=*/
		/*qcom,mdss-dsi-hsa-power-mode=*/
		/*qcom,mdss-dsi-last-line-interleave=*/
		qcom,mdss-dsi-bllp-eof-power-mode;
		qcom,mdss-dsi-bllp-power-mode;
		qcom,mdss-dsi-traffic-mode= "burst_mode";

		qcom,mdss-dsi-pixel-packing = "loose";

		qcom,mdss-dsi-virtual-channel-id = <0>;
		qcom,mdss-dsi-color-order = "rgb_swap_rgb";
		qcom,mdss-dsi-lane-0-state;
		qcom,mdss-dsi-lane-1-state;
		qcom,mdss-dsi-lane-2-state;
		qcom,mdss-dsi-lane-3-state;
		qcom,mdss-dsi-lane-map = "lane_map_0123";

		qcom,mdss-dsi-t-clk-pre = <0x2B>;
		qcom,mdss-dsi-t-clk-post = <0x02>;

		qcom,mdss-dsi-stream = <0>;
		qcom,mdss-dsi-mdp-trigger = "none";
		qcom,mdss-dsi-dma-trigger = "trigger_sw";
		qcom,mdss-dsi-panel-framerate = <60>;
		qcom,mdss-dsi-panel-clockrate = <850000000>;
		qcom,mdss-dsi-on-command-state = "dsi_lp_mode";
		qcom,mdss-dsi-off-command-state = "dsi_hs_mode";

		qcom,mdss-pan-physical-width-dimension = <69>;
		qcom,mdss-pan-physical-height-dimension = <122>;

		qcom,mdss-dsi-panel-mode-gpio-state = "invalid";

		qcom,mdss-dsi-reset-sequence = <1 20>, <0 20>, <1 20>;

		/* S6E3FA3(LDI) Does not support Partial Update */
		/*qcom,partial-update-enabled;*/
		/*qcom,panel-roi-alignment=<8 8 1 1 1 1>;*/
		/*qcom,mdss-dsi-horizontal-line-idle*/

		qcom,mdss-dsi-lp11-init;
		qcom,mdss-dsi-init-delay-us = <1000>;

		qcom,mdss-dsi-rx-eot-ignore;
		qcom,mdss-dsi-tx-eot-append;

		/*qcom,ulps-enabled*/
		/*qcom,mdss-dsi-panel-status-command=*/
		/*qcom,mdss-dsi-panel-status-command-mode="dsi_lp_mode";*/
		/*qcom,esd-check-enabled;*/
		qcom,mdss-dsi-panel-status-check-mode="reg_read_irq";
		qcom,mdss-dsi-panel-status-value = <1>;
		qcom,mdss-dsi-panel-status-irq-trigger="rising";
		/*qcom,dynamic-mode-switch-enabled*/
		/*qcom,video-to-cmd-mode-switch-commands=*/
		/*qcom,cmd-to-video-mode-switch-commands=*/
/*
 * ************************************************************************************************************************************
 *
 *
 *			Below  parameters are samsung dependent thigs
 *
 *
 * ************************************************************************************************************************************
 */
		samsung,dsi-lp11-init;

		samsung,display_on_tx_cmds_revA = [05 01 00 00 32 00 02 29 00];
		samsung,display_off_tx_cmds_revA = [05 01 00 00 32 00 02 28 00];

		samsung,level1_key_enable_tx_cmds_revA = [
			29 01 00 00 00 00 03 F0 5A 5A
		];
		samsung,level1_key_disable_tx_cmds_revA = [
			29 01 00 00 00 00 03 F0 A5 A5
		];
		samsung,level2_key_enable_tx_cmds_revA = [
			29 00 00 00 00 00 03 F0 5A 5A
			29 01 00 00 00 00 03 FC 5A 5A
		];
		samsung,level2_key_disable_tx_cmds_revA = [
			29 00 00 00 00 00 03 F0 A5 A5
			29 01 00 00 00 00 03 FC A5 A5
		];

		samsung,packet_size_tx_cmds_revA = [
			37 01 00 00 00 00 02 07 00
		];

		/*
		 * First parameters can be changed
		 * by function of samsung_nv_read()
		 * because of that means offset of
		 * read position
		 */
		samsung,reg_read_pos_tx_cmds_revA = [
			15 01 00 00 00 00 02 B0 00
		];

		/*
		 * ************************************************************************************************************************
		 *	 06 01 00 00 00 00 01 c8 07 21
		 *	READ 0xC8 SIZE 0x07 OFFSET 0x21
		 * ************************************************************************************************************************
		 */
		samsung,smart_dimming_mtp_rx_cmds_revA = [ 06 01 00 00 00 00 01 c8 23 00];
		/* the last byte in all read commands will represent READ LENGH */
		samsung,manufacture_id0_rx_cmds_revA = [ 06 01 00 00 00 00 01 da 01 00];
		samsung,manufacture_id1_rx_cmds_revA = [ 06 01 00 00 00 00 01 db 01 00];
		samsung,manufacture_id2_rx_cmds_revA = [ 06 01 00 00 00 00 01 dc 01 00];

		samsung,manufacture_date_rx_cmds_revA = [ 06 01 00 00 00 00 01 c8 02 28];	/* read C8 41~42th , 40=0x28*/
		samsung,ddi_id_rx_cmds_revA = [ 06 01 00 00 00 00 01 d6 05 00];			/* read D6 1~5th */
		samsung,cell_id_rx_cmds_revA = [ 06 01 00 00 00 00 01 C8 0B 28];		/* read C8 41~51th, 40=0x28 */
		samsung,mtp_read_sysfs_rx_cmds_revA = [ 06 01 00 00 00 00 01 01 01 01];

		samsung,elvss_rx_cmds_revA = [ 06 01 00 00 00 00 01 b6 02 15];			/* read B6 22th , 21=0x15*/
		samsung,mdnie_read_rx_cmds_revA	= [ 06 01 00 00 00 00 01 A1 04 00];

		samsung,ldi_debug0_rx_cmds_revA = [06 01 00 00 00 00 01 0A 01 00];
		samsung,ldi_debug1_rx_cmds_revA = [06 01 00 00 00 00 01 0E 01 00];
		samsung,ldi_debug2_rx_cmds_revA = [06 01 00 00 00 00 01 EA 08 00];
		samsung,hbm_rx_cmds_revA = [ 06 01 00 00 00 00 01 B4 04 00];		/* read B4 1th~4th */
		samsung,hbm2_rx_cmds_revA = [ 06 01 00 00 00 00 01 B4 1D 04];		/* read B4 5th~33th */

		/*
		 * ************************************************************************************************************************
		 *	 COMMON CMD LIST
		 * ************************************************************************************************************************
		 */

		samsung,elvss_lowtemp_tx_cmds_revA = [
			29 01 00 00 00 00 02 B8 19
		];	/* Low Temperature Command */

		samsung,elvss_lowtemp2_tx_cmds_revA = [
			29 01 00 00 00 00 02 B0 15
			29 01 00 00 00 00 02 B6 00
		];	/* Low Temperature Command: default */

		samsung,gamma_tx_cmds_revA = [
			29 01 00 00 00 00 24 CA		/* 1) Gamma 2.2 Setting */
				01 00 01 00 01 00
				80 80 80
				80 80 80
				80 80 80
				80 80 80
				80 80 80
				80 80 80
				80 80 80
				80 80 80
				00 00 00
				00 00
			29 01 00 00 00 00 02 F7 03	/* Gamma, LTPS(AID) update */

			29 01 00 00 00 00 3C		/* dummy for single transmission more 100ns delay */
			00 00 00 00 00 00 00 00 00 00
			00 00 00 00 00 00 00 00 00 00
			00 00 00 00 00 00 00 00 00 00
			00 00 00 00 00 00 00 00 00 00
			00 00 00 00 00 00 00 00 00 00
			00 00 00 00 00 00 00 00 00 00

			29 01 00 00 00 00 02 F7 00
		];

		samsung,hbm_gamma_tx_cmds_revA = [
			29 01 00 00 00 00 24 CA			/* 1) Gamma 2.2 Setting */
				01 00 01 00 01 00
				80 80 80
				80 80 80
				80 80 80
				80 80 80
				80 80 80
				80 80 80
				80 80 80
				80 80 80
				00 00 00
				00 00
			29 01 00 00 00 00 03 B2 00 10		/* AID set : AOR 0% */
			29 01 00 00 00 00 02 F7 03		/* Gamma, LTPS(AID) update */
		];

		samsung,hbm_etc_tx_cmds_revA = [		/* HBM interpolation: 465~578nit */
			29 01 00 00 00 00 03 B6 BC 04		/* HBM ELVSS */
			29 01 00 00 00 00 02 B0 15		/* HBM interpolation */
			29 01 00 00 00 00 02 B6 00
			29 01 00 00 00 00 02 B5 50		/* ACL OPR 32 Frame Average */
			29 01 00 00 00 00 02 53 00		/* HBM Off */
			29 01 00 00 00 00 02 55 02		/* ACL ON  */
		];

		samsung,hbm_pure_etc_tx_cmds_revA = [		/* HBM pure : 600nit */
			29 01 00 00 00 00 03 B6 BC 04		/* HBM ELVSS */
			29 01 00 00 00 00 02 B5 50		/* ACL OPR 32 Frame Average */
			29 01 00 00 00 00 02 53 C0		/* HBM On : elvss acl auto*/
		];

		samsung,hbm_off_tx_cmds_revA = [
			29 01 00 00 00 00 02 53 00	/* HBM Off */
		];

		/*
		 * ************************************************************************************************************************
		 * AID command list and mappings
		 * ************************************************************************************************************************
		 */

		samsung,aid_tx_cmds_revA = [
			/*	0	*/29 01 00 00 00 00 03 B2 70 74 /* 2 CD */
			/*	1	*/29 01 00 00 00 00 03 B2 70 67 /* 3 CD */
			/*	2	*/29 01 00 00 00 00 03 B2 70 60 /* 4 CD */
			/*	3	*/29 01 00 00 00 00 03 B2 70 50 /* 5 CD */
			/*	4	*/29 01 00 00 00 00 03 B2 70 42 /* 6 CD */
			/*	5	*/29 01 00 00 00 00 03 B2 70 32 /* 7 CD */
			/*	6	*/29 01 00 00 00 00 03 B2 70 22 /* 8 CD */
			/*	7	*/29 01 00 00 00 00 03 B2 70 13 /* 9 CD */
			/*	8	*/29 01 00 00 00 00 03 B2 70 03 /* 10 CD */
			/*	9	*/29 01 00 00 00 00 03 B2 60 F4 /* 11 CD */
			/*	10	*/29 01 00 00 00 00 03 B2 60 E2 /* 12 CD */
			/*	11	*/29 01 00 00 00 00 03 B2 60 D2 /* 13 CD */
			/*	12	*/29 01 00 00 00 00 03 B2 60 C0 /* 14 CD */
			/*	13	*/29 01 00 00 00 00 03 B2 60 B3 /* 15 CD */
			/*	14	*/29 01 00 00 00 00 03 B2 60 A2 /* 16 CD */
			/*	15	*/29 01 00 00 00 00 03 B2 60 92 /* 17 CD */
			/*	16	*/29 01 00 00 00 00 03 B2 60 72 /* 19 CD */
			/*	17	*/29 01 00 00 00 00 03 B2 60 56 /* 20 CD */
			/*	18	*/29 01 00 00 00 00 03 B2 60 53 /* 21 CD */
			/*	19	*/29 01 00 00 00 00 03 B2 60 45 /* 22 CD */
			/*	20	*/29 01 00 00 00 00 03 B2 60 25 /* 24 CD */
			/*	21	*/29 01 00 00 00 00 03 B2 60 15 /* 25 CD */
			/*	22	*/29 01 00 00 00 00 03 B2 50 F5 /* 27 CD */
			/*	23	*/29 01 00 00 00 00 03 B2 50 D6 /* 29 CD */
			/*	24	*/29 01 00 00 00 00 03 B2 50 C6 /* 30 CD */
			/*	25	*/29 01 00 00 00 00 03 B2 50 A6 /* 32 CD */
			/*	26	*/29 01 00 00 00 00 03 B2 50 87 /* 34 CD */
			/*	27	*/29 01 00 00 00 00 03 B2 50 56 /* 37 CD */
			/*	28	*/29 01 00 00 00 00 03 B2 50 36 /* 39 CD */
			/*	29	*/29 01 00 00 00 00 03 B2 50 1C /* 41 CD */
			/*	30	*/29 01 00 00 00 00 03 B2 40 E6 /* 44 CD */
			/*	31	*/29 01 00 00 00 00 03 B2 40 B7 /* 47 CD */
			/*	32	*/29 01 00 00 00 00 03 B2 40 86 /* 50 CD */
			/*	33	*/29 01 00 00 00 00 03 B2 40 57 /* 53 CD */
			/*	34	*/29 01 00 00 00 00 03 B2 40 24 /* 56 CD */
			/*	35	*/29 01 00 00 00 00 03 B2 30 EC /* 60 CD */
			/*	36	*/29 01 00 00 00 00 03 B2 30 A5 /* 64 CD */
			/*	37	*/29 01 00 00 00 00 03 B2 30 56 /* 68 CD */
			/*	38	*/29 01 00 00 00 00 03 B2 30 00 /* 72 CD */
			/*	39	*/29 01 00 00 00 00 03 B2 20 B0 /* 77 CD */
			/*	40	*/29 01 00 00 00 00 03 B2 20 B0 /* 82 CD */
			/*	41	*/29 01 00 00 00 00 03 B2 20 B0 /* 87 CD */
			/*	42	*/29 01 00 00 00 00 03 B2 20 B0 /* 93 CD */
			/*	43	*/29 01 00 00 00 00 03 B2 20 B0 /* 98 CD */
			/*	44	*/29 01 00 00 00 00 03 B2 20 B0 /* 105 CD */
			/*	45	*/29 01 00 00 00 00 03 B2 20 B0 /* 111 CD */
			/*	46	*/29 01 00 00 00 00 03 B2 20 B0 /* 119 CD */
			/*	47	*/29 01 00 00 00 00 03 B2 20 B0 /* 126 CD */
			/*	48	*/29 01 00 00 00 00 03 B2 20 B0 /* 134 CD */
			/*	49	*/29 01 00 00 00 00 03 B2 20 B0 /* 143 CD */
			/*	50	*/29 01 00 00 00 00 03 B2 20 B0 /* 152 CD */
			/*	51	*/29 01 00 00 00 00 03 B2 20 B0 /* 162 CD */
			/*	52	*/29 01 00 00 00 00 03 B2 20 B0 /* 172 CD */
			/*	53	*/29 01 00 00 00 00 03 B2 20 B0 /* 183 CD */
			/*	54	*/29 01 00 00 00 00 03 B2 20 56 /* 195 CD */
			/*	55	*/29 01 00 00 00 00 03 B2 10 F7 /* 207 CD */
			/*	56	*/29 01 00 00 00 00 03 B2 10 90 /* 220 CD */
			/*	57	*/29 01 00 00 00 00 03 B2 10 26 /* 234 CD */
			/*	58	*/29 01 00 00 00 00 03 B2 00 C4 /* 249 CD */
			/*	59	*/29 01 00 00 00 00 03 B2 00 C4 /* 265 CD */
			/*	60	*/29 01 00 00 00 00 03 B2 00 C4 /* 282 CD */
			/*	61	*/29 01 00 00 00 00 03 B2 00 C4 /* 300 CD */
			/*	62	*/29 01 00 00 00 00 03 B2 00 C4 /* 316 CD */
			/*	63	*/29 01 00 00 00 00 03 B2 00 C4 /* 333 CD */
			/*	64	*/29 01 00 00 00 00 03 B2 00 C4 /* 350 CD */
			/*	65	*/29 01 00 00 00 00 03 B2 00 C4 /* 357 CD */
			/*	66	*/29 01 00 00 00 00 03 B2 00 C4 /* 365 CD */
			/*	67	*/29 01 00 00 00 00 03 B2 00 B0 /* 372 CD */
			/*	68	*/29 01 00 00 00 00 03 B2 00 80 /* 380 CD */
			/*	69	*/29 01 00 00 00 00 03 B2 00 60 /* 387 CD */
			/*	70	*/29 01 00 00 00 00 03 B2 00 38 /* 395 CD */
			/*	71	*/29 01 00 00 00 00 03 B2 00 20 /* 403 CD */
			/*	72	*/29 01 00 00 00 00 03 B2 00 15 /* 412 CD */
			/*	73	*/29 01 00 00 00 00 03 B2 00 10 /* 420 CD */
		];

		samsung,aid_subdivision_tx_cmds_revA = [
			29 01 00 00 00 00 03 B2 70 74 /* 0   */
			29 01 00 00 00 00 03 B2 70 66 /* 1   */
			29 01 00 00 00 00 03 B2 70 5E /* 2   */
			29 01 00 00 00 00 03 B2 70 56 /* 3   */
			29 01 00 00 00 00 03 B2 70 47 /* 4   */
			29 01 00 00 00 00 03 B2 70 37 /* 5   */
			29 01 00 00 00 00 03 B2 70 27 /* 6   */
			29 01 00 00 00 00 03 B2 70 18 /* 7   */
			29 01 00 00 00 00 03 B2 70 07 /* 8   */
			29 01 00 00 00 00 03 B2 60 FA /* 9   */
			29 01 00 00 00 00 03 B2 60 E8 /* 10  */
			29 01 00 00 00 00 03 B2 60 D6 /* 11  */
			29 01 00 00 00 00 03 B2 60 C7 /* 12  */
			29 01 00 00 00 00 03 B2 60 B7 /* 13  */
			29 01 00 00 00 00 03 B2 60 A7 /* 14  */
			29 01 00 00 00 00 03 B2 60 97 /* 15  */
			29 01 00 00 00 00 03 B2 60 86 /* 16  */
			29 01 00 00 00 00 03 B2 60 77 /* 17  */
			29 01 00 00 00 00 03 B2 60 69 /* 18  */
			29 01 00 00 00 00 03 B2 60 56 /* 19  */
			29 01 00 00 00 00 03 B2 60 48 /* 20  */
			29 01 00 00 00 00 03 B2 60 37 /* 21  */
			29 01 00 00 00 00 03 B2 60 19 /* 22  */
			29 01 00 00 00 00 03 B2 60 15 /* 23  */
			29 01 00 00 00 00 03 B2 60 03 /* 24  */
			29 01 00 00 00 00 03 B2 50 F0 /* 25  */
			29 01 00 00 00 00 03 B2 50 D3 /* 26  */
			29 01 00 00 00 00 03 B2 50 C6 /* 27  */
			29 01 00 00 00 00 03 B2 50 B4 /* 28  */
			29 01 00 00 00 00 03 B2 50 A2 /* 29  */
			29 01 00 00 00 00 03 B2 50 92 /* 30  */
			29 01 00 00 00 00 03 B2 50 82 /* 31  */
			29 01 00 00 00 00 03 B2 50 6A /* 32  */
			29 01 00 00 00 00 03 B2 50 52 /* 33  */
			29 01 00 00 00 00 03 B2 50 32 /* 34  */
			29 01 00 00 00 00 03 B2 50 22 /* 35  */
			29 01 00 00 00 00 03 B2 50 12 /* 36  */
			29 01 00 00 00 00 03 B2 40 F9 /* 37  */
			29 01 00 00 00 00 03 B2 40 E0 /* 38  */
			29 01 00 00 00 00 03 B2 40 D1 /* 39  */
			29 01 00 00 00 00 03 B2 40 C1 /* 40  */
			29 01 00 00 00 00 03 B2 40 B2 /* 41  */
			29 01 00 00 00 00 03 B2 40 99 /* 42  */
			29 01 00 00 00 00 03 B2 40 80 /* 43  */
			29 01 00 00 00 00 03 B2 40 68 /* 44  */
			29 01 00 00 00 00 03 B2 40 50 /* 45  */
			29 01 00 00 00 00 03 B2 40 38 /* 46  */
			29 01 00 00 00 00 03 B2 40 20 /* 47  */
			29 01 00 00 00 00 03 B2 40 0B /* 48  */
			29 01 00 00 00 00 03 B2 30 F5 /* 49  */
			29 01 00 00 00 00 03 B2 30 E0 /* 50  */
			29 01 00 00 00 00 03 B2 30 C7 /* 51  */
			29 01 00 00 00 00 03 B2 30 AE /* 52  */
			29 01 00 00 00 00 03 B2 30 95 /* 53  */
			29 01 00 00 00 00 03 B2 30 80 /* 54  */
			29 01 00 00 00 00 03 B2 30 6B /* 55  */
			29 01 00 00 00 00 03 B2 30 56 /* 56  */
			29 01 00 00 00 00 03 B2 30 2E /* 57  */
			29 01 00 00 00 00 03 B2 30 07 /* 58  */
			29 01 00 00 00 00 03 B2 30 03 /* 59  */
			29 01 00 00 00 00 03 B2 20 EF /* 60  */
			29 01 00 00 00 00 03 B2 20 DB /* 61  */
			29 01 00 00 00 00 03 B2 20 C7 /* 62  */
			29 01 00 00 00 00 03 B2 20 F9 /* 63  */
			29 01 00 00 00 00 03 B2 20 E0 /* 64  */
			29 01 00 00 00 00 03 B2 20 C7 /* 65  */
			29 01 00 00 00 00 03 B2 20 FC /* 66  */
			29 01 00 00 00 00 03 B2 20 EA /* 67  */
			29 01 00 00 00 00 03 B2 20 D9 /* 68  */
			29 01 00 00 00 00 03 B2 20 C7 /* 69  */
			29 01 00 00 00 00 03 B2 30 02 /* 70  */
			29 01 00 00 00 00 03 B2 20 EF /* 71  */
			29 01 00 00 00 00 03 B2 20 DB /* 72  */
			29 01 00 00 00 00 03 B2 20 C7 /* 73  */
			29 01 00 00 00 00 03 B2 20 F1 /* 74  */
			29 01 00 00 00 00 03 B2 20 DC /* 75  */
			29 01 00 00 00 00 03 B2 20 C7 /* 76  */
			29 01 00 00 00 00 03 B2 30 04 /* 77  */
			29 01 00 00 00 00 03 B2 20 F0 /* 78  */
			29 01 00 00 00 00 03 B2 20 DB /* 79  */
			29 01 00 00 00 00 03 B2 20 C7 /* 80  */
			29 01 00 00 00 00 03 B2 20 F9 /* 81  */
			29 01 00 00 00 00 03 B2 20 E8 /* 82  */
			29 01 00 00 00 00 03 B2 20 D8 /* 83  */
			29 01 00 00 00 00 03 B2 20 C7 /* 84  */
			29 01 00 00 00 00 03 B2 30 09 /* 85  */
			29 01 00 00 00 00 03 B2 20 F8 /* 86  */
			29 01 00 00 00 00 03 B2 20 E8 /* 87  */
			29 01 00 00 00 00 03 B2 20 D7 /* 88  */
			29 01 00 00 00 00 03 B2 20 C7 /* 89  */
			29 01 00 00 00 00 03 B2 20 FD /* 90  */
			29 01 00 00 00 00 03 B2 20 F0 /* 91  */
			29 01 00 00 00 00 03 B2 20 E2 /* 92  */
			29 01 00 00 00 00 03 B2 20 D5 /* 93  */
			29 01 00 00 00 00 03 B2 20 C7 /* 94  */
			29 01 00 00 00 00 03 B2 30 02 /* 95  */
			29 01 00 00 00 00 03 B2 20 F3 /* 96  */
			29 01 00 00 00 00 03 B2 20 E4 /* 97  */
			29 01 00 00 00 00 03 B2 20 D6 /* 98  */
			29 01 00 00 00 00 03 B2 20 C7 /* 99  */
			29 01 00 00 00 00 03 B2 30 05 /* 100 */
			29 01 00 00 00 00 03 B2 20 F5 /* 101 */
			29 01 00 00 00 00 03 B2 20 E6 /* 102 */
			29 01 00 00 00 00 03 B2 20 D6 /* 103 */
			29 01 00 00 00 00 03 B2 20 C7 /* 104 */
			29 01 00 00 00 00 03 B2 30 03 /* 105 */
			29 01 00 00 00 00 03 B2 20 F7 /* 106 */
			29 01 00 00 00 00 03 B2 20 EB /* 107 */
			29 01 00 00 00 00 03 B2 20 DF /* 108 */
			29 01 00 00 00 00 03 B2 20 D3 /* 109 */
			29 01 00 00 00 00 03 B2 20 C7 /* 110 */
			29 01 00 00 00 00 03 B2 30 06 /* 111 */
			29 01 00 00 00 00 03 B2 20 F9 /* 112 */
			29 01 00 00 00 00 03 B2 20 ED /* 113 */
			29 01 00 00 00 00 03 B2 20 E0 /* 114 */
			29 01 00 00 00 00 03 B2 20 D4 /* 115 */
			29 01 00 00 00 00 03 B2 20 C7 /* 116 */
			29 01 00 00 00 00 03 B2 30 00 /* 117 */
			29 01 00 00 00 00 03 B2 20 F2 /* 118 */
			29 01 00 00 00 00 03 B2 20 E3 /* 119 */
			29 01 00 00 00 00 03 B2 20 D5 /* 120 */
			29 01 00 00 00 00 03 B2 20 C7 /* 121 */
			29 01 00 00 00 00 03 B2 30 06 /* 122 */
			29 01 00 00 00 00 03 B2 20 FC /* 123 */
			29 01 00 00 00 00 03 B2 20 F1 /* 124 */
			29 01 00 00 00 00 03 B2 20 E7 /* 125 */
			29 01 00 00 00 00 03 B2 20 DC /* 126 */
			29 01 00 00 00 00 03 B2 20 D2 /* 127 */
			29 01 00 00 00 00 03 B2 20 C7 /* 128 */
			29 01 00 00 00 00 03 B2 20 B7 /* 129 */
			29 01 00 00 00 00 03 B2 20 A7 /* 130 */
			29 01 00 00 00 00 03 B2 20 96 /* 131 */
			29 01 00 00 00 00 03 B2 20 86 /* 132 */
			29 01 00 00 00 00 03 B2 20 76 /* 133 */
			29 01 00 00 00 00 03 B2 20 66 /* 134 */
			29 01 00 00 00 00 03 B2 20 56 /* 135 */
			29 01 00 00 00 00 03 B2 20 48 /* 136 */
			29 01 00 00 00 00 03 B2 20 3B /* 137 */
			29 01 00 00 00 00 03 B2 20 2D /* 138 */
			29 01 00 00 00 00 03 B2 20 20 /* 139 */
			29 01 00 00 00 00 03 B2 20 12 /* 140 */
			29 01 00 00 00 00 03 B2 20 05 /* 141 */
			29 01 00 00 00 00 03 B2 10 F7 /* 142 */
			29 01 00 00 00 00 03 B2 10 E8 /* 143 */
			29 01 00 00 00 00 03 B2 10 DA /* 144 */
			29 01 00 00 00 00 03 B2 10 CB /* 145 */
			29 01 00 00 00 00 03 B2 10 BC /* 146 */
			29 01 00 00 00 00 03 B2 10 AD /* 147 */
			29 01 00 00 00 00 03 B2 10 9F /* 148 */
			29 01 00 00 00 00 03 B2 10 90 /* 149 */
			29 01 00 00 00 00 03 B2 10 83 /* 150 */
			29 01 00 00 00 00 03 B2 10 75 /* 151 */
			29 01 00 00 00 00 03 B2 10 68 /* 152 */
			29 01 00 00 00 00 03 B2 10 5B /* 153 */
			29 01 00 00 00 00 03 B2 10 4E /* 154 */
			29 01 00 00 00 00 03 B2 10 40 /* 155 */
			29 01 00 00 00 00 03 B2 10 33 /* 156 */
			29 01 00 00 00 00 03 B2 10 26 /* 157 */
			29 01 00 00 00 00 03 B2 10 20 /* 158 */
			29 01 00 00 00 00 03 B2 10 13 /* 159 */
			29 01 00 00 00 00 03 B2 10 06 /* 160 */
			29 01 00 00 00 00 03 B2 00 F8 /* 161 */
			29 01 00 00 00 00 03 B2 00 EB /* 162 */
			29 01 00 00 00 00 03 B2 00 DE /* 163 */
			29 01 00 00 00 00 03 B2 00 D1 /* 164 */
			29 01 00 00 00 00 03 B2 00 C4 /* 165 */
			29 01 00 00 00 00 03 B2 10 21 /* 166 */
			29 01 00 00 00 00 03 B2 10 16 /* 167 */
			29 01 00 00 00 00 03 B2 10 0A /* 168 */
			29 01 00 00 00 00 03 B2 00 FE /* 169 */
			29 01 00 00 00 00 03 B2 00 F3 /* 170 */
			29 01 00 00 00 00 03 B2 00 E7 /* 171 */
			29 01 00 00 00 00 03 B2 00 DB /* 172 */
			29 01 00 00 00 00 03 B2 00 D0 /* 173 */
			29 01 00 00 00 00 03 B2 00 C4 /* 174 */
			29 01 00 00 00 00 03 B2 10 21 /* 175 */
			29 01 00 00 00 00 03 B2 10 16 /* 176 */
			29 01 00 00 00 00 03 B2 10 0A /* 177 */
			29 01 00 00 00 00 03 B2 00 FE /* 178 */
			29 01 00 00 00 00 03 B2 00 F3 /* 179 */
			29 01 00 00 00 00 03 B2 00 E7 /* 180 */
			29 01 00 00 00 00 03 B2 00 DB /* 181 */
			29 01 00 00 00 00 03 B2 00 D0 /* 182 */
			29 01 00 00 00 00 03 B2 00 C4 /* 183 */
			29 01 00 00 00 00 03 B2 10 22 /* 184 */
			29 01 00 00 00 00 03 B2 10 18 /* 185 */
			29 01 00 00 00 00 03 B2 10 0D /* 186 */
			29 01 00 00 00 00 03 B2 10 03 /* 187 */
			29 01 00 00 00 00 03 B2 00 F8 /* 188 */
			29 01 00 00 00 00 03 B2 00 EE /* 189 */
			29 01 00 00 00 00 03 B2 00 E3 /* 190 */
			29 01 00 00 00 00 03 B2 00 D9 /* 191 */
			29 01 00 00 00 00 03 B2 00 CE /* 192 */
			29 01 00 00 00 00 03 B2 00 C4 /* 193 */
			29 01 00 00 00 00 03 B2 10 11 /* 194 */
			29 01 00 00 00 00 03 B2 10 06 /* 195 */
			29 01 00 00 00 00 03 B2 00 FB /* 196 */
			29 01 00 00 00 00 03 B2 00 F0 /* 197 */
			29 01 00 00 00 00 03 B2 00 E5 /* 198 */
			29 01 00 00 00 00 03 B2 00 DA /* 199 */
			29 01 00 00 00 00 03 B2 00 CF /* 200 */
			29 01 00 00 00 00 03 B2 00 C4 /* 201 */
			29 01 00 00 00 00 03 B2 10 13 /* 202 */
			29 01 00 00 00 00 03 B2 10 09 /* 203 */
			29 01 00 00 00 00 03 B2 00 FF /* 204 */
			29 01 00 00 00 00 03 B2 00 F5 /* 205 */
			29 01 00 00 00 00 03 B2 00 EB /* 206 */
			29 01 00 00 00 00 03 B2 00 E2 /* 207 */
			29 01 00 00 00 00 03 B2 00 D8 /* 208 */
			29 01 00 00 00 00 03 B2 00 CE /* 209 */
			29 01 00 00 00 00 03 B2 00 C4 /* 210 */
			29 01 00 00 00 00 03 B2 10 0F /* 211 */
			29 01 00 00 00 00 03 B2 10 06 /* 212 */
			29 01 00 00 00 00 03 B2 00 FC /* 213 */
			29 01 00 00 00 00 03 B2 00 F3 /* 214 */
			29 01 00 00 00 00 03 B2 00 EA /* 215 */
			29 01 00 00 00 00 03 B2 00 E0 /* 216 */
			29 01 00 00 00 00 03 B2 00 D7 /* 217 */
			29 01 00 00 00 00 03 B2 00 CD /* 218 */
			29 01 00 00 00 00 03 B2 00 C4 /* 219 */
			29 01 00 00 00 00 03 B2 00 DE /* 220 */
			29 01 00 00 00 00 03 B2 00 D5 /* 221 */
			29 01 00 00 00 00 03 B2 00 CD /* 222 */
			29 01 00 00 00 00 03 B2 00 C4 /* 223 */
			29 01 00 00 00 00 03 B2 00 E1 /* 224 */
			29 01 00 00 00 00 03 B2 00 D7 /* 225 */
			29 01 00 00 00 00 03 B2 00 CE /* 226 */
			29 01 00 00 00 00 03 B2 00 C4 /* 227 */
			29 01 00 00 00 00 03 B2 00 B9 /* 228 */
			29 01 00 00 00 00 03 B2 00 AE /* 229 */
			29 01 00 00 00 00 03 B2 00 A3 /* 230 */
			29 01 00 00 00 00 03 B2 00 97 /* 231 */
			29 01 00 00 00 00 03 B2 00 8B /* 232 */
			29 01 00 00 00 00 03 B2 00 7F /* 233 */
			29 01 00 00 00 00 03 B2 00 73 /* 234 */
			29 01 00 00 00 00 03 B2 00 6B /* 235 */
			29 01 00 00 00 00 03 B2 00 63 /* 236 */
			29 01 00 00 00 00 03 B2 00 5A /* 237 */
			29 01 00 00 00 00 03 B2 00 52 /* 238 */
			29 01 00 00 00 00 03 B2 00 47 /* 239 */
			29 01 00 00 00 00 03 B2 00 3D /* 240 */
			29 01 00 00 00 00 03 B2 00 32 /* 241 */
			29 01 00 00 00 00 03 B2 00 27 /* 242 */
			29 01 00 00 00 00 03 B2 00 2D /* 243 */
			29 01 00 00 00 00 03 B2 00 23 /* 244 */
			29 01 00 00 00 00 03 B2 00 1A /* 245 */
			29 01 00 00 00 00 03 B2 00 10 /* 246 */
			29 01 00 00 00 00 03 B2 00 2F /* 247 */
			29 01 00 00 00 00 03 B2 00 25 /* 248 */
			29 01 00 00 00 00 03 B2 00 1A /* 249 */
			29 01 00 00 00 00 03 B2 00 10 /* 250 */
			29 01 00 00 00 00 03 B2 00 2B /* 251 */
			29 01 00 00 00 00 03 B2 00 22 /* 252 */
			29 01 00 00 00 00 03 B2 00 19 /* 253 */
			29 01 00 00 00 00 03 B2 00 10 /* 254 */
			29 01 00 00 00 00 03 B2 00 10 /* 255 */
		];

		/* bl_level, Index in acl command list */
		samsung,aid_map_table_revA = <
			2	0		3	1		4	2		5	3		6	4
			7	5		8	6		9	7		10	8		11	9
			12	10		13	11		14	12		15	13		16	14
			17	15		19	16		20	17		21	18		22	19
			24	20		25	21		27	22		29	23		30	24
			32	25		34	26		37	27		39	28		41	29
			44	30		47	31		50	32		53	33		56	34
			60	35		64	36		68	37		72	38		77	39
			82	40		87	41		93	42		98	43		105	44
			111	45		119	46		126	47		134	48		143	49
			152	50		162	51		172	52		183	53		195	54
			207	55		220	56		234	57		249	58		265	59
			282	60		300	61		316	62		333	63		350	64
			357	65		365	66		372	67		380	68		387	69
			395	70		403	71		412	72		420	73
		>;

		/*
		 * ************************************************************************************************************************
		 * ACL command list and mappings
		 * ************************************************************************************************************************
		 */

		samsung,acl_on_tx_cmds_revA = [
			29 01 00 00 00 00 02 B5 50	/* ACL 32Frame Averaging */
			29 01 00 00 00 00 02 55 02	/* ACL ON */
		];

		samsung,acl_percent_tx_cmds_revA = [
			29 01 00 00 00 00 02 55 00	/* ACL OFF */
			29 01 00 00 00 00 02 55 01
			29 01 00 00 00 00 02 55 02	/* Default ACL */
			29 01 00 00 00 00 02 55 03
		];

		samsung,acl_off_tx_cmds_revA = [
			29 01 00 00 00 00 02 B5 40	/* 16 Frame Avg. */
			29 01 00 00 00 00 02 55 00	/* ACL OFF */
		];

		/* bl_level , Index in acl command list */
		samsung,acl_map_table_revA =  <
			2	2		3	2		4	2		5	2		6	2
			7	2		8	2		9	2		10	2		11	2
			12	2		13	2		14	2		15	2		16	2
			17	2		19	2		20	2		21	2		22	2
			24	2		25	2		27	2		29	2		30	2
			32	2		34	2		37	2		39	2		41	2
			44	2		47	2		50	2		53	2		56	2
			60	2		64	2		68	2		72	2		77	2
			82	2		87	2		93	2		98	2		105	2
			111	2		119	2		126	2		134	2		143	2
			152	2		162	2		172	2		183	2		195	2
			207	2		220	2		234	2		249	2		265	2
			282	2		300	2		316	2		333	2		350	2
			357	2		365	2		372	2		380	2		387	2
			395	2		403	2		412	2		420	2
		>;

		/*
		 * ************************************************************************************************************************
		 * SMART ACL(ACL On) ELVSS command list and mappings
		 * ************************************************************************************************************************
		 */
		samsung,smart_acl_elvss_tx_cmds_revA = [
			29 01 00 00 00 00 03 B6 AC 0A /* 0 */
			29 01 00 00 00 00 03 B6 AC 0C /* 1 */
			29 01 00 00 00 00 03 B6 AC 0D /* 2 */
			29 01 00 00 00 00 03 B6 AC 0F /* 3 */
			29 01 00 00 00 00 03 B6 AC 11 /* 4 */
			29 01 00 00 00 00 03 B6 AC 12 /* 5 */
			29 01 00 00 00 00 03 B6 AC 13 /* 6 */
			29 01 00 00 00 00 03 B6 AC 14 /* 7 */
			29 01 00 00 00 00 03 B6 AC 15 /* 8 */
			29 01 00 00 00 00 03 B6 AC 16 /* 9 */
			29 01 00 00 00 00 03 B6 AC 17 /* 10 */
			29 01 00 00 00 00 03 B6 AC 18 /* 11 */
			29 01 00 00 00 00 03 B6 AC 19 /* 12 */
			29 01 00 00 00 00 03 B6 BC 14 /* 13 */
			29 01 00 00 00 00 03 B6 BC 13 /* 14 */
			29 01 00 00 00 00 03 B6 BC 12 /* 15 */
			29 01 00 00 00 00 03 B6 BC 11 /* 16 */
			29 01 00 00 00 00 03 B6 BC 10 /* 17 */
			29 01 00 00 00 00 03 B6 BC 0F /* 18 */
			29 01 00 00 00 00 03 B6 BC 0E /* 19 */
			29 01 00 00 00 00 03 B6 BC 0D /* 20 */
			29 01 00 00 00 00 03 B6 BC 0C /* 21 */
			29 01 00 00 00 00 03 B6 BC 0B /* 22 */
			29 01 00 00 00 00 03 B6 BC 0A /* 23 */
			29 01 00 00 00 00 03 B6 BC 09 /* 24 */
			29 01 00 00 00 00 03 B6 BC 08 /* 25 */
			29 01 00 00 00 00 03 B6 BC 07 /* 26 */
			29 01 00 00 00 00 03 B6 BC 06 /* 27 */
			29 01 00 00 00 00 03 B6 BC 05 /* 28 */
			29 01 00 00 00 00 03 B6 BC 04 /* 29 */
		];

		/* bl_level, Index in elvss command list */
		samsung,smart_acl_elvss_map_table_revA = <
			2	0		3	1		4	2		5	3		6	4
			7	5		8	6		9	7		10	8		11	9
			12	10		13	11		14	12		15	7		16	7
			17	7		19	7		20	7		21	7		22	7
			24	7		25	7		27	7		29	7		30	7
			32	7		34	7		37	7		39	7		41	13
			44	13		47	13		50	13		53	13		56	13
			60	13		64	13		68	13		72	13		77	13
			82	13		87	14		93	14		98	14		105	15
			111	15		119	16		126	16		134	17		143	17
			152	18		162	18		172	19		183	19		195	20
			207	20		220	20		234	20		249	20		265	21
			282	22		300	23		316	24		333	25		350	26
			357	26		365	27		372	27		380	27		387	28
			395	28		403	28		412	29		420	29
		>;

		/*
		 * ************************************************************************************************************************
		 * candela to index mappings
		 * ************************************************************************************************************************
		 */
		samsung,candela_map_table_revA = <
		/*<idx><PMSL range> <candella> *//*linear map*/
		0	0	0	2
		1	1	2	3
		2	3	3	4
		3	4	4	5
		4	5	5	6
		5	6	6	7
		6	7	7	8
		7	8	8	9
		8	9	9	10
		9	10	10	11
		10	11	11	12
		11	12	12	13
		12	13	13	14
		13	14	14	15
		14	15	15	16
		15	16	17	17
		16	18	18	19
		17	19	19	20 /* dimming*/
		18	20	20	21
		19	21	21	22
		20	22	22	24
		21	23	24	25
		22	25	25	27
		23	26	26	29
		24	27	28	30
		25	29	30	32
		26	31	32	34
		27	33	33	37
		28	34	35	39
		29	36	37	41
		30	38	40	44
		31	41	42	47
		32	43	44	50
		33	45	46	53
		34	47	49	56
		35	50	52	60
		36	53	55	64
		37	56	57	68
		38	58	61	72
		39	62	64	77
		40	65	68	82
		41	69	72	87
		42	73	75	93
		43	76	79	98
		44	80	83	105
		45	84	88	111
		46	89	93	119
		47	94	98	126
		48	99	103	134
		49	104	109	143
		50	110	115	152
		51	116	120	162
		52	121	127	172
		53	128	134	183 /* default */
		54	135	141	195
		55	142	148	207
		56	149	156	220
		57	157	164	234
		58	165	173	249
		59	174	182	265
		60	183	192	282
		61	193	200	300
		62	201	209	316
		63	210	218	333
		64	219	222	350
		65	223	226	357
		66	227	229	365
		67	230	233	372
		68	234	237	380
		69	238	241	387
		70	242	245	395
		71	246	249	403
		72	250	253	412
		73	254	255	420
		>;

		/*
		* ************************************************************************************************************************
		*  HMT
		* ************************************************************************************************************************
		*/
		samsung,hmt_enabled;
		samsung,hmt_aid_tx_cmds_revA = [
			29 01 00 00 00 00 03 B2 10 84 /* 10 CD */
			29 01 00 00 00 00 03 B2 10 84 /* 11 CD */
			29 01 00 00 00 00 03 B2 10 84 /* 12 CD */
			29 01 00 00 00 00 03 B2 10 84 /* 13 CD */
			29 01 00 00 00 00 03 B2 10 84 /* 14 CD */
			29 01 00 00 00 00 03 B2 10 84 /* 15 CD */
			29 01 00 00 00 00 03 B2 10 84 /* 16 CD */
			29 01 00 00 00 00 03 B2 10 84 /* 17 CD */
			29 01 00 00 00 00 03 B2 10 84 /* 19 CD */
			29 01 00 00 00 00 03 B2 10 84 /* 20 CD */
			29 01 00 00 00 00 03 B2 10 84 /* 21 CD */
			29 01 00 00 00 00 03 B2 10 84 /* 22 CD */
			29 01 00 00 00 00 03 B2 10 84 /* 23 CD */
			29 01 00 00 00 00 03 B2 10 84 /* 25 CD */
			29 01 00 00 00 00 03 B2 10 84 /* 27 CD */
			29 01 00 00 00 00 03 B2 10 84 /* 29 CD */
			29 01 00 00 00 00 03 B2 10 84 /* 31 CD */
			29 01 00 00 00 00 03 B2 10 84 /* 33 CD */
			29 01 00 00 00 00 03 B2 10 84 /* 35 CD */
			29 01 00 00 00 00 03 B2 10 84 /* 37 CD */
			29 01 00 00 00 00 03 B2 10 84 /* 39 CD */
			29 01 00 00 00 00 03 B2 10 84 /* 41 CD */
			29 01 00 00 00 00 03 B2 10 84 /* 44 CD */
			29 01 00 00 00 00 03 B2 10 84 /* 47 CD */
			29 01 00 00 00 00 03 B2 10 84 /* 50 CD */
			29 01 00 00 00 00 03 B2 10 84 /* 50 CD */
			29 01 00 00 00 00 03 B2 10 84 /* 53 CD */
			29 01 00 00 00 00 03 B2 10 84 /* 56 CD */
			29 01 00 00 00 00 03 B2 10 84 /* 60 CD */
			29 01 00 00 00 00 03 B2 10 84 /* 64 CD */
			29 01 00 00 00 00 03 B2 10 84 /* 68 CD */
			29 01 00 00 00 00 03 B2 10 84 /* 72 CD */
			29 01 00 00 00 00 03 B2 20 46 /* 77 CD */
			29 01 00 00 00 00 03 B2 20 46 /* 82 CD */
			29 01 00 00 00 00 03 B2 20 46 /* 87 CD */
			29 01 00 00 00 00 03 B2 20 46 /* 93 CD */
			29 01 00 00 00 00 03 B2 20 46 /* 99 CD */
			29 01 00 00 00 00 03 B2 20 46 /* 105 CD */
		];

		/* bl_level, Index in acl command list */
		samsung,hmt_reverse_aid_map_table_revA = <
			10	0
			11	1
			12	2
			13	3
			14	4
			15	5
			16	6
			17	7
			19	8
			20	9
			21	10
			22	11
			23	12
			25	13
			27	14
			29	15
			31	16
			33	17
			35	18
			37	19
			39	20
			41	21
			44	22
			47	23
			50	24
			53	25
			56	26
			60	27
			64	28
			68	29
			72	30
			77	31
			82	32
			87	33
			93	34
			99	35
			105	36
		>;

		samsung,hmt_candela_map_table_revA = <
		/*<idx>	  <from>  <till> <candella> */
			0	0	6	10
			1	7	13	11
			2	14	20	12
			3	21	27	13
			4	28	34	14
			5	35	41	15
			6	42	48	16
			7	49	55	17
			8	56	62	19
			9	63	69	20
			10	70	76	21
			11	77	83	22
			12	84	90	23
			13	91	97	25
			14	98	104	27
			15	105	111	29
			16	112	118	31
			17	119	125	33
			18	126	132	35
			19	133	139	37
			20	140	146	39
			21	147	153	41
			22	154	160	44
			23	161	167	47
			24	168	174	50
			25	175	181	53
			26	182	188	56
			27	189	195	60
			28	196	202	64
			29	203	209	68
			30	210	216	72
			31	217	223	77
			32	224	230	82
			33	231	237	87
			34	238	244	93
			35	245	251	99
			36	252	255	105
		>;

		samsung,hmt_gamma_tx_cmds_revA = [ // 5.3.1 Dimming For HMD : ???
			29 01 00 00 00 00 24 CA
				01 00 01 00 01 00
				80 80 80
				80 80 80
				80 80 80
				80 80 80
				80 80 80
				80 80 80
				80 80 80
				80 80 80
				00 00 00
				00 00
			29 01 00 00 00 00 03 B2 00 10		// AID set : AOR 0%
			29 01 00 00 00 00 02 F7 03		// Gamma, LTPS(AID) update
		];

		samsung,hmt_elvss_tx_cmds_revA = [
			29 01 00 00 00 00 03 B6 BC 04
		];

		samsung,hmt_enable_tx_cmds_revA = [ // 5.2.1 HMD On Setting
			29 01 00 00 00 00 03 F0 5A 5A
			29 01 00 00 00 00 07 B2 20 46 12 12 12 00		// AOR 70%, AID 1 -Cycle
			29 01 00 00 00 00 03 F0 A5 A5
		];

		samsung,hmt_reverse_tx_cmds_revA = [ // 5.2.2 AID Reverse Setting
			29 01 00 00 00 00 03 F0 5A 5A
			29 01 00 00 00 00 08 F2 01 00 02 5A F0 0C 08		// Reverse Porch Setting
			29 01 00 00 00 00 41 CB 				// LTPS Setting
				28 01 01 01 10 66 88 00
				00 00 0D 00 00 00 00 00
				00 12 6E 00 00 00 00 14
				00 00 00 00 74 00 00 CF
				11 0D 04 05 00 C2 00 00
				00 C0 C0 C0 C0 84 C5 C2
				C0 00 00 00 00 00 00 00
				00 00 00 8C 6E 00 00 14
			29 01 00 00 01 00 02 F7 03
			29 01 00 00 00 00 03 F0 A5 A5
		];

		samsung,hmt_disable_tx_cmds_revA = [ // 5.2.3 HMD OFF Setting
			29 01 00 00 00 00 03 F0 5A 5A
			29 01 00 00 00 00 07 B2 00 10 12 12 12 40 	// AOR 0%, AID 4 -Cycle
			29 01 00 00 01 00 02 F7 03			// Gamma, AID update
			29 01 00 00 00 00 03 F0 A5 A5
		];

		samsung,hmt_forward_tx_cmds_revA = [ // 5.2.4 AID Forawrd Setting
			29 01 00 00 00 00 03 F0 5A 5A
			29 01 00 00 00 00 08 F2 01 00 02 5A F0 09 07	// Porch Setting
			29 01 00 00 00 00 41 CB			// LTPS Setting
				28 01 01 01 10 66 88 00
				00 05 05 00 00 00 00 00
				00 12 6E 00 00 00 00 01
				00 00 00 00 74 00 00 CF
				11 0D 04 05 00 C2 00 00
				00 C0 C0 C0 C0 04 C5 C2
				C0 00 00 00 00 00 00 00
				00 00 00 8C 6E 00 00 01
			29 01 00 00 01 00 02 F7 03
			29 01 00 00 00 00 03 F0 A5 A5
		];
	};
};
