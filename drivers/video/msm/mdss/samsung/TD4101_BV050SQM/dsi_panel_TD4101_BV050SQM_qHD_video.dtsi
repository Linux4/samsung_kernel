/* Copyright (c) 2013-14, Samsung Electronics Corporation. All rights reserved.
 *
 * This program is free software; you can redistribute it and/or modify
 * it under the terms of the GNU General Public License version 2 and
 * only version 2 as published by the Free Software Foundation.
 *
 * This program is distributed in the hope that it will be useful,
 * but WITHOUT ANY WARRANTY; without even the implied warranty of
 * MERCHANTABILITY or FITNESS FOR A PARTICULAR PURPOSE.  See the
 * GNU General Public License for more details.
 */

/*---------------------------------------------------------------------------
 * This file is autogenerated file using gcdb parser. Please do not edit it.
 * Update input XML file to add a new entry or update variable in this file
 * VERSION = "1.0"
 *---------------------------------------------------------------------------*/
&mdss_mdp {
	ss_dsi_panel_TD4101_BV050SQM_qHD: ss_dsi_panel_TD4101_BV050SQM_qHD {
		qcom,mdss-dsi-panel-name = "ss_dsi_panel_TD4101_BV050SQM_qHD";
		qcom,mdss-dsi-panel-controller = <&mdss_dsi0>;
		qcom,mdss-dsi-panel-width = <540>;
		qcom,mdss-dsi-panel-height = <960>;
		qcom,mdss-dsi-bpp = <24>;
		qcom,mdss-dsi-panel-destination = "display_1";
		qcom,mdss-dsi-panel-timings = [DB 34 22 00 64 66 28 38 2B 03 04 00];
		qcom,mdss-dsi-on-command = [
			/* Initializing Sequence(1)*/
			39 01 00 00 00 00 02 B0 04
			39 01 00 00 00 00 04 B3 10 00 06			/* Interface setting */
			39 01 00 00 00 00 03 B4 00 01
			39 01 00 00 00 00 05 B5 00 00 00 00
			39 01 00 00 00 00 08 B6 32 53 80 00 00 07 86	/* DSI control */
			39 01 00 00 00 00 02 B7 00
			39 01 00 00 00 00 07 BA 07 87 3A 0A 3D 88
			
			/* Sunlight readablility enhancement */
			39 01 00 00 00 00 04 BB 00 B4 A0
			39 01 00 00 00 00 04 BC 00 B4 A0
			39 01 00 00 00 00 04 BD 00 B4 A0
			39 01 00 00 00 00 02 BE 04
			39 01 00 00 00 00 05 BF 02 3c 80 09
			39 01 00 00 00 00 12 C0 00 00 00 00 00 00 00 00 00 00 00 00 00 00 00 00 00
			39 01 00 00 00 00 23 C1 04 48 01 03 33 08 11 00 11 00 73 23 23 11 00 00 00 00 00 00 00 00 00 00 00 00 DF 00 30 00 01 00 00 00
			39 01 00 00 00 00 14 C2 00 F0 03 C0 0A 04 08 00 24 19 00 00 00 00 00 00 00 03 00
			39 01 00 00 00 00 40 C3 3D 00 00 00 00 00 00 00 00 00 00 00 00 00 00 00 00 00 00 00 01 01 03 28 00 01 03 01 44 00 00 00 00 00 00 00 00 00 00 00 00 00 00 00 00 00 00 00 F0 00 00 00 00 00 F0 00 00 00 00 00 40 20 03
			39 01 00 00 00 00 29 C4 70 01 00 00 00 00 00 00 00 00 00 00 00 00 00 00 00 00 00 00 00 00 00 00 00 00 00 00 00 00 00 00 00 00 00 00 00 00 01 01

			/* Initializing Sequence(2)*/
			39 01 00 00 00 00 0B C5 08 00 00 00 00 70 00 00 2D 41
			39 01 00 00 00 00 22 C6 FA 54 D7 00 00 54 D7 00 00 00 00 00 00 00 00 00 00 00 00 00 00 00 00 00 00 00 00 00 00 00 00 80 FA
			39 01 00 00 00 00 2F C7 00 0B 14 22 2F 38 52 65 75 83 38 43 53 6E 7B 87 8D 96 B8 00 0B 14 22 2F 38 52 65 75 83 38 49 59 6E 7B 87 8D 96 B8 00 97 00 97 00 97 00 97
			39 01 00 00 00 00 38 C8 00 00 00 00 00 FC 00 00 00 00 00 FC 00 00 00 00 00 FC 00 00 00 00 00 FC 00 00 00 00 00 FC 00 00 00 00 00 FC 00 00 00 00 00 FC 00 00 00 00 00 FC 00 00 00 00 00 FC 00
			39 01 00 00 00 00 14 C9 00 00 00 00 00 FC 00 00 00 00 00 FC 00 00 00 00 00 FC 00
			39 01 00 00 00 00 2C CA 1D FC FC FC 00 D9 DA 70 00 F0 26 BA 00 9A 00 02 39 D6 00 EE 00 0D 00 00 00 00 00 00 00 00 00 00 00 00 00 00 00 00 00 00 00 00 00
			39 01 00 00 00 00 2E CC D2 72 46 42 12 16 1A 1E 00 D0 70 00 00 00 00 00 00 00 00 00 00 00 00 00 00 00 00 00 00 00 00 00 00 70 D0 00 1C 18 14 10 40 44 72 D2 00

			/* Initializing Sequence(3)*/
			39 01 00 00 00 00 14 CD D3 03 F2 00 00 00 00 00 00 00 00 00 00 00 00 00 01 00 00
			39 01 00 00 00 00 19 CE 7D 40 48 56 67 78 88 98 A7 B5 C3 D1 DE E9 F2 FA FF 3C 00 01 04 45 00 00
			39 01 00 00 00 00 03 CF 48 10
			39 01 00 00 00 00 13 D0 11 04 59 E3 03 10 10 40 19 08 99 00 00 00 00 00 00 00
			39 01 00 00 00 00 02 D1 04
			39 01 00 00 00 00 1C D3 BB 3B 33 3B 44 3B 44 3B 00 00 EC 91 87 23 22 E7 E7 3B BB 4F D0 3C 10 12 10 00 10
			39 01 00 00 00 00 19 D4 80 04 04 33 00 04 00 00 00 00 00 00 00 00 00 00 00 00 0A 90 05 00 64 94
			39 01 00 00 00 00 02 D6 41

		
			39 01 00 00 00 00 25 D7 F6 FF 03 05 43 24 80 1F C7 1F 1B 00 0F 01 20 08 80 3F 00 78 00 40 24 15 00 33 02 C0 AF CB 60 30 FC 00 3F 00
			39 01 00 00 00 00 09 D8 00 00 00 00 00 00 00 00
			39 01 00 00 00 00 05 DD 30 06 23 65
			39 01 00 00 00 00 05 DE 00 FF FF 90

			/* PWM INIT */
			39 01 00 00 00 00 02 53 0C 
			39 01 00 00 00 00 02 5E 30
			39 01 00 00 00 00 02 55 03

			/* Display on Sequence(4) */
			39 01 00 00 00 00 02 11 00
		];
		qcom,mdss-dsi-off-command = [
			/* Display Off and Wait 1 frame = 16.67 ms minimum */
			39 01 00 00 00 00 02 28 00
			39 01 00 00 00 00 02 10 00
		];
		qcom,mdss-dsi-h-back-porch = <40>;
		qcom,mdss-dsi-v-back-porch = <13>;
		qcom,mdss-dsi-v-front-porch = <244>;
		qcom,mdss-dsi-v-pulse-width = <2>;
		qcom,mdss-dsi-h-front-porch = <364>;
		qcom,mdss-dsi-h-pulse-width = <4>;
		qcom,mdss-dsi-h-sync-skew = <0>;
		qcom,mdss-dsi-h-left-border = <0>;
		qcom,mdss-dsi-h-right-border = <0>;
		qcom,mdss-dsi-v-top-border = <0>;
		qcom,mdss-dsi-v-bottom-border = <0>;
		qcom,mdss-dsi-underflow-color = <0xff>;
		qcom,mdss-dsi-border-color = <0>;
		qcom,mdss-dsi-bl-pmic-control-type = "bl_ctrl_dcs";
		qcom,mdss-dsi-bl-min-level = <3>;/*need to check with hw member*/
		qcom,mdss-dsi-bl-max-level = <256>;
		qcom,mdss-brightness-max-level = <256>;
		qcom,mdss-dsi-panel-type = "dsi_video_mode";
		qcom,mdss-dsi-h-sync-pulse = <0>; /*need to check*/
		/*qcom,mdss-dsi-hfp-power-mode;
		qcom,mdss-dsi-hbp-power-mode; */
		qcom,mdss-dsi-bllp-eof-power-mode;
		qcom,mdss-dsi-bllp-power-mode;
		qcom,mdss-dsi-traffic-mode = "burst_mode";
		qcom,mdss-dsi-pixel-packing = "loose";
		qcom,mdss-dsi-virtual-channel-id = <0>;
		qcom,mdss-dsi-color-order = <0>;
		qcom,mdss-dsi-lane-0-state;
		qcom,mdss-dsi-lane-1-state;
		qcom,mdss-dsi-t-clk-post = <0x03>;
		qcom,mdss-dsi-t-clk-pre = <0x25>;
		qcom,mdss-dsi-stream = <0>;
		qcom,mdss-dsi-mdp-trigger = "none";
		qcom,mdss-dsi-dma-trigger = "trigger_sw";
		qcom,mdss-dsi-panel-framerate = <60>;
/*		qcom,mdss-dsi-panel-clockrate = <509000000>;*/
		qcom,mdss-dsi-on-command-state = "dsi_lp_mode";
		qcom,mdss-dsi-off-command-state = "dsi_hs_mode";
		qcom,mdss-pan-physical-width-dimension = <62>;
		qcom,mdss-pan-physical-height-dimension = <110>;
		qcom,mdss-dsi-reset-sequence = <1 10>, <0 20>, <1 200>;
		qcom,mdss-dsi-lp11-init;
		qcom,mdss-dsi-init-delay-us = <100>;
		qcom,mdss-dsi-rx-eot-ignore;
		qcom,mdss-dsi-tx-eot-append;

/*
 * ************************************************************************************************************************************
 *
 *
 *			Below  parameters are samsung dependent thigs
 *
 *
 * ************************************************************************************************************************************
 */
		samsung,panel-vendor = "BOE";
		samsung,tft-common-support;
		samsung,enter_hbm_lux = <20000>;

		samsung,reduce_display_on_time;
		qcom,mdss-dsi-force-clock-lane-hs;
		/*panel swap test*/
		samsung,support_factory_panel_swap;
		samsung,wait_after_reset_delay = <80>; /* Flash loading time */
		samsung,wait_after_sleep_out_delay = <100>; /* 6frame 16.6 * 6 = about 100ms*/
		samsung,mdss-power-off-reset-after-vsp;
		samsung,mdss-power-on-reset-delay-us = <2000>;
		
		samsung,packet_size_tx_cmds_revA = [37 01 00 00 00 00 02 07 00	];

		samsung,display_on_tx_cmds_revA = [39 01 00 00 00 00 02 29 00];

		samsung,display_off_tx_cmds_revA = [05 01 00 00 00 00 02 28 00];

		/*
		 * First parameters can be changed
		 * by function of samsung_nv_read()
		 * because of that means offset of
		 * read position
		 */
		samsung,reg_read_pos_tx_cmds_revA = [
			15 01 00 00 00 00 02 B0 00
		];
		samsung,manufacture_id0_rx_cmds_revA = [06 01 00 00 00 00 01 da 01 00];
		samsung,manufacture_id1_rx_cmds_revA = [06 01 00 00 00 00 01 db 01 00];
		samsung,manufacture_id2_rx_cmds_revA = [06 01 00 00 00 00 01 dc 01 00];

		samsung,mtp_read_sysfs_rx_cmds_revA = [06 01 00 00 00 00 01 00 00 00];

		samsung,tft_pwm_tx_cmds_revA=[39 01 00 00 00 00 02 51 FF	];

		/*
		* ************************************************************************************************************************
		* Scaled level to index mappings
		* ************************************************************************************************************************
		*/
		samsung,candela_map_table_revA = <
		/*<idx>	  <from>  <till> <scaled_level> */
		0		0		0		0
		1		1		1		0
		2		2		2		0
		3		3		3		2
		4		4		4		2
		5		5		5		3
		6		6		6		3
		7		7		7		4
		8		8		8		4
		9		9		9		5
		10		10		10		5
		11		11		11		6
		12		12		12		6
		13		13		13		7
		14		14		14		7
		15		15		15		7
		16		16		16		8
		17		17		17		9
		18		18		18		10
		19		19		19		11
		20		20		20		12
		21		21		21		12
		22		22		22		13
		23		23		23		13
		24		24		24		14
		25		25		25		15
		26		26		26		15
		27		27		27		16
		28		28		28		16
		29		29		29		17
		30		30		30		17
		31		31		31		18
		32		32		32		19
		33		33		33		19
		34		34		34		20
		35		35		35		20
		36		36		36		21
		37		37		37		22
		38		38		38		22
		39		39		39		23
		40		40		40		23
		41		41		41		24
		42		42		42		25
		43		43		43		25
		44		44		44		26
		45		45		45		26
		46		46		46		27
		47		47		47		28
		48		48		48		28
		49		49		49		29
		50		50		50		29
		51		51		51		30
		52		52		52		31
		53		53		53		31
		54		54		54		32
		55		55		55		32
		56		56		56		33
		57		57		57		33
		58		58		58		34
		59		59		59		35
		60		60		60		35
		61		61		61		36
		62		62		62		36
		63		63		63		37
		64		64		64		38
		65		65		65		38
		66		66		66		39
		67		67		67		39
		68		68		68		40
		69		69		69		41
		70		70		70		41
		71		71		71		42
		72		72		72		42
		73		73		73		43
		74		74		74		44
		75		75		75		44
		76		76		76		45
		77		77		77		45
		78		78		78		46
		79		79		79		46
		80		80		80		47
		81		81		81		48
		82		82		82		48
		83		83		83		49
		84		84		84		49
		85		85		85		50
		86		86		86		51
		87		87		87		51
		88		88		88		52
		89		89		89		52
		90		90		90		53
		91		91		91		54
		92		92		92		54
		93		93		93		55
		94		94		94		55
		95		95		95		56
		96		96		96		57
		97		97		97		57
		98		98		98		58
		99		99		99		58
		100		100		100		59
		101		101		101		60
		102		102		102		60
		103		103		103		61
		104		104		104		61
		105		105		105		62
		106		106		106		62
		107		107		107		63
		108		108		108		64
		109		109		109		64
		110		110		110		65
		111		111		111		65
		112		112		112		66
		113		113		113		67
		114		114		114		67
		115		115		115		68
		116		116		116		68
		117		117		117		69
		118		118		118		70
		119		119		119		70
		120		120		120		71
		121		121		121		71
		122		122		122		72
		123		123		123		73
		124		124		124		73
		125		125		125		74
		126		126		126		74
		127		127		127		75
		128		128		128		76
		129		129		129		76
		130		130		130		77
		131		131		131		78
		132		132		132		79
		133		133		133		80
		134		134		134		80
		135		135		135		81
		136		136		136		82
		137		137		137		83
		138		138		138		84
		139		139		139		85
		140		140		140		85
		141		141		141		86
		142		142		142		87
		143		143		143		88
		144		144		144		89
		145		145		145		89
		146		146		146		90
		147		147		147		91
		148		148		148		92
		149		149		149		93
		150		150		150		94
		151		151		151		94
		152		152		152		95
		153		153		153		96
		154		154		154		97
		155		155		155		98
		156		156		156		98
		157		157		157		99
		158		158		158		100
		159		159		159		101
		160		160		160		102
		161		161		161		103
		162		162		162		103
		163		163		163		104
		164		164		164		105
		165		165		165		106
		166		166		166		107
		167		167		167		107
		168		168		168		108
		169		169		169		109
		170		170		170		110
		171		171		171		111
		172		172		172		112
		173		173		173		112
		174		174		174		113
		175		175		175		114
		176		176		176		115
		177		177		177		116
		178		178		178		116
		179		179		179		117
		180		180		180		118
		181		181		181		119
		182		182		182		120
		183		183		183		121
		184		184		184		121
		185		185		185		122
		186		186		186		123
		187		187		187		124
		188		188		188		125
		189		189		189		125
		190		190		190		126
		191		191		191		127
		192		192		192		128
		193		193		193		129
		194		194		194		130
		195		195		195		130
		196		196		196		131
		197		197		197		132
		198		198		198		133
		199		199		199		134
		200		200		200		134
		201		201		201		135
		202		202		202		136
		203		203		203		137
		204		204		204		138
		205		205		205		139
		206		206		206		139
		207		207		207		140
		208		208		208		141
		209		209		209		142
		210		210		210		143
		211		211		211		143
		212		212		212		144
		213		213		213		145
		214		214		214		146
		215		215		215		147
		216		216		216		148
		217		217		217		148
		218		218		218		149
		219		219		219		150
		220		220		220		151
		221		221		221		152
		222		222		222		152
		223		223		223		153
		224		224		224		154
		225		225		225		155
		226		226		226		156
		227		227		227		157
		228		228		228		157
		229		229		229		158
		230		230		230		159
		231		231		231		160
		232		232		232		161
		233		233		233		161
		234		234		234		162
		235		235		235		163
		236		236		236		164
		237		237		237		165
		238		238		238		166
		239		239		239		166
		240		240		240		167
		241		241		241		168
		242		242		242		169
		243		243		243		170
		244		244		244		170
		245		245		245		171
		246		246		246		172
		247		247		247		173
		248		248		248		174
		249		249		249		175
		250		250		250		175
		251		251		251		176
		252		252		252		177
		253		253		253		178
		254		254		254		179
		255		255		255		180
		256		256		256		242
		>;
	};
};
