/* Copyright (c) 2012, Samsung Electronics Corporation. All rights reserved.
 *
 * This program is free software; you can redistribute it and/or modify
 * it under the terms of the GNU General Public License version 2 and
 * only version 2 as published by the Free Software Foundation.
 *
 * This program is distributed in the hope that it will be useful,
 * but WITHOUT ANY WARRANTY; without even the implied warranty of
 * MERCHANTABILITY or FITNESS FOR A PARTICULAR PURPOSE.  See the
 * GNU General Public License for more details.
 */

&mdss_mdp {
	ss_dsi_panel_S6E3HA2_AMS509ES01_WQHD: ss_dsi_panel_S6E3HA2_AMS509ES01_WQHD {
		qcom,mdss-dsi-panel-name = "ss_dsi_panel_S6E3HA2_AMS509ES01_WQHD";
		label = "ss_dsi_panel_S6E3HA2_AMS509ES01_WQHD";
		qcom,mdss-dsi-panel-width = <720>;
		qcom,mdss-dsi-panel-height = <2560>;
		qcom,mdss-dsi-bpp = <24>;
		qcom,mdss-dsi-panel-timings = [FE 56 3C 00 74 88 3C 56 4A 03 04 A0];

		qcom,mdss-dsi-on-command= [
			05 01 00 00 0A 00 01 11 			/* Sleep out, wait 10ms */

			29 00 00 00 05 00 03 F0 5A 5A 		/* TEST KEY1 Enable */
			29 00 00 00 00 00 02 F2 63			/* DUAL DSI ,hsync timing: 453 */
			29 01 00 00 78 00 03 F0 A5 A5		/* TEST KEY1 key Disable  */

			29 00 00 00 00 00 03 F0 5A 5A 		/* TEST KEY1 Enable */
			29 00 00 00 00 00 02 35 00			/* TE Vsync ON */
			29 00 00 00 00 00 07 BD 11 11 02 16 02 16  /* TSP TE */
			29 00 00 00 00 00 05 C0 00 00 D8 D8	/* Pentile setting */

			29 00 00 00 00 00 03 FC 5A 5A 		/* TEST2 KEY enable */
			29 00 00 00 00 00 02 B0 20
			29 00 00 00 00 00 02 FE 08			/* POC setting*/
			29 00 00 00 00 00 03 FC A5 A5 		/* TEST2 KEY Disable */

			29 00 00 00 00 00 02 CC 5C			/* PCD Setting */
			29 00 00 00 00 00 02 ED 44			/* ERR_FG setting */

			29 00 00 00 00 00 03 FC 5A 5A 		/* TEST2 KEY enable */
			29 00 00 00 00 00 02 FD 1C			/* OCS A-type Setting */
			29 00 00 00 00 00 02 FE A0
			29 00 00 00 00 00 02 FE 20
			29 00 00 00 00 00 03 FC A5 A5 		/* TEST2 KEY Disable */

			29 00 00 00 00 00 24				/* Brightness condition set */
				CA
				01 00 01 00 01 00
				80 80 80
				80 80 80
				80 80 80
				80 80 80
				80 80 80
				80 80 80
				80 80 80
				80 80 80
				00 00 00
				00 00

			29 00 00 00 00 00 03 B2 03 10		/* AID 10% */
			29 00 00 00 00 00 03 B6 9C 0A		/* ELVSS Setting:CAPS ON : acl off */
			29 00 00 00 00 00 03 F4 8B 21		/* VINT set */
			29 00 00 00 00 00 02 B5 50			/* CAPS ON : 16 frame avg. at acl off */
			29 00 00 00 00 00 02 55 00			/* acl off */

			29 01 00 00 01 00 02 F7 03			/* Gamma, LTPS(AID) update wait more 100ns */
			29 00 00 00 00 00 02 F7 00

			29 01 00 00 00 00 03 F0 A5 A5		/* TEST KEY key Disable  */
		];

		qcom,mdss-dsi-off-command=[
			05 01 00 00 00 00 02 28 00
			05 01 00 00 78 00 02 10 00	/* wait 120ms(0x78) */
		];

		qcom,cont-splash-enabled;
		qcom,dcs-cmd-by-left;
		/*qcom,cmd-sync-wait-broadcast;*/
		/*qcom,cmd-sync-wait-trigger;*/
		/*qcom,mdss-dsi-fbc-enable=*/
		/*qcom,mdss-dsi-fbc-bpp=*/
		/*qcom,mdss-dsi-fbc-packing=*/
		/*qcom,mdss-dsi-fbc-quant-error=*/
		/*qcom,mdss-dsi-fbc-bias=*/
		/*qcom,mdss-dsi-fbc-pat-mode=*/
		/*qcom,mdss-dsi-fbc-vlc-mode=*/
		/*qcom,mdss-dsi-fbc-bflc-mode=*/
		/*qcom,mdss-dsi-fbc-h-line-budget=*/
		/*qcom,mdss-dsi-fbc-budget-ctrl=*/
		/*qcom,mdss-dsi-fbc-block-budget=*/
		/*qcom,mdss-dsi-fbc-lossless-threshold=*/
		/*qcom,mdss-dsi-fbc-lossy-threshold=*/
		/*qcom,mdss-dsi-fbc-rgb-threshold=*/
		/*qcom,mdss-dsi-fbc-lossy-mode-idx=*/

		qcom,mdss-dsi-h-back-porch = <108>;
		qcom,mdss-dsi-h-front-porch = <16>;
		qcom,mdss-dsi-h-pulse-width = <212>;
		qcom,mdss-dsi-h-sync-skew = <0>;
		qcom,mdss-dsi-v-back-porch = <6>;
		qcom,mdss-dsi-v-front-porch = <10>;
		qcom,mdss-dsi-v-pulse-width = <2>;

		qcom,mdss-dsi-h-left-border = <0>;
		qcom,mdss-dsi-h-right-border = <0>;
		qcom,mdss-dsi-v-top-border = <0>;
		qcom,mdss-dsi-v-bottom-border = <0>;

		qcom,mdss-dsi-underflow-color = <0xFF>;
		qcom,mdss-dsi-border-color = <0>;

		/*qcom,mdss-dsi-pan-enable-dynamic-fps=*/
		/*qcom,mdss-dsi-pan-fps-update=*/

		qcom,mdss-dsi-bl-pmic-control-type = "bl_ctrl_dcs";
		/*qcom,mdss-dsi-bl-pmic-bank-select=*/
		/*qcom,mdss-dsi-bl-pmic-pwm-frequency=*/
		/*qcom,mdss-dsi-pwm-gpio=*/

		qcom,mdss-dsi-bl-min-level = <1>;
		qcom,mdss-dsi-bl-max-level = <255>;
		qcom,mdss-brightness-max-level = <255>;
		qcom,mdss-dsi-interleave-mode = <0>;
		qcom,mdss-dsi-panel-type = "dsi_cmd_mode";

		/*qcom,mdss-dsi-te-check-enable; */
		qcom,mdss-dsi-te-using-te-pin;
		qcom,mdss-dsi-te-pin-select = <1>;

		qcom,mdss-dsi-te-dcs-command = <1>;
		qcom,mdss-dsi-wr-mem-start = <0x2C>;
		qcom,mdss-dsi-wr-mem-continue = <0x3C>;

		/* CMD mode panel doesn't need below stuff */
		/*qcom,mdss-dsi-h-sync-pulse=*/
		/*qcom,mdss-dsi-hfp-power-mode=*/
		/*qcom,mdss-dsi-hbp-power-mode=*/
		/*qcom,mdss-dsi-hsa-power-mode=*/
		/*qcom,mdss-dsi-last-line-interleave=*/
		/*qcom,mdss-dsi-bllp-eof-power-mode=*/
		/*qcom,mdss-dsi-bllp-power-mode=*/
		/*qcom,mdss-dsi-traffic-mode=*/

		qcom,mdss-dsi-pixel-packing = "loose";

		qcom,mdss-dsi-virtual-channel-id = <0>;
		qcom,mdss-dsi-color-order = "rgb_swap_rgb";
		qcom,mdss-dsi-lane-0-state;
		qcom,mdss-dsi-lane-1-state;
		qcom,mdss-dsi-lane-2-state;
		qcom,mdss-dsi-lane-3-state;
		qcom,mdss-dsi-lane-map = "lane_map_0123";

		qcom,mdss-dsi-t-clk-pre = <0x34>;
		qcom,mdss-dsi-t-clk-post = <0x0E>;

		qcom,mdss-dsi-stream = <0>;
		qcom,mdss-dsi-mdp-trigger = "none";
		qcom,mdss-dsi-dma-trigger = "trigger_sw";
		qcom,mdss-dsi-panel-framerate = <60>;
		/*qcom,mdss-dsi-panel-clockrate = <980500000>;*/
		qcom,mdss-dsi-on-command-state = "dsi_lp_mode";
		qcom,mdss-dsi-off-command-state = "dsi_hs_mode";

		qcom,mdss-pan-physical-width-dimension = <72>;
		qcom,mdss-pan-physical-height-dimension = <126>;

		qcom,mdss-dsi-panel-mode-gpio-state = "invalid";

		/*qcom,mdss-tear-check-disable*/
		//qcom,mdss-tear-check-sync-cfg-height = <2576>;
		/*qcom,mdss-tear-check-sync-init-val=*/
		/*qcom,mdss-tear-check-sync-threshold-start=*/
		/*qcom,mdss-tear-check-sync-threshold-continue=*/
		/*qcom,mdss-tear-check-start-pos=*/
		/*qcom,mdss-tear-check-rd-ptr-trigger-intr=*/
		/*qcom,mdss-tear-check-frame-rate=*/

		qcom,mdss-dsi-reset-sequence = <1 5>, <0 5>, <1 5>;
		qcom,partial-update-enabled;
		qcom,partial-update-roi-merge;
		qcom,panel-roi-alignment=<8 1 8 1 8 1>;
		/*qcom,mdss-dsi-horizontal-line-idle*/

		qcom,mdss-dsi-lp11-init;
		qcom,mdss-dsi-init-delay-us = <1000>;

		qcom,mdss-dsi-rx-eot-ignore;
		qcom,mdss-dsi-tx-eot-append;

		qcom,ulps-enabled;
		/*qcom,suspend-ulps-enabled;*/
		/*qcom,esd-check-enabled*/
		/*qcom,mdss-dsi-panel-status-command=*/
		/*qcom,mdss-dsi-panel-status-command-mode="dsi_lp_mode";*/
		/*qcom,mdss-dsi-panel-status-check-mode="reg_read";*/
		/*qcom,mdss-dsi-panel-status-value=<1>;*/
		/*qcom,dynamic-mode-switch-enabled*/
		/*qcom,video-to-cmd-mode-switch-commands=*/
		/*qcom,cmd-to-video-mode-switch-commands=*/

/*
* ************************************************************************************************************************************
*
*
*			Below  parameters are samsung dependent thigs
*
*
* ************************************************************************************************************************************
*/
		samsung,support_panel_max = <1>;
		samsung,hw-config = "split_dsi";
		samsung,enter_hbm_lux = <10000>;

		/*
		 * ************************************************************************************************************************
		 *   APLPM
		 * ************************************************************************************************************************
		 */
		samsung,alpm_on_tx_cmds_revA = [
			29 01 00 00 00 00 03 F0 5A 5A		/* TEST KEY Enable */
			05 01 00 00 14 00 02 28 00			/* display off wait 20ms */

			29 01 00 00 14 00 02 53 23			/* alpm on wait 20ms */

			29 01 00 00 01 00 02 F7 03		/* Gamma, LTPS(AID) update */
			29 01 00 00 00 00 02 F7 00
			29 01 00 00 00 00 03 F0 A5 A5
		];
		samsung,alpm_off_tx_cmds_revA = [
			29 01 00 00 00 00 03 F0 5A 5A		/* TEST KEY Disable */
			05 01 00 00 14 00 02 28 00			/* display off wait 20ms */

			/* image write for normal mode */

			29 01 00 00 14 00 02 53 00			/* alpm off */
			29 01 00 00 01 00 02 F7 03		/* Gamma, LTPS(AID) update */
			29 01 00 00 00 00 02 F7 00
			29 01 00 00 00 00 03 F0 A5 A5
		];

		/*
		the last byte in read commands	represent READ LENGH,
		like below  READ LENGH = 0x21
		*/
		samsung,level1_key_enable_tx_cmds_revA = [
			29 01 00 00 00 00 03 F0 5A 5A
		];
		samsung,level1_key_disable_tx_cmds_revA = [
			29 01 00 00 00 00 03 F0 A5 A5
		];
		samsung,level2_key_enable_tx_cmds_revA = [
			29 01 00 00 00 00 03 F2 5A 5A
		];
		samsung,level2_key_disable_tx_cmds_revA = [
			29 01 00 00 00 00 03 F2 A5 A5
		];

		samsung,packet_size_tx_cmds_revA = [
			37 01 00 00 00 00 02 07 00
		];

		samsung,reg_read_pos_tx_cmds_revA = [
			15 01 00 00 00 00 02 B0 00
		];

		samsung,smart_dimming_mtp_rx_cmds_revA = [ 06 01 00 00 00 00 01 c8 23 00];
		samsung,hbm_rx_cmds_revA = [ 06 01 00 00 00 00 01 c8 07 21];	/* read C8 34~40th , 33=0x21*/ /*not needed :joann*/
		samsung,hbm2_rx_cmds_revA = [ 06 01 00 00 00 00 01 c8 0F 48];	/* read C8 73~87th , 72=0x48*//*not needed :joann*/
		samsung,mdnie_read_rx_cmds_revA = [ 06 01 00 00 00 00 01 A1 04 00];
		samsung,elvss_rx_cmds_revA = [ 06 01 00 00 00 00 01 b6 01 15];	/* read C6 22th , 21=0x15*/

		/* the last byte in all read commands will represent READ LENGH */
		samsung,manufacture_read_pre_tx_cmds_revA = [
			05 01 00 00 05 00 01 11
			29 01 00 00 00 00 03 F0 5A 5A

			29 01 00 00 78 00 02 F2 63	/* DUAL DSI */
		];

		samsung,manufacture_id0_rx_cmds_revA = [ 06 01 00 00 00 00 01 da 01 00];
		samsung,manufacture_id1_rx_cmds_revA = [ 06 01 00 00 00 00 01 db 01 00];
		samsung,manufacture_id2_rx_cmds_revA = [ 06 01 00 00 00 00 01 dc 01 00];

		samsung,manufacture_date_rx_cmds_revA = [ 06 01 00 00 00 00 01 c8 04 28];	/* read C8 41~44th , 40=0x28*/

		samsung,cell_id_rx_cmds_revA = [ 06 01 00 00 00 00 01 C8 07 28]; /* read C8 41th~47th */

		samsung,ddi_id_rx_cmds_revA = [ 06 01 00 00 00 00 01 d6 05 00]; /* read D6 1~5th */

		samsung,ldi_debug0_rx_cmds_revA = [06 01 00 00 00 00 01 0A 01 00];
		samsung,ldi_debug1_rx_cmds_revA = [06 01 00 00 00 00 01 0E 01 00];
		samsung,ldi_debug2_rx_cmds_revA = [06 01 00 00 00 00 01 EA 08 00];

		samsung,ldi_fps_change_tx_cmds_revA = [
			29 00 00 00 00 00 03 F0 5A 5A
			29 00 00 00 00 00 03 FC 5A 5A
			29 00 00 00 00 00 04 F2 63 41 C5	/* C5 => hsync timing: 453*/
			29 00 00 00 00 00 03 F0 A5 A5
			29 01 00 00 00 00 03 FC A5 A5
		];

		samsung,ldi_fps_rx_cmds_revA = [06 01 00 00 00 00 01 D7 01 1A]; /* read D7 27th , 27=0x1B*/

		samsung,mtp_read_sysfs_rx_cmds_revA = [ 06 01 00 00 00 00 01 00 00 00];

		samsung,display_on_tx_cmds_revA = [05 01 00 00 32 00 02 29 00];
		samsung,display_off_tx_cmds_revA = [05 01 00 00 32 00 02 28 00];

		samsung,elvss_lowtemp_tx_cmds_revA = [
			29 01 00 00 00 00 02 B0 07
			29 01 00 00 00 00 02 B8 00
		];	/* Low Temperature Command */

		samsung,elvss_lowtemp2_tx_cmds_revA = [
			29 01 00 00 00 00 02 B0 15
			29 01 00 00 00 00 02 B6 00
		];	/* Low Temperature Command: default */

		samsung,gamma_tx_cmds_revA = [
			29 01 00 00 00 00 24		/* Brightness Condition Set - Gamma 2.2 Setting*/
			CA 01 00 01 00 01 00 80
			80 80 80 80 80 80 80 80
			80 80 80 80 80 80 80 80
			80 80 80 80 80 80 80 00
			00 00 00 00
			29 01 00 00 00 00 02 F7 03		/* Gamma, LTPS(AID) update */

			29 01 00 00 00 00 3C		/* dummy for single transmission more 100ns delay */
			00 00 00 00 00 00 00 00 00 00
			00 00 00 00 00 00 00 00 00 00
			00 00 00 00 00 00 00 00 00 00
			00 00 00 00 00 00 00 00 00 00
			00 00 00 00 00 00 00 00 00 00
			00 00 00 00 00 00 00 00 00 00

			29 01 00 00 00 00 02 F7 00
		];

		samsung,hbm_gamma_tx_cmds_revA = [
			29 01 00 00 00 00 24		/* Brightness Condition Set - Gamma 2.2 Setting*/
			CA 01 00 01 00 01 00 80
			80 80 80 80 80 80 80 80
			80 80 80 80 80 80 80 80
			80 80 80 80 80 80 80 00
			00 00 00 00
		];

		samsung,hbm_etc_tx_cmds_revA = [
			29 01 00 00 00 00 03 B6 8C 0A		/* ELVSS Setting */
			29 01 00 00 00 00 03 F4 8B 21		/* VINT set*/
			15 01 00 00 00 00 02 B5 50		/* 32 frame avg.*/
			15 01 00 00 00 00 02 53 C0		/* HBM on*/
		];

		samsung,panel-hbm-off-cmds_revA = [
			15 01 00 00 00 00 02 53 00		/* HBM off*/
		];

		/*
		* ************************************************************************************************************************
		* AID command list and mappings
		* ************************************************************************************************************************
		*/
		samsung,aid_tx_cmds_revA = [
			29 01 00 00 00 00 03 B2 DF 90  /* 98.1% 2CD 0 */
			29 01 00 00 00 00 03 B2 C6 90  /* 97.13% 3CD 1 */
			29 01 00 00 00 00 03 B2 B2 90  /* 96.35% 4CD 2 */
			29 01 00 00 00 00 03 B2 97 90  /* 95.3% 5CD 3 */
			29 01 00 00 00 00 03 B2 85 90  /* 94.6% 6CD 4 */
			29 01 00 00 00 00 03 B2 6B 90  /* 93.59% 7CD 5 */
			29 01 00 00 00 00 03 B2 57 90  /* 92.82% 8CD 6 */
			29 01 00 00 00 00 03 B2 3D 90  /* 91.81% 9CD 7 */
			29 01 00 00 00 00 03 B2 32 90  /* 91.38% 10CD 8 */
			29 01 00 00 00 00 03 B2 18 90  /* 90.37% 11CD 9 */
			29 01 00 00 00 00 03 B2 07 90  /* 89.71% 12CD 10 */
			29 01 00 00 00 00 03 B2 F3 80  /* 88.94% 13CD 11 */
			29 01 00 00 00 00 03 B2 DC 80  /* 88.04% 14CD 12 */
			29 01 00 00 00 00 03 B2 C6 80  /* 87.19% 15CD 13 */
			29 01 00 00 00 00 03 B2 B2 80  /* 86.41% 16CD 14 */
			29 01 00 00 00 00 03 B2 99 80  /* 85.44% 17CD 15 */
			29 01 00 00 00 00 03 B2 6C 80  /* 83.7% 19CD 16 */
			29 01 00 00 00 00 03 B2 57 80  /* 82.88% 20CD 17 */
			29 01 00 00 00 00 03 B2 44 80  /* 82.14% 21CD 18 */
			29 01 00 00 00 00 03 B2 2A 80  /* 81.13% 22CD 19 */
			29 01 00 00 00 00 03 B2 02 80  /* 79.58% 24CD 20 */
			29 01 00 00 00 00 03 B2 E8 70  /* 78.57% 25CD 21 */
			29 01 00 00 00 00 03 B2 C1 70  /* 77.06% 27CD 22 */
			29 01 00 00 00 00 03 B2 92 70  /* 75.23% 29CD 23 */
			29 01 00 00 00 00 03 B2 76 70  /* 74.15% 30CD 24 */
			29 01 00 00 00 00 03 B2 4B 70  /* 72.48% 32CD 25 */
			29 01 00 00 00 00 03 B2 22 70  /* 70.89% 34CD 26 */
			29 01 00 00 00 00 03 B2 CF 60  /* 67.66% 37CD 27 */
			29 01 00 00 00 00 03 B2 B0 60  /* 66.46% 39CD 28 */
			29 01 00 00 00 00 03 B2 7E 60  /* 64.52% 41CD 29 */
			29 01 00 00 00 00 03 B2 37 60  /* 61.76% 44CD 30 */
			29 01 00 00 00 00 03 B2 F4 50  /* 59.16% 47CD 31 */
			29 01 00 00 00 00 03 B2 B1 50  /* 56.56% 50CD 32 */
			29 01 00 00 00 00 03 B2 64 50  /* 53.57% 53CD 33 */
			29 01 00 00 00 00 03 B2 18 50  /* 50.62% 56CD 34 */
			29 01 00 00 00 00 03 B2 BE 40  /* 47.13% 60CD 35 */
			29 01 00 00 00 00 03 B2 63 40  /* 43.59% 64CD 36 */
			29 01 00 00 00 00 03 B2 F8 30  /* 39.44% 68CD 37 */
			29 01 00 00 00 00 03 B2 A0 30  /* 36.02% 72CD 38 */
			29 01 00 00 00 00 03 B2 A0 30  /* 36.02% 77CD 39 */
			29 01 00 00 00 00 03 B2 A0 30  /* 36.02% 82CD 40 */
			29 01 00 00 00 00 03 B2 A0 30  /* 36.02% 87CD 41 */
			29 01 00 00 00 00 03 B2 A0 30  /* 36.02% 93CD 42 */
			29 01 00 00 00 00 03 B2 A0 30  /* 36.02% 98CD 43 */
			29 01 00 00 00 00 03 B2 A0 30  /* 36.02% 105CD 44 */
			29 01 00 00 00 00 03 B2 A0 30  /* 36.02% 111CD 45 */
			29 01 00 00 00 00 03 B2 A0 30  /* 36.02% 119CD 46 */
			29 01 00 00 00 00 03 B2 A0 30  /* 36.02% 126CD 47 */
			29 01 00 00 00 00 03 B2 A0 30  /* 36.02% 134CD 48 */
			29 01 00 00 00 00 03 B2 A0 30  /* 36.02% 143CD 49 */
			29 01 00 00 00 00 03 B2 A0 30  /* 36.02% 152CD 50 */
			29 01 00 00 00 00 03 B2 A0 30  /* 36.02% 162CD 51 */
			29 01 00 00 00 00 03 B2 A0 30  /* 36.02% 172CD 52 */
			29 01 00 00 00 00 03 B2 A0 30  /* 36.02% 183CD 53 */
			29 01 00 00 00 00 03 B2 1C 30  /* 30.9% 195CD 54 */
			29 01 00 00 00 00 03 B2 A3 20  /* 26.2% 207CD 55 */
			29 01 00 00 00 00 03 B2 0B 20  /* 20.3% 220CD 56 */
			29 01 00 00 00 00 03 B2 75 10  /* 14.48% 234CD 57 */
			29 01 00 00 00 00 03 B2 03 10  /* 10.05% 249CD 58 */
			29 01 00 00 00 00 03 B2 03 10  /* 10.05% 265CD 59 */
			29 01 00 00 00 00 03 B2 03 10  /* 10.05% 282CD 60 */
			29 01 00 00 00 00 03 B2 03 10  /* 10.05% 300CD 61 */
			29 01 00 00 00 00 03 B2 03 10  /* 10.05% 316CD 62 */
			29 01 00 00 00 00 03 B2 03 10  /* 10.05% 333CD 63 */
			29 01 00 00 00 00 03 B2 03 10  /* 10.05% 360CD 64 */
		];

		/* bl_level, Index in acl command list */
		samsung,aid_map_table_revA = <
			2	0		3	1		4	2		5	3		6	4
			7	5		8	6		9	7		10	8		11	9
			12	10		13	11		14	12		15	13		16	14
			17	15		19	16		20	17		21	18		22	19
			24	20		25	21		27	22		29	23		30	24
			32	25		34	26		37	27		39	28		41	29
			44	30		47	31		50	32		53	33		56	34
			60	35		64	36		68	37		72	38		77	39
			82	40		87	41		93	42		98	43		105	44
			111	45		119	46		126	47		134	48		143	49
			152	50		162	51		172	52		183	53		195	54
			207	55		220	56		234	57		249	58		265	59
			282	60		300	61		316	62		333	63		360	64
		>;

		/*
		* ************************************************************************************************************************
		* ACL command list and mappings
		* ************************************************************************************************************************
		*/
		samsung,acl_on_tx_cmds_revA = [29 01 00 00 00 00 02 B5 50]; /* ACL on, B5 <- 0x51 */

		samsung,acl_percent_tx_cmds_revA = [
			29 01 00 00 00 00 02 55 00
			29 01 00 00 00 00 02 55 01
			29 01 00 00 00 00 02 55 02	/* default ACL 8% */
			29 01 00 00 00 00 02 55 03
		];	/* ACL 50% */

		samsung,acl_off_tx_cmds_revA = [
			29 01 00 00 00 00 02 B5 40   /* ACL OFF - 41 (16Frame Averaging) */
			29 01 00 00 00 00 02 55 00
		];/*off, b5<-0x41*/

		/* bl_level , Index in acl command list */
		samsung,acl_map_table_revA =  <
			2	2		3	2		4	2		5	2		6	2
			7	2		8	2		9	2		10	2		11	2
			12	2		13	2		14	2		15	2		16	2
			17	2		19	2		20	2		21	2		22	2
			24	2		25	2		27	2		29	2		30	2
			32	2		34	2		37	2		39	2		41	2
			44	2		47	2		50	2		53	2		56	2
			60	2		64	2		68	2		72	2		77	2
			82	2		87	2		93	2		98	2		105	2
			111	2		119	2		126	2		134	2		143	2
			152	2		162	2		172	2		183	2		195	2
			207	2		220	2		234	2		249	2		265	2
			282	2		300	2		316	2		333	2		360	2
		>;
		/*
		* ************************************************************************************************************************
		* ELVSS(ACL Off) command list and mappings
		* ************************************************************************************************************************
		*/
		samsung,elvss_tx_cmds_revA = [
			29 01 00 00 00 00 03 b6 9C 0A /* 360CD 0 */
			29 01 00 00 00 00 03 b6 9C 0B /* 333CD 1 */
			29 01 00 00 00 00 03 b6 9C 0B /* 316CD 2 */
			29 01 00 00 00 00 03 b6 9C 0C /* 300CD 3 */
			29 01 00 00 00 00 03 b6 9C 0D /* 282CD 4 */
			29 01 00 00 00 00 03 b6 9C 0D /* 265CD 5 */
			29 01 00 00 00 00 03 b6 9C 0E /* 249CD 6 */
			29 01 00 00 00 00 03 b6 9C 0F /* 234CD 7 */
			29 01 00 00 00 00 03 b6 9C 0F /* 220CD 8 */
			29 01 00 00 00 00 03 b6 9C 0F /* 207CD 9 */
			29 01 00 00 00 00 03 b6 9C 0F /* 195CD 10 */
			29 01 00 00 00 00 03 b6 9C 0F /* 183CD 11 */
			29 01 00 00 00 00 03 b6 9C 0F /* 172CD 12 */
			29 01 00 00 00 00 03 b6 9C 10 /* 162CD 13 */
			29 01 00 00 00 00 03 b6 9C 10 /* 152CD 14 */
			29 01 00 00 00 00 03 b6 9C 11 /* 143CD 15 */
			29 01 00 00 00 00 03 b6 9C 12 /* 134CD 16 */
			29 01 00 00 00 00 03 b6 9C 12 /* 126CD 17 */
			29 01 00 00 00 00 03 b6 9C 13 /* 119CD 18 */
			29 01 00 00 00 00 03 b6 9C 13 /* 110CD 19 */
			29 01 00 00 00 00 03 b6 9C 14 /* 105CD 20 */
			29 01 00 00 00 00 03 b6 9C 14 /* 98CD 21 */
			29 01 00 00 00 00 03 b6 9C 14 /* 93CD 22 */
			29 01 00 00 00 00 03 b6 9C 15 /* 87CD 23 */
			29 01 00 00 00 00 03 b6 9C 15 /* 82CD 24 */
			29 01 00 00 00 00 03 b6 9C 15 /* 77CD 25 */
			29 01 00 00 00 00 03 b6 9C 16 /* 2 ~ 72CD 26 */
		];

		/*
		* ************************************************************************************************************************
		* SMART ACL(ACL On) ELVSS command list and mappings
		* ************************************************************************************************************************
		*/

		/* 0xB6 address second parameter value*/
		samsung,smart_acl_elvss_tx_cmds_revA = [
			29 01 00 00 00 00 03 b6 8C 0A /* 360CD 0 */
			29 01 00 00 00 00 03 b6 8C  0B /* 333CD 1 */
			29 01 00 00 00 00 03 b6 8C  0B /* 316CD 2 */
			29 01 00 00 00 00 03 b6 8C  0C /* 300CD 3 */
			29 01 00 00 00 00 03 b6 8C  0D /* 282CD 4 */
			29 01 00 00 00 00 03 b6 8C  0D /* 265CD 5 */
			29 01 00 00 00 00 03 b6 8C  0E /* 249CD 6 */
			29 01 00 00 00 00 03 b6 8C  0F /* 234CD 7 */
			29 01 00 00 00 00 03 b6 8C  0F /* 220CD 8 */
			29 01 00 00 00 00 03 b6 8C  0F /* 207CD 9 */
			29 01 00 00 00 00 03 b6 8C  0F /* 195CD 10 */
			29 01 00 00 00 00 03 b6 8C  0F /* 183CD 11 */
			29 01 00 00 00 00 03 b6 8C  0F /* 172CD 12 */
			29 01 00 00 00 00 03 b6 8C  10 /* 162CD 13 */
			29 01 00 00 00 00 03 b6 8C  10 /* 152CD 14 */
			29 01 00 00 00 00 03 b6 8C  11 /* 143CD 15 */
			29 01 00 00 00 00 03 b6 8C  12 /* 134CD 16 */
			29 01 00 00 00 00 03 b6 8C  12 /* 126CD 17 */
			29 01 00 00 00 00 03 b6 8C  13 /* 119CD 18 */
			29 01 00 00 00 00 03 b6 8C  13 /* 110CD 19 */
			29 01 00 00 00 00 03 b6 8C  14 /* 105CD 20 */
			29 01 00 00 00 00 03 b6 8C  14 /* 98CD 21 */
			29 01 00 00 00 00 03 b6 8C  14 /* 93CD 22 */
			29 01 00 00 00 00 03 b6 8C  15 /* 87CD 23 */
			29 01 00 00 00 00 03 b6 8C  15 /* 82CD 24 */
			29 01 00 00 00 00 03 b6 8C  15 /* 77CD 25 */
			29 01 00 00 00 00 03 b6 8C  16 /* 2 ~ 72CD 26 */
		];

		/* bl_level, Index in elvss command list */
		samsung,smart_acl_elvss_map_table_revA = <
			2	26		3	26		4	26		5	26		6	26
			7	26		8	26		9	26		10	26		11	26
			12	26		13	26		14	26		15	26		16	26
			17	26		19	26		20	26		21	26		22	26
			24	26		25	26		27	26		29	26		30	26
			32	26		34	26		37	26		39	26		41	26
			44	26		47	26		50	26		53	26		56	26
			60	26		64	26		68	26		72	26		77	25
			82	24		87	23		93	22		98	21		105	20
			111	19		119	18		126	17		134	16		143	15
			152	14		162	13		172	12		183	11		195	10
			207	9		220	8		234	7		249	6		265	5
			282	4		300	3		316	2		333	1		360	0
		>;
		/*
		* ************************************************************************************************************************
		* candela to index mappings
		* ************************************************************************************************************************
		*/
		samsung,candela_map_table_revA = <
		/*<idx>   <from>  <till> <candella> */
			0	2	2	2
			1	3	6	3
			2	7	10	4
			3	11	14	5
			4	15	18	6
			5	19	22	7
			6	23	26	8
			7	27	30	9
			8	31	34	10
			9	35	38	11
			10	39	42	12
			11	43	46	13
			12	47	50	14
			13	51	54	15
			14	55	58	16
			15	59	62	17
			16	63	66	19
			17	67	70	20
			18	71	74	21
			19	75	78	22
			20	79	82	24
			21	83	86	25
			22	87	90	27
			23	91	94	29
			24	95	98	30
			25	99	102	32
			26	103	106	34
			27	107	110	37
			28	111	114	39
			29	115	118	41
			30	119	122	44
			31	123	126	47
			32	127	130	50
			33	131	133	53
			34	134	137	56
			35	138	141	60
			36	142	145	64
			37	146	149	68
			38	150	153	72
			39	154	157	77
			40	158	161	82
			41	162	165	87
			42	166	169	93
			43	170	173	98
			44	174	177	105
			45	178	181	111
			46	182	185	119
			47	186	189	126
			48	190	193	134
			49	194	197	143
			50	198	201	152
			51	202	205	162
			52	206	209	172
			53	210	213	183
			54	214	217	195
			55	218	221	207
			56	222	225	220
			57	226	229	234
			58	230	233	249
			59	234	237	265
			60	238	241	282
			61	242	245	300
			62	246	249	316
			63	250	254	333
			64	255	255	360
		>;

		/* HMT */

		samsung,hmt_enabled;

		samsung,hmt_aid_tx_cmds_revA = [
			29 01 00 00 00 00 07 B2 03 12 03 00 00 00	/* 20cd */
			29 01 00 00 00 00 07 B2 03 12 03 00 00 00	/* 21cd */
			29 01 00 00 00 00 07 B2 03 12 03 00 00 00	/* 22cd */
			29 01 00 00 00 00 07 B2 03 12 03 00 00 00	/* 23cd */
			29 01 00 00 00 00 07 B2 03 12 03 00 00 00	/* 25cd */
			29 01 00 00 00 00 07 B2 03 12 03 00 00 00	/* 27cd */
			29 01 00 00 00 00 07 B2 03 12 03 00 00 00	/* 29cd */
			29 01 00 00 00 00 07 B2 03 12 03 00 00 00	/* 31cd */
			29 01 00 00 00 00 07 B2 03 12 03 00 00 00	/* 33cd */
			29 01 00 00 00 00 07 B2 03 12 03 00 00 00	/* 35cd */
			29 01 00 00 00 00 07 B2 03 12 03 00 00 00	/* 37cd */
			29 01 00 00 00 00 07 B2 03 12 03 00 00 00	/* 39cd */
			29 01 00 00 00 00 07 B2 03 12 03 00 00 00	/* 41cd */
			29 01 00 00 00 00 07 B2 03 12 03 00 00 00	/* 44cd */
			29 01 00 00 00 00 07 B2 03 12 03 00 00 00	/* 47cd */
			29 01 00 00 00 00 07 B2 03 12 03 00 00 00	/* 50cd */
			29 01 00 00 00 00 07 B2 03 12 03 00 00 00	/* 53cd */
			29 01 00 00 00 00 07 B2 03 12 03 00 00 00	/* 56cd */
			29 01 00 00 00 00 07 B2 03 12 03 00 00 00	/* 60cd */
			29 01 00 00 00 00 07 B2 03 12 03 00 00 00	/* 64cd */
			29 01 00 00 00 00 07 B2 03 12 03 00 00 00	/* 68cd */
			29 01 00 00 00 00 07 B2 03 12 03 00 00 00	/* 72cd */
			29 01 00 00 00 00 07 B2 03 13 04 00 00 00	/* 77cd */
			29 01 00 00 00 00 07 B2 03 13 04 00 00 00	/* 82cd */
			29 01 00 00 00 00 07 B2 03 13 04 00 00 00	/* 87cd */
			29 01 00 00 00 00 07 B2 03 13 04 00 00 00	/* 93cd */
			29 01 00 00 00 00 07 B2 03 13 04 00 00 00	/* 99cd */
			29 01 00 00 00 00 07 B2 03 13 04 00 00 00	/* 105cd */
		];

		/* bl_level, Index in acl command list */
		samsung,hmt_reverse_aid_map_table_revA = <
			20 0
			21 1
			22 2
			23 3
			25 4
			27 5
			29 6
			31 7
			33 8
			35 9
			37 10
			39 11
			41 12
			44 13
			47 14
			50 15
			53 16
			56 17
			60 18
			64 19
			68 20
			72 21
			77 22
			82 23
			87 24
			93 25
			99 26
			105 27
		>;

		samsung,hmt_candela_map_table_revA = <
		/*<idx>   <from>  <till> <candella> */
			0	0	9	20
			1	10	19	21
			2	20	29	22
			3	30	39	23
			4	40	49	25
			5	50	59	27
			6	60	68	29
			7	69	77	31
			8	78	86	33
			9	87	95	35
			10	96	104	37
			11	105	113	39
			12	114	122	41
			13	123	131	44
			14	132	140	47
			15	141	149	50
			16	150	158	53
			17	159	167	56
			18	168	176	60
			19	177	185	64
			20	186	194	68
			21	195	203	72
			22	204	212	77
			23	213	221	82
			24	222	230	87
			25	231	239	93
			26	240	248	99
			27	249	255	105
		>;

		samsung,hmt_150cd_rx_cmds_revA = [06 01 00 00 00 00 01 B4 1E 01];	/* read B4 2~31th , 1=0x01*/

		samsung,hmt_gamma_tx_cmds_revA = [
			29 01 00 00 00 00 24
				CA 01 00 01 00 01 00 80
				80 80 80 80 80 80 80 80
				80 80 80 80 80 80 80 80
				80 80 80 80 80 80 80 00
				00 00 00 00
			29 01 00 00 00 00 02 F7 03		/* Gamma, LTPS(AID) update */

			29 01 00 00 00 00 3C		/* dummy for single transmission more 100ns delay */
			00 00 00 00 00 00 00 00 00 00
			00 00 00 00 00 00 00 00 00 00
			00 00 00 00 00 00 00 00 00 00
			00 00 00 00 00 00 00 00 00 00
			00 00 00 00 00 00 00 00 00 00
			00 00 00 00 00 00 00 00 00 00

			29 01 00 00 00 00 02 F7 00
		];

		samsung,hmt_elvss_tx_cmds_revA = [
				29 01 00 00 00 00 03 B6 00 0A
		];

		samsung,hmt_vint_tx_cmds_revA = [
				29 01 00 00 00 00 03 F4 8B 21
		];

		samsung,hmt_enable_tx_cmds_revA = [
				29 01 00 00 00 00 03 F0 5A 5A
				29 01 00 00 00 00 02 B0 03
				29 01 00 00 00 00 03 F2 0A 06
				29 01 00 00 00 00 02 B0 05
				29 01 00 00 00 00 02 B2 00
				29 01 00 00 00 00 02 B0 06
				29 01 00 00 00 00 02 F3 10
				29 01 00 00 00 00 05 2B 00 00 09 FF
				29 01 00 00 00 00 03 F0 A5 A5
			];

		samsung,hmt_disable_tx_cmds_revA = [
				29 01 00 00 00 00 03 F0 5A 5A
				29 01 00 00 00 00 02 B0 03
				29 01 00 00 00 00 03 F2 06 0A
				29 01 00 00 00 00 02 B0 05
				29 01 00 00 00 00 02 B2 40
				29 01 00 00 00 00 02 F7 03

				29 01 00 00 00 00 3C		/* dummy for single transmission more 100ns delay */
				00 00 00 00 00 00 00 00 00 00
				00 00 00 00 00 00 00 00 00 00
				00 00 00 00 00 00 00 00 00 00
				00 00 00 00 00 00 00 00 00 00
				00 00 00 00 00 00 00 00 00 00
				00 00 00 00 00 00 00 00 00 00

				29 01 00 00 00 00 02 F7 00
				29 01 00 00 00 00 03 F0 A5 A5
			];
		samsung,hmt_reverse_enable_tx_cmds_revA = [
				29 01 00 00 00 00 03 F0 5A 5A
				29 01 00 00 00 00 02 B0 09
				29 01 00 00 00 00 02 CB 0B
				29 01 00 00 00 00 02 B0 0F
				29 01 00 00 00 00 02 CB 09
				29 01 00 00 00 00 02 B0 1D
				29 01 00 00 00 00 02 CB 10
				29 01 00 00 00 00 02 B0 3D
				29 01 00 00 00 00 02 CB 0C
				29 01 00 00 00 00 02 F7 03

				29 01 00 00 00 00 3C		/* dummy for single transmission more 100ns delay */
				00 00 00 00 00 00 00 00 00 00
				00 00 00 00 00 00 00 00 00 00
				00 00 00 00 00 00 00 00 00 00
				00 00 00 00 00 00 00 00 00 00
				00 00 00 00 00 00 00 00 00 00
				00 00 00 00 00 00 00 00 00 00

				29 01 00 00 00 00 02 F7 00
				29 01 00 00 00 00 03 F0 A5 A5
			];
		samsung,hmt_reverse_disable_tx_cmds_revA = [
				29 01 00 00 00 00 03 F0 5A 5A
				29 01 00 00 00 00 02 B0 09
				29 01 00 00 00 00 02 CB 09
				29 01 00 00 00 00 02 B0 0F
				29 01 00 00 00 00 02 CB 05
				29 01 00 00 00 00 02 B0 3D
				29 01 00 00 00 00 02 CB 0B
				29 01 00 00 00 00 02 F7 03

				29 01 00 00 00 00 3C		/* dummy for single transmission more 100ns delay */
				00 00 00 00 00 00 00 00 00 00
				00 00 00 00 00 00 00 00 00 00
				00 00 00 00 00 00 00 00 00 00
				00 00 00 00 00 00 00 00 00 00
				00 00 00 00 00 00 00 00 00 00
				00 00 00 00 00 00 00 00 00 00

				29 01 00 00 00 00 02 F7 00
				29 01 00 00 00 00 03 F0 A5 A5
			];
	};
};
