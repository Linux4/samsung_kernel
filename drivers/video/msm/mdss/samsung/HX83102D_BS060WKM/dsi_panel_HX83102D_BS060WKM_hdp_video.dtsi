/* Copyright (c) 2013-14, Samsung Electronics Corporation. All rights reserved.
 *
 * This program is free software; you can redistribute it and/or modify
 * it under the terms of the GNU General Public License version 2 and
 * only version 2 as published by the Free Software Foundation.
 *
 * This program is distributed in the hope that it will be useful,
 * but WITHOUT ANY WARRANTY; without even the implied warranty of
 * MERCHANTABILITY or FITNESS FOR A PARTICULAR PURPOSE.  See the
 * GNU General Public License for more details.
 */

/*---------------------------------------------------------------------------
 * This file is autogenerated file using gcdb parser. Please do not edit it.
 * Update input XML file to add a new entry or update variable in this file
 * VERSION = "1.0"
 *---------------------------------------------------------------------------*/
&mdss_mdp {
	ss_dsi_panel_HX83102D_BS060WKM_HDP: ss_dsi_panel_HX83102D_BS060WKM_HDP {
		qcom,mdss-dsi-panel-name = "ss_dsi_panel_HX83102D_BS060WKM_HDP";
		qcom,mdss-dsi-panel-controller = <&mdss_dsi0>;
		qcom,mdss-dsi-panel-width = <720>;
		qcom,mdss-dsi-panel-height = <1480>;
		qcom,mdss-dsi-h-front-porch = <80>;
		qcom,mdss-dsi-h-back-porch = <62>;
		qcom,mdss-dsi-h-pulse-width = <62>;
		qcom,mdss-dsi-v-back-porch = <10>;
		qcom,mdss-dsi-v-front-porch = <38>;
		qcom,mdss-dsi-v-pulse-width = <2>;
		qcom,mdss-dsi-bpp = <24>;
		qcom,mdss-dsi-panel-destination = "display_1";
		qcom,mdss-dsi-panel-timings = [94 20 14 00 46 48 1A 24 18 03 04 00];
		qcom,mdss-dsi-t-clk-post = <0x04>;
		qcom,mdss-dsi-t-clk-pre = <0x1D>;
		qcom,mdss-dsi-on-command = [

			39 00 00 00 00 00 04 B9 83 10 2D
			39 00 00 00 00 00 0C B1 20 00 25 25 11 77 07 1B 08 08 08
			39 00 00 00 00 00 0F B2 00 00 05 C8 00 0A 26 48 11 00 00 00 F4 20
			39 00 00 00 00 00 0f B4 4A 48 4A 48 4A 48 4A 48 03 FF 01 20 00 FF
			39 00 00 00 00 00 02 CC 02
			39 00 00 00 00 00 29 D3 22 00 3C 03 00 14 00 13 00 22 23 02 02 00 00 32 10 09 00 09 00 00 00 00 00 00 00 00 00 00 00 00 00 00 00 00 02 17 00 00
			39 00 00 00 00 00 2D D5 18 18 18 18 18 18 18 18 21 20 21 20 3A 3A 3A 3A 19 19 19 19 18 18 18 18 39 39 39 39 03 02 03 02 01 00 01 00 3A 3A 3A 3A 18 18 18 18
			39 00 00 00 00 00 2D D6 18 18 18 18 18 18 18 18 20 21 20 21 19 19 19 19 3A 3A 3A 3A 18 18 18 18 39 39 39 39 00 01 00 01 02 03 02 03 3A 3A 3A 3A 18 18 18 18
			39 00 00 00 00 00 18 E7 FF 0F 00 00 23 23 0F 0F 1E 16 1A 91 00 91 00 00 00 00 00 00 17 10 68
			39 00 00 00 00 00 02 BD 01
			39 00 00 00 00 00 08 E7 02 39 01 69 0E 4A 0F
			39 00 00 00 00 00 02 BD 02
			39 00 00 00 00 00 19 E7 01 04 00 00 02 00 23 00 02 01 00 00 00 00 00 00 00 00 00 00 00 00 00 00
			39 00 00 00 00 00 02 BD 00
			39 00 00 00 00 00 04 B6 1C 1C E0
			39 00 00 00 00 00 2F E0 00 08 15 1E 27 4A 62 69 70 6C 86 8B 90 9F 9D A4 AC BC BA 5B 62 6D 7F 00 08 15 1E 27 4A 62 69 70 6C 86 8B 90 9F 9D A4 AC BC BA 5B 62 6D 7F
			39 00 00 00 00 00 03 B0 00 20
			39 00 00 00 00 00 06 CB 00 13 00 02 C4
			39 00 00 00 00 00 14 BA 70 23 A8 9B B2 80 80 01 10 00 00 00 08 3D 82 77 04 01 00
			39 00 00 00 00 00 08 BF FC 00 25 9C F6 00 45
			39 00 00 00 00 00 02 BD 01
			39 00 00 00 00 00 04 B1 01 9B 01
			39 00 00 00 00 00 02 CB 01
			39 00 00 00 00 00 04 D3 01 40 39
			39 00 00 00 00 00 02 BD 02
			39 00 00 00 00 00 09 B4 C2 00 33 00 33 88 B3 00
			39 00 00 00 00 00 04 B1 7F 07 FF
			39 00 00 00 00 00 02 BD 00
			39 00 00 00 00 00 0D D8 AA AA AA FF FA A0 AA AA AA FF FA A0
			39 00 00 00 00 00 02 BD 01
			39 00 00 00 00 00 19 D8 AA AA AF AA AA A0 AA AA AF AA AA A0 AA AA AF AA AA A0 AA AA AF AA AA A0
			39 00 00 00 00 00 02 BD 02
			39 00 00 00 00 00 0D D8 AA AA AF AA AA A0 AA AA AF AA AA A0
			39 00 00 00 00 00 02 BD 03
			39 00 00 00 00 00 19 D8 AA AA AA AA AF F0 AA AA AF AA AA F0 AA FF FF FF FF F0 AA AA AF AA AA F0
			39 00 00 00 00 00 02 BD 00
			39 00 00 00 00 00 03 51 0F FF
			39 00 00 00 00 00 02 53 24
			39 00 00 00 00 00 02 55 00
			39 00 00 00 00 00 05 C9 04 19 64 00
			05 01 00 00 00 00 02 11 00 /* Wait 92 ms */
		];
		qcom,mdss-dsi-off-command = [

			/* Display Off and Wait 1 frame < 0.04 ms minimum 
			05 00 00 00 01 00 02 28 00*/

			/* Sleep in and Wait 2 frame =~ 36 ms minimum */
			05 01 00 00 25 00 02 10 00
		];

		qcom,mdss-dsi-h-sync-skew = <0>;
		qcom,mdss-dsi-h-left-border = <0>;
		qcom,mdss-dsi-h-right-border = <0>;
		qcom,mdss-dsi-v-top-border = <0>;
		qcom,mdss-dsi-v-bottom-border = <0>;
		qcom,mdss-dsi-underflow-color = <0xff>;
		qcom,mdss-dsi-border-color = <0>;
		qcom,mdss-dsi-bl-pmic-control-type = "bl_ctrl_dcs";
		qcom,mdss-dsi-bl-min-level = <1>;
		qcom,mdss-dsi-bl-max-level = <256>;
		qcom,mdss-brightness-max-level = <256>;
		qcom,mdss-dsi-panel-type = "dsi_video_mode";
		qcom,mdss-dsi-h-sync-pulse = <1>;
		/*qcom,mdss-dsi-hfp-power-mode; 
		qcom,mdss-dsi-hbp-power-mode; */ 
		qcom,mdss-dsi-bllp-eof-power-mode; 
		qcom,mdss-dsi-bllp-power-mode;
		qcom,mdss-dsi-traffic-mode = "burst_mode";
		qcom,mdss-dsi-pixel-packing = "loose";
		qcom,mdss-dsi-virtual-channel-id = <0>;
		qcom,mdss-dsi-color-order = <0>;
		qcom,mdss-dsi-lane-0-state;
		qcom,mdss-dsi-lane-1-state;
		qcom,mdss-dsi-lane-2-state;
		qcom,mdss-dsi-lane-3-state;
		qcom,mdss-dsi-stream = <0>;
		qcom,mdss-dsi-mdp-trigger = "none";
		qcom,mdss-dsi-dma-trigger = "trigger_sw";
		qcom,mdss-dsi-panel-framerate = <60>;
		/*qcom,mdss-dsi-panel-clockrate = <509000000>;*/
		qcom,mdss-dsi-on-command-state = "dsi_lp_mode";
		qcom,mdss-dsi-off-command-state = "dsi_hs_mode";
		qcom,mdss-pan-physical-width-dimension = <66>;
		qcom,mdss-pan-physical-height-dimension = <137>;
		qcom,mdss-dsi-rx-eot-ignore;
		qcom,mdss-dsi-tx-eot-append;
		qcom,mdss-dsi-reset-sequence = <1 5>, <0 1>, <1 50>;
		qcom,mdss-dsi-init-delay-us = <1000>;

/*
 * ************************************************************************************************************************************
 *
 *
 *			Below  parameters are samsung dependent thigs
 *
 *
 * ************************************************************************************************************************************
 */
		samsung,panel-vendor = "BOE";
		samsung,tft-common-support;
		samsung,enter_hbm_lux = <20000>;

		qcom,mdss-dsi-force-clock-lane-hs;

		samsung,packet_size_tx_cmds_revA = [
			37 01 00 00 00 00 02 07 00
		];

		samsung,display_on_tx_cmds_revA = [
			39 00 00 00 00 00 03 51 0F FF
			39 00 00 00 00 00 02 53 24
			05 01 00 00 00 00 02 29 00
		];

		samsung,display_off_tx_cmds_revA = [05 01 00 00 00 00 02 28 00];

		/*
		 * First parameters can be changed
		 * by function of samsung_nv_read()
		 * because of that means offset of
		 * read position
		 */
		samsung,reg_read_pos_tx_cmds_revA = [
			15 01 00 00 00 00 02 B0 00
		];
		samsung,manufacture_id0_rx_cmds_revA = [06 01 00 00 00 00 01 da 01 00];
		samsung,manufacture_id1_rx_cmds_revA = [06 01 00 00 00 00 01 db 01 00];
		samsung,manufacture_id2_rx_cmds_revA = [06 01 00 00 00 00 01 dc 01 00];

		samsung,mtp_read_sysfs_rx_cmds_revA = [06 01 00 00 00 00 01 00 00 00];

		samsung,tft_pwm_tx_cmds_revA=[
			39 01 00 00 00 00 03 51 FF FF
		];
		
		samsung,cabc_on_tx_cmds_revA = [
			39 01 00 00 00 00 02 55 01
		];
		samsung,cabc_off_tx_cmds_revA = [
			39 01 00 00 00 00 02 55 00
		];

		/*
		* ************************************************************************************************************************
		* Scaled level to index mappings
		* ************************************************************************************************************************
		*/
		samsung,candela_map_table_revA = <
		/*<idx>	  <from>  <till> <scaled_level> */
			0		0		0		0
			1		1		1		15
			2		2		2		15
			3		3		3		22
			4		4		4		29
			5		5		5		37
			6		6		6		44
			7		7		7		51
			8		8		8		59
			9		9		9		66
			10		10		10		73
			11		11		11		81
			12		12		12		88
			13		13		13		95
			14		14		14		103
			15		15		15		110
			16		16		16		117
			17		17		17		125
			18		18		18		132
			19		19		19		139
			20		20		20		147
			21		21		21		154
			22		22		22		161
			23		23		23		169
			24		24		24		176
			25		25		25		183
			26		26		26		191
			27		27		27		198
			28		28		28		205
			29		29		29		213
			30		30		30		220
			31		31		31		227
			32		32		32		235
			33		33		33		242
			34		34		34		249
			35		35		35		257
			36		36		36		264
			37		37		37		271
			38		38		38		279
			39		39		39		286
			40		40		40		293
			41		41		41		301
			42		42		42		308
			43		43		43		315
			44		44		44		323
			45		45		45		330
			46		46		46		338
			47		47		47		345
			48		48		48		352
			49		49		49		360
			50		50		50		367
			51		51		51		374
			52		52		52		382
			53		53		53		389
			54		54		54		396
			55		55		55		404
			56		56		56		411
			57		57		57		418
			58		58		58		426
			59		59		59		433
			60		60		60		440
			61		61		61		448
			62		62		62		455
			63		63		63		462
			64		64		64		470
			65		65		65		477
			66		66		66		484
			67		67		67		492
			68		68		68		499
			69		69		69		506
			70		70		70		514
			71		71		71		521
			72		72		72		528
			73		73		73		536
			74		74		74		543
			75		75		75		550
			76		76		76		558
			77		77		77		565
			78		78		78		572
			79		79		79		580
			80		80		80		587
			81		81		81		594
			82		82		82		602
			83		83		83		609
			84		84		84		616
			85		85		85		624
			86		86		86		631
			87		87		87		639
			88		88		88		646
			89		89		89		653
			90		90		90		661
			91		91		91		668
			92		92		92		675
			93		93		93		683
			94		94		94		690
			95		95		95		697
			96		96		96		705
			97		97		97		712
			98		98		98		719
			99		99		99		727
			100		100		100		734
			101		101		101		741
			102		102		102		749
			103		103		103		756
			104		104		104		763
			105		105		105		771
			106		106		106		778
			107		107		107		785
			108		108		108		793
			109		109		109		800
			110		110		110		807
			111		111		111		815
			112		112		112		822
			113		113		113		829
			114		114		114		837
			115		115		115		844
			116		116		116		851
			117		117		117		859
			118		118		118		866
			119		119		119		873
			120		120		120		881
			121		121		121		888
			122		122		122		895
			123		123		123		903
			124		124		124		910
			125		125		125		917
			126		126		126		925
			127		127		127		932
			128		128		128		940
			129		129		129		952
			130		130		130		964
			131		131		131		976
			132		132		132		988
			133		133		133		1000
			134		134		134		1012
			135		135		135		1024
			136		136		136		1036
			137		137		137		1048
			138		138		138		1060
			139		139		139		1072
			140		140		140		1084
			141		141		141		1096
			142		142		142		1108
			143		143		143		1120
			144		144		144		1132
			145		145		145		1144
			146		146		146		1156
			147		147		147		1168
			148		148		148		1180
			149		149		149		1192
			150		150		150		1205
			151		151		151		1217
			152		152		152		1229
			153		153		153		1241
			154		154		154		1253
			155		155		155		1265
			156		156		156		1277
			157		157		157		1289
			158		158		158		1301
			159		159		159		1313
			160		160		160		1325
			161		161		161		1337
			162		162		162		1349
			163		163		163		1361
			164		164		164		1373
			165		165		165		1385
			166		166		166		1397
			167		167		167		1409
			168		168		168		1421
			169		169		169		1433
			170		170		170		1445
			171		171		171		1458
			172		172		172		1470
			173		173		173		1482
			174		174		174		1494
			175		175		175		1506
			176		176		176		1518
			177		177		177		1530
			178		178		178		1542
			179		179		179		1554
			180		180		180		1566
			181		181		181		1578
			182		182		182		1590
			183		183		183		1602
			184		184		184		1614
			185		185		185		1626
			186		186		186		1638
			187		187		187		1650
			188		188		188		1662
			189		189		189		1674
			190		190		190		1686
			191		191		191		1698
			192		192		192		1711
			193		193		193		1723
			194		194		194		1735
			195		195		195		1747
			196		196		196		1759
			197		197		197		1771
			198		198		198		1783
			199		199		199		1795
			200		200		200		1807
			201		201		201		1819
			202		202		202		1831
			203		203		203		1843
			204		204		204		1855
			205		205		205		1867
			206		206		206		1879
			207		207		207		1891
			208		208		208		1903
			209		209		209		1915
			210		210		210		1927
			211		211		211		1939
			212		212		212		1951
			213		213		213		1964
			214		214		214		1976
			215		215		215		1988
			216		216		216		2000
			217		217		217		2012
			218		218		218		2024
			219		219		219		2036
			220		220		220		2048
			221		221		221		2060
			222		222		222		2072
			223		223		223		2084
			224		224		224		2096
			225		225		225		2108
			226		226		226		2120
			227		227		227		2132
			228		228		228		2144
			229		229		229		2156
			230		230		230		2168
			231		231		231		2180
			232		232		232		2192
			233		233		233		2204
			234		234		234		2217
			235		235		235		2229
			236		236		236		2241
			237		237		237		2253
			238		238		238		2265
			239		239		239		2277
			240		240		240		2289
			241		241		241		2301
			242		242		242		2313
			243		243		243		2325
			244		244		244		2337
			245		245		245		2349
			246		246		246		2361
			247		247		247		2373
			248		248		248		2385
			249		249		249		2397
			250		250		250		2409
			251		251		251		2421
			252		252		252		2433
			253		253		253		2445
			254		254		254		2457
			255		255		255		2470
			256		256		256		2890
		>;
	};
};
