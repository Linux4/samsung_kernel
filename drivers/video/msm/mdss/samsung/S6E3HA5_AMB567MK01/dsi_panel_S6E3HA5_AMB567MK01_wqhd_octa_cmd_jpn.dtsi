/* Copyright (c) 2012, Samsung Electronics Corporation. All rights reserved.
 *
 * This program is free software; you can redistribute it and/or modify
 * it under the terms of the GNU General Public License version 2 and
 * only version 2 as published by the Free Software Foundation.
 *
 * This program is distributed in the hope that it will be useful,
 * but WITHOUT ANY WARRANTY; without even the implied warranty of
 * MERCHANTABILITY or FITNESS FOR A PARTICULAR PURPOSE.  See the
 * GNU General Public License for more details.
 */

&mdss_mdp {
	ss_dsi_panel_S6E3HA5_AMB567MK01_WQHD: ss_dsi_panel_S6E3HA5_AMB567MK01_WQHD {
		/*
		* ************************************************************************************************************************
		*  IRC
		* ************************************************************************************************************************
		*/
		samsung,irc_subdivision_tx_cmds_revA = [
			29 01 00 00 00 00 15 B8 6D B0 48 4C 95 DA 33 69 12 7A DA 00 00 00 00 00 00 00 00 00  /* 00 */
			29 01 00 00 00 00 15 B8 6D B0 48 4C 95 DA 33 69 12 7A DA 00 00 00 00 00 00 00 00 00  /* 01 */
			29 01 00 00 00 00 15 B8 6D B0 48 4C 95 DA 33 69 12 7A DA 00 00 00 00 00 00 00 00 00  /* 02 */
			29 01 00 00 00 00 15 B8 6D B0 48 4C 95 DA 33 69 12 7A DA 00 00 00 00 00 00 00 00 00  /* 03 */
			29 01 00 00 00 00 15 B8 6D B0 48 4C 95 DA 33 69 12 7A DA 00 00 00 00 00 00 00 00 00  /* 04 */
			29 01 00 00 00 00 15 B8 6D B0 48 4C 95 DA 33 69 12 7A DA 00 00 00 00 00 00 00 00 00  /* 05 */
			29 01 00 00 00 00 15 B8 6D B0 48 4C 95 DA 33 69 12 7A DA 00 00 00 00 00 00 00 00 00  /* 06 */
			29 01 00 00 00 00 15 B8 6D B0 48 4C 95 DA 33 69 12 7A DA 00 00 00 00 00 00 00 00 00  /* 07 */
			29 01 00 00 00 00 15 B8 6D B0 48 4C 95 DA 33 69 12 7A DA 00 00 00 00 00 00 00 00 00  /* 08 */
			29 01 00 00 00 00 15 B8 6D B0 48 4C 95 DA 33 69 12 7A DA 00 00 00 00 00 00 00 00 00  /* 09 */
			29 01 00 00 00 00 15 B8 6D B0 48 4C 95 DA 33 69 12 7A DA 00 00 00 00 00 00 00 00 00  /* 10 */
			29 01 00 00 00 00 15 B8 6D B0 48 4C 95 DA 33 69 12 7A DA 00 00 00 00 00 00 00 00 00  /* 11 */
			29 01 00 00 00 00 15 B8 6D B0 48 4C 95 DA 33 69 12 7A DA 00 00 00 00 00 00 00 00 00  /* 12 */
			29 01 00 00 00 00 15 B8 6D B0 48 4C 95 DA 33 69 12 7A DA 00 00 00 00 00 00 00 00 00  /* 13 */
			29 01 00 00 00 00 15 B8 6D B0 48 4C 95 DA 33 69 12 7A DA 00 00 00 00 00 00 00 00 00  /* 14 */
			29 01 00 00 00 00 15 B8 6D B0 48 4C 95 DA 33 69 12 7A DA 00 00 00 00 00 00 00 00 00  /* 15 */
			29 01 00 00 00 00 15 B8 6D B0 48 4C 95 DA 33 69 12 7A DA 00 00 00 00 00 00 00 00 00  /* 16 */
			29 01 00 00 00 00 15 B8 6D B0 48 4C 95 DA 33 69 12 7A DA 00 00 00 00 00 00 00 00 00  /* 17 */
			29 01 00 00 00 00 15 B8 6D B0 48 4C 95 DA 33 69 12 7A DA 00 00 00 00 00 00 00 00 00  /* 18 */
			29 01 00 00 00 00 15 B8 6D B0 48 4C 95 DA 33 69 12 7A DA 00 00 00 00 00 00 00 00 00  /* 19 */
			29 01 00 00 00 00 15 B8 6D B0 48 4C 95 DA 33 69 12 7A DA 00 00 00 00 00 00 00 00 00  /* 20 */
			29 01 00 00 00 00 15 B8 6D B0 48 4C 95 DA 33 69 12 7A DA 00 00 00 00 00 00 00 00 00  /* 21 */
			29 01 00 00 00 00 15 B8 6D B0 48 4C 95 DA 33 69 12 7A DA 00 00 00 00 00 00 00 00 00  /* 22 */
			29 01 00 00 00 00 15 B8 6D B0 48 4C 95 DA 33 69 12 7A DA 00 00 00 00 00 00 00 00 00  /* 23 */
			29 01 00 00 00 00 15 B8 6D B0 48 4C 95 DA 33 69 12 7A DA 00 00 00 00 00 00 00 00 00  /* 24 */
			29 01 00 00 00 00 15 B8 6D B0 48 4C 95 DA 33 69 12 7A DA 00 00 00 00 00 00 00 00 00  /* 25 */
			29 01 00 00 00 00 15 B8 6D B0 48 4C 95 DA 33 69 12 7A DA 00 00 00 00 00 00 00 00 00  /* 26 */
			29 01 00 00 00 00 15 B8 6D B0 48 4C 95 DA 33 69 12 7A DA 00 00 00 00 00 00 00 00 00  /* 27 */
			29 01 00 00 00 00 15 B8 6D B0 48 4C 95 DA 33 69 12 7A DA 00 00 00 00 00 00 00 00 00  /* 28 */
			29 01 00 00 00 00 15 B8 6D B0 48 4C 95 DA 33 69 12 7A DA 00 00 00 00 00 00 00 00 00  /* 29 */
			29 01 00 00 00 00 15 B8 6D B0 48 4C 95 DA 33 69 12 7A DA 00 00 00 00 00 00 00 00 00  /* 30 */
			29 01 00 00 00 00 15 B8 6D B0 48 4C 95 DA 33 69 12 7A DA 00 00 00 00 00 00 00 00 00  /* 31 */
			29 01 00 00 00 00 15 B8 6D B0 48 4C 95 DA 33 69 12 7A DA 00 00 00 00 00 00 00 00 00  /* 32 */
			29 01 00 00 00 00 15 B8 6D B0 48 4C 95 DA 33 69 12 7A DA 00 00 00 00 00 00 00 00 00  /* 33 */
			29 01 00 00 00 00 15 B8 6D B0 48 4C 95 DA 33 69 12 7A DA 00 00 00 00 00 00 00 00 00  /* 34 */
			29 01 00 00 00 00 15 B8 6D B0 48 4C 95 DA 33 69 12 7A DA 00 00 00 00 00 00 00 00 00  /* 35 */
			29 01 00 00 00 00 15 B8 6D B0 48 4C 95 DA 33 69 12 7A DA 00 00 00 00 00 00 00 00 00  /* 36 */
			29 01 00 00 00 00 15 B8 6D B0 48 4C 95 DA 33 69 12 7A DA 00 00 00 00 00 00 00 00 00  /* 37 */
			29 01 00 00 00 00 15 B8 6D B0 48 4C 95 DA 33 69 12 7A DA 00 00 00 00 00 00 00 00 00  /* 38 */
			29 01 00 00 00 00 15 B8 6D B0 48 4C 95 DA 33 69 12 7A DA 02 02 01 00 00 01 01 01 00  /* 39 */
			29 01 00 00 00 00 15 B8 6D B0 48 4C 95 DA 33 69 12 7A DA 02 02 02 00 00 00 01 01 00  /* 40 */
			29 01 00 00 00 00 15 B8 6D B0 48 4C 95 DA 33 69 12 7A DA 02 02 02 00 00 00 01 01 00  /* 41 */
			29 01 00 00 00 00 15 B8 6D B0 48 4C 95 DA 33 69 12 7A DA 02 02 02 00 00 00 01 01 00  /* 42 */
			29 01 00 00 00 00 15 B8 6D B0 48 4C 95 DA 33 69 12 7A DA 02 02 02 00 01 00 01 00 00  /* 43 */
			29 01 00 00 00 00 15 B8 6D B0 48 4C 95 DA 33 69 12 7A DA 02 02 02 00 01 00 01 00 01  /* 44 */
			29 01 00 00 00 00 15 B8 6D B0 48 4C 95 DA 33 69 12 7A DA 02 02 02 00 01 00 01 00 01  /* 45 */
			29 01 00 00 00 00 15 B8 6D B0 48 4C 95 DA 33 69 12 7A DA 02 02 02 01 01 00 00 00 01  /* 46 */
			29 01 00 00 00 00 15 B8 6D B0 48 4C 95 DA 33 69 12 7A DA 02 02 02 01 01 00 00 00 01  /* 47 */
			29 01 00 00 00 00 15 B8 6D B0 48 4C 95 DA 33 69 12 7A DA 02 02 02 01 01 00 00 00 01  /* 48 */
			29 01 00 00 00 00 15 B8 6D B0 48 4C 95 DA 33 69 12 7A DA 02 02 02 01 01 00 00 01 01  /* 49 */
			29 01 00 00 00 00 15 B8 6D B0 48 4C 95 DA 33 69 12 7A DA 02 02 02 01 01 00 00 01 01  /* 50 */
			29 01 00 00 00 00 15 B8 6D B0 48 4C 95 DA 33 69 12 7A DA 02 02 02 01 01 01 00 01 00  /* 51 */
			29 01 00 00 00 00 15 B8 6D B0 48 4C 95 DA 33 69 12 7A DA 02 02 02 01 01 01 00 01 00  /* 52 */
			29 01 00 00 00 00 15 B8 6D B0 48 4C 95 DA 33 69 12 7A DA 02 02 02 01 01 01 00 01 00  /* 53 */
			29 01 00 00 00 00 15 B8 6D B0 48 4C 95 DA 33 69 12 7A DA 02 02 02 01 01 01 01 01 00  /* 54 */
			29 01 00 00 00 00 15 B8 6D B0 48 4C 95 DA 33 69 12 7A DA 02 02 02 01 01 01 01 01 00  /* 55 */
			29 01 00 00 00 00 15 B8 6D B0 48 4C 95 DA 33 69 12 7A DA 02 02 02 01 01 01 01 01 00  /* 56 */
			29 01 00 00 00 00 15 B8 6D B0 48 4C 95 DA 33 69 12 7A DA 02 02 02 01 01 01 01 01 00  /* 57 */
			29 01 00 00 00 00 15 B8 6D B0 48 4C 95 DA 33 69 12 7A DA 02 02 02 01 01 01 01 01 00  /* 58 */
			29 01 00 00 00 00 15 B8 6D B0 48 4C 95 DA 33 69 12 7A DA 02 02 02 01 01 01 01 01 00  /* 59 */
			29 01 00 00 00 00 15 B8 6D B0 48 4C 95 DA 33 69 12 7A DA 03 02 02 00 02 01 01 00 00  /* 60 */
			29 01 00 00 00 00 15 B8 6D B0 48 4C 95 DA 33 69 12 7A DA 03 03 02 00 01 01 01 00 00  /* 61 */
			29 01 00 00 00 00 15 B8 6D B0 48 4C 95 DA 33 69 12 7A DA 03 03 02 00 01 01 01 00 01  /* 62 */
			29 01 00 00 00 00 15 B8 6D B0 48 4C 95 DA 33 69 12 7A DA 03 03 02 00 01 01 01 00 01  /* 63 */
			29 01 00 00 00 00 15 B8 6D B0 48 4C 95 DA 33 69 12 7A DA 03 03 02 01 01 01 00 01 01  /* 64 */
			29 01 00 00 00 00 15 B8 6D B0 48 4C 95 DA 33 69 12 7A DA 03 03 02 01 01 01 00 01 01  /* 65 */
			29 01 00 00 00 00 15 B8 6D B0 48 4C 95 DA 33 69 12 7A DA 03 03 02 01 01 01 00 01 01  /* 66 */
			29 01 00 00 00 00 15 B8 6D B0 48 4C 95 DA 33 69 12 7A DA 03 03 03 01 01 00 00 01 01  /* 67 */
			29 01 00 00 00 00 15 B8 6D B0 48 4C 95 DA 33 69 12 7A DA 03 03 03 01 01 00 01 01 01  /* 68 */
			29 01 00 00 00 00 15 B8 6D B0 48 4C 95 DA 33 69 12 7A DA 03 03 03 01 01 00 01 01 01  /* 69 */
			29 01 00 00 00 00 15 B8 6D B0 48 4C 95 DA 33 69 12 7A DA 03 03 03 01 01 01 01 01 00  /* 70 */
			29 01 00 00 00 00 15 B8 6D B0 48 4C 95 DA 33 69 12 7A DA 03 03 03 01 01 01 01 01 00  /* 71 */
			29 01 00 00 00 00 15 B8 6D B0 48 4C 95 DA 33 69 12 7A DA 03 03 03 01 01 01 01 01 00  /* 72 */
			29 01 00 00 00 00 15 B8 6D B0 48 4C 95 DA 33 69 12 7A DA 03 03 03 01 02 01 01 00 00  /* 73 */
			29 01 00 00 00 00 15 B8 6D B0 48 4C 95 DA 33 69 12 7A DA 03 03 03 01 02 01 01 01 00  /* 74 */
			29 01 00 00 00 00 15 B8 6D B0 48 4C 95 DA 33 69 12 7A DA 03 03 03 01 02 01 01 01 01  /* 75 */
			29 01 00 00 00 00 15 B8 6D B0 48 4C 95 DA 33 69 12 7A DA 03 03 03 02 02 01 00 01 01  /* 76 */
			29 01 00 00 00 00 15 B8 6D B0 48 4C 95 DA 33 69 12 7A DA 04 03 03 01 02 01 01 01 01  /* 77 */
			29 01 00 00 00 00 15 B8 6D B0 48 4C 95 DA 33 69 12 7A DA 04 04 03 01 01 01 01 01 01  /* 78 */
			29 01 00 00 00 00 15 B8 6D B0 48 4C 95 DA 33 69 12 7A DA 04 04 03 01 01 01 01 01 01  /* 79 */
			29 01 00 00 00 00 15 B8 6D B0 48 4C 95 DA 33 69 12 7A DA 04 04 03 01 01 02 01 02 00  /* 80 */
			29 01 00 00 00 00 15 B8 6D B0 48 4C 95 DA 33 69 12 7A DA 04 04 04 01 02 01 01 01 00  /* 81 */
			29 01 00 00 00 00 15 B8 6D B0 48 4C 95 DA 33 69 12 7A DA 04 04 04 01 02 01 01 01 00  /* 82 */
			29 01 00 00 00 00 15 B8 6D B0 48 4C 95 DA 33 69 12 7A DA 04 04 04 01 02 01 01 01 01  /* 83 */
			29 01 00 00 00 00 15 B8 6D B0 48 4C 95 DA 33 69 12 7A DA 04 04 04 02 02 01 01 01 01  /* 84 */
			29 01 00 00 00 00 15 B8 6D B0 48 4C 95 DA 33 69 12 7A DA 04 04 04 02 02 01 01 01 01  /* 85 */
			29 01 00 00 00 00 15 B8 6D B0 48 4C 95 DA 33 69 12 7A DA 04 04 04 02 02 01 01 01 01  /* 86 */
			29 01 00 00 00 00 15 B8 6D B0 48 4C 95 DA 33 69 12 7A DA 04 04 04 02 02 01 01 01 01  /* 87 */
			29 01 00 00 00 00 15 B8 6D B0 48 4C 95 DA 33 69 12 7A DA 04 04 04 02 02 01 01 02 01  /* 88 */
			29 01 00 00 00 00 15 B8 6D B0 48 4C 95 DA 33 69 12 7A DA 05 04 04 01 02 01 01 02 01  /* 89 */
			29 01 00 00 00 00 15 B8 6D B0 48 4C 95 DA 33 69 12 7A DA 05 05 04 01 02 02 01 01 00  /* 90 */
			29 01 00 00 00 00 15 B8 6D B0 48 4C 95 DA 33 69 12 7A DA 05 05 04 01 02 02 02 01 01  /* 91 */
			29 01 00 00 00 00 15 B8 6D B0 48 4C 95 DA 33 69 12 7A DA 05 05 04 02 02 02 01 01 01  /* 92 */
			29 01 00 00 00 00 15 B8 6D B0 48 4C 95 DA 33 69 12 7A DA 05 05 04 02 02 02 01 02 01  /* 93 */
			29 01 00 00 00 00 15 B8 6D B0 48 4C 95 DA 33 69 12 7A DA 05 05 05 02 02 01 01 02 01  /* 94 */
			29 01 00 00 00 00 15 B8 6D B0 48 4C 95 DA 33 69 12 7A DA 05 05 05 02 02 01 01 02 01  /* 95 */
			29 01 00 00 00 00 15 B8 6D B0 48 4C 95 DA 33 69 12 7A DA 05 05 05 02 02 01 01 02 01  /* 96 */
			29 01 00 00 00 00 15 B8 6D B0 48 4C 95 DA 33 69 12 7A DA 05 05 05 02 03 01 02 01 01  /* 97 */
			29 01 00 00 00 00 15 B8 6D B0 48 4C 95 DA 33 69 12 7A DA 06 05 05 01 03 02 02 01 01  /* 98 */
			29 01 00 00 00 00 15 B8 6D B0 48 4C 95 DA 33 69 12 7A DA 06 06 05 02 02 02 01 02 01  /* 99 */
			29 01 00 00 00 00 15 B8 6D B0 48 4C 95 DA 33 69 12 7A DA 06 06 05 02 02 02 01 02 01  /* 100 */
			29 01 00 00 00 00 15 B8 6D B0 48 4C 95 DA 33 69 12 7A DA 06 06 05 02 02 02 01 02 01  /* 101 */
			29 01 00 00 00 00 15 B8 6D B0 48 4C 95 DA 33 69 12 7A DA 06 06 05 02 02 02 01 02 01  /* 102 */
			29 01 00 00 00 00 15 B8 6D B0 48 4C 95 DA 33 69 12 7A DA 06 06 05 02 03 02 02 01 01  /* 103 */
			29 01 00 00 00 00 15 B8 6D B0 48 4C 95 DA 33 69 12 7A DA 06 06 06 02 03 01 02 02 01  /* 104 */
			29 01 00 00 00 00 15 B8 6D B0 48 4C 95 DA 33 69 12 7A DA 06 06 06 02 03 01 02 02 02  /* 105 */
			29 01 00 00 00 00 15 B8 6D B0 48 4C 95 DA 33 69 12 7A DA 06 06 06 03 03 02 01 02 01  /* 106 */
			29 01 00 00 00 00 15 B8 6D B0 48 4C 95 DA 33 69 12 7A DA 07 06 06 02 03 02 01 02 01  /* 107 */
			29 01 00 00 00 00 15 B8 6D B0 48 4C 95 DA 33 69 12 7A DA 07 07 06 02 02 02 02 02 01  /* 108 */
			29 01 00 00 00 00 15 B8 6D B0 48 4C 95 DA 33 69 12 7A DA 07 07 06 02 03 02 02 02 01  /* 109 */
			29 01 00 00 00 00 15 B8 6D B0 48 4C 95 DA 33 69 12 7A DA 07 07 06 02 03 02 02 02 01  /* 110 */
			29 01 00 00 00 00 15 B8 6D B0 48 4C 95 DA 33 69 12 7A DA 07 07 06 03 03 03 01 02 01  /* 111 */
			29 01 00 00 00 00 15 B8 6D B0 48 4C 95 DA 33 69 12 7A DA 07 07 07 03 03 02 02 03 01  /* 112 */
			29 01 00 00 00 00 15 B8 6D B0 48 4C 95 DA 33 69 12 7A DA 08 07 07 02 04 02 02 02 01  /* 113 */
			29 01 00 00 00 00 15 B8 6D B0 48 4C 95 DA 33 69 12 7A DA 08 08 07 02 03 02 02 02 01  /* 114 */
			29 01 00 00 00 00 15 B8 6D B0 48 4C 95 DA 33 69 12 7A DA 08 08 07 02 03 02 02 02 02  /* 115 */
			29 01 00 00 00 00 15 B8 6D B0 48 4C 95 DA 33 69 12 7A DA 08 08 07 03 03 02 02 03 02  /* 116 */
			29 01 00 00 00 00 15 B8 6D B0 48 4C 95 DA 33 69 12 7A DA 08 08 07 03 03 03 02 03 01  /* 117 */
			29 01 00 00 00 00 15 B8 6D B0 48 4C 95 DA 33 69 12 7A DA 08 08 07 03 04 03 02 02 01  /* 118 */
			29 01 00 00 00 00 15 B8 6D B0 48 4C 95 DA 33 69 12 7A DA 08 08 08 03 04 02 02 02 01  /* 119 */
			29 01 00 00 00 00 15 B8 6D B0 48 4C 95 DA 33 69 12 7A DA 09 09 08 02 03 02 03 03 02  /* 120 */
			29 01 00 00 00 00 15 B8 6D B0 48 4C 95 DA 33 69 12 7A DA 09 09 08 03 03 02 02 03 02  /* 121 */
			29 01 00 00 00 00 15 B8 6D B0 48 4C 95 DA 33 69 12 7A DA 09 09 08 03 04 03 02 02 01  /* 122 */
			29 01 00 00 00 00 15 B8 6D B0 48 4C 95 DA 33 69 12 7A DA 09 09 08 03 04 03 03 03 02  /* 123 */
			29 01 00 00 00 00 15 B8 6D B0 48 4C 95 DA 33 69 12 7A DA 0A 09 08 02 04 03 03 03 02  /* 124 */
			29 01 00 00 00 00 15 B8 6D B0 48 4C 95 DA 33 69 12 7A DA 0A 0A 09 03 04 02 02 02 02  /* 125 */
			29 01 00 00 00 00 15 B8 6D B0 48 4C 95 DA 33 69 12 7A DA 0A 0A 09 03 04 03 03 03 01  /* 126 */
			29 01 00 00 00 00 15 B8 6D B0 48 4C 95 DA 33 69 12 7A DA 0A 0A 09 03 04 03 03 03 02  /* 127 */
			29 01 00 00 00 00 15 B8 6D B0 48 4C 95 DA 33 69 12 7A DA 0A 0A 09 04 04 03 02 04 02  /* 128 */
			29 01 00 00 00 00 15 B8 6D B0 48 4C 95 DA 33 69 12 7A DA 0B 0A 09 03 05 04 03 03 01  /* 129 */
			29 01 00 00 00 00 15 B8 6D B0 48 4C 95 DA 33 69 12 7A DA 0B 0B 0A 03 04 03 03 04 02  /* 130 */
			29 01 00 00 00 00 15 B8 6D B0 48 4C 95 DA 33 69 12 7A DA 0B 0B 0A 04 05 03 03 03 02  /* 131 */
			29 01 00 00 00 00 15 B8 6D B0 48 4C 95 DA 33 69 12 7A DA 0C 0B 0A 03 05 04 03 04 02  /* 132 */
			29 01 00 00 00 00 15 B8 6D B0 48 4C 95 DA 33 69 12 7A DA 0C 0C 0B 04 05 03 03 03 02  /* 133 */
			29 01 00 00 00 00 15 B8 6D B0 48 4C 95 DA 33 69 12 7A DA 0C 0C 0B 04 05 04 03 04 02  /* 134 */
			29 01 00 00 00 00 15 B8 6D B0 48 4C 95 DA 33 69 12 7A DA 0D 0D 0B 04 05 04 03 04 02  /* 135 */
			29 01 00 00 00 00 15 B8 6D B0 48 4C 95 DA 33 69 12 7A DA 0D 0D 0C 04 05 04 04 04 02  /* 136 */
			29 01 00 00 00 00 15 B8 6D B0 48 4C 95 DA 33 69 12 7A DA 0E 0D 0C 04 06 04 03 04 02  /* 137 */
			29 01 00 00 00 00 15 B8 6D B0 48 4C 95 DA 33 69 12 7A DA 0E 0E 0C 04 06 05 04 04 02  /* 138 */
			29 01 00 00 00 00 15 B8 6D B0 48 4C 95 DA 33 69 12 7A DA 0F 0E 0D 04 06 04 04 05 03  /* 139 */
			29 01 00 00 00 00 15 B8 6D B0 48 4C 95 DA 33 69 12 7A DA 0F 0F 0D 05 06 04 03 04 03  /* 140 */
			29 01 00 00 00 00 15 B8 6D B0 48 4C 95 DA 33 69 12 7A DA 0F 0F 0E 05 06 04 04 05 03  /* 141 */
			29 01 00 00 00 00 15 B8 6D B0 48 4C 95 DA 33 69 12 7A DA 10 10 0E 05 06 05 04 05 02  /* 142 */
			29 01 00 00 00 00 15 B8 6D B0 48 4C 95 DA 33 69 12 7A DA 10 10 0F 06 07 04 04 05 03  /* 143 */
			29 01 00 00 00 00 15 B8 6D B0 48 4C 95 DA 33 69 12 7A DA 11 11 0F 05 07 05 05 05 03  /* 144 */
			29 01 00 00 00 00 15 B8 6D B0 48 4C 95 DA 33 69 12 7A DA 12 11 0F 05 07 06 04 06 03  /* 145 */
			29 01 00 00 00 00 15 B8 6D B0 48 4C 95 DA 33 69 12 7A DA 12 12 10 06 07 05 04 05 03  /* 146 */
			29 01 00 00 00 00 15 B8 6D B0 48 4C 95 DA 33 69 12 7A DA 13 12 11 05 08 05 05 06 03  /* 147 */
			29 01 00 00 00 00 15 B8 6D B0 48 4C 95 DA 33 69 12 7A DA 13 13 11 06 08 06 05 06 03  /* 148 */
			29 01 00 00 00 00 15 B8 6D B0 48 4C 95 DA 33 69 12 7A DA 14 13 12 06 09 05 05 05 04  /* 149 */
			29 01 00 00 00 00 15 B8 6D B0 48 4C 95 DA 33 69 12 7A DA 14 14 12 07 08 06 05 06 03  /* 150 */
			29 01 00 00 00 00 15 B8 6D B0 48 4C 95 DA 33 69 12 7A DA 15 15 13 07 08 06 05 07 03  /* 151 */
			29 01 00 00 00 00 15 B8 6D B0 48 4C 95 DA 33 69 12 7A DA 16 15 13 07 09 07 05 07 03  /* 152 */
			29 01 00 00 00 00 15 B8 6D B0 48 4C 95 DA 33 69 12 7A DA 16 16 14 07 09 06 06 07 04  /* 153 */
			29 01 00 00 00 00 15 B8 6D B0 48 4C 95 DA 33 69 12 7A DA 17 16 14 07 0A 07 06 07 04  /* 154 */
			29 01 00 00 00 00 15 B8 6D B0 48 4C 95 DA 33 69 12 7A DA 18 17 15 07 0A 07 06 07 04  /* 155 */
			29 01 00 00 00 00 15 B8 6D B0 48 4C 95 DA 33 69 12 7A DA 19 18 16 07 0A 07 07 08 04  /* 156 */
			29 01 00 00 00 00 15 B8 6D B0 48 4C 95 DA 33 69 12 7A DA 19 19 16 08 0A 08 07 08 04  /* 157 */
			29 01 00 00 00 00 15 B8 6D B0 48 4C 95 DA 33 69 12 7A DA 1A 1A 17 08 0A 08 07 08 04  /* 158 */
			29 01 00 00 00 00 15 B8 6D B0 48 4C 95 DA 33 69 12 7A DA 1B 1A 18 08 0B 08 07 09 04  /* 159 */
			29 01 00 00 00 00 15 B8 6D B0 48 4C 95 DA 33 69 12 7A DA 1C 1B 19 08 0C 08 07 08 04  /* 160 */
			29 01 00 00 00 00 15 B8 6D B0 48 4C 95 DA 33 69 12 7A DA 1D 1C 19 09 0C 09 07 08 05  /* 161 */
			29 01 00 00 00 00 15 B8 6D B0 48 4C 95 DA 33 69 12 7A DA 1E 1D 1A 09 0C 09 07 09 05  /* 162 */
			29 01 00 00 00 00 15 B8 6D B0 48 4C 95 DA 33 69 12 7A DA 1F 1E 1B 09 0C 09 08 0A 05  /* 163 */
			29 01 00 00 00 00 15 B8 6D B0 48 4C 95 DA 33 69 12 7A DA 1F 1F 1C 0A 0D 09 08 09 05  /* 164 */
			29 01 00 00 00 00 15 B8 6D B0 48 4C 95 DA 33 69 12 7A DA 21 20 1D 0A 0D 09 08 0A 06  /* 165 */
			29 01 00 00 00 00 15 B8 6D B0 48 4C 95 DA 33 69 12 7A DA 22 21 1E 0A 0E 09 08 0A 06  /* 166 */
			29 01 00 00 00 00 15 B8 6D B0 48 4C 95 DA 33 69 12 7A DA 23 22 1F 0A 0E 0A 09 0A 06  /* 167 */
			29 01 00 00 00 00 15 B8 6D B0 48 4C 95 DA 33 69 12 7A DA 24 23 20 0B 0F 0A 09 0A 06  /* 168 */
			29 01 00 00 00 00 15 B8 6D B0 48 4C 95 DA 33 69 12 7A DA 25 24 21 0B 0F 0A 09 0B 06  /* 169 */
			29 01 00 00 00 00 15 B8 6D B0 48 4C 95 DA 33 69 12 7A DA 26 25 22 0C 10 0A 09 0B 07  /* 170 */
			29 01 00 00 00 00 15 B8 6D B0 48 4C 95 DA 33 69 12 7A DA 27 26 22 0B 10 0B 0A 0B 07  /* 171 */
			29 01 00 00 00 00 15 B8 6D B0 48 4C 95 DA 33 69 12 7A DA 27 26 23 0C 10 0B 0A 0C 07  /* 172 */
			29 01 00 00 00 00 15 B8 6D B0 48 4C 95 DA 33 69 12 7A DA 28 27 23 0C 10 0C 0A 0C 06  /* 173 */
			29 01 00 00 00 00 15 B8 6D B0 48 4C 95 DA 33 69 12 7A DA 28 27 24 0D 11 0B 0A 0C 07  /* 174 */
			29 01 00 00 00 00 15 B8 6D B0 48 4C 95 DA 33 69 12 7A DA 29 28 24 0D 11 0C 0A 0C 07  /* 175 */
			29 01 00 00 00 00 15 B8 6D B0 48 4C 95 DA 33 69 12 7A DA 2A 29 25 0D 11 0C 0A 0C 07  /* 176 */
			29 01 00 00 00 00 15 B8 6D B0 48 4C 95 DA 33 69 12 7A DA 2A 29 25 0D 12 0D 0B 0C 07  /* 177 */
			29 01 00 00 00 00 15 B8 6D B0 48 4C 95 DA 33 69 12 7A DA 2B 2A 26 0D 12 0C 0B 0C 08  /* 178 */
			29 01 00 00 00 00 15 B8 6D B0 48 4C 95 DA 33 69 12 7A DA 2C 2B 27 0D 12 0C 0B 0D 08  /* 179 */
			29 01 00 00 00 00 15 B8 6D B0 48 4C 95 DA 33 69 12 7A DA 2C 2B 27 0E 13 0D 0B 0D 07  /* 180 */
			29 01 00 00 00 00 15 B8 6D B0 48 4C 95 DA 33 69 12 7A DA 2D 2C 28 0E 12 0D 0B 0E 07  /* 181 */
			29 01 00 00 00 00 15 B8 6D B0 48 4C 95 DA 33 69 12 7A DA 2E 2D 28 0E 12 0D 0B 0E 08  /* 182 */
			29 01 00 00 00 00 15 B8 6D B0 48 4C 95 DA 33 69 12 7A DA 2E 2D 29 0F 13 0D 0B 0E 08  /* 183 */
			29 01 00 00 00 00 15 B8 6D B0 48 4C 95 DA 33 69 12 7A DA 2F 2E 2A 0F 13 0D 0C 0E 08  /* 184 */
			29 01 00 00 00 00 15 B8 6D B0 48 4C 95 DA 33 69 12 7A DA 30 2F 2A 0F 13 0E 0C 0F 08  /* 185 */
			29 01 00 00 00 00 15 B8 6D B0 48 4C 95 DA 33 69 12 7A DA 30 2F 2B 10 14 0E 0C 0F 08  /* 186 */
			29 01 00 00 00 00 15 B8 6D B0 48 4C 95 DA 33 69 12 7A DA 31 30 2C 10 14 0E 0C 0F 08  /* 187 */
			29 01 00 00 00 00 15 B8 6D B0 48 4C 95 DA 33 69 12 7A DA 32 31 2C 10 15 0F 0C 0F 08  /* 188 */
			29 01 00 00 00 00 15 B8 6D B0 48 4C 95 DA 33 69 12 7A DA 33 32 2D 10 15 0F 0C 0F 08  /* 189 */
			29 01 00 00 00 00 15 B8 6D B0 48 4C 95 DA 33 69 12 7A DA 34 32 2E 10 16 0E 0D 0F 09  /* 190 */
			29 01 00 00 00 00 15 B8 6D B0 48 4C 95 DA 33 69 12 7A DA 34 33 2E 11 16 0F 0D 10 09  /* 191 */
			29 01 00 00 00 00 15 B8 6D B0 48 4C 95 DA 33 69 12 7A DA 35 34 2F 11 16 0F 0D 10 0A  /* 192 */
			29 01 00 00 00 00 15 B8 6D B0 48 4C 95 DA 33 69 12 7A DA 36 35 30 11 16 0F 0E 10 0A  /* 193 */
			29 01 00 00 00 00 15 B8 6D B0 48 4C 95 DA 33 69 12 7A DA 37 36 31 11 16 0F 0E 11 0A  /* 194 */
			29 01 00 00 00 00 15 B8 6D B0 48 4C 95 DA 33 69 12 7A DA 38 36 31 11 18 10 0E 10 0A  /* 195 */
			29 01 00 00 00 00 15 B8 6D B0 48 4C 95 DA 33 69 12 7A DA 39 37 32 11 18 10 0F 11 0A  /* 196 */
			29 01 00 00 00 00 15 B8 6D B0 48 4C 95 DA 33 69 12 7A DA 3A 38 33 11 18 10 0F 11 0A  /* 197 */
			29 01 00 00 00 00 15 B8 6D B0 48 4C 95 DA 33 69 12 7A DA 3A 39 34 13 18 10 0E 12 0B  /* 198 */
			29 01 00 00 00 00 15 B8 6D B0 48 4C 95 DA 33 69 12 7A DA 3B 3A 34 12 18 11 0F 12 0A  /* 199 */
			29 01 00 00 00 00 15 B8 6D B0 48 4C 95 DA 33 69 12 7A DA 3C 3A 35 12 19 11 0F 12 0A  /* 200 */
			29 01 00 00 00 00 15 B8 6D B0 48 4C 95 DA 33 69 12 7A DA 3C 3B 35 13 19 12 0F 12 0A  /* 201 */
			29 01 00 00 00 00 15 B8 6D B0 48 4C 95 DA 33 69 12 7A DA 3D 3C 36 13 19 11 0F 12 0B  /* 202 */
			29 01 00 00 00 00 15 B8 6D B0 48 4C 95 DA 33 69 12 7A DA 3E 3C 36 13 1A 12 0F 12 0B  /* 203 */
			29 01 00 00 00 00 15 B8 6D B0 48 4C 95 DA 33 69 12 7A DA 3E 3D 37 13 19 12 10 13 0B  /* 204 */
			29 01 00 00 00 00 15 B8 6D B0 48 4C 95 DA 33 69 12 7A DA 3F 3D 38 13 1A 12 10 13 0A  /* 205 */
			29 01 00 00 00 00 15 B8 6D B0 48 4C 95 DA 33 69 12 7A DA 3F 3E 38 14 1A 12 10 13 0B  /* 206 */
			29 01 00 00 00 00 15 B8 6D B0 48 4C 95 DA 33 69 12 7A DA 40 3F 39 14 1A 12 10 13 0B  /* 207 */
			29 01 00 00 00 00 15 B8 6D B0 48 4C 95 DA 33 69 12 7A DA 41 3F 39 14 1B 13 10 13 0B  /* 208 */
			29 01 00 00 00 00 15 B8 6D B0 48 4C 95 DA 33 69 12 7A DA 41 40 3A 15 1B 13 10 14 0B  /* 209 */
			29 01 00 00 00 00 15 B8 6D B0 48 4C 95 DA 33 69 12 7A DA 42 41 3B 15 1B 13 10 14 0B  /* 210 */
			29 01 00 00 00 00 15 B8 6D B0 48 4C 95 DA 33 69 12 7A DA 43 41 3B 15 1C 13 11 14 0C  /* 211 */
			29 01 00 00 00 00 15 B8 6D B0 48 4C 95 DA 33 69 12 7A DA 44 42 3C 15 1C 13 11 14 0C  /* 212 */
			29 01 00 00 00 00 15 B8 6D B0 48 4C 95 DA 33 69 12 7A DA 44 43 3C 15 1C 14 12 14 0C  /* 213 */
			29 01 00 00 00 00 15 B8 6D B0 48 4C 95 DA 33 69 12 7A DA 45 43 3D 15 1D 14 12 15 0C  /* 214 */
			29 01 00 00 00 00 15 B8 6D B0 48 4C 95 DA 33 69 12 7A DA 46 44 3E 15 1D 14 12 15 0C  /* 215 */
			29 01 00 00 00 00 15 B8 6D B0 48 4C 95 DA 33 69 12 7A DA 46 45 3E 16 1D 15 12 15 0C  /* 216 */
			29 01 00 00 00 00 15 B8 6D B0 48 4C 95 DA 33 69 12 7A DA 47 45 3F 16 1E 14 12 15 0D  /* 217 */
			29 01 00 00 00 00 15 B8 6D B0 48 4C 95 DA 33 69 12 7A DA 48 46 40 16 1E 14 12 15 0D  /* 218 */
			29 01 00 00 00 00 15 B8 6D B0 48 4C 95 DA 33 69 12 7A DA 49 47 40 16 1E 15 12 16 0D  /* 219 */
			29 01 00 00 00 00 15 B8 6D B0 48 4C 95 DA 33 69 12 7A DA 49 47 40 16 1E 15 13 16 0D  /* 220 */
			29 01 00 00 00 00 15 B8 6D B0 48 4C 95 DA 33 69 12 7A DA 49 48 41 17 1E 15 12 16 0C  /* 221 */
			29 01 00 00 00 00 15 B8 6D B0 48 4C 95 DA 33 69 12 7A DA 4A 48 41 16 1E 15 13 16 0D  /* 222 */
			29 01 00 00 00 00 15 B8 6D B0 48 4C 95 DA 33 69 12 7A DA 4A 48 41 17 1F 16 13 16 0C  /* 223 */
			29 01 00 00 00 00 15 B8 6D B0 48 4C 95 DA 33 69 12 7A DA 4A 49 42 17 1E 15 13 17 0D  /* 224 */
			29 01 00 00 00 00 15 B8 6D B0 48 4C 95 DA 33 69 12 7A DA 4B 49 42 17 1F 16 13 16 0D  /* 225 */
			29 01 00 00 00 00 15 B8 6D B0 48 4C 95 DA 33 69 12 7A DA 4B 49 43 18 20 15 13 16 0D  /* 226 */
			29 01 00 00 00 00 15 B8 6D B0 48 4C 95 DA 33 69 12 7A DA 4C 4A 43 17 1F 16 13 17 0D  /* 227 */
			29 01 00 00 00 00 15 B8 6D B0 48 4C 95 DA 33 69 12 7A DA 4C 4A 43 18 20 16 13 17 0D  /* 228 */
			29 01 00 00 00 00 15 B8 6D B0 48 4C 95 DA 33 69 12 7A DA 4D 4B 44 17 1F 16 14 17 0D  /* 229 */
			29 01 00 00 00 00 15 B8 6D B0 48 4C 95 DA 33 69 12 7A DA 4D 4B 44 18 20 16 13 17 0E  /* 230 */
			29 01 00 00 00 00 15 B8 6D B0 48 4C 95 DA 33 69 12 7A DA 4D 4C 45 19 20 16 13 17 0D  /* 231 */
			29 01 00 00 00 00 15 B8 6D B0 48 4C 95 DA 33 69 12 7A DA 4E 4C 45 18 20 16 14 18 0E  /* 232 */
			29 01 00 00 00 00 15 B8 6D B0 48 4C 95 DA 33 69 12 7A DA 4E 4D 45 19 20 17 13 17 0D  /* 233 */
			29 01 00 00 00 00 15 B8 6D B0 48 4C 95 DA 33 69 12 7A DA 4F 4D 46 18 20 16 14 18 0E  /* 234 */
			29 01 00 00 00 00 15 B8 6D B0 48 4C 95 DA 33 69 12 7A DA 4F 4D 46 19 21 17 14 18 0D  /* 235 */
			29 01 00 00 00 00 15 B8 6D B0 48 4C 95 DA 33 69 12 7A DA 4F 4E 46 19 20 17 14 18 0E  /* 236 */
			29 01 00 00 00 00 15 B8 6D B0 48 4C 95 DA 33 69 12 7A DA 50 4E 47 19 21 17 14 18 0D  /* 237 */
			29 01 00 00 00 00 15 B8 6D B0 48 4C 95 DA 33 69 12 7A DA 50 4E 47 19 21 17 14 18 0E  /* 238 */
			29 01 00 00 00 00 15 B8 6D B0 48 4C 95 DA 33 69 12 7A DA 51 4F 47 19 21 17 14 18 0E  /* 239 */
			29 01 00 00 00 00 15 B8 6D B0 48 4C 95 DA 33 69 12 7A DA 51 4F 48 19 22 17 15 18 0E  /* 240 */
			29 01 00 00 00 00 15 B8 6D B0 48 4C 95 DA 33 69 12 7A DA 51 50 48 1A 21 17 14 19 0E  /* 241 */
			29 01 00 00 00 00 15 B8 6D B0 48 4C 95 DA 33 69 12 7A DA 52 50 48 19 22 18 15 18 0E  /* 242 */
			29 01 00 00 00 00 15 B8 6D B0 48 4C 95 DA 33 69 12 7A DA 52 50 49 1A 22 17 15 19 0F  /* 243 */
			29 01 00 00 00 00 15 B8 6D B0 48 4C 95 DA 33 69 12 7A DA 53 51 49 19 22 18 15 19 0E  /* 244 */
			29 01 00 00 00 00 15 B8 6D B0 48 4C 95 DA 33 69 12 7A DA 53 51 4A 1A 23 17 15 18 0F  /* 245 */
			29 01 00 00 00 00 15 B8 6D B0 48 4C 95 DA 33 69 12 7A DA 53 52 4A 1A 22 18 15 19 0E  /* 246 */
			29 01 00 00 00 00 15 B8 6D B0 48 4C 95 DA 33 69 12 7A DA 54 52 4A 1A 23 18 15 19 0F  /* 247 */
			29 01 00 00 00 00 15 B8 6D B0 48 4C 95 DA 33 69 12 7A DA 54 52 4B 1B 23 18 15 1A 0F  /* 248 */
			29 01 00 00 00 00 15 B8 6D B0 48 4C 95 DA 33 69 12 7A DA 55 53 4B 1A 23 19 16 19 0E  /* 249 */
			29 01 00 00 00 00 15 B8 6D B0 48 4C 95 DA 33 69 12 7A DA 55 53 4C 1B 24 18 15 19 0F  /* 250 */
			29 01 00 00 00 00 15 B8 6D B0 48 4C 95 DA 33 69 12 7A DA 56 54 4C 1A 23 19 16 1A 0E  /* 251 */
			29 01 00 00 00 00 15 B8 6D B0 48 4C 95 DA 33 69 12 7A DA 56 54 4C 1B 24 19 16 1A 0F  /* 252 */
			29 01 00 00 00 00 15 B8 6D B0 48 4C 95 DA 33 69 12 7A DA 57 55 4D 1A 23 19 16 1A 0E  /* 253 */
			29 01 00 00 00 00 15 B8 6D B0 48 4C 95 DA 33 69 12 7A DA 57 55 4D 1B 24 19 16 1A 0F  /* 254 */
			29 01 00 00 00 00 15 B8 6D B0 48 4C 95 DA 33 69 12 7A DA 57 55 4D 1B 24 19 16 1A 0F  /* 255 */
		];

		samsung,irc_subdivision_tx_cmds_revB = [
			29 01 00 00 00 00 15 B8 6D B0 48 4C 95 DA 33 69 12 7A DA 00 00 00 00 00 00 00 00 00  /* 00 */
			29 01 00 00 00 00 15 B8 6D B0 48 4C 95 DA 33 69 12 7A DA 00 00 00 00 00 00 00 00 00  /* 01 */
			29 01 00 00 00 00 15 B8 6D B0 48 4C 95 DA 33 69 12 7A DA 00 00 00 00 00 00 00 00 00  /* 02 */
			29 01 00 00 00 00 15 B8 6D B0 48 4C 95 DA 33 69 12 7A DA 00 00 00 00 00 00 00 00 00  /* 03 */
			29 01 00 00 00 00 15 B8 6D B0 48 4C 95 DA 33 69 12 7A DA 00 00 00 00 00 00 00 00 00  /* 04 */
			29 01 00 00 00 00 15 B8 6D B0 48 4C 95 DA 33 69 12 7A DA 00 00 00 00 00 00 00 00 00  /* 05 */
			29 01 00 00 00 00 15 B8 6D B0 48 4C 95 DA 33 69 12 7A DA 00 00 00 00 00 00 00 00 00  /* 06 */
			29 01 00 00 00 00 15 B8 6D B0 48 4C 95 DA 33 69 12 7A DA 00 00 00 00 00 00 00 00 00  /* 07 */
			29 01 00 00 00 00 15 B8 6D B0 48 4C 95 DA 33 69 12 7A DA 00 00 00 00 00 00 00 00 00  /* 08 */
			29 01 00 00 00 00 15 B8 6D B0 48 4C 95 DA 33 69 12 7A DA 00 00 00 00 00 00 00 00 00  /* 09 */
			29 01 00 00 00 00 15 B8 6D B0 48 4C 95 DA 33 69 12 7A DA 00 00 00 00 00 00 00 00 00  /* 10 */
			29 01 00 00 00 00 15 B8 6D B0 48 4C 95 DA 33 69 12 7A DA 00 00 00 00 00 00 00 00 00  /* 11 */
			29 01 00 00 00 00 15 B8 6D B0 48 4C 95 DA 33 69 12 7A DA 00 00 00 00 00 00 00 00 00  /* 12 */
			29 01 00 00 00 00 15 B8 6D B0 48 4C 95 DA 33 69 12 7A DA 00 00 00 00 00 00 00 00 00  /* 13 */
			29 01 00 00 00 00 15 B8 6D B0 48 4C 95 DA 33 69 12 7A DA 00 00 00 00 00 00 00 00 00  /* 14 */
			29 01 00 00 00 00 15 B8 6D B0 48 4C 95 DA 33 69 12 7A DA 00 00 00 00 00 00 00 00 00  /* 15 */
			29 01 00 00 00 00 15 B8 6D B0 48 4C 95 DA 33 69 12 7A DA 00 00 00 00 00 00 00 00 00  /* 16 */
			29 01 00 00 00 00 15 B8 6D B0 48 4C 95 DA 33 69 12 7A DA 00 00 00 00 00 00 00 00 00  /* 17 */
			29 01 00 00 00 00 15 B8 6D B0 48 4C 95 DA 33 69 12 7A DA 00 00 00 00 00 00 00 00 00  /* 18 */
			29 01 00 00 00 00 15 B8 6D B0 48 4C 95 DA 33 69 12 7A DA 00 00 00 00 00 00 00 00 00  /* 19 */
			29 01 00 00 00 00 15 B8 6D B0 48 4C 95 DA 33 69 12 7A DA 00 00 00 00 00 00 00 00 00  /* 20 */
			29 01 00 00 00 00 15 B8 6D B0 48 4C 95 DA 33 69 12 7A DA 00 00 00 00 00 00 00 00 00  /* 21 */
			29 01 00 00 00 00 15 B8 6D B0 48 4C 95 DA 33 69 12 7A DA 00 00 00 00 00 00 00 00 00  /* 22 */
			29 01 00 00 00 00 15 B8 6D B0 48 4C 95 DA 33 69 12 7A DA 00 00 00 00 00 00 00 00 00  /* 23 */
			29 01 00 00 00 00 15 B8 6D B0 48 4C 95 DA 33 69 12 7A DA 00 00 00 00 00 00 00 00 00  /* 24 */
			29 01 00 00 00 00 15 B8 6D B0 48 4C 95 DA 33 69 12 7A DA 00 00 00 00 00 00 00 00 00  /* 25 */
			29 01 00 00 00 00 15 B8 6D B0 48 4C 95 DA 33 69 12 7A DA 00 00 00 00 00 00 00 00 00  /* 26 */
			29 01 00 00 00 00 15 B8 6D B0 48 4C 95 DA 33 69 12 7A DA 00 00 00 00 00 00 00 00 00  /* 27 */
			29 01 00 00 00 00 15 B8 6D B0 48 4C 95 DA 33 69 12 7A DA 00 00 00 00 00 00 00 00 00  /* 28 */
			29 01 00 00 00 00 15 B8 6D B0 48 4C 95 DA 33 69 12 7A DA 00 00 00 00 00 00 00 00 00  /* 29 */
			29 01 00 00 00 00 15 B8 6D B0 48 4C 95 DA 33 69 12 7A DA 00 00 00 00 00 00 00 00 00  /* 30 */
			29 01 00 00 00 00 15 B8 6D B0 48 4C 95 DA 33 69 12 7A DA 00 00 00 00 00 00 00 00 00  /* 31 */
			29 01 00 00 00 00 15 B8 6D B0 48 4C 95 DA 33 69 12 7A DA 00 00 00 00 00 00 00 00 00  /* 32 */
			29 01 00 00 00 00 15 B8 6D B0 48 4C 95 DA 33 69 12 7A DA 00 00 00 00 00 00 00 00 00  /* 33 */
			29 01 00 00 00 00 15 B8 6D B0 48 4C 95 DA 33 69 12 7A DA 00 00 00 00 00 00 00 00 00  /* 34 */
			29 01 00 00 00 00 15 B8 6D B0 48 4C 95 DA 33 69 12 7A DA 00 00 00 00 00 00 00 00 00  /* 35 */
			29 01 00 00 00 00 15 B8 6D B0 48 4C 95 DA 33 69 12 7A DA 00 00 00 00 00 00 00 00 00  /* 36 */
			29 01 00 00 00 00 15 B8 6D B0 48 4C 95 DA 33 69 12 7A DA 00 00 00 00 00 00 00 00 00  /* 37 */
			29 01 00 00 00 00 15 B8 6D B0 48 4C 95 DA 33 69 12 7A DA 00 00 00 00 00 00 00 00 00  /* 38 */
			29 01 00 00 00 00 15 B8 6D B0 48 4C 95 DA 33 69 12 7A DA 02 02 01 00 00 01 01 01 01  /* 39 */
			29 01 00 00 00 00 15 B8 6D B0 48 4C 95 DA 33 69 12 7A DA 02 02 02 00 00 00 01 01 01  /* 40 */
			29 01 00 00 00 00 15 B8 6D B0 48 4C 95 DA 33 69 12 7A DA 02 02 02 00 00 00 01 01 01  /* 41 */
			29 01 00 00 00 00 15 B8 6D B0 48 4C 95 DA 33 69 12 7A DA 02 02 02 00 00 00 01 01 01  /* 42 */
			29 01 00 00 00 00 15 B8 6D B0 48 4C 95 DA 33 69 12 7A DA 02 02 02 01 01 01 00 00 00  /* 43 */
			29 01 00 00 00 00 15 B8 6D B0 48 4C 95 DA 33 69 12 7A DA 02 02 02 01 01 01 00 00 00  /* 44 */
			29 01 00 00 00 00 15 B8 6D B0 48 4C 95 DA 33 69 12 7A DA 02 02 02 01 01 01 00 00 00  /* 45 */
			29 01 00 00 00 00 15 B8 6D B0 48 4C 95 DA 33 69 12 7A DA 02 02 02 01 01 01 00 00 00  /* 46 */
			29 01 00 00 00 00 15 B8 6D B0 48 4C 95 DA 33 69 12 7A DA 02 02 02 01 01 01 00 00 00  /* 47 */
			29 01 00 00 00 00 15 B8 6D B0 48 4C 95 DA 33 69 12 7A DA 02 02 02 01 01 01 00 00 00  /* 48 */
			29 01 00 00 00 00 15 B8 6D B0 48 4C 95 DA 33 69 12 7A DA 02 02 02 01 01 01 01 00 01  /* 49 */
			29 01 00 00 00 00 15 B8 6D B0 48 4C 95 DA 33 69 12 7A DA 02 02 02 01 01 01 01 00 01  /* 50 */
			29 01 00 00 00 00 15 B8 6D B0 48 4C 95 DA 33 69 12 7A DA 02 02 02 01 01 01 01 00 01  /* 51 */
			29 01 00 00 00 00 15 B8 6D B0 48 4C 95 DA 33 69 12 7A DA 02 02 02 01 01 01 01 00 01  /* 52 */
			29 01 00 00 00 00 15 B8 6D B0 48 4C 95 DA 33 69 12 7A DA 02 02 02 01 01 01 01 01 01  /* 53 */
			29 01 00 00 00 00 15 B8 6D B0 48 4C 95 DA 33 69 12 7A DA 02 02 02 01 01 01 01 01 01  /* 54 */
			29 01 00 00 00 00 15 B8 6D B0 48 4C 95 DA 33 69 12 7A DA 02 02 02 01 01 01 01 01 01  /* 55 */
			29 01 00 00 00 00 15 B8 6D B0 48 4C 95 DA 33 69 12 7A DA 02 02 02 01 01 01 01 01 01  /* 56 */
			29 01 00 00 00 00 15 B8 6D B0 48 4C 95 DA 33 69 12 7A DA 02 02 02 01 01 01 01 01 01  /* 57 */
			29 01 00 00 00 00 15 B8 6D B0 48 4C 95 DA 33 69 12 7A DA 02 02 02 01 01 01 01 01 01  /* 58 */
			29 01 00 00 00 00 15 B8 6D B0 48 4C 95 DA 33 69 12 7A DA 02 02 02 01 01 01 01 01 01  /* 59 */
			29 01 00 00 00 00 15 B8 6D B0 48 4C 95 DA 33 69 12 7A DA 03 02 02 01 02 02 00 00 00  /* 60 */
			29 01 00 00 00 00 15 B8 6D B0 48 4C 95 DA 33 69 12 7A DA 03 03 02 01 01 02 00 00 00  /* 61 */
			29 01 00 00 00 00 15 B8 6D B0 48 4C 95 DA 33 69 12 7A DA 03 03 02 01 01 02 00 00 00  /* 62 */
			29 01 00 00 00 00 15 B8 6D B0 48 4C 95 DA 33 69 12 7A DA 03 03 02 01 01 02 01 00 01  /* 63 */
			29 01 00 00 00 00 15 B8 6D B0 48 4C 95 DA 33 69 12 7A DA 03 03 02 01 01 02 01 00 01  /* 64 */
			29 01 00 00 00 00 15 B8 6D B0 48 4C 95 DA 33 69 12 7A DA 03 03 02 01 01 02 01 00 01  /* 65 */
			29 01 00 00 00 00 15 B8 6D B0 48 4C 95 DA 33 69 12 7A DA 03 03 02 01 01 02 01 00 01  /* 66 */
			29 01 00 00 00 00 15 B8 6D B0 48 4C 95 DA 33 69 12 7A DA 03 03 03 01 01 01 01 01 01  /* 67 */
			29 01 00 00 00 00 15 B8 6D B0 48 4C 95 DA 33 69 12 7A DA 03 03 03 01 01 01 01 01 01  /* 68 */
			29 01 00 00 00 00 15 B8 6D B0 48 4C 95 DA 33 69 12 7A DA 03 03 03 01 01 01 01 01 01  /* 69 */
			29 01 00 00 00 00 15 B8 6D B0 48 4C 95 DA 33 69 12 7A DA 03 03 03 01 01 01 01 01 01  /* 70 */
			29 01 00 00 00 00 15 B8 6D B0 48 4C 95 DA 33 69 12 7A DA 03 03 03 01 01 01 01 01 01  /* 71 */
			29 01 00 00 00 00 15 B8 6D B0 48 4C 95 DA 33 69 12 7A DA 03 03 03 01 01 01 01 01 01  /* 72 */
			29 01 00 00 00 00 15 B8 6D B0 48 4C 95 DA 33 69 12 7A DA 03 03 03 02 02 02 01 00 01  /* 73 */
			29 01 00 00 00 00 15 B8 6D B0 48 4C 95 DA 33 69 12 7A DA 03 03 03 02 02 02 01 00 01  /* 74 */
			29 01 00 00 00 00 15 B8 6D B0 48 4C 95 DA 33 69 12 7A DA 03 03 03 02 02 02 01 00 01  /* 75 */
			29 01 00 00 00 00 15 B8 6D B0 48 4C 95 DA 33 69 12 7A DA 03 03 03 02 02 02 01 00 01  /* 76 */
			29 01 00 00 00 00 15 B8 6D B0 48 4C 95 DA 33 69 12 7A DA 04 03 03 01 02 02 01 01 01  /* 77 */
			29 01 00 00 00 00 15 B8 6D B0 48 4C 95 DA 33 69 12 7A DA 04 04 03 01 01 02 01 01 01  /* 78 */
			29 01 00 00 00 00 15 B8 6D B0 48 4C 95 DA 33 69 12 7A DA 04 04 03 01 01 02 01 01 02  /* 79 */
			29 01 00 00 00 00 15 B8 6D B0 48 4C 95 DA 33 69 12 7A DA 04 04 03 01 01 02 02 01 02  /* 80 */
			29 01 00 00 00 00 15 B8 6D B0 48 4C 95 DA 33 69 12 7A DA 04 04 04 02 02 02 01 00 01  /* 81 */
			29 01 00 00 00 00 15 B8 6D B0 48 4C 95 DA 33 69 12 7A DA 04 04 04 02 02 02 01 00 01  /* 82 */
			29 01 00 00 00 00 15 B8 6D B0 48 4C 95 DA 33 69 12 7A DA 04 04 04 02 02 02 01 01 01  /* 83 */
			29 01 00 00 00 00 15 B8 6D B0 48 4C 95 DA 33 69 12 7A DA 04 04 04 02 02 02 01 01 01  /* 84 */
			29 01 00 00 00 00 15 B8 6D B0 48 4C 95 DA 33 69 12 7A DA 04 04 04 02 02 02 01 01 01  /* 85 */
			29 01 00 00 00 00 15 B8 6D B0 48 4C 95 DA 33 69 12 7A DA 04 04 04 02 02 02 01 01 01  /* 86 */
			29 01 00 00 00 00 15 B8 6D B0 48 4C 95 DA 33 69 12 7A DA 04 04 04 02 02 02 02 01 02  /* 87 */
			29 01 00 00 00 00 15 B8 6D B0 48 4C 95 DA 33 69 12 7A DA 04 04 04 02 02 02 02 01 02  /* 88 */
			29 01 00 00 00 00 15 B8 6D B0 48 4C 95 DA 33 69 12 7A DA 05 04 04 01 02 02 02 01 02  /* 89 */
			29 01 00 00 00 00 15 B8 6D B0 48 4C 95 DA 33 69 12 7A DA 05 05 04 02 02 03 01 00 01  /* 90 */
			29 01 00 00 00 00 15 B8 6D B0 48 4C 95 DA 33 69 12 7A DA 05 05 04 02 02 03 01 01 01  /* 91 */
			29 01 00 00 00 00 15 B8 6D B0 48 4C 95 DA 33 69 12 7A DA 05 05 04 02 02 03 01 01 02  /* 92 */
			29 01 00 00 00 00 15 B8 6D B0 48 4C 95 DA 33 69 12 7A DA 05 05 04 02 02 03 02 01 02  /* 93 */
			29 01 00 00 00 00 15 B8 6D B0 48 4C 95 DA 33 69 12 7A DA 05 05 05 02 02 02 02 01 02  /* 94 */
			29 01 00 00 00 00 15 B8 6D B0 48 4C 95 DA 33 69 12 7A DA 05 05 05 02 02 02 02 01 02  /* 95 */
			29 01 00 00 00 00 15 B8 6D B0 48 4C 95 DA 33 69 12 7A DA 05 05 05 02 02 02 02 01 02  /* 96 */
			29 01 00 00 00 00 15 B8 6D B0 48 4C 95 DA 33 69 12 7A DA 05 05 05 03 03 03 01 01 01  /* 97 */
			29 01 00 00 00 00 15 B8 6D B0 48 4C 95 DA 33 69 12 7A DA 06 05 05 02 03 03 02 01 02  /* 98 */
			29 01 00 00 00 00 15 B8 6D B0 48 4C 95 DA 33 69 12 7A DA 06 06 05 02 02 03 02 01 02  /* 99 */
			29 01 00 00 00 00 15 B8 6D B0 48 4C 95 DA 33 69 12 7A DA 06 06 05 02 02 03 02 01 02  /* 100 */
			29 01 00 00 00 00 15 B8 6D B0 48 4C 95 DA 33 69 12 7A DA 06 06 05 02 02 03 02 02 02  /* 101 */
			29 01 00 00 00 00 15 B8 6D B0 48 4C 95 DA 33 69 12 7A DA 06 06 05 02 02 03 02 02 02  /* 102 */
			29 01 00 00 00 00 15 B8 6D B0 48 4C 95 DA 33 69 12 7A DA 06 06 05 03 03 04 01 01 02  /* 103 */
			29 01 00 00 00 00 15 B8 6D B0 48 4C 95 DA 33 69 12 7A DA 06 06 06 03 03 03 02 01 02  /* 104 */
			29 01 00 00 00 00 15 B8 6D B0 48 4C 95 DA 33 69 12 7A DA 06 06 06 03 03 03 02 01 02  /* 105 */
			29 01 00 00 00 00 15 B8 6D B0 48 4C 95 DA 33 69 12 7A DA 06 06 06 03 03 03 02 01 02  /* 106 */
			29 01 00 00 00 00 15 B8 6D B0 48 4C 95 DA 33 69 12 7A DA 07 06 06 02 03 03 02 02 02  /* 107 */
			29 01 00 00 00 00 15 B8 6D B0 48 4C 95 DA 33 69 12 7A DA 07 07 06 02 02 03 03 02 03  /* 108 */
			29 01 00 00 00 00 15 B8 6D B0 48 4C 95 DA 33 69 12 7A DA 07 07 06 03 03 04 02 01 02  /* 109 */
			29 01 00 00 00 00 15 B8 6D B0 48 4C 95 DA 33 69 12 7A DA 07 07 06 03 03 04 02 01 02  /* 110 */
			29 01 00 00 00 00 15 B8 6D B0 48 4C 95 DA 33 69 12 7A DA 07 07 06 03 03 04 02 02 02  /* 111 */
			29 01 00 00 00 00 15 B8 6D B0 48 4C 95 DA 33 69 12 7A DA 07 07 07 03 03 03 03 02 03  /* 112 */
			29 01 00 00 00 00 15 B8 6D B0 48 4C 95 DA 33 69 12 7A DA 08 07 07 03 04 04 02 01 02  /* 113 */
			29 01 00 00 00 00 15 B8 6D B0 48 4C 95 DA 33 69 12 7A DA 08 08 07 03 03 04 02 01 02  /* 114 */
			29 01 00 00 00 00 15 B8 6D B0 48 4C 95 DA 33 69 12 7A DA 08 08 07 03 03 04 03 02 03  /* 115 */
			29 01 00 00 00 00 15 B8 6D B0 48 4C 95 DA 33 69 12 7A DA 08 08 07 03 03 04 03 02 03  /* 116 */
			29 01 00 00 00 00 15 B8 6D B0 48 4C 95 DA 33 69 12 7A DA 08 08 07 03 03 04 03 02 03  /* 117 */
			29 01 00 00 00 00 15 B8 6D B0 48 4C 95 DA 33 69 12 7A DA 08 08 07 04 04 05 02 01 02  /* 118 */
			29 01 00 00 00 00 15 B8 6D B0 48 4C 95 DA 33 69 12 7A DA 08 08 08 04 04 04 02 01 03  /* 119 */
			29 01 00 00 00 00 15 B8 6D B0 48 4C 95 DA 33 69 12 7A DA 09 09 08 03 03 04 03 02 03  /* 120 */
			29 01 00 00 00 00 15 B8 6D B0 48 4C 95 DA 33 69 12 7A DA 09 09 08 03 03 04 03 02 03  /* 121 */
			29 01 00 00 00 00 15 B8 6D B0 48 4C 95 DA 33 69 12 7A DA 09 09 08 04 04 05 03 01 03  /* 122 */
			29 01 00 00 00 00 15 B8 6D B0 48 4C 95 DA 33 69 12 7A DA 09 09 08 04 04 05 03 02 03  /* 123 */
			29 01 00 00 00 00 15 B8 6D B0 48 4C 95 DA 33 69 12 7A DA 0A 09 08 03 04 05 03 02 03  /* 124 */
			29 01 00 00 00 00 15 B8 6D B0 48 4C 95 DA 33 69 12 7A DA 0A 0A 09 04 04 05 03 01 03  /* 125 */
			29 01 00 00 00 00 15 B8 6D B0 48 4C 95 DA 33 69 12 7A DA 0A 0A 09 04 04 05 03 02 03  /* 126 */
			29 01 00 00 00 00 15 B8 6D B0 48 4C 95 DA 33 69 12 7A DA 0A 0A 09 04 04 05 03 02 03  /* 127 */
			29 01 00 00 00 00 15 B8 6D B0 48 4C 95 DA 33 69 12 7A DA 0A 0A 09 04 04 05 04 02 04  /* 128 */
			29 01 00 00 00 00 15 B8 6D B0 48 4C 95 DA 33 69 12 7A DA 0B 0A 09 04 05 06 03 02 03  /* 129 */
			29 01 00 00 00 00 15 B8 6D B0 48 4C 95 DA 33 69 12 7A DA 0B 0B 0A 04 04 05 04 02 04  /* 130 */
			29 01 00 00 00 00 15 B8 6D B0 48 4C 95 DA 33 69 12 7A DA 0B 0B 0A 05 05 06 03 02 03  /* 131 */
			29 01 00 00 00 00 15 B8 6D B0 48 4C 95 DA 33 69 12 7A DA 0C 0B 0A 04 05 06 04 02 04  /* 132 */
			29 01 00 00 00 00 15 B8 6D B0 48 4C 95 DA 33 69 12 7A DA 0C 0C 0B 05 05 06 03 02 04  /* 133 */
			29 01 00 00 00 00 15 B8 6D B0 48 4C 95 DA 33 69 12 7A DA 0C 0C 0B 05 05 06 04 03 04  /* 134 */
			29 01 00 00 00 00 15 B8 6D B0 48 4C 95 DA 33 69 12 7A DA 0D 0D 0B 05 05 07 04 02 04  /* 135 */
			29 01 00 00 00 00 15 B8 6D B0 48 4C 95 DA 33 69 12 7A DA 0D 0D 0C 05 05 06 05 03 05  /* 136 */
			29 01 00 00 00 00 15 B8 6D B0 48 4C 95 DA 33 69 12 7A DA 0E 0D 0C 05 06 07 04 03 04  /* 137 */
			29 01 00 00 00 00 15 B8 6D B0 48 4C 95 DA 33 69 12 7A DA 0E 0E 0C 06 06 08 04 02 04  /* 138 */
			29 01 00 00 00 00 15 B8 6D B0 48 4C 95 DA 33 69 12 7A DA 0F 0E 0D 05 06 07 05 03 05  /* 139 */
			29 01 00 00 00 00 15 B8 6D B0 48 4C 95 DA 33 69 12 7A DA 0F 0F 0D 06 06 08 04 03 05  /* 140 */
			29 01 00 00 00 00 15 B8 6D B0 48 4C 95 DA 33 69 12 7A DA 0F 0F 0E 06 06 07 05 03 05  /* 141 */
			29 01 00 00 00 00 15 B8 6D B0 48 4C 95 DA 33 69 12 7A DA 10 10 0E 06 06 08 05 03 05  /* 142 */
			29 01 00 00 00 00 15 B8 6D B0 48 4C 95 DA 33 69 12 7A DA 10 10 0F 07 07 08 05 03 05  /* 143 */
			29 01 00 00 00 00 15 B8 6D B0 48 4C 95 DA 33 69 12 7A DA 11 11 0F 07 07 09 05 03 05  /* 144 */
			29 01 00 00 00 00 15 B8 6D B0 48 4C 95 DA 33 69 12 7A DA 12 11 0F 06 07 09 06 04 06  /* 145 */
			29 01 00 00 00 00 15 B8 6D B0 48 4C 95 DA 33 69 12 7A DA 12 12 10 07 07 09 06 04 06  /* 146 */
			29 01 00 00 00 00 15 B8 6D B0 48 4C 95 DA 33 69 12 7A DA 13 12 11 07 08 09 06 04 06  /* 147 */
			29 01 00 00 00 00 15 B8 6D B0 48 4C 95 DA 33 69 12 7A DA 13 13 11 08 08 0A 06 04 06  /* 148 */
			29 01 00 00 00 00 15 B8 6D B0 48 4C 95 DA 33 69 12 7A DA 14 13 12 08 09 0A 06 03 06  /* 149 */
			29 01 00 00 00 00 15 B8 6D B0 48 4C 95 DA 33 69 12 7A DA 14 14 12 08 08 0A 07 04 07  /* 150 */
			29 01 00 00 00 00 15 B8 6D B0 48 4C 95 DA 33 69 12 7A DA 15 15 13 08 08 0A 07 04 07  /* 151 */
			29 01 00 00 00 00 15 B8 6D B0 48 4C 95 DA 33 69 12 7A DA 16 15 13 08 09 0B 07 05 07  /* 152 */
			29 01 00 00 00 00 15 B8 6D B0 48 4C 95 DA 33 69 12 7A DA 16 16 14 09 09 0B 07 04 07  /* 153 */
			29 01 00 00 00 00 15 B8 6D B0 48 4C 95 DA 33 69 12 7A DA 17 16 14 09 0A 0C 07 04 07  /* 154 */
			29 01 00 00 00 00 15 B8 6D B0 48 4C 95 DA 33 69 12 7A DA 18 17 15 09 0A 0C 08 05 08  /* 155 */
			29 01 00 00 00 00 15 B8 6D B0 48 4C 95 DA 33 69 12 7A DA 19 18 16 09 0A 0C 08 05 08  /* 156 */
			29 01 00 00 00 00 15 B8 6D B0 48 4C 95 DA 33 69 12 7A DA 19 19 16 0A 0A 0D 08 05 08  /* 157 */
			29 01 00 00 00 00 15 B8 6D B0 48 4C 95 DA 33 69 12 7A DA 1A 1A 17 0A 0A 0D 08 05 09  /* 158 */
			29 01 00 00 00 00 15 B8 6D B0 48 4C 95 DA 33 69 12 7A DA 1B 1A 18 0A 0B 0D 09 06 09  /* 159 */
			29 01 00 00 00 00 15 B8 6D B0 48 4C 95 DA 33 69 12 7A DA 1C 1B 19 0B 0C 0E 08 05 09  /* 160 */
			29 01 00 00 00 00 15 B8 6D B0 48 4C 95 DA 33 69 12 7A DA 1D 1C 19 0B 0C 0F 09 06 09  /* 161 */
			29 01 00 00 00 00 15 B8 6D B0 48 4C 95 DA 33 69 12 7A DA 1E 1D 1A 0B 0C 0F 09 06 0A  /* 162 */
			29 01 00 00 00 00 15 B8 6D B0 48 4C 95 DA 33 69 12 7A DA 1F 1E 1B 0B 0C 0F 0A 06 0A  /* 163 */
			29 01 00 00 00 00 15 B8 6D B0 48 4C 95 DA 33 69 12 7A DA 1F 1F 1C 0D 0D 10 0A 06 0A  /* 164 */
			29 01 00 00 00 00 15 B8 6D B0 48 4C 95 DA 33 69 12 7A DA 21 20 1D 0C 0D 10 0A 07 0B  /* 165 */
			29 01 00 00 00 00 15 B8 6D B0 48 4C 95 DA 33 69 12 7A DA 22 21 1E 0D 0E 11 0A 06 0A  /* 166 */
			29 01 00 00 00 00 15 B8 6D B0 48 4C 95 DA 33 69 12 7A DA 23 22 1F 0D 0E 11 0B 07 0B  /* 167 */
			29 01 00 00 00 00 15 B8 6D B0 48 4C 95 DA 33 69 12 7A DA 24 23 20 0E 0F 12 0B 07 0B  /* 168 */
			29 01 00 00 00 00 15 B8 6D B0 48 4C 95 DA 33 69 12 7A DA 25 24 21 0E 0F 12 0C 07 0C  /* 169 */
			29 01 00 00 00 00 15 B8 6D B0 48 4C 95 DA 33 69 12 7A DA 26 25 22 0F 10 13 0B 07 0C  /* 170 */
			29 01 00 00 00 00 15 B8 6D B0 48 4C 95 DA 33 69 12 7A DA 27 26 22 0F 10 14 0C 07 0C  /* 171 */
			29 01 00 00 00 00 15 B8 6D B0 48 4C 95 DA 33 69 12 7A DA 27 26 23 0F 10 13 0D 08 0D  /* 172 */
			29 01 00 00 00 00 15 B8 6D B0 48 4C 95 DA 33 69 12 7A DA 28 27 23 0F 10 14 0D 08 0D  /* 173 */
			29 01 00 00 00 00 15 B8 6D B0 48 4C 95 DA 33 69 12 7A DA 28 27 24 10 11 14 0D 08 0D  /* 174 */
			29 01 00 00 00 00 15 B8 6D B0 48 4C 95 DA 33 69 12 7A DA 29 28 24 10 11 15 0D 08 0D  /* 175 */
			29 01 00 00 00 00 15 B8 6D B0 48 4C 95 DA 33 69 12 7A DA 2A 29 25 10 11 15 0D 08 0D  /* 176 */
			29 01 00 00 00 00 15 B8 6D B0 48 4C 95 DA 33 69 12 7A DA 2A 29 25 11 12 16 0D 08 0D  /* 177 */
			29 01 00 00 00 00 15 B8 6D B0 48 4C 95 DA 33 69 12 7A DA 2B 2A 26 11 12 16 0D 08 0D  /* 178 */
			29 01 00 00 00 00 15 B8 6D B0 48 4C 95 DA 33 69 12 7A DA 2C 2B 27 11 12 16 0D 08 0E  /* 179 */
			29 01 00 00 00 00 15 B8 6D B0 48 4C 95 DA 33 69 12 7A DA 2C 2B 27 12 13 17 0D 08 0E  /* 180 */
			29 01 00 00 00 00 15 B8 6D B0 48 4C 95 DA 33 69 12 7A DA 2D 2C 28 11 12 16 0E 09 0F  /* 181 */
			29 01 00 00 00 00 15 B8 6D B0 48 4C 95 DA 33 69 12 7A DA 2E 2D 28 11 12 17 0F 09 0F  /* 182 */
			29 01 00 00 00 00 15 B8 6D B0 48 4C 95 DA 33 69 12 7A DA 2E 2D 29 12 13 17 0F 09 0F  /* 183 */
			29 01 00 00 00 00 15 B8 6D B0 48 4C 95 DA 33 69 12 7A DA 2F 2E 2A 12 13 17 0F 0A 10  /* 184 */
			29 01 00 00 00 00 15 B8 6D B0 48 4C 95 DA 33 69 12 7A DA 30 2F 2A 12 13 18 0F 0A 10  /* 185 */
			29 01 00 00 00 00 15 B8 6D B0 48 4C 95 DA 33 69 12 7A DA 30 2F 2B 13 14 18 0F 0A 10  /* 186 */
			29 01 00 00 00 00 15 B8 6D B0 48 4C 95 DA 33 69 12 7A DA 31 30 2C 13 14 18 10 0A 10  /* 187 */
			29 01 00 00 00 00 15 B8 6D B0 48 4C 95 DA 33 69 12 7A DA 32 31 2C 14 15 1A 0F 09 10  /* 188 */
			29 01 00 00 00 00 15 B8 6D B0 48 4C 95 DA 33 69 12 7A DA 33 32 2D 14 15 1A 0F 0A 10  /* 189 */
			29 01 00 00 00 00 15 B8 6D B0 48 4C 95 DA 33 69 12 7A DA 34 32 2E 14 16 1A 10 0A 10  /* 190 */
			29 01 00 00 00 00 15 B8 6D B0 48 4C 95 DA 33 69 12 7A DA 34 33 2E 15 16 1B 10 0A 11  /* 191 */
			29 01 00 00 00 00 15 B8 6D B0 48 4C 95 DA 33 69 12 7A DA 35 34 2F 15 16 1B 11 0A 11  /* 192 */
			29 01 00 00 00 00 15 B8 6D B0 48 4C 95 DA 33 69 12 7A DA 36 35 30 15 16 1B 11 0B 12  /* 193 */
			29 01 00 00 00 00 15 B8 6D B0 48 4C 95 DA 33 69 12 7A DA 37 36 31 15 16 1B 11 0B 12  /* 194 */
			29 01 00 00 00 00 15 B8 6D B0 48 4C 95 DA 33 69 12 7A DA 38 36 31 16 18 1D 11 0A 12  /* 195 */
			29 01 00 00 00 00 15 B8 6D B0 48 4C 95 DA 33 69 12 7A DA 39 37 32 16 18 1D 11 0B 12  /* 196 */
			29 01 00 00 00 00 15 B8 6D B0 48 4C 95 DA 33 69 12 7A DA 3A 38 33 16 18 1D 12 0B 13  /* 197 */
			29 01 00 00 00 00 15 B8 6D B0 48 4C 95 DA 33 69 12 7A DA 3A 39 34 17 18 1D 12 0C 13  /* 198 */
			29 01 00 00 00 00 15 B8 6D B0 48 4C 95 DA 33 69 12 7A DA 3B 3A 34 17 18 1E 12 0C 13  /* 199 */
			29 01 00 00 00 00 15 B8 6D B0 48 4C 95 DA 33 69 12 7A DA 3C 3A 35 17 19 1E 12 0C 13  /* 200 */
			29 01 00 00 00 00 15 B8 6D B0 48 4C 95 DA 33 69 12 7A DA 3C 3B 35 18 19 1F 13 0C 13  /* 201 */
			29 01 00 00 00 00 15 B8 6D B0 48 4C 95 DA 33 69 12 7A DA 3D 3C 36 18 19 1F 13 0C 13  /* 202 */
			29 01 00 00 00 00 15 B8 6D B0 48 4C 95 DA 33 69 12 7A DA 3E 3C 36 18 1A 20 13 0C 13  /* 203 */
			29 01 00 00 00 00 15 B8 6D B0 48 4C 95 DA 33 69 12 7A DA 3E 3D 37 18 19 1F 14 0D 14  /* 204 */
			29 01 00 00 00 00 15 B8 6D B0 48 4C 95 DA 33 69 12 7A DA 3F 3D 38 18 1A 1F 14 0D 15  /* 205 */
			29 01 00 00 00 00 15 B8 6D B0 48 4C 95 DA 33 69 12 7A DA 3F 3E 38 19 1A 20 14 0D 15  /* 206 */
			29 01 00 00 00 00 15 B8 6D B0 48 4C 95 DA 33 69 12 7A DA 40 3F 39 19 1A 20 14 0D 15  /* 207 */
			29 01 00 00 00 00 15 B8 6D B0 48 4C 95 DA 33 69 12 7A DA 41 3F 39 19 1B 21 14 0D 15  /* 208 */
			29 01 00 00 00 00 15 B8 6D B0 48 4C 95 DA 33 69 12 7A DA 41 40 3A 1A 1B 21 14 0D 15  /* 209 */
			29 01 00 00 00 00 15 B8 6D B0 48 4C 95 DA 33 69 12 7A DA 42 41 3B 1A 1B 21 15 0D 15  /* 210 */
			29 01 00 00 00 00 15 B8 6D B0 48 4C 95 DA 33 69 12 7A DA 43 41 3B 1A 1C 22 15 0D 16  /* 211 */
			29 01 00 00 00 00 15 B8 6D B0 48 4C 95 DA 33 69 12 7A DA 44 42 3C 1A 1C 22 15 0D 16  /* 212 */
			29 01 00 00 00 00 15 B8 6D B0 48 4C 95 DA 33 69 12 7A DA 44 43 3C 1B 1C 23 15 0D 16  /* 213 */
			29 01 00 00 00 00 15 B8 6D B0 48 4C 95 DA 33 69 12 7A DA 45 43 3D 1B 1D 23 15 0D 16  /* 214 */
			29 01 00 00 00 00 15 B8 6D B0 48 4C 95 DA 33 69 12 7A DA 46 44 3E 1B 1D 23 16 0E 16  /* 215 */
			29 01 00 00 00 00 15 B8 6D B0 48 4C 95 DA 33 69 12 7A DA 46 45 3E 1C 1D 24 16 0E 17  /* 216 */
			29 01 00 00 00 00 15 B8 6D B0 48 4C 95 DA 33 69 12 7A DA 47 45 3F 1C 1E 24 16 0E 17  /* 217 */
			29 01 00 00 00 00 15 B8 6D B0 48 4C 95 DA 33 69 12 7A DA 48 46 40 1C 1E 24 16 0E 17  /* 218 */
			29 01 00 00 00 00 15 B8 6D B0 48 4C 95 DA 33 69 12 7A DA 49 47 40 1C 1E 25 16 0E 17  /* 219 */
			29 01 00 00 00 00 15 B8 6D B0 48 4C 95 DA 33 69 12 7A DA 49 47 40 1C 1E 25 17 0F 18  /* 220 */
			29 01 00 00 00 00 15 B8 6D B0 48 4C 95 DA 33 69 12 7A DA 49 48 41 1D 1E 25 17 0E 17  /* 221 */
			29 01 00 00 00 00 15 B8 6D B0 48 4C 95 DA 33 69 12 7A DA 4A 48 41 1C 1E 25 17 0F 18  /* 222 */
			29 01 00 00 00 00 15 B8 6D B0 48 4C 95 DA 33 69 12 7A DA 4A 48 41 1D 1F 26 17 0E 18  /* 223 */
			29 01 00 00 00 00 15 B8 6D B0 48 4C 95 DA 33 69 12 7A DA 4A 49 42 1D 1E 25 18 0F 18  /* 224 */
			29 01 00 00 00 00 15 B8 6D B0 48 4C 95 DA 33 69 12 7A DA 4B 49 42 1D 1F 26 17 0F 18  /* 225 */
			29 01 00 00 00 00 15 B8 6D B0 48 4C 95 DA 33 69 12 7A DA 4B 49 43 1E 20 26 17 0E 18  /* 226 */
			29 01 00 00 00 00 15 B8 6D B0 48 4C 95 DA 33 69 12 7A DA 4C 4A 43 1D 1F 26 18 0F 18  /* 227 */
			29 01 00 00 00 00 15 B8 6D B0 48 4C 95 DA 33 69 12 7A DA 4C 4A 43 1E 20 27 17 0F 18  /* 228 */
			29 01 00 00 00 00 15 B8 6D B0 48 4C 95 DA 33 69 12 7A DA 4D 4B 44 1D 1F 26 18 0F 19  /* 229 */
			29 01 00 00 00 00 15 B8 6D B0 48 4C 95 DA 33 69 12 7A DA 4D 4B 44 1E 20 27 18 0F 19  /* 230 */
			29 01 00 00 00 00 15 B8 6D B0 48 4C 95 DA 33 69 12 7A DA 4D 4C 45 1F 20 27 18 0F 19  /* 231 */
			29 01 00 00 00 00 15 B8 6D B0 48 4C 95 DA 33 69 12 7A DA 4E 4C 45 1E 20 27 18 10 19  /* 232 */
			29 01 00 00 00 00 15 B8 6D B0 48 4C 95 DA 33 69 12 7A DA 4E 4D 45 1F 20 28 18 0F 19  /* 233 */
			29 01 00 00 00 00 15 B8 6D B0 48 4C 95 DA 33 69 12 7A DA 4F 4D 46 1E 20 27 19 10 1A  /* 234 */
			29 01 00 00 00 00 15 B8 6D B0 48 4C 95 DA 33 69 12 7A DA 4F 4D 46 1F 21 28 19 0F 19  /* 235 */
			29 01 00 00 00 00 15 B8 6D B0 48 4C 95 DA 33 69 12 7A DA 4F 4E 46 1F 20 28 19 10 1A  /* 236 */
			29 01 00 00 00 00 15 B8 6D B0 48 4C 95 DA 33 69 12 7A DA 50 4E 47 1F 21 28 19 10 1A  /* 237 */
			29 01 00 00 00 00 15 B8 6D B0 48 4C 95 DA 33 69 12 7A DA 50 4E 47 1F 21 28 19 10 1A  /* 238 */
			29 01 00 00 00 00 15 B8 6D B0 48 4C 95 DA 33 69 12 7A DA 51 4F 47 1F 21 29 19 10 1A  /* 239 */
			29 01 00 00 00 00 15 B8 6D B0 48 4C 95 DA 33 69 12 7A DA 51 4F 48 20 22 29 19 0F 1A  /* 240 */
			29 01 00 00 00 00 15 B8 6D B0 48 4C 95 DA 33 69 12 7A DA 51 50 48 20 21 29 19 10 1A  /* 241 */
			29 01 00 00 00 00 15 B8 6D B0 48 4C 95 DA 33 69 12 7A DA 52 50 48 20 22 2A 19 10 1A  /* 242 */
			29 01 00 00 00 00 15 B8 6D B0 48 4C 95 DA 33 69 12 7A DA 52 50 49 20 22 29 1A 10 1B  /* 243 */
			29 01 00 00 00 00 15 B8 6D B0 48 4C 95 DA 33 69 12 7A DA 53 51 49 20 22 2A 1A 10 1B  /* 244 */
			29 01 00 00 00 00 15 B8 6D B0 48 4C 95 DA 33 69 12 7A DA 53 51 4A 21 23 2A 19 10 1A  /* 245 */
			29 01 00 00 00 00 15 B8 6D B0 48 4C 95 DA 33 69 12 7A DA 53 52 4A 21 22 2A 1A 10 1B  /* 246 */
			29 01 00 00 00 00 15 B8 6D B0 48 4C 95 DA 33 69 12 7A DA 54 52 4A 21 23 2B 1A 10 1B  /* 247 */
			29 01 00 00 00 00 15 B8 6D B0 48 4C 95 DA 33 69 12 7A DA 54 52 4B 21 23 2A 1B 11 1C  /* 248 */
			29 01 00 00 00 00 15 B8 6D B0 48 4C 95 DA 33 69 12 7A DA 55 53 4B 21 23 2B 1A 11 1B  /* 249 */
			29 01 00 00 00 00 15 B8 6D B0 48 4C 95 DA 33 69 12 7A DA 55 53 4C 22 24 2B 1A 10 1B  /* 250 */
			29 01 00 00 00 00 15 B8 6D B0 48 4C 95 DA 33 69 12 7A DA 56 54 4C 21 23 2B 1B 11 1C  /* 251 */
			29 01 00 00 00 00 15 B8 6D B0 48 4C 95 DA 33 69 12 7A DA 56 54 4C 22 24 2C 1B 11 1C  /* 252 */
			29 01 00 00 00 00 15 B8 6D B0 48 4C 95 DA 33 69 12 7A DA 57 55 4D 21 23 2B 1B 11 1C  /* 253 */
			29 01 00 00 00 00 15 B8 6D B0 48 4C 95 DA 33 69 12 7A DA 57 55 4D 22 24 2C 1B 11 1C  /* 254 */
			29 01 00 00 00 00 15 B8 6D B0 48 4C 95 DA 33 69 12 7A DA 57 55 4D 22 24 2C 1B 11 1C  /* 255 */
		];


		/*
		* ************************************************************************************************************************
		* AID command list and mappings
		* ************************************************************************************************************************
		*/
		samsung,aid_subdivision_tx_cmds_revA = [
			29 01 00 00 00 00 03 B1 90 E2  /* 00 */
			29 01 00 00 00 00 03 B1 90 E1  /* 01 */
			29 01 00 00 00 00 03 B1 90 DF  /* 02 */
			29 01 00 00 00 00 03 B1 90 DD  /* 03 */
			29 01 00 00 00 00 03 B1 90 D3  /* 04 */
			29 01 00 00 00 00 03 B1 90 D1  /* 05 */
			29 01 00 00 00 00 03 B1 90 CF  /* 06 */
			29 01 00 00 00 00 03 B1 90 CA  /* 07 */
			29 01 00 00 00 00 03 B1 90 C3  /* 08 */
			29 01 00 00 00 00 03 B1 90 C1  /* 09 */
			29 01 00 00 00 00 03 B1 90 BF  /* 10 */
			29 01 00 00 00 00 03 B1 90 BD  /* 11 */
			29 01 00 00 00 00 03 B1 90 B3  /* 12 */
			29 01 00 00 00 00 03 B1 90 B1  /* 13 */
			29 01 00 00 00 00 03 B1 90 B0  /* 14 */
			29 01 00 00 00 00 03 B1 90 AD  /* 15 */
			29 01 00 00 00 00 03 B1 90 A3  /* 16 */
			29 01 00 00 00 00 03 B1 90 A1  /* 17 */
			29 01 00 00 00 00 03 B1 90 9F  /* 18 */
			29 01 00 00 00 00 03 B1 90 9D  /* 19 */
			29 01 00 00 00 00 03 B1 90 93  /* 20 */
			29 01 00 00 00 00 03 B1 90 92  /* 21 */
			29 01 00 00 00 00 03 B1 90 91  /* 22 */
			29 01 00 00 00 00 03 B1 90 8F  /* 23 */
			29 01 00 00 00 00 03 B1 90 8D  /* 24 */
			29 01 00 00 00 00 03 B1 90 83  /* 25 */
			29 01 00 00 00 00 03 B1 90 81  /* 26 */
			29 01 00 00 00 00 03 B1 90 7F  /* 27 */
			29 01 00 00 00 00 03 B1 90 7D  /* 28 */
			29 01 00 00 00 00 03 B1 90 73  /* 29 */
			29 01 00 00 00 00 03 B1 90 71  /* 30 */
			29 01 00 00 00 00 03 B1 90 6F  /* 31 */
			29 01 00 00 00 00 03 B1 90 6D  /* 32 */
			29 01 00 00 00 00 03 B1 90 63  /* 33 */
			29 01 00 00 00 00 03 B1 90 61  /* 34 */
			29 01 00 00 00 00 03 B1 90 5D  /* 35 */
			29 01 00 00 00 00 03 B1 90 59  /* 36 */
			29 01 00 00 00 00 03 B1 90 55  /* 37 */
			29 01 00 00 00 00 03 B1 90 51  /* 38 */
			29 01 00 00 00 00 03 B1 90 4D  /* 39 */
			29 01 00 00 00 00 03 B1 90 47  /* 40 */
			29 01 00 00 00 00 03 B1 90 42  /* 41 */
			29 01 00 00 00 00 03 B1 90 3C  /* 42 */
			29 01 00 00 00 00 03 B1 90 37  /* 43 */
			29 01 00 00 00 00 03 B1 90 31  /* 44 */
			29 01 00 00 00 00 03 B1 90 2D  /* 45 */
			29 01 00 00 00 00 03 B1 90 29  /* 46 */
			29 01 00 00 00 00 03 B1 90 25  /* 47 */
			29 01 00 00 00 00 03 B1 90 21  /* 48 */
			29 01 00 00 00 00 03 B1 90 1D  /* 49 */
			29 01 00 00 00 00 03 B1 90 17  /* 50 */
			29 01 00 00 00 00 03 B1 90 11  /* 51 */
			29 01 00 00 00 00 03 B1 90 0C  /* 52 */
			29 01 00 00 00 00 03 B1 90 06  /* 53 */
			29 01 00 00 00 00 03 B1 90 00  /* 54 */
			29 01 00 00 00 00 03 B1 80 FC  /* 55 */
			29 01 00 00 00 00 03 B1 80 F9  /* 56 */
			29 01 00 00 00 00 03 B1 80 F5  /* 57 */
			29 01 00 00 00 00 03 B1 80 F2  /* 58 */
			29 01 00 00 00 00 03 B1 80 EE  /* 59 */
			29 01 00 00 00 00 03 B1 80 E8  /* 60 */
			29 01 00 00 00 00 03 B1 80 E3  /* 61 */
			29 01 00 00 00 00 03 B1 80 DD  /* 62 */
			29 01 00 00 00 00 03 B1 80 D8  /* 63 */
			29 01 00 00 00 00 03 B1 80 D2  /* 64 */
			29 01 00 00 00 00 03 B1 80 CD  /* 65 */
			29 01 00 00 00 00 03 B1 80 C8  /* 66 */
			29 01 00 00 00 00 03 B1 80 C3  /* 67 */
			29 01 00 00 00 00 03 B1 80 BE  /* 68 */
			29 01 00 00 00 00 03 B1 80 B5  /* 69 */
			29 01 00 00 00 00 03 B1 80 AC  /* 70 */
			29 01 00 00 00 00 03 B1 80 A3  /* 71 */
			29 01 00 00 00 00 03 B1 80 9C  /* 72 */
			29 01 00 00 00 00 03 B1 80 95  /* 73 */
			29 01 00 00 00 00 03 B1 80 8E  /* 74 */
			29 01 00 00 00 00 03 B1 80 84  /* 75 */
			29 01 00 00 00 00 03 B1 80 7B  /* 76 */
			29 01 00 00 00 00 03 B1 80 71  /* 77 */
			29 01 00 00 00 00 03 B1 80 62  /* 78 */
			29 01 00 00 00 00 03 B1 80 54  /* 79 */
			29 01 00 00 00 00 03 B1 80 45  /* 80 */
			29 01 00 00 00 00 03 B1 80 3E  /* 81 */
			29 01 00 00 00 00 03 B1 80 36  /* 82 */
			29 01 00 00 00 00 03 B1 80 2F  /* 83 */
			29 01 00 00 00 00 03 B1 80 26  /* 84 */
			29 01 00 00 00 00 03 B1 80 1C  /* 85 */
			29 01 00 00 00 00 03 B1 80 13  /* 86 */
			29 01 00 00 00 00 03 B1 80 0A  /* 87 */
			29 01 00 00 00 00 03 B1 80 00  /* 88 */
			29 01 00 00 00 00 03 B1 70 F7  /* 89 */
			29 01 00 00 00 00 03 B1 70 E7  /* 90 */
			29 01 00 00 00 00 03 B1 70 D7  /* 91 */
			29 01 00 00 00 00 03 B1 70 C7  /* 92 */
			29 01 00 00 00 00 03 B1 70 BF  /* 93 */
			29 01 00 00 00 00 03 B1 70 B6  /* 94 */
			29 01 00 00 00 00 03 B1 70 AE  /* 95 */
			29 01 00 00 00 00 03 B1 70 9E  /* 96 */
			29 01 00 00 00 00 03 B1 70 8F  /* 97 */
			29 01 00 00 00 00 03 B1 70 7F  /* 98 */
			29 01 00 00 00 00 03 B1 70 6E  /* 99 */
			29 01 00 00 00 00 03 B1 70 5E  /* 100 */
			29 01 00 00 00 00 03 B1 70 4D  /* 101 */
			29 01 00 00 00 00 03 B1 70 43  /* 102 */
			29 01 00 00 00 00 03 B1 70 38  /* 103 */
			29 01 00 00 00 00 03 B1 70 2E  /* 104 */
			29 01 00 00 00 00 03 B1 70 1C  /* 105 */
			29 01 00 00 00 00 03 B1 70 09  /* 106 */
			29 01 00 00 00 00 03 B1 60 F7  /* 107 */
			29 01 00 00 00 00 03 B1 60 EA  /* 108 */
			29 01 00 00 00 00 03 B1 60 DC  /* 109 */
			29 01 00 00 00 00 03 B1 60 CF  /* 110 */
			29 01 00 00 00 00 03 B1 60 B6  /* 111 */
			29 01 00 00 00 00 03 B1 60 9C  /* 112 */
			29 01 00 00 00 00 03 B1 60 83  /* 113 */
			29 01 00 00 00 00 03 B1 60 72  /* 114 */
			29 01 00 00 00 00 03 B1 60 60  /* 115 */
			29 01 00 00 00 00 03 B1 60 4F  /* 116 */
			29 01 00 00 00 00 03 B1 60 3D  /* 117 */
			29 01 00 00 00 00 03 B1 60 2C  /* 118 */
			29 01 00 00 00 00 03 B1 60 1A  /* 119 */
			29 01 00 00 00 00 03 B1 60 01  /* 120 */
			29 01 00 00 00 00 03 B1 50 E8  /* 121 */
			29 01 00 00 00 00 03 B1 50 CF  /* 122 */
			29 01 00 00 00 00 03 B1 50 B4  /* 123 */
			29 01 00 00 00 00 03 B1 50 99  /* 124 */
			29 01 00 00 00 00 03 B1 50 7E  /* 125 */
			29 01 00 00 00 00 03 B1 50 64  /* 126 */
			29 01 00 00 00 00 03 B1 50 4A  /* 127 */
			29 01 00 00 00 00 03 B1 50 30  /* 128 */
			29 01 00 00 00 00 03 B1 50 08  /* 129 */
			29 01 00 00 00 00 03 B1 40 E1  /* 130 */
			29 01 00 00 00 00 03 B1 40 B8  /* 131 */
			29 01 00 00 00 00 03 B1 40 8E  /* 132 */
			29 01 00 00 00 00 03 B1 40 57  /* 133 */
			29 01 00 00 00 00 03 B1 40 1F  /* 134 */
			29 01 00 00 00 00 03 B1 30 E8  /* 135 */
			29 01 00 00 00 00 03 B1 30 B1  /* 136 */
			29 01 00 00 00 00 03 B1 30 D8  /* 137 */
			29 01 00 00 00 00 03 B1 30 A7  /* 138 */
			29 01 00 00 00 00 03 B1 30 D5  /* 139 */
			29 01 00 00 00 00 03 B1 30 A7  /* 140 */
			29 01 00 00 00 00 03 B1 30 DD  /* 141 */
			29 01 00 00 00 00 03 B1 30 A7  /* 142 */
			29 01 00 00 00 00 03 B1 30 D9  /* 143 */
			29 01 00 00 00 00 03 B1 30 A7  /* 144 */
			29 01 00 00 00 00 03 B1 30 D6  /* 145 */
			29 01 00 00 00 00 03 B1 30 A7  /* 146 */
			29 01 00 00 00 00 03 B1 30 DC  /* 147 */
			29 01 00 00 00 00 03 B1 30 A7  /* 148 */
			29 01 00 00 00 00 03 B1 30 D1  /* 149 */
			29 01 00 00 00 00 03 B1 30 A7  /* 150 */
			29 01 00 00 00 00 03 B1 30 DE  /* 151 */
			29 01 00 00 00 00 03 B1 30 A7  /* 152 */
			29 01 00 00 00 00 03 B1 30 D4  /* 153 */
			29 01 00 00 00 00 03 B1 30 A7  /* 154 */
			29 01 00 00 00 00 03 B1 30 DE  /* 155 */
			29 01 00 00 00 00 03 B1 30 A7  /* 156 */
			29 01 00 00 00 00 03 B1 30 D5  /* 157 */
			29 01 00 00 00 00 03 B1 30 A7  /* 158 */
			29 01 00 00 00 00 03 B1 30 D8  /* 159 */
			29 01 00 00 00 00 03 B1 30 A7  /* 160 */
			29 01 00 00 00 00 03 B1 30 DB  /* 161 */
			29 01 00 00 00 00 03 B1 30 A7  /* 162 */
			29 01 00 00 00 00 03 B1 30 D8  /* 163 */
			29 01 00 00 00 00 03 B1 30 A7  /* 164 */
			29 01 00 00 00 00 03 B1 30 DA  /* 165 */
			29 01 00 00 00 00 03 B1 30 A7  /* 166 */
			29 01 00 00 00 00 03 B1 30 D7  /* 167 */
			29 01 00 00 00 00 03 B1 30 A7  /* 168 */
			29 01 00 00 00 00 03 B1 30 D6  /* 169 */
			29 01 00 00 00 00 03 B1 30 A4  /* 170 */
			29 01 00 00 00 00 03 B1 30 83  /* 171 */
			29 01 00 00 00 00 03 B1 30 61  /* 172 */
			29 01 00 00 00 00 03 B1 30 40  /* 173 */
			29 01 00 00 00 00 03 B1 30 1F  /* 174 */
			29 01 00 00 00 00 03 B1 20 FC  /* 175 */
			29 01 00 00 00 00 03 B1 20 D8  /* 176 */
			29 01 00 00 00 00 03 B1 20 B5  /* 177 */
			29 01 00 00 00 00 03 B1 20 91  /* 178 */
			29 01 00 00 00 00 03 B1 20 6D  /* 179 */
			29 01 00 00 00 00 03 B1 20 49  /* 180 */
			29 01 00 00 00 00 03 B1 20 24  /* 181 */
			29 01 00 00 00 00 03 B1 20 00  /* 182 */
			29 01 00 00 00 00 03 B1 10 D4  /* 183 */
			29 01 00 00 00 00 03 B1 10 A8  /* 184 */
			29 01 00 00 00 00 03 B1 10 7C  /* 185 */
			29 01 00 00 00 00 03 B1 10 50  /* 186 */
			29 01 00 00 00 00 03 B1 10 6C  /* 187 */
			29 01 00 00 00 00 03 B1 10 49  /* 188 */
			29 01 00 00 00 00 03 B1 10 26  /* 189 */
			29 01 00 00 00 00 03 B1 10 03  /* 190 */
			29 01 00 00 00 00 03 B1 10 6C  /* 191 */
			29 01 00 00 00 00 03 B1 10 49  /* 192 */
			29 01 00 00 00 00 03 B1 10 26  /* 193 */
			29 01 00 00 00 00 03 B1 10 03  /* 194 */
			29 01 00 00 00 00 03 B1 10 6C  /* 195 */
			29 01 00 00 00 00 03 B1 10 49  /* 196 */
			29 01 00 00 00 00 03 B1 10 26  /* 197 */
			29 01 00 00 00 00 03 B1 10 03  /* 198 */
			29 01 00 00 00 00 03 B1 10 77  /* 199 */
			29 01 00 00 00 00 03 B1 10 60  /* 200 */
			29 01 00 00 00 00 03 B1 10 49  /* 201 */
			29 01 00 00 00 00 03 B1 10 32  /* 202 */
			29 01 00 00 00 00 03 B1 10 1A  /* 203 */
			29 01 00 00 00 00 03 B1 10 03  /* 204 */
			29 01 00 00 00 00 03 B1 10 61  /* 205 */
			29 01 00 00 00 00 03 B1 10 4A  /* 206 */
			29 01 00 00 00 00 03 B1 10 32  /* 207 */
			29 01 00 00 00 00 03 B1 10 1B  /* 208 */
			29 01 00 00 00 00 03 B1 10 03  /* 209 */
			29 01 00 00 00 00 03 B1 10 62  /* 210 */
			29 01 00 00 00 00 03 B1 10 4A  /* 211 */
			29 01 00 00 00 00 03 B1 10 32  /* 212 */
			29 01 00 00 00 00 03 B1 10 1B  /* 213 */
			29 01 00 00 00 00 03 B1 10 03  /* 214 */
			29 01 00 00 00 00 03 B1 10 5D  /* 215 */
			29 01 00 00 00 00 03 B1 10 47  /* 216 */
			29 01 00 00 00 00 03 B1 10 30  /* 217 */
			29 01 00 00 00 00 03 B1 10 1A  /* 218 */
			29 01 00 00 00 00 03 B1 10 03  /* 219 */
			29 01 00 00 00 00 03 B1 10 25  /* 220 */
			29 01 00 00 00 00 03 B1 10 1A  /* 221 */
			29 01 00 00 00 00 03 B1 10 0E  /* 222 */
			29 01 00 00 00 00 03 B1 10 03  /* 223 */
			29 01 00 00 00 00 03 B1 10 29  /* 224 */
			29 01 00 00 00 00 03 B1 10 1C  /* 225 */
			29 01 00 00 00 00 03 B1 10 10  /* 226 */
			29 01 00 00 00 00 03 B1 10 03  /* 227 */
			29 01 00 00 00 00 03 B1 00 EE  /* 228 */
			29 01 00 00 00 00 03 B1 00 D8  /* 229 */
			29 01 00 00 00 00 03 B1 00 C3  /* 230 */
			29 01 00 00 00 00 03 B1 00 B5  /* 231 */
			29 01 00 00 00 00 03 B1 00 A6  /* 232 */
			29 01 00 00 00 00 03 B1 00 98  /* 233 */
			29 01 00 00 00 00 03 B1 00 8A  /* 234 */
			29 01 00 00 00 00 03 B1 00 7D  /* 235 */
			29 01 00 00 00 00 03 B1 00 70  /* 236 */
			29 01 00 00 00 00 03 B1 00 64  /* 237 */
			29 01 00 00 00 00 03 B1 00 57  /* 238 */
			29 01 00 00 00 00 03 B1 00 45  /* 239 */
			29 01 00 00 00 00 03 B1 00 33  /* 240 */
			29 01 00 00 00 00 03 B1 00 22  /* 241 */
			29 01 00 00 00 00 03 B1 00 10  /* 242 */
			29 01 00 00 00 00 03 B1 00 32  /* 243 */
			29 01 00 00 00 00 03 B1 00 26  /* 244 */
			29 01 00 00 00 00 03 B1 00 19  /* 245 */
			29 01 00 00 00 00 03 B1 00 0C  /* 246 */
			29 01 00 00 00 00 03 B1 00 36  /* 247 */
			29 01 00 00 00 00 03 B1 00 28  /* 248 */
			29 01 00 00 00 00 03 B1 00 1A  /* 249 */
			29 01 00 00 00 00 03 B1 00 0C  /* 250 */
			29 01 00 00 00 00 03 B1 00 31  /* 251 */
			29 01 00 00 00 00 03 B1 00 24  /* 252 */
			29 01 00 00 00 00 03 B1 00 18  /* 253 */
			29 01 00 00 00 00 03 B1 00 0C  /* 254 */
			29 01 00 00 00 00 03 B1 00 0C  /* 255 */
		];

		/*
		* ************************************************************************************************************************
		* candela to index mappings
		* ************************************************************************************************************************
		*/
		samsung,candela_map_table_revA = <
			/*<idx>   <from>  <till> <candella> */
			0	0	0	2
			1	1	7	3
			2	8	14	4
			3	15	21	5
			4	22	28	6
			5	29	34	7
			6	35	39	8
			7	40	44	9
			8	45	49	10
			9	50	54	11
			10	55	59	12
			11	60	64	13
			12	65	68	14
			13	69	71	15
			14	72	74	16
			15	75	77	17
			16	78	80	19
			17	81	83	20
			18	84	86	21
			19	87	89	22
			20	90	92	24
			21	93	95	25
			22	96	98	27
			23	99	101	29
			24	102	104	30
			25	105	107	32
			26	108	110	34
			27	111	113	37
			28	114	116	39
			29	117	119	41
			30	120	122	44
			31	123	125	47
			32	126	128	50
			33	129	130	53
			34	131	132	56
			35	133	134	60
			36	135	136	64
			37	137	138	68
			38	139	140	72
			39	141	142	77
			40	143	144	82
			41	145	146	87
			42	147	148	93
			43	149	150	98
			44	151	152	105
			45	153	154	111
			46	155	156	119
			47	157	158	126
			48	159	160	134
			49	161	162	143
			50	163	164	152
			51	165	166	162
			52	167	168	172
			53	169	170	183
			54	171	174	195
			55	175	178	207
			56	179	182	220
			57	183	186	234
			58	187	190	249
			59	191	194	265
			60	195	198	282
			61	199	204	300
			62	205	209	316
			63	210	214	333
			64	215	219	350
			65	220	223	357
			66	224	227	365
			67	228	230	372
			68	231	234	380
			69	235	238	387
			70	239	242	395
			71	243	246	403
			72	247	250	412
			73	251	255	420
		>;

		samsung,hbm_candela_map_table_revA = <
			0	282	295	465	6
			1	296	309	488	7
			2	310	323	510	8
			3	324	336	533	9
			4	337	350	555	10
			5	351	364	578	11
			6	365	365	600	12
		>;
	};
};
