/* Copyright (c) 2012, Samsung Electronics Corporation. All rights reserved.
 *
 * This program is free software; you can redistribute it and/or modify
 * it under the terms of the GNU General Public License version 2 and
 * only version 2 as published by the Free Software Foundation.
 *
 * This program is distributed in the hope that it will be useful,
 * but WITHOUT ANY WARRANTY; without even the implied warranty of
 * MERCHANTABILITY or FITNESS FOR A PARTICULAR PURPOSE.  See the
 * GNU General Public License for more details.
 */

&mdss_mdp {
	ss_dsi_panel_S6E3FA2_AMS510CV01_FHD: ss_dsi_panel_S6E3FA2_AMS510CV01_FHD{
		qcom,mdss-dsi-panel-name = "samsung,mdss-amoled-dsi-panel-1080p-S6E3FA2";
		label = "ss_dsi_panel_S6E3FA2_AMS510CV01_FHD";

		qcom,mdss-dsi-panel-controller = <&mdss_dsi0>;

		qcom,mdss-dsi-panel-width = <1080>;
		qcom,mdss-dsi-panel-height = <1920>;
		qcom,mdss-dsi-bpp = <24>;
		qcom,mdss-dsi-panel-destination = "display_1";

		qcom,mdss-dsi-panel-timings = [FA 4B 41 00 66 81 34 4B 41 03 04 A0];

	qcom,mdss-dsi-on-command= [
			29 01 00 00 00 00 03 F0 5A 5A		/* TEST KEY Enable */
			29 01 00 00 00 00 03 FC 5A 5A		/* TEST KEY Enable */

			/* MIPI Interface (Single DSI) */
			05 01 00 00 00 00 02 F2 07
			05 01 00 00 05 00 02 F9 09

			05 01 00 00 14 00 02 11 00			/* Sleep out, wait 20ms(0x14) */

			/* Brightness condition set */
			29 01 00 00 00 00 22				/* 1) Gamma 2.2 Setting */
			CA 01 00 01 00 01 00 80
			80 80 80 80 80 80 80 80
			80 80 80 80 80 80 80 80
			80 80 80 80 80 80 80 00
			00 00
			29 01 00 00 00 00 05 B2 00 0E 00 0E /* AID 0% */

			29 01 00 00 00 00 15				/* CAPS ELVSS Set */
			B6 98 04 00 00 00 00
			00 03 55 54 20
			00 0A AA AF 0F
			02 22 22 10
			29 01 00 00 00 00 02 B5 41			/* 16 frame Averaging (0x41) */

			23 01 00 00 00 00 02 F7 03			/* 2) Gamma, LTPS(AID) update */
			23 01 00 00 00 00 02 F7 00

			/* TE Vsync ON	*/
			29 01 00 00 00 00 02 B0 02
			29 01 00 00 00 00 02 FD 0A
			29 01 00 00 00 00 02 FE 80
			29 01 00 00 00 00 02 FE 00
			29 01 00 00 00 00 02 35 00

			/* OSC Type Condition(Type B) */
			29 01 00 00 00 00 03 F0 5A 5A		/* TEST KEY Enable */
			29 01 00 00 00 00 03 FC 5A 5A		/* TEST KEY Enable */
			29 01 00 00 00 00 02 FD B8			/* Set TE fitting value for OSC Type B */
			29 01 00 00 00 00 02 B0 14
			29 01 00 00 00 00 02 D7 75
			29 01 00 00 00 00 02 B0 20			/* Reset the offset of OSC clock for 1 hsync */
			29 01 00 00 00 00 02 D7 00
			29 01 00 00 00 00 02 FE 80			/* Activate TE Fitting */
			29 01 00 00 78 00 02 FE 00
			29 01 00 00 00 00 03 F0 A5 A5			/* TEST KEY Disable */
			29 01 00 00 00 00 03 FC A5 A5			/* TEST KEY Disable */

			/* Touch Hsync */
			29 01 00 00 78 00 04 BD 05 02 02	/* Touch Hsync Enable */
			/* wait 120ms(0x78) */

			29 01 00 00 00 00 03 F0 A5 A5		/* TEST KEY Disable */
			29 01 00 00 00 00 03 FC A5 A5		/* TEST KEY Disable */
		];

		qcom,mdss-dsi-off-command=[
			05 01 00 00 0A 00 02 28 00	/* wait 10ms(0x0A) */
			05 01 00 00 78 00 02 10 00	/* wait 120ms(0x78) */
		];

		qcom,cont-splash-enabled;
		/*qcom,cmd-sync-wait-broadcast;*/
		/*qcom,cmd-sync-wait-trigger;*/
		/*qcom,mdss-dsi-fbc-enable=*/
		/*qcom,mdss-dsi-fbc-bpp=*/
		/*qcom,mdss-dsi-fbc-packing=*/
		/*qcom,mdss-dsi-fbc-quant-error=*/
		/*qcom,mdss-dsi-fbc-bias=*/
		/*qcom,mdss-dsi-fbc-pat-mode=*/
		/*qcom,mdss-dsi-fbc-vlc-mode=*/
		/*qcom,mdss-dsi-fbc-bflc-mode=*/
		/*qcom,mdss-dsi-fbc-h-line-budget=*/
		/*qcom,mdss-dsi-fbc-budget-ctrl=*/
		/*qcom,mdss-dsi-fbc-block-budget=*/
		/*qcom,mdss-dsi-fbc-lossless-threshold=*/
		/*qcom,mdss-dsi-fbc-lossy-threshold=*/
		/*qcom,mdss-dsi-fbc-rgb-threshold=*/
		/*qcom,mdss-dsi-fbc-lossy-mode-idx=*/

		qcom,mdss-dsi-h-back-porch = <36>;
		qcom,mdss-dsi-h-front-porch = <162>;
		qcom,mdss-dsi-h-pulse-width = <10>;
		qcom,mdss-dsi-h-sync-skew = <0>;
		qcom,mdss-dsi-v-back-porch = <3>;
		qcom,mdss-dsi-v-front-porch = <13>;
		qcom,mdss-dsi-v-pulse-width = <2>;

		qcom,mdss-dsi-h-left-border = <0>;
		qcom,mdss-dsi-h-right-border = <0>;
		qcom,mdss-dsi-v-top-border = <0>;
		qcom,mdss-dsi-v-bottom-border = <0>;

		qcom,mdss-dsi-underflow-color = <0xFF>;
		qcom,mdss-dsi-border-color = <0>;

		/*qcom,mdss-dsi-pan-enable-dynamic-fps=*/
		/*qcom,mdss-dsi-pan-fps-update=*/

		qcom,mdss-dsi-bl-pmic-control-type = "bl_ctrl_dcs";
		/*qcom,mdss-dsi-bl-pmic-bank-select=*/
		/*qcom,mdss-dsi-bl-pmic-pwm-frequency=*/
		/*qcom,mdss-dsi-pwm-gpio=*/

		qcom,mdss-dsi-bl-min-level = <1>;
		qcom,mdss-dsi-bl-max-level = <255>;
		qcom,mdss-brightness-max-level = <255>;
		qcom,mdss-dsi-interleave-mode = <0>;
		qcom,mdss-dsi-panel-type = "dsi_cmd_mode";

		/*qcom,mdss-dsi-te-check-enable; */
		qcom,mdss-dsi-te-using-te-pin;
		qcom,mdss-dsi-te-pin-select = <1>;

		qcom,mdss-dsi-te-dcs-command = <1>;
		qcom,mdss-dsi-wr-mem-start = <0x2C>;
		qcom,mdss-dsi-wr-mem-continue = <0x3C>;

		/* CMD mode panel doesn't need below stuff */
		qcom,mdss-dsi-h-sync-pulse= <0>;
		/*qcom,mdss-dsi-hfp-power-mode=*/
		/*qcom,mdss-dsi-hbp-power-mode=*/
		/*qcom,mdss-dsi-hsa-power-mode=*/
		/*qcom,mdss-dsi-last-line-interleave=*/
		/*qcom,mdss-dsi-bllp-eof-power-mode=*/
		/*qcom,mdss-dsi-bllp-power-mode=*/
		/*qcom,mdss-dsi-traffic-mode=*/

		qcom,mdss-dsi-pixel-packing = "loose";

		qcom,mdss-dsi-virtual-channel-id = <0>;
		qcom,mdss-dsi-color-order = "rgb_swap_rgb";
		qcom,mdss-dsi-lane-0-state;
		qcom,mdss-dsi-lane-1-state;
		qcom,mdss-dsi-lane-2-state;
		qcom,mdss-dsi-lane-3-state;
		qcom,mdss-dsi-lane-map = "lane_map_0123";

		qcom,mdss-dsi-t-clk-pre = <0x30>;
		qcom,mdss-dsi-t-clk-post = <0x04>;

		qcom,mdss-dsi-stream = <0>;
		qcom,mdss-dsi-mdp-trigger = "none";
		qcom,mdss-dsi-dma-trigger = "trigger_sw";
		qcom,mdss-dsi-panel-framerate = <60>;
		qcom,mdss-dsi-panel-clockrate = <898000000>;
		qcom,mdss-dsi-on-command-state = "dsi_lp_mode";
		qcom,mdss-dsi-off-command-state = "dsi_hs_mode";

		qcom,mdss-pan-physical-width-dimension = <65>;
		qcom,mdss-pan-physical-height-dimension = <115>;

		qcom,mdss-dsi-panel-mode-gpio-state = "invalid";

		/*qcom,mdss-tear-check-disable*/
		/*qcom,mdss-tear-check-sync-cfg-height=*/
		/*qcom,mdss-tear-check-sync-init-val=*/
		/*qcom,mdss-tear-check-sync-threshold-start=*/
		/*qcom,mdss-tear-check-sync-threshold-continue=*/
		/*qcom,mdss-tear-check-start-pos=*/
		/*qcom,mdss-tear-check-rd-ptr-trigger-intr=*/
		/*qcom,mdss-tear-check-frame-rate=*/

		qcom,mdss-dsi-reset-sequence = <1 10>, <0 10>, <1 10>;
		/*qcom,partial-update-enabled*/
		/*qcom,partial-update-roi-merge*/
		/*qcom,mdss-dsi-horizontal-line-idle*/

		qcom,mdss-dsi-lp11-init;
		qcom,mdss-dsi-init-delay-us = <1000>;

		/*qcom,mdss-dsi-rx-eot-ignore;*/
		qcom,mdss-dsi-tx-eot-append;

		/*qcom,ulps-enabled*/
		/*qcom,panel-roi-alignment=<4 4 2 2 20 20>;*/
		/*qcom,esd-check-enabled*/
		/*qcom,mdss-dsi-panel-status-command=*/
		/*qcom,mdss-dsi-panel-status-command-mode="dsi_lp_mode";*/
		/*qcom,mdss-dsi-panel-status-check-mode="reg_read";*/
		/*qcom,mdss-dsi-panel-status-value=<1>;*/
		/*qcom,dynamic-mode-switch-enabled*/
		/*qcom,video-to-cmd-mode-switch-commands=*/
		/*qcom,cmd-to-video-mode-switch-commands=*/
/*
 * ************************************************************************************************************************************
 *
 *
 *			Below  parameters are samsung dependent thigs
 *
 *
 * ************************************************************************************************************************************
 */
		samsung,dsi-lp11-init;
		samsung,osc-te-fitting-enable;
		/*
		 * Index of te fitting command from
		 * "qcom,mdss-dsi-on-command" and
		 * "samsung,osc_te_fitting_tx_cmds_revA"
		 */
		samsung,osc-te-fitting-cmd-index = <20 03>;
		/* Check the duration of N-1 vsync */
		samsung,osc-te-fitting-sampling-rate = <5>;
 		samsung,display_on_tx_cmds_revI = [05 01 00 00 32 00 02 29 00];
		samsung,display_off_tx_cmds_revI = [05 01 00 00 32 00 02 28 00];

		samsung,level1_key_enable_tx_cmds_revI = [
			29 01 00 00 00 00 03 F0 5A 5A
		];
		samsung,level1_key_disable_tx_cmds_revI = [
			29 01 00 00 00 00 03 F0 A5 A5
		];
		samsung,level2_key_enable_tx_cmds_revI = [
			29 00 00 00 00 00 03 F0 5A 5A
			29 01 00 00 00 00 03 fc 5a 5a
		];
		samsung,level2_key_disable_tx_cmds_revI = [
			29 00 00 00 00 00 03 F0 A5 A5
			29 01 00 00 00 00 03 fc A5 A5
		];

		samsung,packet_size_tx_cmds_revA = [
			37 01 00 00 00 00 02 07 00
		];

		/*
		 * First parameters can be changed
		 * by function of samsung_nv_read()
		 * because of that means offset of
		 * read position
		 */
		samsung,reg_read_pos_tx_cmds_revA = [
			15 01 00 00 00 00 02 B0 00
		];

		samsung,hsync_on_tx_cmds_revI = [
				29 01 00 00 00 00 03 F0 5A 5A		/* TEST KEY Enable */
				29 01 00 00 00 00 04 BD 85 02 0C	/* Touch Hsync Enable */
				29 01 00 00 00 00 03 F0 A5 A5		/* TEST KEY Disable */
		];

		/*
		 * ************************************************************************************************************************
		 *	 06 01 00 00 00 00 01 c8 07 21
		 *	READ 0xC8 SIZE 0x07 OFFSET 0x21
		 * ************************************************************************************************************************
		 */
		samsung,smart_dimming_mtp_rx_cmds_revI = [ 06 01 00 00 00 00 01 c8 21 00];
		/* the last byte in all read commands will represent READ LENGH */
		samsung,manufacture_id0_rx_cmds_revI = [ 06 01 00 00 00 00 01 da 01 00];
		samsung,manufacture_id1_rx_cmds_revI = [ 06 01 00 00 00 00 01 db 01 00];
		samsung,manufacture_id2_rx_cmds_revI = [ 06 01 00 00 00 00 01 dc 01 00];

		samsung,manufacture_date_rx_cmds_revI = [ 06 01 00 00 00 00 01 c8 02 28];	/* read C8 41~42th , 40=0x28*/
		samsung,ddi_id_rx_cmds_revI = [ 06 01 00 00 00 00 01 d6 05 00];	/* read D6 1~5th */
		samsung,mtp_read_sysfs_rx_cmds_revI = [ 06 01 00 00 00 00 01 01 01 01];

		samsung,hbm_rx_cmds_revI = [ 06 01 00 00 00 00 01 c8 07 21];	/* read C8 34~40th , 33=0x21*/
		samsung,hbm2_rx_cmds_revI = [ 06 01 00 00 00 00 01 c8 0F 48];	/* read C8 73~87th , 72=0x48*/

		samsung,elvss_rx_cmds_revI = [ 06 01 00 00 00 00 01 b6 01 14];	/* read C6 21th , 20=0x14*/
		samsung,mdnie_read_rx_cmds_revI	= [ 06 01 00 00 00 00 01 A1 04 00];

		samsung,ldi_debug0_rx_cmds_revI = [06 01 00 00 00 00 01 0A 01 00];
		samsung,ldi_debug1_rx_cmds_revI = [06 01 00 00 00 00 01 0E 01 00];
		samsung,ldi_debug2_rx_cmds_revI = [06 01 00 00 00 00 01 EA 08 00];

		/*
		 * ************************************************************************************************************************
		 * 	 COMMON CMD LIST
		 * ************************************************************************************************************************
		 */
		samsung,partial_display_on_tx_cmds_revI = [
			29 00 00 00 00 00 05 30 00 C8 03 20
			29 01 00 00 00 00 02 12 00
		];
		samsung,partial_display_off_tx_cmds_revI = [29 01 00 00 00 00 02 13 00];
		samsung,partial_display_column_row_tx_cmds_revI = [
			29 00 00 00 00 00 05 2a 00 00 03 00
			29 01 00 00 00 00 05 2b 00 00 05 00
		];

		samsung,elvss_lowtemp_tx_cmds_revI = [
			29 01 00 00 00 00 02 B0 05
			29 01 00 00 00 00 02 B8 00
		];	/* Low Temperature Command */

		samsung,elvss_lowtemp2_tx_cmds_revI = [
			29 01 00 00 00 00 02 B0 14
			29 01 00 00 00 00 02 B6 00
		];	/* Low Temperature Command: default */


		samsung,gamma_tx_cmds_revI = [
			29 01 00 00 00 00 22            /* Brightness Condition Set - Gamma 2.2 Setting*/
				CA 01 00 01 00 01 00 80
				80 80 80 80 80 80 80 80
				80 80 80 80 80 80 80 80
				80 80 80 80 80 80 80 00
				00 00
			29 01 00 00 00 00 02 00 00
			29 01 00 00 00 00 02 F7 03	/* Gamma, LTPS(AID) update */

			29 01 00 00 00 00 3C		/* dummy for single transmission more 100ns delay */
			00 00 00 00 00 00 00 00 00 00
			00 00 00 00 00 00 00 00 00 00
			00 00 00 00 00 00 00 00 00 00
			00 00 00 00 00 00 00 00 00 00
			00 00 00 00 00 00 00 00 00 00
			00 00 00 00 00 00 00 00 00 00

			29 01 00 00 00 00 02 F7 00
		];

		samsung,hbm_gamma_tx_cmds_revI = [
				29 01 00 00 00 00 22	/* Brightness Condition Set for HBM - Gamma 2.2 Setting*/
				CA 01 00 01 00 01 00 80
				80 80 80 80 80 80 80 80
				80 80 80 80 80 80 80 80
				80 80 80 80 80 80 80 00
				00 00
		];

		samsung,hbm_etc_tx_cmds_revI = [
			29 01 00 00 00 00 05 B2 00 0E 00 0E	/* AID 0% */
			29 01 00 00 00 00 16 B6
				88 04 00 00 00
				00 00 03 55 54
				20 00 0A AA AF
				0F 02 11 11 10
				00			/* HBM ELVSS Setting */
			/*29 01 00 00 00 00 07 B5 03 99 27 1F 45 0A*/	/* ACL control */
			29 01 00 00 00 00 02 55 02	/* RE(low) & ACL */
			29 01 00 00 00 00 02 B5 51	/* 32 frame Averaging (0x51) */
			29 01 00 00 00 00 02 00 00
			29 01 00 00 00 00 02 F7 03	/* Gamma, LTPS(AID) update */

			29 01 00 00 00 00 3C		/* dummy for single transmission more 100ns delay */
			00 00 00 00 00 00 00 00 00 00
			00 00 00 00 00 00 00 00 00 00
			00 00 00 00 00 00 00 00 00 00
			00 00 00 00 00 00 00 00 00 00
			00 00 00 00 00 00 00 00 00 00
			00 00 00 00 00 00 00 00 00 00

			29 01 00 00 00 00 02 F7 00
		];

		samsung,osc_te_fitting_tx_cmds_revA = [
			/* TEST KEY Enable */
			29 01 00 00 00 00 03 F0 5A 5A
			29 01 00 00 00 00 03 FC 5A 5A

			/* Set TE fitting value for OSC Type B */
			29 01 00 00 00 00 02 B0 14
			29 01 00 00 00 00 02 D7 00

			/*
			 * Reset the offset of OSC clock for 1 hsync
			 */
			29 01 00 00 00 00 02 B0 20
			29 01 00 00 00 00 02 D7 00

			/* Activate TE Fitting */
			29 01 00 00 00 00 02 FE 80
			29 01 00 64 00 00 02 FE 00

			/* TEST KEY Disable */
			29 01 00 00 00 00 03 F0 A5 A5
			29 01 00 00 00 00 03 FC A5 A5

		];

		/*
		 * ************************************************************************************************************************
		 * AID command list and mappings
		 * ************************************************************************************************************************
		 */
		/* bl_level, Index in acl command list */
		samsung,aid_tx_cmds_revI = [
			29 01 00 00 00 00 05 B2 07 68 00 0E /* 0  samsung_brightness_aor_2cd_97.9 */
			29 01 00 00 00 00 05 B2 07 58 00 0E /* 1  samsung_brightness_aor_3cd_97.1 */
			29 01 00 00 00 00 05 B2 07 49 00 0E /* 2  samsung_brightness_aor_4cd_96.3 */
			29 01 00 00 00 00 05 B2 07 39 00 0E /* 3  samsung_brightness_aor_5cd_95.5 */
			29 01 00 00 00 00 05 B2 07 29 00 0E /* 4  samsung_brightness_aor_6cd_94.7 */
			29 01 00 00 00 00 05 B2 07 19 00 0E /* 5  samsung_brightness_aor_7cd_93.9 */
			29 01 00 00 00 00 05 B2 07 09 00 0E /* 6  samsung_brightness_aor_8cd_93.0 */
			29 01 00 00 00 00 05 B2 06 F8 00 0E /* 7  samsung_brightness_aor_9cd_92.1 */
			29 01 00 00 00 00 05 B2 06 E7 00 0E /* 8  samsung_brightness_aor_10cd_91.3 */
			29 01 00 00 00 00 05 B2 06 D7 00 0E /* 9  samsung_brightness_aor_11cd_90.4 */
			29 01 00 00 00 00 05 B2 06 C8 00 0E /* 10 samsung_brightness_aor_12cd_89.7 */
			29 01 00 00 00 00 05 B2 06 B7 00 0E /* 11 samsung_brightness_aor_13cd_88.8 */
			29 01 00 00 00 00 05 B2 06 A5 00 0E /* 12 samsung_brightness_aor_14cd_87.9 */
			29 01 00 00 00 00 05 B2 06 95 00 0E /* 13 samsung_brightness_aor_15cd_87.0 */
			29 01 00 00 00 00 05 B2 06 83 00 0E /* 14 samsung_brightness_aor_16cd_87.0 */
			29 01 00 00 00 00 05 B2 06 73 00 0E /* 15 samsung_brightness_aor_17cd_85.3 */
			29 01 00 00 00 00 05 B2 06 53 00 0E /* 16 samsung_brightness_aor_19cd_83.6 */
			29 01 00 00 00 00 05 B2 06 2F 00 0E /* 17 samsung_brightness_aor_20cd_81.8 */
			29 01 00 00 00 00 05 B2 06 27 00 0E /* 18 samsung_brightness_aor_21cd_81.4 */
			29 01 00 00 00 00 05 B2 06 17 00 0E /* 19 samsung_brightness_aor_22cd_80.5 */
			29 01 00 00 00 00 05 B2 05 FF 00 0E /* 20 samsung_brightness_aor_24cd_79.3 */
			29 01 00 00 00 00 05 B2 05 EF 00 0E /* 21 samsung_brightness_aor_25cd_78.5 */
			29 01 00 00 00 00 05 B2 05 CC 00 0E /* 22 samsung_brightness_aor_27cd_76.7*/
			29 01 00 00 00 00 05 B2 05 AB 00 0E /* 23 samsung_brightness_aor_29cd_74.9 */
			29 01 00 00 00 00 05 B2 05 98 00 0E /* 24 samsung_brightness_aor_30cd_74.0 */
			29 01 00 00 00 00 05 B2 05 76 00 0E /* 25 samsung_brightness_aor_32cd_72.2 */
			29 01 00 00 00 00 05 B2 05 53 00 0E /* 26 samsung_brightness_aor_34cd_70.4*/
			29 01 00 00 00 00 05 B2 05 1D 00 0E /* 27 samsung_brightness_aor_37cd_67.6*/
			29 01 00 00 00 00 05 B2 04 FB 00 0E /* 28 samsung_brightness_aor_39cd_65.9 */
			29 01 00 00 00 00 05 B2 04 D2 00 0E /* 29 samsung_brightness_aor_41cd_63.7 */
			29 01 00 00 00 00 05 B2 04 9E 00 0E /* 30 samsung_brightness_aor_44cd_61.1 */
			29 01 00 00 00 00 05 B2 04 62 00 0E /* 31 samsung_brightness_aor_47cd_58.0 */
			29 01 00 00 00 00 05 B2 04 2B 00 0E /* 32 samsung_brightness_aor_50cd_55.1*/
			29 01 00 00 00 00 05 B2 03 ED 00 0E /* 33 samsung_brightness_aor_53cd_51.9 */
			29 01 00 00 00 00 05 B2 03 AD 00 0E /* 34 samsung_brightness_aor_56cd_48.6 */
			29 01 00 00 00 00 05 B2 03 56 00 0E /* 35 samsung_brightness_aor_60cd_44.1 */
			29 01 00 00 00 00 05 B2 03 29 00 0E /* 36 samsung_brightness_aor_64_152cd_41.8 */
			29 01 00 00 00 00 05 B2 02 BE 00 0E /* 37 samsung_brightness_aor_162cd_36.6 */
			29 01 00 00 00 00 05 B2 02 67 00 0E /* 38 samsung_brightness_aor_172cd_31.8 */
			29 01 00 00 00 00 05 B2 02 1D 00 0E /* 39 samsung_brightness_aor_183cd_27.9  */
			29 01 00 00 00 00 05 B2 01 BD 00 0E /* 40 samsung_brightness_aor_195cd_23.0*/
			29 01 00 00 00 00 05 B2 01 4E 00 0E /* 41 samsung_brightness_aor_207cd_17.3 */
			29 01 00 00 00 00 05 B2 00 D6 00 0E /* 42 samsung_brightness_aor_220cd_11.1*/
			29 01 00 00 00 00 05 B2 00 53 00 0E /* 43 samsung_brightness_aor_234cd_4.3*/
			29 01 00 00 00 00 05 B2 00 0E 00 0E /* 44 samsung_brightness_aor_249_350.7 0cd_0.7 */
		];


		/* bl_level, Index in acl command list */
		samsung,aid_map_table_revI = <
			2	0
			4	2		5	3		6	4		8	6		9	7
			10	8		12	10		13	11		15	13		16	14
			17	15		19	16		20	17		21	18		24	20
			25	21		27	22		29	23		30	24		32	25
			34	26		37	27		39	28		41	29		44	30
			47	31		50	32		53	33		56	34		60	35
			64	36		68	36		72	36		77	36		82	36
			87	36		93	36		98	36		105	36		111	36
			119	36		126	36		134	36		143	36		152	36
			162	37		172	38		183	39		195	40		207	41
			220	42		234	43		249	44		265	44		282	44
			300	44		316	44		333	44		350	44
			>;

		/*
		 * ************************************************************************************************************************
		 * ACL command list and mappings
		 * ************************************************************************************************************************
		 */
		samsung,acl_on_tx_cmds_revI = [
			29 01 00 00 00 00 02 B5 51
		];	/* ACL on, B5 <- 0x51 */

		samsung,acl_percent_tx_cmds_revI = [
			29 01 00 00 00 00 02 55 00
			29 01 00 00 00 00 02 55 01	/* ACL 30% */
			29 01 00 00 00 00 02 55 02	/* default ACL 15% */
			29 01 00 00 00 00 02 55 03
		];	/* ACL 50% */

		samsung,acl_off_tx_cmds_revI = [
			29 01 00 00 00 00 02 B5 41	/* ACL OFF - 41 (16Frame Averaging) */
			29 01 00 00 00 00 02 55 00
		];	/*off, b5<-0x41*/

		/* bl_level , Index in acl command list */
		samsung,acl_map_table_revI =  <
			2    2
			4    2	 	5    2         	 6   2          8   2		9   2
			10   2          12   2   	13   2        	15   2		16   2
			17   2   	19   2     	20   2	 	21   2		24   2
			25   2      	27   2	 	29   2         	30   2		32   2
			34   2      	37   2	 	39   2         	41   2		44   2
			47   2      	50   2	 	53   2         	56   2		60   2
			64   2      	68   2	 	72   2         	77   2        	82   2
			87   2      	93   2  	98   2         	105  2        	111  2
			119  2      	126  2 		134  2         	143  2        	152  2
			162  2      	172  2	 	183  2         	195  2        	207  2
			220  2      	234  2	 	249  2         	265  2        	282  2
			300  2	  	316  2	 	333  2		350  2		>;

		/*
		 * ************************************************************************************************************************
		 * ELVSS(ACL Off) command list and mappings
		 * ************************************************************************************************************************
		 */
		samsung,elvss_tx_cmds_revI = [
			29 01 00 00 00 00 03 b6 88 0B /* 0 */
			29 01 00 00 00 00 03 b6 88 0C /* 1 */
			29 01 00 00 00 00 03 b6 88 0C /* 2 */
			29 01 00 00 00 00 03 b6 88 0D /* 3 */
			29 01 00 00 00 00 03 b6 88 0D /* 4 */
			29 01 00 00 00 00 03 b6 88 0E /* 5 */
			29 01 00 00 00 00 03 b6 88 0F /* 6 */
			29 01 00 00 00 00 03 b6 88 10 /* 7 */
			29 01 00 00 00 00 03 b6 88 0F /* 8 */
			29 01 00 00 00 00 03 b6 88 0E /* 9 */
			29 01 00 00 00 00 03 b6 88 0E /* 10 */
			29 01 00 00 00 00 03 b6 88 0D /* 11 */
			29 01 00 00 00 00 03 b6 88 0D /* 12 */
			29 01 00 00 00 00 03 b6 88 0C /* 13 */
			29 01 00 00 00 00 03 b6 88 0C /* 14 */
			29 01 00 00 00 00 03 b6 88 0B /* 15 */
			29 01 00 00 00 00 03 b6 88 0A /* 16 */
			29 01 00 00 00 00 03 b6 88 09 /* 17 */
			29 01 00 00 00 00 03 b6 88 09 /* 18 */
			29 01 00 00 00 00 03 b6 88 09 /* 19 */
			29 01 00 00 00 00 03 b6 88 09 /* 20 */
			29 01 00 00 00 00 03 b6 88 09 /* 21 */
			29 01 00 00 00 00 03 b6 88 09 /* 22 */
			29 01 00 00 00 00 03 b6 88 09 /* 23 */
			29 01 00 00 00 00 03 b6 88 09 /* 24 */
			29 01 00 00 00 00 03 b6 88 08 /* 25 */
			29 01 00 00 00 00 03 b6 88 07 /* 26 */
			29 01 00 00 00 00 03 b6 88 06 /* 27 */
			29 01 00 00 00 00 03 b6 88 06 /* 28 */
			29 01 00 00 00 00 03 b6 88 05 /* 29 */
			29 01 00 00 00 00 03 b6 88 04 /* 30 */
		];

		/*
		 * ************************************************************************************************************************
		 * SMART ACL(ACL On) ELVSS command list and mappings
		 * ************************************************************************************************************************
		 */
		samsung,smart_acl_elvss_tx_cmds_revI = [
			29 01 00 00 00 00 03 b6 88 0B /* 0 */
			29 01 00 00 00 00 03 b6 88 0C /* 1 */
			29 01 00 00 00 00 03 b6 88 0C /* 2 */
			29 01 00 00 00 00 03 b6 88 0D /* 3 */
			29 01 00 00 00 00 03 b6 88 0D /* 4 */
			29 01 00 00 00 00 03 b6 88 0E /* 5 */
			29 01 00 00 00 00 03 b6 88 0F /* 6 */
			29 01 00 00 00 00 03 b6 88 10 /* 7 */
			29 01 00 00 00 00 03 b6 88 0F /* 8 */
			29 01 00 00 00 00 03 b6 88 0E /* 9 */
			29 01 00 00 00 00 03 b6 88 0E /* 10 */
			29 01 00 00 00 00 03 b6 88 0D /* 11 */
			29 01 00 00 00 00 03 b6 88 0D /* 12 */
			29 01 00 00 00 00 03 b6 88 0C /* 13 */
			29 01 00 00 00 00 03 b6 88 0C /* 14 */
			29 01 00 00 00 00 03 b6 88 0B /* 15 */
			29 01 00 00 00 00 03 b6 88 0A /* 16 */
			29 01 00 00 00 00 03 b6 88 09 /* 17 */
			29 01 00 00 00 00 03 b6 88 09 /* 18 */
			29 01 00 00 00 00 03 b6 88 09 /* 19 */
			29 01 00 00 00 00 03 b6 88 09 /* 20 */
			29 01 00 00 00 00 03 b6 88 09 /* 21 */
			29 01 00 00 00 00 03 b6 88 09 /* 22 */
			29 01 00 00 00 00 03 b6 88 09 /* 23 */
			29 01 00 00 00 00 03 b6 88 09 /* 24 */
			29 01 00 00 00 00 03 b6 88 08 /* 25 */
			29 01 00 00 00 00 03 b6 88 07 /* 26 */
			29 01 00 00 00 00 03 b6 88 06 /* 27 */
			29 01 00 00 00 00 03 b6 88 06 /* 28 */
			29 01 00 00 00 00 03 b6 88 05 /* 29 */
			29 01 00 00 00 00 03 b6 88 04 /* 30 */
		];

		/* bl_level, Index in elvss command list */
		samsung,smart_acl_elvss_map_table_revI = <
			2    0
			4    0			5    0			6		 0			8    0			9   0
			10   0			12   0			13   0			15   0			16   0
			17   0			19   0			20   0			21   0			24   0
			25   0			27   0			29   0			30   0			32   0
			34   0			37   0			39   0			41   0			44   0
			47   0			50   0			53   0			56   0			60   0
			64   0			68   0			72   0			77   0			82   1
			87   2			93   3			98   4			105  5			111  6
			119  7			126  8			134  9			143  10			152  11
			162  12			172  13			183  14			195  15			207  16
			220  17			234  18			249  19			265  20			 282  21
			300  22			316  23			333	 24			350  25	
		>;
		/*
		 * ************************************************************************************************************************
		 * candela to index mappings
		 * ************************************************************************************************************************
		 */
		samsung,candela_map_table_revI = <
		/*<idx><PMSL range> <candella> *//*linear map*/
				0	1	2	2
				1	3	3	4
				2	4	4	5
				3	5	5	6
				4	6	6	8
				5	7	7	9
				6	8	8	10
				7	9	9	12
				8	10	10	13
				9	11	11	15
				10	12	12	16
				11	13	13	17
				12	14	14	19
				13	15	15	20
				14	16	16	21
				15	17	17	24
				16	18	18	25
				17	19	19	27
				18	20	21	29
				19	22	23	30
				20	24	24	32
				21	25	26	34
				22	27	28	37
				23	29	29	39
				24	30	32	41
				25	33	34	44
				26	35	36	47
				27	37	38	50
				28	39	40	53
				29	41	43	56
				30	44	46	60
				31	47	49	64
				32	50	52	68
				33	53	56	72
				34	57	59	77
				35	60	63	82
				36	64	67	87
				37	68	71	93
				38	72	76	98
				39	77	80	105
				40	81	86	111
				41	87	91	119
				42	92	97	126
				43	98	104	134
				44	105	110	143
				45	111	118	152
				46	119	125	162
				47	126	133	172
				48	134	142	183
				49	143	150	195
				50	151	160	207
				51	161	170	220
				52	171	181	234
				53	182	193	249
				54	194	205	265
				55	206	218	282
				56	219	230	300
				57	231	242	316
				58	243	254	333
				59	255	255	350
		>;

		/*
		 * ************************************************************************************************************************
		 *   APLPM
		 * ************************************************************************************************************************
		 */
		samsung,alpm_on_tx_cmds_revI = [
			05 01 00 00 14 00 02 28 00	/* display off wait 20ms */
			29 01 00 00 00 00 03 F0 5A 5A	/* TEST KEY Enable */
			29 01 00 00 00 00 0A		/* Update Gamma */
				BB 01 00 00 00
				07 80 4D 4A 5B
			29 01 00 00 00 00 03 F0 A5 A5	/* TEST KEY Enable */
			/* image write for APLM mode */
			29 01 00 00 00 00 05 30 00 00 00 00	/* user set partial area */
			29 01 00 00 00 00 02 12 00		/* partial mode on */
			29 01 00 00 14 00 02 39 00		/* idel mode on wait 20ms */
/*			29 01 00 00 00 00 02 29 00*/		/* display on */
		];

		samsung,alpm_off_tx_cmds_revI = [
			05 01 00 00 14 00 02 28 00	/* display off wait 20ms */
			/* image write for normal mode */
			29 01 00 00 00 00 02 38 00	/* idel Mode off */
			29 01 00 00 00 00 02 13 00	/* normal mode on */

/*			29 01 00 00 00 00 02 29 00*/	/* display on */
		];
	};
};
