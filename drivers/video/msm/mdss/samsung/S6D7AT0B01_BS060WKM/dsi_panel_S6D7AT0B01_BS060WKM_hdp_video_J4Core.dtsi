/* Copyright (c) 2013-14, Samsung Electronics Corporation. All rights reserved.
 *
 * This program is free software; you can redistribute it and/or modify
 * it under the terms of the GNU General Public License version 2 and
 * only version 2 as published by the Free Software Foundation.
 *
 * This program is distributed in the hope that it will be useful,
 * but WITHOUT ANY WARRANTY; without even the implied warranty of
 * MERCHANTABILITY or FITNESS FOR A PARTICULAR PURPOSE.  See the
 * GNU General Public License for more details.
 */

/*---------------------------------------------------------------------------
 * This file is autogenerated file using gcdb parser. Please do not edit it.
 * Update input XML file to add a new entry or update variable in this file
 * VERSION = "1.0"
 *---------------------------------------------------------------------------*/
&mdss_mdp {
	ss_dsi_panel_S6D7AT0B01_BS060WKM_HDP: ss_dsi_panel_S6D7AT0B01_BS060WKM_HDP {
		/*
		* ************************************************************************************************************************
		* Scaled level to index mappings
		* ************************************************************************************************************************
		*/
		samsung,candela_map_table_revA = <
		/*<idx>	<from>  <till> <scaled_level> */
			0		0		0		0
			1		1		1		0
			2		2		2		15
			3		3		3		23
			4		4		4		31
			5		5		5		39
			6		6		6		46
			7		7		7		53
			8		8		8		60
			9		9		9		67
			10		10		10		74
			11		11		11		81
			12		12		12		88
			13		13		13		95
			14		14		14		102
			15		15		15		109
			16		16		16		116
			17		17		17		123
			18		18		18		130
			19		19		19		137
			20		20		20		144
			21		21		21		151
			22		22		22		158
			23		23		23		165
			24		24		24		172
			25		25		25		179
			26		26		26		186
			27		27		27		193
			28		28		28		200
			29		29		29		207
			30		30		30		214
			31		31		31		221
			32		32		32		228
			33		33		33		235
			34		34		34		242
			35		35		35		249
			36		36		36		256
			37		37		37		263
			38		38		38		270
			39		39		39		277
			40		40		40		284
			41		41		41		291
			42		42		42		298
			43		43		43		305
			44		44		44		312
			45		45		45		319
			46		46		46		326
			47		47		47		333
			48		48		48		340
			49		49		49		347
			50		50		50		354
			51		51		51		361
			52		52		52		368
			53		53		53		375
			54		54		54		382
			55		55		55		389
			56		56		56		396
			57		57		57		403
			58		58		58		410
			59		59		59		417
			60		60		60		424
			61		61		61		431
			62		62		62		438
			63		63		63		445
			64		64		64		452
			65		65		65		459
			66		66		66		465
			67		67		67		471
			68		68		68		477
			69		69		69		483
			70		70		70		489
			71		71		71		495
			72		72		72		501
			73		73		73		507
			74		74		74		513
			75		75		75		519
			76		76		76		525
			77		77		77		531
			78		78		78		537
			79		79		79		543
			80		80		80		549
			81		81		81		555
			82		82		82		561
			83		83		83		567
			84		84		84		573
			85		85		85		579
			86		86		86		585
			87		87		87		591
			88		88		88		597
			89		89		89		603
			90		90		90		609
			91		91		91		615
			92		92		92		621
			93		93		93		627
			94		94		94		633
			95		95		95		639
			96		96		96		645
			97		97		97		651
			98		98		98		657
			99		99		99		663
			100		100		100		669
			101		101		101		675
			102		102		102		681
			103		103		103		687
			104		104		104		693
			105		105		105		699
			106		106		106		705
			107		107		107		711
			108		108		108		717
			109		109		109		723
			110		110		110		729
			111		111		111		735
			112		112		112		741
			113		113		113		747
			114		114		114		753
			115		115		115		759
			116		116		116		765
			117		117		117		771
			118		118		118		777
			119		119		119		783
			120		120		120		789
			121		121		121		795
			122		122		122		801
			123		123		123		807
			124		124		124		813
			125		125		125		819
			126		126		126		825
			127		127		127		831
			128		128		128		837
			129		129		129		847
			130		130		130		857
			131		131		131		867
			132		132		132		877
			133		133		133		887
			134		134		134		897
			135		135		135		907
			136		136		136		917
			137		137		137		927
			138		138		138		937
			139		139		139		947
			140		140		140		957
			141		141		141		967
			142		142		142		977
			143		143		143		987
			144		144		144		997
			145		145		145		1007
			146		146		146		1017
			147		147		147		1027
			148		148		148		1037
			149		149		149		1047
			150		150		150		1057
			151		151		151		1067
			152		152		152		1077
			153		153		153		1087
			154		154		154		1097
			155		155		155		1107
			156		156		156		1117
			157		157		157		1127
			158		158		158		1137
			159		159		159		1147
			160		160		160		1157
			161		161		161		1167
			162		162		162		1177
			163		163		163		1187
			164		164		164		1197
			165		165		165		1207
			166		166		166		1217
			167		167		167		1227
			168		168		168		1237
			169		169		169		1247
			170		170		170		1257
			171		171		171		1267
			172		172		172		1277
			173		173		173		1287
			174		174		174		1297
			175		175		175		1307
			176		176		176		1317
			177		177		177		1327
			178		178		178		1337
			179		179		179		1347
			180		180		180		1357
			181		181		181		1367
			182		182		182		1377
			183		183		183		1387
			184		184		184		1397
			185		185		185		1407
			186		186		186		1417
			187		187		187		1427
			188		188		188		1437
			189		189		189		1447
			190		190		190		1457
			191		191		191		1467
			192		192		192		1477
			193		193		193		1487
			194		194		194		1497
			195		195		195		1507
			196		196		196		1817
			197		197		197		1527
			198		198		198		1537
			199		199		199		1547
			200		200		200		1557
			201		201		201		1567
			202		202		202		1577
			203		203		203		1587
			204		204		204		1897
			205		205		205		1607
			206		206		206		1617
			207		207		207		1627
			208		208		208		1637
			209		209		209		1646
			210		210		210		1655
			211		211		211		1664
			212		212		212		1673
			213		213		213		1682
			214		214		214		1691
			215		215		215		1700
			216		216		216		1709
			217		217		217		1718
			218		218		218		1727
			219		219		219		1736
			220		220		220		1745
			221		221		221		1754
			222		222		222		1763
			223		223		223		1772
			224		224		224		1781
			225		225		225		1790
			226		226		226		1799
			227		227		227		1808
			228		228		228		1817
			229		229		229		1826
			230		230		230		1835
			231		231		231		1844
			232		232		232		1853
			233		233		233		1862
			234		234		234		1871
			235		235		235		1880
			236		236		236		1889
			237		237		237		1898
			238		238		238		1907
			239		239		239		1916
			240		240		240		1925
			241		241		241		1934
			242		242		242		1943
			243		243		243		1952
			244		244		244		1961
			245		245		245		1970
			246		246		246		1979
			247		247		247		1988
			248		248		248		1997
			249		249		249		2006
			250		250		250		2015
			251		251		251		2024
			252		252		252		2013
			253		253		253		2042
			254		254		254		2051
			255		255		255		2060
			256		256		256		2890
		>;
	};
};
