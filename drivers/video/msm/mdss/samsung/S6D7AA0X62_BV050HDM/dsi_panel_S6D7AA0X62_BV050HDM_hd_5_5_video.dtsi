/* Copyright (c) 2013, The Linux Foundation. All rights reserved.
 *
 * This program is free software; you can redistribute it and/or modify
 * it under the terms of the GNU General Public License version 2 and
 * only version 2 as published by the Free Software Foundation.
 *
 * This program is distributed in the hope that it will be useful,
 * but WITHOUT ANY WARRANTY; without even the implied warranty of
 * MERCHANTABILITY or FITNESS FOR A PARTICULAR PURPOSE.  See the
 * GNU General Public License for more details.
 */

/*---------------------------------------------------------------------------
 * This file is autogenerated file using gcdb parser. Please do not edit it.
 * Update input XML file to add a new entry or update variable in this file
 * VERSION = "1.0"
 *---------------------------------------------------------------------------*/
&mdss_mdp {
	dsi_sdc_hd_vid: qcom,mdss_dsi_sdc_hd_video {
		qcom,mdss-dsi-panel-name = "S6D7AA0X62 hd video mode dsi panel";
		label = "ss_dsi_panel_S6D7AA0X62_BV050HDM_HD";
		qcom,mdss-dsi-panel-controller = <&mdss_dsi0>;
		qcom,mdss-dsi-panel-type = "dsi_video_mode";
		qcom,mdss-dsi-panel-destination = "display_1";
		qcom,cont-splash-enabled;
		qcom,mdss-dsi-panel-framerate = <60>;
		qcom,mdss-dsi-virtual-channel-id = <0>;
		qcom,mdss-dsi-stream = <0>;
		qcom,mdss-dsi-panel-width = <720>;
		qcom,mdss-dsi-panel-height = <1280>;
		qcom,mdss-dsi-h-back-porch = <58>;
		qcom,mdss-dsi-h-front-porch = <16>;
		qcom,mdss-dsi-h-pulse-width = <10>;
		qcom,mdss-dsi-h-sync-skew = <0>;
		qcom,mdss-dsi-v-back-porch = <12>;
		qcom,mdss-dsi-v-front-porch = <16>;
		qcom,mdss-dsi-v-pulse-width = <4>;
		qcom,mdss-dsi-h-left-border = <0>;
		qcom,mdss-dsi-h-right-border = <0>;
		qcom,mdss-dsi-v-top-border = <0>;
		qcom,mdss-dsi-v-bottom-border = <0>;
		qcom,mdss-dsi-bpp = <24>;
		qcom,mdss-dsi-underflow-color = <0xff>;
		qcom,mdss-dsi-border-color = <0>;
		qcom,mdss-dsi-on-command = [
               39 01 00 00 00 00 03 F0 5A 5A
               39 01 00 00 00 00 03 F1 5A 5A
               39 01 00 00 00 00 03 FC A5 A5
               05 01 00 00 78 00 02 11 00
               39 01 00 00 00 00 02 B1 12
               39 01 00 00 00 00 05 B2 14 22 2F 04
               39 01 00 00 00 00 02 B3 04
               39 01 00 00 00 00 0A BA 03 19 19 11 03 05 18 18 77
               39 01 00 00 00 00 04 BC 00 4E 0B
               39 01 00 00 00 00 04 C0 80 00 00
               39 01 00 00 00 00 02 C1 03
               39 01 00 00 0A 00 02 C2 00
               39 01 00 00 00 00 04 C3 40 00 28
               39 01 00 00 00 00 06 E1 03 10 1C A0 10
               39 01 00 00 00 00 09 EE A8 00 95 00 A8 00 95 00
               39 01 00 00 00 00 06 F2 02 10 10 44 10
               39 01 00 00 00 00 0B F3 01 93 20 22 80 05 25 3C 26 00
               39 01 00 00 00 00 2E F4 02 02 10 26 10 02 03 03 03 10 16
				03 00 0C 0C 03 04 05 13 1E 09 0A 05 05 01 04
			02 61 74 75 72 83 80 80 00 00 01 01 28 04 03
			28 01 D1 32
               39 01 00 00 00 00 1B F5 A1 1C 34 5F BC 8B 55 0F 33 33 03
			59 54 52 45 57 60 10 60 80 27 26 52 25 6F 1B
               39 01 00 00 00 00 21 F7 01 1B 08 0C 09 0D 01 01 01 04 06
			01 01 00 00 1A 01 1B 0A 0E 0B 0F 01 01 01 05
			07 01 01 00 00 1A
               39 01 00 00 00 00 12 EF 34 12 98 BA 10 80 24 80 80 80 00
			00 00 44 A0 82 00
               39 01 00 00 00 00 07 F6 60 25 05 00 00 03
               39 01 00 00 00 00 06 FD 16 10 11 23 09
               39 01 00 00 00 00 07 FE 00 0D 03 21 80 78
               39 01 00 00 00 00 12 FA 00 3F 06 0C 03 09 0F 0E 12 1C 20
			1F 21 21 21 26 2F
               39 01 00 00 00 00 12 FB 00 3F 06 0D 04 09 0F 0E 12 1C 20
			1F 21 21 21 26 2F
		39 01 00 00 00 00 02 36 1C
               39 01 00 00 00 00 02 53 24
               39 01 00 00 00 00 02 55 00
               05 01 00 00 14 00 02 29 00
               39 01 00 00 00 00 03 F0 A5 A5
               39 01 00 00 00 00 03 F1 A5 A5
               39 01 00 00 00 00 03 FC 5A 5A
		];
		qcom,mdss-dsi-off-command = [
					39 01 00 00 00 00 02 22 00
					05 01 00 00 0A 00 02 28 00
					05 01 00 00 78 00 02 10 00
		];
		qcom,mdss-dsi-on-command-state = "dsi_lp_mode";
		qcom,mdss-dsi-off-command-state = "dsi_hs_mode";
		qcom,mdss-dsi-h-sync-pulse = <0>;
		qcom,mdss-dsi-bllp-eof-power-mode;
		qcom,mdss-dsi-bllp-power-mode;
		qcom,mdss-dsi-lane-0-state;
		qcom,mdss-dsi-lane-1-state;
		qcom,mdss-dsi-lane-2-state;
		qcom,mdss-dsi-lane-3-state;
		qcom,mdss-dsi-panel-timings = [7D 18 10 00 3A 3E 14 1A 13 03 04 00];
		qcom,mdss-dsi-t-clk-post = <0x04>;
		qcom,mdss-dsi-t-clk-pre = <0x1A>;
		qcom,mdss-dsi-bl-min-level = <1>;
		qcom,mdss-dsi-bl-max-level = <255>;
		qcom,mdss-dsi-dma-trigger = "trigger_sw";
		qcom,mdss-dsi-mdp-trigger = "none";
		qcom,mdss-dsi-bl-pmic-control-type = "bl_ctrl_dcs";
		qcom,mdss-dsi-traffic-mode = "burst_mode";
		samsung,mdnie-tuning-enable-tft;
		samsung,level2_key_enable_tx_cmds_revA=[
			39 01 00 00 00 00 03 F0 5A 5A
		];
		samsung,level2_key_disable_tx_cmds_revA=[
			39 01 00 00 00 00 03 F0 A5 A5
		];
		samsung,tft_pwm_tx_cmds_revA=[
			39 01 00 00 00 00 02 51 FF/*First command should be PWM duty change command*/
		];
		samsung,cabc_on_tx_cmds_revA = [
			39 01 00 00 00 00 02 55 01
		];
		samsung,cabc_off_tx_cmds_revA = [
			39 01 00 00 00 00 02 55 00
		];
		/*
		* ************************************************************************************************************************
		* Scaled level to index mappings
		* ************************************************************************************************************************
		*/
		samsung,scaled_level_map_table_revA = <
		/*<idx>	  <from>  <till> <scaled_level> */
			0		0		0		0
			1		1		2		2
			2		3		4		3
			3		5		7		5
			4		8		10		7
			5		11		13		9
			6		14		16		11
			7		17		19		13
			8		20		22		15
			9		23		25		17
			10		26		28		19
			11		29		31		21
			12		32		34		23
			13		35		37		25
			14		38		40		27
			15		41		43		29
			16		44		46		31
			17		47		49		33
			18		50		52		35
			19		53		55		37
			20		56		58		39
			21		59		61		41
			22		62		64		43
			23		65		67		45
			24		68		70		47
			25		71		73		49
			26		74		76		51
			27		77		79		53
			28		80		82		56
			29		83		85		59
			30		86		88		62
			31		89		91		65
			32		92		94		68
			33		95		97		71
			34		98		100		74
			35		101		103		77
			36		104		106		80
			37		107		109		83
			38		110		112		86
			39		113		115		89
			40		116		118		92
			41		119		121		95
			42		122		124		98
			43		125		127		101
			44		128		130		104
			45		131		133		107
			46		134		136		110
			47		137		139		113
			48		140		142		116
			49		143		145		119
			50		146		148		122
			51		149		151		125
			52		152		154		128
			53		155		157		131
			54		158		160		134
			55		161		163		137
			56		164		166		140
			57		167		169		143
			58		170		172		146
			59		173		175		149
			60		176		178		152
			61		179		181		155
			62		182		184		158
			63		185		187		161
			64		188		190		164
			65		191		193		167
			66		194		196		170
			67		197		199		173
			68		200		202		176
			69		203		205		179
			70		206		208		182
			71		209		211		185
			72		212		214		188
			73		215		217		191
			74		218		220		194
			75		221		223		197
			76		224		226		200
			77		227		229		203
			78		230		232		206
			79		233		235		209
			80		236		238		212
			81		239		241		215
			82		242		245		218
			83		246		249		221
			84		250		253		224
			85		254		255		227
		>;
		samsung,tft-common-support;
		samsung,panel-vendor = "BOE";
		qcom,mdss-dsi-reset-sequence = <1 20>, <0 20>, <1 20>;
		qcom,mdss-pan-physical-width-dimension = <72>;
		qcom,mdss-pan-physical-height-dimension = <129>;
		qcom,mdss-dsi-lp11-init;
		qcom,mdss-dsi-init-delay-us = <20000>;
		qcom,mdss-dsi-force-clk-lane-hs;
	};
};
