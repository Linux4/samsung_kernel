/* Copyright (c) 2013-2014, The Linux Foundation. All rights reserved.
 *
 * This program is free software; you can redistribute it and/or modify
 * it under the terms of the GNU General Public License version 2 and
 * only version 2 as published by the Free Software Foundation.
 *
 * This program is distributed in the hope that it will be useful,
 * but WITHOUT ANY WARRANTY; without even the implied warranty of
 * MERCHANTABILITY or FITNESS FOR A PARTICULAR PURPOSE.  See the
 * GNU General Public License for more details.
 */

/*---------------------------------------------------------------------------
 * This file is autogenerated file using gcdb parser. Please do not edit it.
 * Update input XML file to add a new entry or update variable in this file
 * VERSION = "1.0"
 *---------------------------------------------------------------------------*/
&mdss_mdp {
	ss_dsi_panel_S6E3FA5_AMS420MS01_FHD: ss_dsi_panel_S6E3FA5_AMS420MS01_FHD {
		qcom,mdss-dsi-panel-name = "ss_dsi_panel_S6E3FA5_AMS420MS01_FHD";
		qcom,mdss-dsi-panel-controller = <&mdss_dsi0>;
		qcom,mdss-dsi-panel-width = <1080>;
		qcom,mdss-dsi-panel-height = <1920>;
		qcom,mdss-dsi-bpp = <24>;
		qcom,mdss-dsi-panel-destination = "display_1";

		qcom,mdss-dsi-panel-timings = [E6 38 26 00 68 6E 2A 46 2C 03 04 00];

		qcom,mdss-dsi-on-command= [
			29 00 00 00 05 00 03 F0 5A 5A		/* TEST KEY1 Enable - 5ms */

			05 01 00 00 14 00 02 11 00			/* Sleep out, wait 20ms(0x14) */

			/* TE Vsync On */
			29 01 00 00 00 00 02 35 00

			/* PCD Setting */
			29 01 00 00 00 00 02 CC 4C			/* PCD */

			/* ERR FG */
			29 01 00 00 00 00 02 ED 44			/* ERR_FG */

			/* Brightness condition set */
			29 01 00 00 00 00 24 CA
				01 00 01 00 01 00
				80 80 80
				80 80 80
				80 80 80
				80 80 80
				80 80 80
				80 80 80
				80 80 80
				80 80 80
				00 00 00
				00 00
			29 01 00 00 00 00 03 B1 80 10		/* AID set : AOR 0% */
			29 01 00 00 00 00 04 B5 19 DC 0A	/* MPS & ELVSS Set */
			29 01 00 00 00 00 03 F4 DB 1E		/* VINT */
			29 01 00 00 00 00 02 F7 03			/* Gamma, LTPS(AID) update */

			/* Memory Access */
			05 01 00 00 00 00 02 2C 00
			05 01 00 00 00 00 02 3C 00

			29 01 00 00 00 00 03 F0 A5 A5		/* TEST KEY key Disable  */
		];

		qcom,mdss-dsi-off-command=[
			05 01 00 00 0A 00 02 28 00	/* wait 10ms(0x0A) */
			05 01 00 00 96 00 02 10 00	/* wait 150ms(0x96) */
		];

		qcom,cont-splash-enabled;
		qcom,mdss-dsi-force-clk-lane-hs;
		/*qcom,cmd-sync-wait-broadcast;*/
		/*qcom,cmd-sync-wait-trigger;*/
		/*qcom,mdss-dsi-fbc-enable=*/
		/*qcom,mdss-dsi-fbc-bpp=*/
		/*qcom,mdss-dsi-fbc-packing=*/
		/*qcom,mdss-dsi-fbc-quant-error=*/
		/*qcom,mdss-dsi-fbc-bias=*/
		/*qcom,mdss-dsi-fbc-pat-mode=*/
		/*qcom,mdss-dsi-fbc-vlc-mode=*/
		/*qcom,mdss-dsi-fbc-bflc-mode=*/
		/*qcom,mdss-dsi-fbc-h-line-budget=*/
		/*qcom,mdss-dsi-fbc-budget-ctrl=*/
		/*qcom,mdss-dsi-fbc-block-budget=*/
		/*qcom,mdss-dsi-fbc-lossless-threshold=*/
		/*qcom,mdss-dsi-fbc-lossy-threshold=*/
		/*qcom,mdss-dsi-fbc-rgb-threshold=*/
		/*qcom,mdss-dsi-fbc-lossy-mode-idx=*/

		qcom,mdss-dsi-h-back-porch = <32>;
		qcom,mdss-dsi-h-front-porch = <92>;
		qcom,mdss-dsi-h-pulse-width = <16>;
		qcom,mdss-dsi-h-sync-skew = <0>;
		qcom,mdss-dsi-v-back-porch = <7>;
		qcom,mdss-dsi-v-front-porch = <7>;
		qcom,mdss-dsi-v-pulse-width = <2>;

		qcom,mdss-dsi-h-left-border = <0>;
		qcom,mdss-dsi-h-right-border = <0>;
		qcom,mdss-dsi-v-top-border = <0>;
		qcom,mdss-dsi-v-bottom-border = <0>;

		qcom,mdss-dsi-underflow-color = <0xFF>;
		qcom,mdss-dsi-border-color = <0>;

		/*qcom,mdss-dsi-pan-enable-dynamic-fps=*/
		/*qcom,mdss-dsi-pan-fps-update=*/

		qcom,mdss-dsi-bl-pmic-control-type = "bl_ctrl_dcs";
		/*qcom,mdss-dsi-bl-pmic-bank-select=*/
		/*qcom,mdss-dsi-bl-pmic-pwm-frequency=*/
		/*qcom,mdss-dsi-pwm-gpio=*/

		qcom,mdss-dsi-bl-min-level = <0>;
		qcom,mdss-dsi-bl-max-level = <365>;
		qcom,mdss-brightness-max-level = <365>;
		qcom,mdss-dsi-interleave-mode = <0>;
		qcom,mdss-dsi-panel-type = "dsi_cmd_mode";

		qcom,mdss-dsi-te-check-enable;
		qcom,mdss-dsi-te-using-te-pin;
		qcom,mdss-dsi-te-pin-select = <1>;

		qcom,mdss-dsi-te-dcs-command = <1>;
		qcom,mdss-dsi-wr-mem-start = <0x2C>;
		qcom,mdss-dsi-wr-mem-continue = <0x3C>;

		/* CMD mode panel doesn't need below stuff */
		qcom,mdss-dsi-h-sync-pulse= <0>;
		/*qcom,mdss-dsi-hfp-power-mode=*/
		/*qcom,mdss-dsi-hbp-power-mode=*/
		/*qcom,mdss-dsi-hsa-power-mode=*/
		/*qcom,mdss-dsi-last-line-interleave=*/
		qcom,mdss-dsi-bllp-eof-power-mode;
		qcom,mdss-dsi-bllp-power-mode;
		qcom,mdss-dsi-traffic-mode= "burst_mode";

		qcom,mdss-dsi-pixel-packing = "loose";

		qcom,mdss-dsi-virtual-channel-id = <0>;
		qcom,mdss-dsi-color-order = "rgb_swap_rgb";
		qcom,mdss-dsi-lane-0-state;
		qcom,mdss-dsi-lane-1-state;
		qcom,mdss-dsi-lane-2-state;
		qcom,mdss-dsi-lane-3-state;
		qcom,mdss-dsi-lane-map = "lane_map_0123";

		qcom,mdss-dsi-t-clk-pre = <0x2E>;
		qcom,mdss-dsi-t-clk-post = <0x0D>;

		qcom,mdss-dsi-stream = <0>;
		qcom,mdss-dsi-mdp-trigger = "none";
		qcom,mdss-dsi-dma-trigger = "trigger_sw";
		qcom,mdss-dsi-panel-framerate = <60>;
/*		qcom,mdss-dsi-panel-clockrate = <850000000>;*/
		qcom,mdss-dsi-on-command-state = "dsi_lp_mode";
		qcom,mdss-dsi-off-command-state = "dsi_hs_mode";

		qcom,mdss-pan-physical-width-dimension = <69>;
		qcom,mdss-pan-physical-height-dimension = <122>;

		qcom,mdss-dsi-panel-mode-gpio-state = "invalid";

		qcom,mdss-dsi-reset-sequence = <1 5>, <0 5>, <1 5>;

		/* FA5 ddi does not support partial update */
		/*qcom,partial-update-enabled;*/
		/*qcom,partial-update-roi-merge;*/
		/*qcom,panel-roi-alignment=<8 8 1 1 1 1>;*/
		/*qcom,mdss-dsi-horizontal-line-idle*/

		qcom,mdss-dsi-lp11-init;
		qcom,mdss-dsi-init-delay-us = <1000>;

		qcom,mdss-dsi-rx-eot-ignore;
		qcom,mdss-dsi-tx-eot-append;

		/*qcom,ulps-enabled*/
		/*qcom,mdss-dsi-panel-status-command=*/
		/*qcom,mdss-dsi-panel-status-command-mode="dsi_lp_mode";*/
		qcom,esd-check-enabled;
		qcom,mdss-dsi-panel-status-check-mode="reg_read_irq";
		qcom,mdss-dsi-panel-status-value = <1>;
		qcom,mdss-dsi-panel-status-irq-trigger1="rising";
		qcom,mdss-dsi-panel-orientation = "180";
		/*qcom,dynamic-mode-switch-enabled*/
		/*qcom,video-to-cmd-mode-switch-commands=*/
		/*qcom,cmd-to-video-mode-switch-commands=*/
/*
 * ************************************************************************************************************************************
 *
 *
 *			Below  parameters are samsung dependent thigs
 *
 *
 * ************************************************************************************************************************************
 */
 		samsung,support_panel_max = <1>;
		samsung,hw-config = "single_dsi";
		samsung,panel-lpm-enable;
		/*samsung,support_irc;*/
		samsung,elvss_interpolation_temperature = <(-15)>;
		samsung,support_factory_panel_swap;

 		samsung,enter_hbm_lux = <10000>;
		samsung,dsi-lp11-init;

		/*
		* ************************************************************************************************************************
		*  Tx
		* ************************************************************************************************************************
		*/

		samsung,display_on_tx_cmds_revA = [05 01 00 00 32 00 02 29 00];
		samsung,display_off_tx_cmds_revA = [05 01 00 00 32 00 02 28 00];

		samsung,level1_key_enable_tx_cmds_revA = [
			29 01 00 00 00 00 03 F0 5A 5A
		];
		samsung,level1_key_disable_tx_cmds_revA = [
			29 01 00 00 00 00 03 F0 A5 A5
		];
		samsung,level2_key_enable_tx_cmds_revA = [
			29 00 00 00 00 00 03 F0 5A 5A
			29 01 00 00 00 00 03 FC 5A 5A
		];
		samsung,level2_key_disable_tx_cmds_revA = [
			29 00 00 00 00 00 03 F0 A5 A5
			29 01 00 00 00 00 03 FC A5 A5
		];

		samsung,packet_size_tx_cmds_revA = [
			37 01 00 00 00 00 02 07 00
		];

		/*
		 * First parameters can be changed
		 * by function of samsung_nv_read()
		 * because of that means offset of
		 * read position
		 */
		samsung,reg_read_pos_tx_cmds_revA = [
			15 01 00 00 00 00 02 B0 00
		];

		/*
		 * ************************************************************************************************************************
		 *	 06 01 00 00 00 00 01 c8 07 21
		 *	READ 0xC8 SIZE 0x07 OFFSET 0x21
		 * ************************************************************************************************************************
		 */

		samsung,smart_dimming_mtp_rx_cmds_revA = [ 06 01 00 00 00 00 01 c8 23 00];
		/* the last byte in all read commands will represent READ LENGH */
		samsung,manufacture_id0_rx_cmds_revA = [ 06 01 00 00 00 00 01 da 01 00];
		samsung,manufacture_id1_rx_cmds_revA = [ 06 01 00 00 00 00 01 db 01 00];
		samsung,manufacture_id2_rx_cmds_revA = [ 06 01 00 00 00 00 01 dc 01 00];

		samsung,manufacture_date_rx_cmds_revA = [ 06 01 00 00 00 00 01 c8 04 28];	/* read C8 41~44th , 40=0x28*/
		samsung,ddi_id_rx_cmds_revA = [ 06 01 00 00 00 00 01 d6 05 00];			/* read D6 1~5th */
		samsung,cell_id_rx_cmds_revA = [ 06 01 00 00 00 00 01 C8 0B 28];		/* read C8 41~51th, 40=0x28 */
		samsung,mtp_read_sysfs_rx_cmds_revA = [ 06 01 00 00 00 00 01 01 01 01];

		samsung,elvss_rx_cmds_revA = [ 06 01 00 00 00 00 01 B5 02 17];	/* read B5 24,25th , 23=0x17*/

		samsung,mdnie_read_rx_cmds_revA	= [ 06 01 00 00 00 00 01 A1 04 00];

		samsung,ldi_debug0_rx_cmds_revA = [06 01 00 00 00 00 01 0A 01 00];
		samsung,ldi_debug1_rx_cmds_revA = [06 01 00 00 00 00 01 0E 01 00];
		samsung,ldi_debug2_rx_cmds_revA = [06 01 00 00 00 00 01 EA 08 00];

		samsung,hbm_rx_cmds_revA = [ 06 01 00 00 00 00 01 B3 04 02];		/* read B4 3rd~6th */
		samsung,hbm2_rx_cmds_revA = [ 06 01 00 00 00 00 01 B3 1D 06];		/* read B4 7th~35th */


		/*
		 * ************************************************************************************************************************
		 *   ALPM
		 * ************************************************************************************************************************
		 */

		/*
		 * The command set of R53h will be replaced with
		 * lpm 2nit or 40nit tx commnad for
		 * changing brightness level
		 */
		samsung,alpm_on_tx_cmds_revA = [
			29 01 00 00 00 00 03 F0 5A 5A		/* TEST KEY Enable */
			29 01 00 00 00 00 03 FC 5A 5A		/* TEST KEY Enable */

			29 01 00 00 00 00 02 BB C4			/* HLPM 2nit(0x54)/ALPM 2nit(0xC4) Mode On */
			29 01 00 00 00 00 02 53 03			/* ALPM/HLPM 2nit On*/

			29 01 00 00 01 00 02 F7 03			/* Gamma, LTPS(AID) update */
			29 01 00 00 00 00 02 F7 00

			29 01 00 00 00 00 03 FC A5 A5
			29 01 00 00 00 00 03 F0 A5 A5
		];

		samsung,alpm_off_tx_cmds_revA = [
			29 01 00 00 00 00 03 F0 5A 5A	/* TEST KEY Enable */
			29 01 00 00 00 00 03 FC 5A 5A		/* TEST KEY Enable */

			05 01 00 00 00 00 02 28 00		/* display off wait 20ms */

			/* image write for normal mode */

			29 01 00 00 00 00 02 53 00		/* alpm off */

			29 01 00 00 01 00 02 F7 03		/* Gamma, LTPS(AID) update */
			29 01 00 00 00 00 02 F7 00

			29 01 00 00 00 00 03 FC A5 A5
			29 01 00 00 00 00 03 F0 A5 A5	/* TEST KEY Disable */
		];

		samsung,lpm_2nit_tx_cmds_revA = [29 01 00 00 00 00 02 53 03];
		samsung,lpm_60nit_tx_cmds_revA = [29 01 00 00 00 00 02 53 02];

		samsung,lpm_ctrl_alpm_2nit_tx_cmds_revA = [29 01 00 00 00 00 02 BB C4];
		samsung,lpm_ctrl_alpm_60nit_tx_cmds_revA = [29 01 00 00 00 00 02 BB 84];
		samsung,lpm_ctrl_hlpm_2nit_tx_cmds_revA = [29 01 00 00 00 00 02 BB 54];
		samsung,lpm_ctrl_hlpm_60nit_tx_cmds_revA = [29 01 00 00 00 00 02 BB 14];

		/*
		* ************************************************************************************************************************
		*  VINT
		* ************************************************************************************************************************
		*/

		samsung,vint_tx_cmds_revA = [
			29 01 00 00 00 00 03 F4 DB 1E	/* 0: 420cd ~ 20cd */
			29 01 00 00 00 00 03 F4 DB 1D	/* 1: 19cd */
			29 01 00 00 00 00 03 F4 DB 1C	/* 2: 17cd */
			29 01 00 00 00 00 03 F4 DB 1B	/* 3: 16cd */
			29 01 00 00 00 00 03 F4 DB 1A	/* 4: 15cd */
			29 01 00 00 00 00 03 F4 DB 19	/* 5: 14cd */
			29 01 00 00 00 00 03 F4 DB 18	/* 6: 13cd */
			29 01 00 00 00 00 03 F4 DB 17	/* 7: 12cd */
			29 01 00 00 00 00 03 F4 DB 16	/* 8: 11cd */
			29 01 00 00 00 00 03 F4 DB 15	/* 9: 10cd */
			29 01 00 00 00 00 03 F4 DB 14	/* 10: 9cd */
			29 01 00 00 00 00 03 F4 DB 13	/* 11: 8cd */
			29 01 00 00 00 00 03 F4 DB 12	/* 12: 7cd */
			29 01 00 00 00 00 03 F4 DB 11	/* 13: 6cd */
			29 01 00 00 00 00 03 F4 DB 10	/* 14: 5cd ~ 2cd */
		];

		samsung,vint_map_table_revA = <
			2	14		3	14		4	14		5	14		6	13
			7	12		8	11		9	10		10	9		11	8
			12	7		13	6		14	5		15	4		16	3
			17	2		19	1		20	0		21	0		22	0
			24	0		25	0		27	0		29	0		30	0
			32	0		34	0		37	0		39	0		41	0
			44	0		47	0		50	0		53	0		56	0
			60	0		64	0		68	0		72	0		77	0
			82	0		87	0		93	0		98	0		105	0
			111	0		119	0		126	0		134	0		143	0
			152	0		162	0		172	0		183	0		195	0
			207	0		220	0		234	0		249	0		265	0
			282	0		300	0		316	0		333	0		350	0
			357	0		365	0		372	0		380	0		387	0
			395	0		403	0		412	0		420	0
		>;

		/*
		* ************************************************************************************************************************
		* ELVSS(ACL Off) command list and mappings
		* ************************************************************************************************************************
		*/

		samsung,elvss_lowtemp_tx_cmds_revA = [
			29 01 00 00 00 00 02 B5 19
			29 01 00 00 00 00 02 B0 17
			29 01 00 00 00 00 02 B5 00
		];	/* Low Temperature Command */

		/*
		* ************************************************************************************************************************
		*  GAMMA
		* ************************************************************************************************************************
		*/

		samsung,gamma_tx_cmds_revA = [
			29 01 00 00 00 00 24 CA		/* 1) Gamma 2.2 Setting */
				01 00 01 00 01 00
				80 80 80
				80 80 80
				80 80 80
				80 80 80
				80 80 80
				80 80 80
				80 80 80
				80 80 80
				00 00 00
				00 00
			29 01 00 00 00 00 02 F7 03	/* Gamma, LTPS(AID) update */

			29 01 00 00 00 00 3C		/* dummy for single transmission more 100ns delay */
			00 00 00 00 00 00 00 00 00 00
			00 00 00 00 00 00 00 00 00 00
			00 00 00 00 00 00 00 00 00 00
			00 00 00 00 00 00 00 00 00 00
			00 00 00 00 00 00 00 00 00 00
			00 00 00 00 00 00 00 00 00 00

			29 01 00 00 00 00 02 F7 00
		];

		/*
		* ************************************************************************************************************************
		*  HBM
		* ************************************************************************************************************************
		*/

		samsung,hbm_gamma_tx_cmds_revA = [
			29 01 00 00 00 00 24 CA			/* Gamma 2.2 Setting */
				01 00 01 00 01 00
				80 80 80
				80 80 80
				80 80 80
				80 80 80
				80 80 80
				80 80 80
				80 80 80
				80 80 80
				00 00 00
				00 00
		];

		samsung,hbm_etc_tx_cmds_revA = [
			29 01 00 00 00 00 03 B1 80 10		/* AID set : AOR 0% */
			29 01 00 00 00 00 04 B5 19 DC 0A	/* HBM ELVSS */
			29 01 00 00 00 00 02 B0 17
			29 01 00 00 00 00 02 B5 00			/* ELVSS */
			29 01 00 00 00 00 07 B4 00 50 99 00 00 0A /* OPR */
			29 01 00 00 00 00 02 55 02			/* ACL On */
			29 01 00 00 00 00 03 F4 DB 1E		/* VINT */
			29 01 00 00 00 00 02 53 C0			/* HBM On */

			29 01 00 00 00 00 02 F7 03
			29 01 00 00 00 00 02 F7 00
		];

		samsung,hbm_off_tx_cmds_revA = [
			29 01 00 00 00 00 02 53 00	/* HBM Off */
		];

		/*
		 * ************************************************************************************************************************
		 * AID command list and mappings
		 * ************************************************************************************************************************
		 */

		samsung,aid_subdivision_tx_cmds_revA = [
			29 01 00 00 00 00 03 B1 87 62  /* 00 */
			29 01 00 00 00 00 03 B1 87 61  /* 01 */
			29 01 00 00 00 00 03 B1 87 57  /* 02 */
			29 01 00 00 00 00 03 B1 87 55  /* 03 */
			29 01 00 00 00 00 03 B1 87 53  /* 04 */
			29 01 00 00 00 00 03 B1 87 51  /* 05 */
			29 01 00 00 00 00 03 B1 87 49  /* 06 */
			29 01 00 00 00 00 03 B1 87 47  /* 07 */
			29 01 00 00 00 00 03 B1 87 45  /* 08 */
			29 01 00 00 00 00 03 B1 87 43  /* 09 */
			29 01 00 00 00 00 03 B1 87 41  /* 10 */
			29 01 00 00 00 00 03 B1 87 37  /* 11 */
			29 01 00 00 00 00 03 B1 87 35  /* 12 */
			29 01 00 00 00 00 03 B1 87 33  /* 13 */
			29 01 00 00 00 00 03 B1 87 31  /* 14 */
			29 01 00 00 00 00 03 B1 87 27  /* 15 */
			29 01 00 00 00 00 03 B1 87 25  /* 16 */
			29 01 00 00 00 00 03 B1 87 23  /* 17 */
			29 01 00 00 00 00 03 B1 87 22  /* 18 */
			29 01 00 00 00 00 03 B1 87 17  /* 19 */
			29 01 00 00 00 00 03 B1 87 15  /* 20 */
			29 01 00 00 00 00 03 B1 87 13  /* 21 */
			29 01 00 00 00 00 03 B1 87 11  /* 22 */
			29 01 00 00 00 00 03 B1 87 07  /* 23 */
			29 01 00 00 00 00 03 B1 87 05  /* 24 */
			29 01 00 00 00 00 03 B1 87 03  /* 25 */
			29 01 00 00 00 00 03 B1 87 01  /* 26 */
			29 01 00 00 00 00 03 B1 86 F7  /* 27 */
			29 01 00 00 00 00 03 B1 86 F5  /* 28 */
			29 01 00 00 00 00 03 B1 86 EF  /* 29 */
			29 01 00 00 00 00 03 B1 86 E8  /* 30 */
			29 01 00 00 00 00 03 B1 86 E2  /* 31 */
			29 01 00 00 00 00 03 B1 86 DC  /* 32 */
			29 01 00 00 00 00 03 B1 86 D7  /* 33 */
			29 01 00 00 00 00 03 B1 86 D1  /* 34 */
			29 01 00 00 00 00 03 B1 86 C8  /* 35 */
			29 01 00 00 00 00 03 B1 86 BE  /* 36 */
			29 01 00 00 00 00 03 B1 86 B5  /* 37 */
			29 01 00 00 00 00 03 B1 86 AF  /* 38 */
			29 01 00 00 00 00 03 B1 86 AA  /* 39 */
			29 01 00 00 00 00 03 B1 86 A4  /* 40 */
			29 01 00 00 00 00 03 B1 86 9E  /* 41 */
			29 01 00 00 00 00 03 B1 86 98  /* 42 */
			29 01 00 00 00 00 03 B1 86 92  /* 43 */
			29 01 00 00 00 00 03 B1 86 8D  /* 44 */
			29 01 00 00 00 00 03 B1 86 87  /* 45 */
			29 01 00 00 00 00 03 B1 86 82  /* 46 */
			29 01 00 00 00 00 03 B1 86 7A  /* 47 */
			29 01 00 00 00 00 03 B1 86 72  /* 48 */
			29 01 00 00 00 00 03 B1 86 6A  /* 49 */
			29 01 00 00 00 00 03 B1 86 62  /* 50 */
			29 01 00 00 00 00 03 B1 86 5A  /* 51 */
			29 01 00 00 00 00 03 B1 86 53  /* 52 */
			29 01 00 00 00 00 03 B1 86 4B  /* 53 */
			29 01 00 00 00 00 03 B1 86 43  /* 54 */
			29 01 00 00 00 00 03 B1 86 30  /* 55 */
			29 01 00 00 00 00 03 B1 86 1D  /* 56 */
			29 01 00 00 00 00 03 B1 86 12  /* 57 */
			29 01 00 00 00 00 03 B1 86 0A  /* 58 */
			29 01 00 00 00 00 03 B1 86 02  /* 59 */
			29 01 00 00 00 00 03 B1 85 F7  /* 60 */
			29 01 00 00 00 00 03 B1 85 EC  /* 61 */
			29 01 00 00 00 00 03 B1 85 D8  /* 62 */
			29 01 00 00 00 00 03 B1 85 C4  /* 63 */
			29 01 00 00 00 00 03 B1 85 BC  /* 64 */
			29 01 00 00 00 00 03 B1 85 B5  /* 65 */
			29 01 00 00 00 00 03 B1 85 A1  /* 66 */
			29 01 00 00 00 00 03 B1 85 8C  /* 67 */
			29 01 00 00 00 00 03 B1 85 79  /* 68 */
			29 01 00 00 00 00 03 B1 85 66  /* 69 */
			29 01 00 00 00 00 03 B1 85 54  /* 70 */
			29 01 00 00 00 00 03 B1 85 3E  /* 71 */
			29 01 00 00 00 00 03 B1 85 29  /* 72 */
			29 01 00 00 00 00 03 B1 85 17  /* 73 */
			29 01 00 00 00 00 03 B1 85 04  /* 74 */
			29 01 00 00 00 00 03 B1 84 E9  /* 75 */
			29 01 00 00 00 00 03 B1 84 CE  /* 76 */
			29 01 00 00 00 00 03 B1 84 BA  /* 77 */
			29 01 00 00 00 00 03 B1 84 A6  /* 78 */
			29 01 00 00 00 00 03 B1 84 92  /* 79 */
			29 01 00 00 00 00 03 B1 84 7E  /* 80 */
			29 01 00 00 00 00 03 B1 84 62  /* 81 */
			29 01 00 00 00 00 03 B1 84 46  /* 82 */
			29 01 00 00 00 00 03 B1 84 26  /* 83 */
			29 01 00 00 00 00 03 B1 84 06  /* 84 */
			29 01 00 00 00 00 03 B1 83 E9  /* 85 */
			29 01 00 00 00 00 03 B1 83 CD  /* 86 */
			29 01 00 00 00 00 03 B1 83 B0  /* 87 */
			29 01 00 00 00 00 03 B1 83 93  /* 88 */
			29 01 00 00 00 00 03 B1 83 74  /* 89 */
			29 01 00 00 00 00 03 B1 83 55  /* 90 */
			29 01 00 00 00 00 03 B1 83 2F  /* 91 */
			29 01 00 00 00 00 03 B1 83 0A  /* 92 */
			29 01 00 00 00 00 03 B1 82 E0  /* 93 */
			29 01 00 00 00 00 03 B1 82 B6  /* 94 */
			29 01 00 00 00 00 03 B1 82 C7  /* 95 */
			29 01 00 00 00 00 03 B1 82 A2  /* 96 */
			29 01 00 00 00 00 03 B1 82 C5  /* 97 */
			29 01 00 00 00 00 03 B1 82 A2  /* 98 */
			29 01 00 00 00 00 03 B1 82 CB  /* 99 */
			29 01 00 00 00 00 03 B1 82 A2  /* 100 */
			29 01 00 00 00 00 03 B1 82 C8  /* 101 */
			29 01 00 00 00 00 03 B1 82 A2  /* 102 */
			29 01 00 00 00 00 03 B1 82 C6  /* 103 */
			29 01 00 00 00 00 03 B1 82 A2  /* 104 */
			29 01 00 00 00 00 03 B1 82 CB  /* 105 */
			29 01 00 00 00 00 03 B1 82 A2  /* 106 */
			29 01 00 00 00 00 03 B1 82 C2  /* 107 */
			29 01 00 00 00 00 03 B1 82 A2  /* 108 */
			29 01 00 00 00 00 03 B1 82 CC  /* 109 */
			29 01 00 00 00 00 03 B1 82 A2  /* 110 */
			29 01 00 00 00 00 03 B1 82 C4  /* 111 */
			29 01 00 00 00 00 03 B1 82 A2  /* 112 */
			29 01 00 00 00 00 03 B1 82 CC  /* 113 */
			29 01 00 00 00 00 03 B1 82 A2  /* 114 */
			29 01 00 00 00 00 03 B1 82 C5  /* 115 */
			29 01 00 00 00 00 03 B1 82 A2  /* 116 */
			29 01 00 00 00 00 03 B1 82 C8  /* 117 */
			29 01 00 00 00 00 03 B1 82 A2  /* 118 */
			29 01 00 00 00 00 03 B1 82 CA  /* 119 */
			29 01 00 00 00 00 03 B1 82 A2  /* 120 */
			29 01 00 00 00 00 03 B1 82 C7  /* 121 */
			29 01 00 00 00 00 03 B1 82 A2  /* 122 */
			29 01 00 00 00 00 03 B1 82 C9  /* 123 */
			29 01 00 00 00 00 03 B1 82 A2  /* 124 */
			29 01 00 00 00 00 03 B1 82 C7  /* 125 */
			29 01 00 00 00 00 03 B1 82 A2  /* 126 */
			29 01 00 00 00 00 03 B1 82 C8  /* 127 */
			29 01 00 00 00 00 03 B1 82 A2  /* 128 */
			29 01 00 00 00 00 03 B1 82 95  /* 129 */
			29 01 00 00 00 00 03 B1 82 87  /* 130 */
			29 01 00 00 00 00 03 B1 82 7A  /* 131 */
			29 01 00 00 00 00 03 B1 82 6C  /* 132 */
			29 01 00 00 00 00 03 B1 82 5F  /* 133 */
			29 01 00 00 00 00 03 B1 82 51  /* 134 */
			29 01 00 00 00 00 03 B1 82 44  /* 135 */
			29 01 00 00 00 00 03 B1 82 37  /* 136 */
			29 01 00 00 00 00 03 B1 82 2A  /* 137 */
			29 01 00 00 00 00 03 B1 82 1C  /* 138 */
			29 01 00 00 00 00 03 B1 82 0F  /* 139 */
			29 01 00 00 00 00 03 B1 82 02  /* 140 */
			29 01 00 00 00 00 03 B1 81 F4  /* 141 */
			29 01 00 00 00 00 03 B1 81 E7  /* 142 */
			29 01 00 00 00 00 03 B1 81 D9  /* 143 */
			29 01 00 00 00 00 03 B1 81 CB  /* 144 */
			29 01 00 00 00 00 03 B1 81 BD  /* 145 */
			29 01 00 00 00 00 03 B1 81 B0  /* 146 */
			29 01 00 00 00 00 03 B1 81 A2  /* 147 */
			29 01 00 00 00 00 03 B1 81 94  /* 148 */
			29 01 00 00 00 00 03 B1 81 86  /* 149 */
			29 01 00 00 00 00 03 B1 81 78  /* 150 */
			29 01 00 00 00 00 03 B1 81 6A  /* 151 */
			29 01 00 00 00 00 03 B1 81 5C  /* 152 */
			29 01 00 00 00 00 03 B1 81 4F  /* 153 */
			29 01 00 00 00 00 03 B1 81 41  /* 154 */
			29 01 00 00 00 00 03 B1 81 33  /* 155 */
			29 01 00 00 00 00 03 B1 81 25  /* 156 */
			29 01 00 00 00 00 03 B1 81 17  /* 157 */
			29 01 00 00 00 00 03 B1 81 20  /* 158 */
			29 01 00 00 00 00 03 B1 81 13  /* 159 */
			29 01 00 00 00 00 03 B1 81 06  /* 160 */
			29 01 00 00 00 00 03 B1 80 F8  /* 161 */
			29 01 00 00 00 00 03 B1 80 EB  /* 162 */
			29 01 00 00 00 00 03 B1 80 DE  /* 163 */
			29 01 00 00 00 00 03 B1 80 D1  /* 164 */
			29 01 00 00 00 00 03 B1 80 C4  /* 165 */
			29 01 00 00 00 00 03 B1 81 21  /* 166 */
			29 01 00 00 00 00 03 B1 81 16  /* 167 */
			29 01 00 00 00 00 03 B1 81 0A  /* 168 */
			29 01 00 00 00 00 03 B1 80 FE  /* 169 */
			29 01 00 00 00 00 03 B1 80 F3  /* 170 */
			29 01 00 00 00 00 03 B1 80 E7  /* 171 */
			29 01 00 00 00 00 03 B1 80 DB  /* 172 */
			29 01 00 00 00 00 03 B1 80 D0  /* 173 */
			29 01 00 00 00 00 03 B1 80 C4  /* 174 */
			29 01 00 00 00 00 03 B1 81 21  /* 175 */
			29 01 00 00 00 00 03 B1 81 16  /* 176 */
			29 01 00 00 00 00 03 B1 81 0A  /* 177 */
			29 01 00 00 00 00 03 B1 80 FE  /* 178 */
			29 01 00 00 00 00 03 B1 80 F3  /* 179 */
			29 01 00 00 00 00 03 B1 80 E7  /* 180 */
			29 01 00 00 00 00 03 B1 80 DB  /* 181 */
			29 01 00 00 00 00 03 B1 80 D0  /* 182 */
			29 01 00 00 00 00 03 B1 80 C4  /* 183 */
			29 01 00 00 00 00 03 B1 81 22  /* 184 */
			29 01 00 00 00 00 03 B1 81 18  /* 185 */
			29 01 00 00 00 00 03 B1 81 0D  /* 186 */
			29 01 00 00 00 00 03 B1 81 03  /* 187 */
			29 01 00 00 00 00 03 B1 80 F8  /* 188 */
			29 01 00 00 00 00 03 B1 80 EE  /* 189 */
			29 01 00 00 00 00 03 B1 80 E3  /* 190 */
			29 01 00 00 00 00 03 B1 80 D9  /* 191 */
			29 01 00 00 00 00 03 B1 80 CE  /* 192 */
			29 01 00 00 00 00 03 B1 80 C4  /* 193 */
			29 01 00 00 00 00 03 B1 81 11  /* 194 */
			29 01 00 00 00 00 03 B1 81 06  /* 195 */
			29 01 00 00 00 00 03 B1 80 FB  /* 196 */
			29 01 00 00 00 00 03 B1 80 F0  /* 197 */
			29 01 00 00 00 00 03 B1 80 E5  /* 198 */
			29 01 00 00 00 00 03 B1 80 DA  /* 199 */
			29 01 00 00 00 00 03 B1 80 CF  /* 200 */
			29 01 00 00 00 00 03 B1 80 C4  /* 201 */
			29 01 00 00 00 00 03 B1 81 13  /* 202 */
			29 01 00 00 00 00 03 B1 81 09  /* 203 */
			29 01 00 00 00 00 03 B1 80 FF  /* 204 */
			29 01 00 00 00 00 03 B1 80 F5  /* 205 */
			29 01 00 00 00 00 03 B1 80 EB  /* 206 */
			29 01 00 00 00 00 03 B1 80 E2  /* 207 */
			29 01 00 00 00 00 03 B1 80 D8  /* 208 */
			29 01 00 00 00 00 03 B1 80 CE  /* 209 */
			29 01 00 00 00 00 03 B1 80 C4  /* 210 */
			29 01 00 00 00 00 03 B1 81 0F  /* 211 */
			29 01 00 00 00 00 03 B1 81 06  /* 212 */
			29 01 00 00 00 00 03 B1 80 FC  /* 213 */
			29 01 00 00 00 00 03 B1 80 F3  /* 214 */
			29 01 00 00 00 00 03 B1 80 EA  /* 215 */
			29 01 00 00 00 00 03 B1 80 E0  /* 216 */
			29 01 00 00 00 00 03 B1 80 D7  /* 217 */
			29 01 00 00 00 00 03 B1 80 CD  /* 218 */
			29 01 00 00 00 00 03 B1 80 C4  /* 219 */
			29 01 00 00 00 00 03 B1 80 DE  /* 220 */
			29 01 00 00 00 00 03 B1 80 D5  /* 221 */
			29 01 00 00 00 00 03 B1 80 CD  /* 222 */
			29 01 00 00 00 00 03 B1 80 C4  /* 223 */
			29 01 00 00 00 00 03 B1 80 E1  /* 224 */
			29 01 00 00 00 00 03 B1 80 D7  /* 225 */
			29 01 00 00 00 00 03 B1 80 CE  /* 226 */
			29 01 00 00 00 00 03 B1 80 C4  /* 227 */
			29 01 00 00 00 00 03 B1 80 B8  /* 228 */
			29 01 00 00 00 00 03 B1 80 AD  /* 229 */
			29 01 00 00 00 00 03 B1 80 A1  /* 230 */
			29 01 00 00 00 00 03 B1 80 9C  /* 231 */
			29 01 00 00 00 00 03 B1 80 98  /* 232 */
			29 01 00 00 00 00 03 B1 80 93  /* 233 */
			29 01 00 00 00 00 03 B1 80 8E  /* 234 */
			29 01 00 00 00 00 03 B1 80 83  /* 235 */
			29 01 00 00 00 00 03 B1 80 78  /* 236 */
			29 01 00 00 00 00 03 B1 80 6E  /* 237 */
			29 01 00 00 00 00 03 B1 80 63  /* 238 */
			29 01 00 00 00 00 03 B1 80 59  /* 239 */
			29 01 00 00 00 00 03 B1 80 50  /* 240 */
			29 01 00 00 00 00 03 B1 80 46  /* 241 */
			29 01 00 00 00 00 03 B1 80 3D  /* 242 */
			29 01 00 00 00 00 03 B1 80 2D  /* 243 */
			29 01 00 00 00 00 03 B1 80 23  /* 244 */
			29 01 00 00 00 00 03 B1 80 1A  /* 245 */
			29 01 00 00 00 00 03 B1 80 10  /* 246 */
			29 01 00 00 00 00 03 B1 80 2F  /* 247 */
			29 01 00 00 00 00 03 B1 80 25  /* 248 */
			29 01 00 00 00 00 03 B1 80 1A  /* 249 */
			29 01 00 00 00 00 03 B1 80 10  /* 250 */
			29 01 00 00 00 00 03 B1 80 2B  /* 251 */
			29 01 00 00 00 00 03 B1 80 22  /* 252 */
			29 01 00 00 00 00 03 B1 80 19  /* 253 */
			29 01 00 00 00 00 03 B1 80 10  /* 254 */
			29 01 00 00 00 00 03 B1 80 10  /* 255 */
		];

		/*
		 * ************************************************************************************************************************
		 * ACL command list and mappings
		 * ************************************************************************************************************************
		 */

		samsung,acl_on_tx_cmds_revA = [
			29 01 00 00 00 00 07 B4 00 50 7F 00 00 14  /* 2nd : 0x50 32frame avg, 3rd : 0x7F start point 50%, 6th: 0x14 ACL 15% */
			29 01 00 00 00 00 02 55 02	/* ACL ON */
		];

		samsung,acl_percent_tx_cmds_revA = [
			29 01 00 00 00 00 02 55 00	/* ACL OFF */
			29 01 00 00 00 00 02 55 02	/* Default ACL */
			29 01 00 00 00 00 02 55 03
		];

		samsung,acl_off_tx_cmds_revA = [
			29 01 00 00 00 00 07 B4 00 40 7F 00 00 00  /* 2nd : 0x40 16frame avg, 3rd : 0x7F start point 50%, 6th: 0x00 ACL OFF */
			29 01 00 00 00 00 02 55 00	/* ACL OFF */
		];

		/* bl_level , Index in acl command list */
		samsung,acl_map_table_revA =  <
			2	1		3	1		4	1		5	1		6	1
			7	1		8	1		9	1		10	1		11	1
			12	1		13	1		14	1		15	1		16	1
			17	1		19	1		20	1		21	1		22	1
			24	1		25	1		27	1		29	1		30	1
			32	1		34	1		37	1		39	1		41	1
			44	1		47	1		50	1		53	1		56	1
			60	1		64	1		68	1		72	1		77	1
			82	1		87	1		93	1		98	1		105	1
			111	1		119	1		126	1		134	1		143	1
			152	1		162	1		172	1		183	1		195	1
			207	1		220	1		234	1		249	1		265	1
			282	1		300	1		316	1		333	1		350	1
			357	1		365	1		372	1		380	1		387	1
			395	1		403	1		412	1		420	1
		>;

		/*
		 * ************************************************************************************************************************
		 * SMART ACL(ACL On) ELVSS command list and mappings
		 * ************************************************************************************************************************
		 */
		samsung,smart_acl_elvss_tx_cmds_revA = [ // ELVSS Table
			29 01 00 00 00 00 04 B5 19 DC 0A /*   0: 412 ~ 420 CD */
			29 01 00 00 00 00 04 B5 19 DC 0B /*   1: 365 ~ 403 CD */
			29 01 00 00 00 00 04 B5 19 DC 0C /*   2: 357 CD */
			29 01 00 00 00 00 04 B5 19 DC 0C /*   3: 350 CD */
			29 01 00 00 00 00 04 B5 19 DC 0D /*   4: 333 CD */
			29 01 00 00 00 00 04 B5 19 DC 0D /*   5: 316 CD */
			29 01 00 00 00 00 04 B5 19 DC 0E /*   6: 300 CD */
			29 01 00 00 00 00 04 B5 19 DC 0F /*   7: 282 CD */
			29 01 00 00 00 00 04 B5 19 DC 10 /*   8: 183 ~ 265 CD */
			29 01 00 00 00 00 04 B5 19 DC 11 /*   9: 172 CD */
			29 01 00 00 00 00 04 B5 19 DC 11 /*  10: 162 CD */
			29 01 00 00 00 00 04 B5 19 DC 11 /*  11: 152 CD */
			29 01 00 00 00 00 04 B5 19 DC 12 /*  12: 143 CD */
			29 01 00 00 00 00 04 B5 19 DC 12 /*  13: 134 CD */
			29 01 00 00 00 00 04 B5 19 CC 13 /*  14: 126 CD */
			29 01 00 00 00 00 04 B5 19 CC 13 /*  15: 119 CD */
			29 01 00 00 00 00 04 B5 19 CC 13 /*  16: 111 CD */
			29 01 00 00 00 00 04 B5 19 CC 14 /*  17: 105 CD */
			29 01 00 00 00 00 04 B5 19 CC 14 /*  18: 98 CD */
			29 01 00 00 00 00 04 B5 19 CC 14 /*  19: 93 CD */
			29 01 00 00 00 00 04 B5 19 CC 15 /*  20: 11 ~ 87 CD */
			29 01 00 00 00 00 04 B5 19 CC 14 /*  21: 10 CD */
			29 01 00 00 00 00 04 B5 19 CC 13 /*  22: 9 CD */
			29 01 00 00 00 00 04 B5 19 CC 12 /*  23: 8 CD */
			29 01 00 00 00 00 04 B5 19 CC 11 /*  24: 7 CD */
			29 01 00 00 00 00 04 B5 19 CC 10 /*  25: 6 CD */
			29 01 00 00 00 00 04 B5 19 CC 0F /*  26: 2 ~ 5 CD */

		];

		/* bl_level, Index in elvss command list */
		samsung,smart_acl_elvss_map_table_revA = <
			2	26		3	26		4	26		5	26		6	25
			7	24		8	23		9	22		10	21		11	20
			12	20		13	20		14	20		15	20		16	20
			17	20		19	20		20	20		21	20		22	20
			24	20		25	20		27	20		29	20		30	20
			32	20		34	20		37	20		39	20		41	20
			44	20		47	20		50	20		53	20		56	20
			60	20		64	20		68	20		72	20		77	20
			82	20		87	20		93	19		98	18		105	17
			111	16		119	15		126	14		134	13		143	12
			152	11		162	10		172	9		183	8		195	8
			207	8		220	8		234	8		249	8		265	8
			282	7		300	6		316	5		333	4		350	3
			357	2		365	1		372	1		380	1		387	1
			395	1		403	1		412	0		420	0
		>;

		/*
		 * ************************************************************************************************************************
		 * candela to index mappings
		 * ************************************************************************************************************************
		 */

		samsung,candela_map_table_revA = <
		/*<idx>   <from>  <till> <candella> */
			0	0	0	2
			1	1	6	3
			2	7	12	4
			3	13	18	5
			4	19	23	6
			5	24	28	7
			6	29	31	8
			7	32	34	9
			8	35	37	10
			9	38	40	11
			10	41	43	12
			11	44	46	13
			12	47	48	14
			13	49	50	15
			14	51	52	16
			15	53	54	17
			16	55	56	19
			17	57	57	20
			18	58	59	21
			19	60	61	22
			20	62	63	24
			21	64	65	25
			22	66	67	27
			23	68	69	29
			24	70	70	30
			25	71	72	32
			26	73	74	34
			27	75	76	37
			28	77	78	39
			29	79	80	41
			30	81	82	44
			31	83	84	47
			32	85	86	50
			33	87	88	53
			34	89	90	56
			35	91	92	60
			36	93	94	64
			37	95	96	68
			38	97	98	72
			39	99	100	77
			40	101	102	82
			41	103	104	87
			42	105	106	93
			43	107	108	98
			44	109	110	105
			45	111	112	111
			46	113	114	119
			47	115	116	126
			48	117	118	134
			49	119	120	143
			50	121	122	152
			51	123	124	162
			52	125	126	172
			53	127	128	183
			54	129	135	195
			55	136	142	207
			56	143	149	220
			57	150	157	234
			58	158	165	249
			59	166	174	265
			60	175	183	282
			61	184	193	300
			62	194	201	316
			63	202	210	333
			64	211	219	350
			65	220	223	357
			66	224	227	365
			67	228	230	372
			68	231	234	380
			69	235	238	387
			70	239	242	395
			71	243	246	403
			72	247	250	412
			73	251	255	420
		>;

		samsung,hbm_candela_map_table_revA = <
			0	282	295	465	6
			1	296	309	488	7
			2	310	323	510	8
			3	324	336	533	9
			4	337	350	555	10
			5	351	364	578	11
			6	365	365	600	12
		>;

		/*
		* ************************************************************************************************************************
		*  HMT
		* ************************************************************************************************************************
		*/

		samsung,hmt_enabled;
		samsung,hmt_aid_tx_cmds_revA = [
			29 01 00 00 00 00 03 B2 10 84 /* 10 CD */
			29 01 00 00 00 00 03 B2 10 84 /* 11 CD */
			29 01 00 00 00 00 03 B2 10 84 /* 12 CD */
			29 01 00 00 00 00 03 B2 10 84 /* 13 CD */
			29 01 00 00 00 00 03 B2 10 84 /* 14 CD */
			29 01 00 00 00 00 03 B2 10 84 /* 15 CD */
			29 01 00 00 00 00 03 B2 10 84 /* 16 CD */
			29 01 00 00 00 00 03 B2 10 84 /* 17 CD */
			29 01 00 00 00 00 03 B2 10 84 /* 19 CD */
			29 01 00 00 00 00 03 B2 10 84 /* 20 CD */
			29 01 00 00 00 00 03 B2 10 84 /* 21 CD */
			29 01 00 00 00 00 03 B2 10 84 /* 22 CD */
			29 01 00 00 00 00 03 B2 10 84 /* 23 CD */
			29 01 00 00 00 00 03 B2 10 84 /* 25 CD */
			29 01 00 00 00 00 03 B2 10 84 /* 27 CD */
			29 01 00 00 00 00 03 B2 10 84 /* 29 CD */
			29 01 00 00 00 00 03 B2 10 84 /* 31 CD */
			29 01 00 00 00 00 03 B2 10 84 /* 33 CD */
			29 01 00 00 00 00 03 B2 10 84 /* 35 CD */
			29 01 00 00 00 00 03 B2 10 84 /* 37 CD */
			29 01 00 00 00 00 03 B2 10 84 /* 39 CD */
			29 01 00 00 00 00 03 B2 10 84 /* 41 CD */
			29 01 00 00 00 00 03 B2 10 84 /* 44 CD */
			29 01 00 00 00 00 03 B2 10 84 /* 47 CD */
			29 01 00 00 00 00 03 B2 10 84 /* 50 CD */
			29 01 00 00 00 00 03 B2 10 84 /* 50 CD */
			29 01 00 00 00 00 03 B2 10 84 /* 53 CD */
			29 01 00 00 00 00 03 B2 10 84 /* 56 CD */
			29 01 00 00 00 00 03 B2 10 84 /* 60 CD */
			29 01 00 00 00 00 03 B2 10 84 /* 64 CD */
			29 01 00 00 00 00 03 B2 10 84 /* 68 CD */
			29 01 00 00 00 00 03 B2 10 84 /* 72 CD */
			29 01 00 00 00 00 03 B2 20 46 /* 77 CD */
			29 01 00 00 00 00 03 B2 20 46 /* 82 CD */
			29 01 00 00 00 00 03 B2 20 46 /* 87 CD */
			29 01 00 00 00 00 03 B2 20 46 /* 93 CD */
			29 01 00 00 00 00 03 B2 20 46 /* 99 CD */
			29 01 00 00 00 00 03 B2 20 46 /* 105 CD */
		];

		/* bl_level, Index in acl command list */
		samsung,hmt_reverse_aid_map_table_revA = <
			10	0
			11	1
			12	2
			13	3
			14	4
			15	5
			16	6
			17	7
			19	8
			20	9
			21	10
			22	11
			23	12
			25	13
			27	14
			29	15
			31	16
			33	17
			35	18
			37	19
			39	20
			41	21
			44	22
			47	23
			50	24
			53	25
			56	26
			60	27
			64	28
			68	29
			72	30
			77	31
			82	32
			87	33
			93	34
			99	35
			105	36
		>;

		samsung,hmt_candela_map_table_revA = <
		/*<idx>	  <from>  <till> <candella> */
			0	0	6	10
			1	7	13	11
			2	14	20	12
			3	21	27	13
			4	28	34	14
			5	35	41	15
			6	42	48	16
			7	49	55	17
			8	56	62	19
			9	63	69	20
			10	70	76	21
			11	77	83	22
			12	84	90	23
			13	91	97	25
			14	98	104	27
			15	105	111	29
			16	112	118	31
			17	119	125	33
			18	126	132	35
			19	133	139	37
			20	140	146	39
			21	147	153	41
			22	154	160	44
			23	161	167	47
			24	168	174	50
			25	175	181	53
			26	182	188	56
			27	189	195	60
			28	196	202	64
			29	203	209	68
			30	210	216	72
			31	217	223	77
			32	224	230	82
			33	231	237	87
			34	238	244	93
			35	245	251	99
			36	252	255	105
		>;

		samsung,hmt_gamma_tx_cmds_revA = [ // 5.3.1 Dimming For HMD : ???
			29 01 00 00 00 00 24 CA
				01 00 01 00 01 00
				80 80 80
				80 80 80
				80 80 80
				80 80 80
				80 80 80
				80 80 80
				80 80 80
				80 80 80
				00 00 00
				00 00
			29 01 00 00 00 00 03 B2 00 10		// AID set : AOR 0%
			29 01 00 00 00 00 02 F7 03		// Gamma, LTPS(AID) update
		];

		samsung,hmt_elvss_tx_cmds_revA = [
			29 01 00 00 00 00 03 B6 BC 04
		];

		samsung,hmt_enable_tx_cmds_revA = [ // 5.2.1 HMD On Setting
			29 01 00 00 00 00 03 F0 5A 5A
			29 01 00 00 00 00 07 B2 20 46 12 12 12 00		// AOR 70%, AID 1 -Cycle
			29 01 00 00 00 00 03 F0 A5 A5
		];

		samsung,hmt_reverse_tx_cmds_revA = [ // 5.2.2 AID Reverse Setting
			29 01 00 00 00 00 03 F0 5A 5A
			29 01 00 00 00 00 08 F2 01 00 02 5A F0 0C 08		// Reverse Porch Setting
			29 01 00 00 00 00 41 CB 				// LTPS Setting
				28 01 01 01 10 66 88 00
				00 00 0D 00 00 00 00 00
				00 12 6E 00 00 00 00 14
				00 00 00 00 74 00 00 CF
				11 0D 04 05 00 C2 00 00
				00 C0 C0 C0 C0 84 C5 C2
				C0 00 00 00 00 00 00 00
				00 00 00 8C 6E 00 00 14
			29 01 00 00 01 00 02 F7 03
			29 01 00 00 00 00 03 F0 A5 A5
		];

		samsung,hmt_disable_tx_cmds_revA = [ // 5.2.3 HMD OFF Setting
			29 01 00 00 00 00 03 F0 5A 5A
			29 01 00 00 00 00 07 B2 00 10 12 12 12 40 	// AOR 0%, AID 4 -Cycle
			29 01 00 00 01 00 02 F7 03			// Gamma, AID update
			29 01 00 00 00 00 03 F0 A5 A5
		];

		samsung,hmt_forward_tx_cmds_revA = [ // 5.2.4 AID Forawrd Setting
			29 01 00 00 00 00 03 F0 5A 5A
			29 01 00 00 00 00 08 F2 01 00 02 5A F0 09 07	// Porch Setting
			29 01 00 00 00 00 41 CB			// LTPS Setting
				28 01 01 01 10 66 88 00
				00 05 05 00 00 00 00 00
				00 12 6E 00 00 00 00 01
				00 00 00 00 74 00 00 CF
				11 0D 04 05 00 C2 00 00
				00 C0 C0 C0 C0 04 C5 C2
				C0 00 00 00 00 00 00 00
				00 00 00 8C 6E 00 00 01
			29 01 00 00 01 00 02 F7 03
			29 01 00 00 00 00 03 F0 A5 A5
		];
	};
};
