/* Copyright (c) 2012, Samsung Electronics Corporation. All rights reserved.
 *
 * This program is free software; you can redistribute it and/or modify
 * it under the terms of the GNU General Public License version 2 and
 * only version 2 as published by the Free Software Foundation.
 *
 * This program is distributed in the hope that it will be useful,
 * but WITHOUT ANY WARRANTY; without even the implied warranty of
 * MERCHANTABILITY or FITNESS FOR A PARTICULAR PURPOSE.  See the
 * GNU General Public License for more details.
 */

&mdss_mdp {
	ss_dsi_panel_ANA38401_AMS968HH01_QXGA: ss_dsi_panel_ANA38401_AMS968HH01_QXGA {
		qcom,mdss-dsi-panel-name = "ss_dsi_panel_ANA38401_AMS968HH01_QXGA";
		label = "ss_dsi_panel_ANA38401_AMS968HH01_QXGA";
		qcom,mdss-dsi-panel-width = <1024>;
		qcom,mdss-dsi-panel-height = <1536>;
		qcom,mdss-dsi-bpp = <24>;
		qcom,mdss-dsi-panel-timings = [FB 3C 2A 00 70 74 2E 40 33 03 04 00];
		qcom,mdss-dsi-panel-timings-phy-v2 = [
			24 1E 08 09 05 03 04 a0
			24 1E 08 09 05 03 04 a0
			24 1E 08 09 05 03 04 a0
			24 1E 08 09 05 03 04 a0
			24 1A 08 09 05 03 04 a0
		];

		qcom,mdss-dsi-on-command= [
			15 01 00 00 00 00 02 B0 34		/* Global Para*/
			39 01 00 00 00 00 03 B2 64 00		/* check fail off */

			15 01 00 00 00 00 02 B0 75		/* Global Para 117th */
			39 01 00 00 00 00 02 B2 28			/* INTR Setting */

			15 01 00 00 00 00 02 B0 51		/* Global Para 81st */
			39 01 00 00 00 00 02 B1 06		/* dual dsi Setting */

			15 01 00 00 00 00 02 B0 D9		/* Global Para 217th */
			39 01 00 00 00 00 02 B1 08		/* Anapass compression mode Setting */

			15 01 00 00 00 00 02 B0 7F		/* Global Para 127th */
			39 01 00 00 00 00 02 B2 15		/* TSP_HTE TSP_VTE Setting */

			39 01 00 00 00 00 03 44 05 F6		/* Set Tear Scanline 1526  */

			15 01 00 00 00 00 02 B0 BC		/* Global Para 188th  ?? */
			39 01 00 00 00 00 02 B2 04		/* Gamma Offset index setting  ??*/

			39 01 00 00 00 00 22 83				/* Brightness condition set */
				80 80
				80 80
				80 80
				80 00
				80 80
				00
				80 80
				80 80
				80 80
				80 00
				80 80
				00
				80 80
				80 80
				80 80
				80 00
				80 80
				00


			39 01 00 00 00 00 04 90 00 00 0E		/* AID 360 nit */

			15 01 00 00 00 00 02 B0 67		/* Global Para 103rd */
			39 01 00 00 00 00 02 B2 0F		/* 360 nit ELVSS */

			15 01 00 00 00 00 02 B0 4D		/* Global Para 77th */
			39 01 00 00 00 00 02 B2 04		/* 16 Frame Avg at ACL off */

			15 01 00 00 00 00 02 B0 36		/* Global Para 54th */
			39 01 00 00 00 00 02 B2 10		/* ACL off */

			15 01 00 00 00 00 02 B0 6D		/* Global Para 109th */
			39 01 00 00 00 00 02 B2 85		/* CAPS on */

			15 01 00 00 00 00 02 B0 35		/* Global Para 53rd */
			39 01 00 00 00 00 02 B2 01		/* Gamma Update: Update key */

								/* ELVSS Temp Compensation */

			15 01 00 00 00 00 02 B0 D0		/* Global Para 208th */
			39 01 00 00 D7 00 02 B1 1D		/* UPLL_F = 35 then delay  215ms */

			05 01 00 00 00 00 02 29 00		/* display on then 50ms delay??*/
		];

		qcom,mdss-dsi-off-command=[
			05 01 00 00 64 00 02 28 00
		];

		/*qcom,cont-splash-enabled;*/
		qcom,dcs-cmd-by-left;
		/*qcom,cmd-sync-wait-broadcast;*/
		/*qcom,cmd-sync-wait-trigger;*/
		/*qcom,mdss-dsi-fbc-enable=*/
		/*qcom,mdss-dsi-fbc-bpp=*/
		/*qcom,mdss-dsi-fbc-packing=*/
		/*qcom,mdss-dsi-fbc-quant-error=*/
		/*qcom,mdss-dsi-fbc-bias=*/
		/*qcom,mdss-dsi-fbc-pat-mode=*/
		/*qcom,mdss-dsi-fbc-vlc-mode=*/
		/*qcom,mdss-dsi-fbc-bflc-mode=*/
		/*qcom,mdss-dsi-fbc-h-line-budget=*/
		/*qcom,mdss-dsi-fbc-budget-ctrl=*/
		/*qcom,mdss-dsi-fbc-block-budget=*/
		/*qcom,mdss-dsi-fbc-lossless-threshold=*/
		/*qcom,mdss-dsi-fbc-lossy-threshold=*/
		/*qcom,mdss-dsi-fbc-rgb-threshold=*/
		/*qcom,mdss-dsi-fbc-lossy-mode-idx=*/

		qcom,mdss-dsi-h-back-porch = <108>;//<108>;
		qcom,mdss-dsi-h-front-porch = <212>; //<16>;
		qcom,mdss-dsi-h-pulse-width = <16>; //<212>;
		qcom,mdss-dsi-h-sync-skew = <0>;
		qcom,mdss-dsi-v-back-porch = <6>;
		qcom,mdss-dsi-v-front-porch = <10>;
		qcom,mdss-dsi-v-pulse-width = <2>;

		qcom,mdss-dsi-h-left-border = <0>;
		qcom,mdss-dsi-h-right-border = <0>;
		qcom,mdss-dsi-v-top-border = <0>;
		qcom,mdss-dsi-v-bottom-border = <0>;

		qcom,mdss-dsi-underflow-color = <0xFF>;
		qcom,mdss-dsi-border-color = <0>;

		/*qcom,mdss-dsi-pan-enable-dynamic-fps=*/
		/*qcom,mdss-dsi-pan-fps-update=*/

		qcom,mdss-dsi-bl-pmic-control-type = "bl_ctrl_dcs";
		/*qcom,mdss-dsi-bl-pmic-bank-select=*/
		/*qcom,mdss-dsi-bl-pmic-pwm-frequency=*/
		/*qcom,mdss-dsi-pwm-gpio=*/

		qcom,mdss-dsi-bl-min-level = <1>;
		qcom,mdss-dsi-bl-max-level = <355>;
		qcom,mdss-brightness-max-level = <355>;
		qcom,mdss-dsi-interleave-mode = <0>;
		qcom,mdss-dsi-panel-type = "dsi_cmd_mode";
		qcom,mdss-dsi-force-clock-lane-hs;

		qcom,mdss-dsi-te-check-enable;
		qcom,mdss-dsi-te-using-te-pin;
		qcom,mdss-dsi-te-pin-select = <1>;

		qcom,mdss-dsi-te-dcs-command = <1>;
		qcom,mdss-dsi-wr-mem-start = <0x2C>;
		qcom,mdss-dsi-wr-mem-continue = <0x3C>;

		/* CMD mode panel doesn't need below stuff */
		/*qcom,mdss-dsi-h-sync-pulse=*/
		/*qcom,mdss-dsi-hfp-power-mode=*/
		/*qcom,mdss-dsi-hbp-power-mode=*/
		/*qcom,mdss-dsi-hsa-power-mode=*/
		/*qcom,mdss-dsi-last-line-interleave=*/
		/*qcom,mdss-dsi-bllp-eof-power-mode;*/
		/*qcom,mdss-dsi-bllp-power-mode;*/
		/*qcom,mdss-dsi-traffic-mode= "burst_mode";*/

		qcom,mdss-dsi-pixel-packing = "loose";

		qcom,mdss-dsi-virtual-channel-id = <0>;
		qcom,mdss-dsi-color-order = "rgb_swap_rgb";
		qcom,mdss-dsi-lane-0-state;
		qcom,mdss-dsi-lane-1-state;
		qcom,mdss-dsi-lane-2-state;
		qcom,mdss-dsi-lane-3-state;
		qcom,mdss-dsi-lane-map = "lane_map_0123";

		qcom,mdss-dsi-t-clk-pre = <0x2F>;
		qcom,mdss-dsi-t-clk-post = <0x0D>;

		qcom,mdss-dsi-stream = <0>;
		qcom,mdss-dsi-mdp-trigger = "none";
		qcom,mdss-dsi-dma-trigger = "trigger_sw";
		qcom,mdss-dsi-panel-framerate = <60>;
		qcom,mdss-dsi-panel-clockrate = <887000000>;
		qcom,mdss-dsi-on-command-state = "dsi_lp_mode";
		qcom,mdss-dsi-off-command-state = "dsi_hs_mode";

		qcom,mdss-pan-physical-width-dimension = <196>;
		qcom,mdss-pan-physical-height-dimension = <147>;

		qcom,mdss-dsi-panel-mode-gpio-state = "invalid";

		/*qcom,mdss-tear-check-sync-cfg-height = <2576>;*/
		/*qcom,mdss-tear-check-sync-init-val=*/
		/*qcom,mdss-tear-check-sync-threshold-start=*/
		/*qcom,mdss-tear-check-sync-threshold-continue=*/
		/*qcom,mdss-tear-check-start-pos=*/
		/*qcom,mdss-tear-check-rd-ptr-trigger-intr=*/
		/*qcom,mdss-tear-check-frame-rate=*/

		/* use fake_regulators in board dtsi,
		 * instead of qcom,mdss-dsi-reset-sequence
		 */
		/*qcom,mdss-dsi-reset-sequence = <0 15>, <1 30>;*/
		/*qcom,partial-update-enabled;*/
		/*qcom,partial-update-roi-merge;*/
		/*qcom,panel-roi-alignment=<8 8 1 1 1 2>;*/
		/*qcom,mdss-dsi-horizontal-line-idle*/

		qcom,mdss-dsi-lp11-init;
		qcom,mdss-dsi-init-delay-us = <1000>;

		qcom,mdss-dsi-rx-eot-ignore;
		qcom,mdss-dsi-tx-eot-append;

		/*qcom,ulps-enabled;*/
		/*qcom,suspend-ulps-enabled;*/

		qcom,esd-check-enabled;
		qcom,mdss-dsi-panel-status-check-mode="reg_read_irq";
 		qcom,mdss-dsi-panel-status-irq-trigger1="falling";

		/*qcom,mdss-dsi-panel-status-command=*/
		/*qcom,mdss-dsi-panel-status-read-length;*/
		/*qcom,mdss-dsi-panel-status-value=<1>;*/
		/*qcom,mdss-dsi-panel-status-command-mode="dsi_lp_mode";*/
		/*qcom,dynamic-mode-switch-enabled*/
		/*qcom,video-to-cmd-mode-switch-commands=*/
		/*qcom,cmd-to-video-mode-switch-commands=*/

/*
* ************************************************************************************************************************************
*
*
*			Below  parameters are samsung dependent thigs
*
*
* ************************************************************************************************************************************
*/
		samsung,support_panel_max = <1>;
		samsung,tcon-clk-on-support;
		samsung,hw-config = "split_dsi";
		samsung,mdss-power-on-reset-delay-us = <70000>;
		samsung,mdss-power-off-delay-us = <10000>;
		samsung,dsi-lp11-init;
		samsung,enter_hbm_lux = <10000>;

		/*
		the last byte in read commands	represent READ LENGH,
		like below  READ LENGH = 0x21
		*/

		samsung,packet_size_tx_cmds_revA = [
			37 01 00 00 00 00 02 21 00
		];

		samsung,reg_read_pos_tx_cmds_revA = [
			15 01 00 00 00 00 02 B0 00
		];

		samsung,smart_dimming_mtp_rx_cmds_revA = [24 01 00 00 00 00 02 d8 08 08 5A]; /*Offset 0x5A*/
		samsung,hbm_rx_cmds_revA = [24 01 00 00 00 00 02 d4 08 08 5B]; /*Offset 0x5B*/
		samsung,hbm2_rx_cmds_revA = [24 01 00 00 00 00 02 d8 01 01 81]; /*Offset 0x7B*/
		samsung,mdnie_read_rx_cmds_revA = [24 01 00 00 00 00 02 d8 04 04 7B]; /*Offset 0x7B*/
		samsung,elvss_rx_cmds_revA = [24 01 00 00 00 00 02 d2 01 01 70]; /*Offset 0x70*/
		samsung,mtp_read_sysfs_rx_cmds_revA = [24 01 00 00 00 00 02 00 00 00 00];

		/* the last byte in all read commands will represent READ LENGH */
		samsung,manufacture_read_pre_tx_cmds_revA = [
			15 01 00 00 00 00 02 B0 34
			39 01 00 00 00 00 03 B2 64 00

			15 01 00 00 00 00 02 B0 D9
			39 01 00 00 00 00 02 B1 08

			15 01 00 00 00 00 02 B0 51
			39 01 00 00 00 00 02 B1 06

			15 01 00 00 00 00 02 B0 75
			39 01 00 00 00 00 02 B2 28
		];

		samsung,manufacture_id0_rx_cmds_revA = [ 06 01 00 00 00 00 01 da 01 00];
		samsung,manufacture_id1_rx_cmds_revA = [ 06 01 00 00 00 00 01 db 01 00];
		samsung,manufacture_id2_rx_cmds_revA = [ 06 01 00 00 00 00 01 dc 01 00];

		samsung,manufacture_date_rx_cmds_revA = [24 01 00 00 00 00 02 D8 02 02 7F]; /*Offset 0x7F*/

		/*samsung,display_on_tx_cmds_revA = [05 01 00 00 32 00 02 29 00];*/
		samsung,display_off_tx_cmds_revA = [05 01 00 00 32 00 02 28 00];

		samsung,gamma_tx_cmds_revA = [
			39 01 00 00 00 00 22				/* Brightness condition set */
			83 80 80 80 80 80 80
			80 00 80 80 00 80 80
			80 80 80 80 80 00 80
			80 00 80 80 80 80 80
			80 80 00 80 80 00

			15 01 00 00 00 00 02 B0 35		/* Global Para 53rd */
			39 01 00 00 00 00 02 B2 01		/* Update key */
		];

		samsung,hbm_gamma_tx_cmds_revA = [
			39 01 00 00 00 00 22				/* Brightness condition set */
			83 80 80 80 80 80 80
			80 00 80 80 00 80 80
			80 80 80 80 80 00 80
			80 00 80 80 80 80 80
			80 80 00 80 80 00
		];

		samsung,hbm_etc_tx_cmds_revA = [
			39 01 00 00 00 00 04 90 00 00 0E		/* AID 360 nit */
			15 01 00 00 00 00 02 B0 67		/* Global Para 103rd */
			39 01 00 00 00 00 02 B2 17		/* HBM ELVSS */
			15 01 00 00 00 00 02 B0 70		/* Global Para 112nd */
			39 01 00 00 00 00 02 B2 00		/* HBM ELVSS */
			15 01 00 00 00 00 02 B0 4D		/* Global Para 77th */
			39 01 00 00 00 00 02 B2 05		/* 32 Frame Avg at ACL on */
			15 01 00 00 00 00 02 B0 36		/* Global Para 54th */
			39 01 00 00 00 00 02 B2 12		/* ACL on */
			15 01 00 00 00 00 02 B0 6D		/* Global Para 109th */
			39 01 00 00 00 00 02 B2 85		/* CAPS on */
			15 01 00 00 00 00 02 B0 35		/* Global Para 53rd */
			39 01 00 00 00 00 02 B2 01		/* Update key */
		];

		samsung,hbm_off_tx_cmds_revA = [
			15 00 00 00 00 00 02 B0 70		/* Global Para 112nd */
			39 00 00 00 00 00 02 B2 00		/* HBM ELVSS */
		];

		/*
		* ************************************************************************************************************************
		* AID command list and mappings
		* ************************************************************************************************************************
		*/
		samsung,aid_tx_cmds_revA = [
			39 01 00 00 00 00 04 90 01 00 7F /* 98.71% 2CD 0 */
			39 01 00 00 00 00 04 90 01 00 7D  /* 98.20% 3CD 1 */
			39 01 00 00 00 00 04 90 01 00 7A  /* 97.42% 4CD 2 */
			39 01 00 00 00 00 04 90 01 00 78  /* 96.91% 5CD 3 */
			39 01 00 00 00 00 04 90 01 00 75  /* 96.13% 6CD 4 */
			39 01 00 00 00 00 04 90 01 00 72  /* 95.36% 7CD 5 */
			39 01 00 00 00 00 04 90 01 00 6F  /* 94.59% 8CD 6 */
			39 01 00 00 00 00 04 90 01 00 6C  /* 93.81% 9CD 7 */
			39 01 00 00 00 00 04 90 01 00 69  /* 93.04% 10CD 8 */
			39 01 00 00 00 00 04 90 01 00 67  /* 92.53% 11CD 9 */
			39 01 00 00 00 00 04 90 01 00 64  /* 91.75% 12CD 10 */
			39 01 00 00 00 00 04 90 01 00 61  /* 90.98% 13CD 11 */
			39 01 00 00 00 00 04 90 01 00 5E  /* 90.21% 14CD 12 */
			39 01 00 00 00 00 04 90 01 00 5A  /* 89.18% 15CD 13 */
			39 01 00 00 00 00 04 90 01 00 58  /* 88.66% 16CD 14 */
			39 01 00 00 00 00 04 90 01 00 56  /* 88.14% 17CD 15 */
			39 01 00 00 00 00 04 90 01 00 50  /* 86.60% 19CD 16 */
			39 01 00 00 00 00 04 90 01 00 4D  /* 85.82% 20CD 17 */
			39 01 00 00 00 00 04 90 01 00 48  /* 84.54% 21CD 18 */
			39 01 00 00 00 00 04 90 01 00 45  /* 83.76% 22CD 19 */
			39 01 00 00 00 00 04 90 01 00 3F  /* 82.22% 24CD 20 */
			39 01 00 00 00 00 04 90 01 00 3C  /* 81.44% 25CD 21 */
			39 01 00 00 00 00 04 90 01 00 36  /* 79.90% 27CD 22 */
			39 01 00 00 00 00 04 90 01 00 30  /* 78.35% 29CD 23 */
			39 01 00 00 00 00 04 90 01 00 2C  /* 77.32% 30CD 24 */
			39 01 00 00 00 00 04 90 01 00 26  /* 75.77% 32CD 25 */
			39 01 00 00 00 00 04 90 01 00 1F  /* 73.97% 34CD 26 */
			39 01 00 00 00 00 04 90 01 00 16  /* 71.65% 37CD 27 */
			39 01 00 00 00 00 04 90 01 00 0F  /* 69.85% 39CD 28 */
			39 01 00 00 00 00 04 90 01 00 09  /* 68.30% 41CD 29 */
			39 01 00 00 00 00 04 90 00 00 FF  /* 65.72% 44CD 30 */
			39 01 00 00 00 00 04 90 00 00 F5  /* 63.14% 47CD 31 */
			39 01 00 00 00 00 04 90 00 00 EB  /* 60.57% 50CD 32 */
			39 01 00 00 00 00 04 90 00 00 E1  /* 57.99% 53CD 33 */
			39 01 00 00 00 00 04 90 00 00 D7  /* 55.41% 56CD 34 */
			39 01 00 00 00 00 04 90 00 00 C9  /* 51.80% 60CD 35 */
			39 01 00 00 00 00 04 90 00 00 BB  /* 48.20% 64CD 36 */
			39 01 00 00 00 00 04 90 00 00 AD  /* 44.59% 68CD 37 */
			39 01 00 00 00 00 04 90 00 00 99  /* 39.43% 72CD 38 */
			39 01 00 00 00 00 04 90 00 00 99  /* 39.43% 77CD 39 */
			39 01 00 00 00 00 04 90 00 00 99  /* 39.43% 82CD 40 */
			39 01 00 00 00 00 04 90 00 00 99  /* 39.43% 87CD 41 */
			39 01 00 00 00 00 04 90 00 00 99 /* 39.43% 93CD 42 */
			39 01 00 00 00 00 04 90 00 00 99  /* 39.43% 98CD 43 */
			39 01 00 00 00 00 04 90 00 00 99  /* 39.43% 105CD 44 */
			39 01 00 00 00 00 04 90 00 00 99  /* 39.43% 111CD 45 */
			39 01 00 00 00 00 04 90 00 00 99  /* 39.43% 119CD 46 */
			39 01 00 00 00 00 04 90 00 00 99  /* 39.43% 126CD 47 */
			39 01 00 00 00 00 04 90 00 00 99  /* 39.43% 134CD 48 */
			39 01 00 00 00 00 04 90 00 00 99  /* 39.43% 143CD 49 */
			39 01 00 00 00 00 04 90 00 00 99  /* 39.43% 152CD 50 */
			39 01 00 00 00 00 04 90 00 00 99  /* 39.43% 162CD 51 */
			39 01 00 00 00 00 04 90 00 00 99  /* 39.43% 172CD 52 */
			39 01 00 00 00 00 04 90 00 00 86  /* 34.54% 183CD 53 */
			39 01 00 00 00 00 04 90 00 00 71  /* 29.12% 195CD 54 */
			39 01 00 00 00 00 04 90 00 00 5C  /* 23.71% 207CD 55 */
			39 01 00 00 00 00 04 90 00 00 45  /* 17.78% 220CD 56 */
			39 01 00 00 00 00 04 90 00 00 2B  /* 11.08% 234CD 57 */
			39 01 00 00 00 00 04 90 00 00 0E  /* 3.61% 249CD 58 */
			39 01 00 00 00 00 04 90 00 00 0E  /* 3.61% 265CD 59 */
			39 01 00 00 00 00 04 90 00 00 0E  /* 3.61% 282CD 60 */
			39 01 00 00 00 00 04 90 00 00 0E  /* 3.61% 300CD 61 */
			39 01 00 00 00 00 04 90 00 00 0E  /* 3.61% 316CD 62 */
			39 01 00 00 00 00 04 90 00 00 0E  /* 3.61% 333CD 63 */
			39 01 00 00 00 00 04 90 00 00 0E  /* 3.61% 360CD 64 */
		];

		/* bl_level, Index in acl command list */
		samsung,aid_map_table_revA = <
			2	0		3	1		4	2		5	3		6	4
			7	5		8	6		9	7		10	8		11	9
			12	10		13	11		14	12		15	13		16	14
			17	15		19	16		20	17		21	18		22	19
			24	20		25	21		27	22		29	23		30	24
			32	25		34	26		37	27		39	28		41	29
			44	30		47	31		50	32		53	33		56	34
			60	35		64	36		68	37		72	38		77	39
			82	40		87	41		93	42		98	43		105	44
			111	45		119	46		126	47		134	48		143	49
			152	50		162	51		172	52		183	53		195	54
			207	55		220	56		234	57		249	58		265	59
			282	60		300	61		316	62		333	63		360	64
		>;

		/*
		* ************************************************************************************************************************
		* CAPS on/off command list and mappings
		* ************************************************************************************************************************
		*/

		samsung,pre_caps_setting_tx_cmds_revA = [
			15 01 00 00 00 00 02 B0 6D		/* Global para 109 */
		];

		samsung,caps_setting_tx_cmds_revA = [
			39 01 00 00 00 00 02 B2 81		/* 2~39CD 0 */
			39 01 00 00 00 00 02 B2 85		/* 44~143CD 1 */
		];

		/* bl_level , Index in caps command list */
		samsung,caps_map_table_revA =  <
			2	0		3	0		4	0		5	0		6	0
			7	0		8	0		9	0		10	0		11	0
			12	0		13	0		14	0		15	0		16	0
			17	0		19	0		20	0		21	0		22	0
			24	0		25	0		27	0		29	0		30	0
			32	0		34	0		37	0		39	0		41	1
			44	1		47	1		50	1		53	1		56	1
			60	1		64	1		68	1		72	1		77	1
			82	1		87	1		93	1		98	1		105	1
			111	1		119	1		126	1		134	1		143	1
			152	1		162	1		172	1		183	1		195	1
			207	1		220	1		234	1		249	1		265	1
			282	1		300	1		316	1		333	1		360	1
		>;
		/*
		* ************************************************************************************************************************
		* ACL command list and mappings
		* ************************************************************************************************************************
		*/
		samsung,acl_on_tx_cmds_revA = [
			15 01 00 00 00 00 02 B0 4D		/* Global Para 77th */
			39 01 00 00 00 00 02 B2 05		/* 32 Frame Avg at ACL on */
		]; /* ACL on, B2 <- 0x05 */

		samsung,acl_pre_percent_tx_cmds_revA = [15 01 00 00 00 00 02 B0 36];
		samsung,acl_percent_tx_cmds_revA = [
			39 01 00 00 00 00 02 B2 10
			39 01 00 00 00 00 02 B2 11
			39 01 00 00 00 00 02 B2 12	/* default ACL 15% */
			39 01 00 00 00 00 02 B2 13
		];	/* ACL 25% */

		samsung,acl_off_tx_cmds_revA = [
			15 01 00 00 00 00 02 B0 4D		/* Global Para 77th */
			39 01 00 00 00 00 02 B2 04		/* 16 Frame Avg at ACL off */
			15 01 00 00 00 00 02 B0 36		/* Global Para 54th */
			39 01 00 00 00 00 02 B2 10		/* ACL off */
		];/*off, b2<-0x04*/

		/* bl_level , Index in acl command list */
		samsung,acl_map_table_revA =  <
			2	2		3	2		4	2		5	2		6	2
			7	2		8	2		9	2		10	2		11	2
			12	2		13	2		14	2		15	2		16	2
			17	2		19	2		20	2		21	2		22	2
			24	2		25	2		27	2		29	2		30	2
			32	2		34	2		37	2		39	2		41	2
			44	2		47	2		50	2		53	2		56	2
			60	2		64	2		68	2		72	2		77	2
			82	2		87	2		93	2		98	2		105	2
			111	2		119	2		126	2		134	2		143	2
			152	2		162	2		172	2		183	2		195	2
			207	2		220	2		234	2		249	2		265	2
			282	2		300	2		316	2		333	2		360	2
		>;
		/*
		* ************************************************************************************************************************
		* ELVSS(ACL Off) command list and mappings
		* ************************************************************************************************************************
		*/
		samsung,elvss_pre_tx_cmds_revA = [15 01 00 00 00 00 02 B0 67];
		samsung,elvss_tx_cmds_revA = [
			39 01 00 00 00 00 02 b2 19 /* 0: 360cd */
			39 01 00 00 00 00 02 b2 1A /* 1: 333cd */
			39 01 00 00 00 00 02 b2 1B /* 2: 316cd */
			39 01 00 00 00 00 02 b2 1C /* 3: 300cd */
			39 01 00 00 00 00 02 b2 1D /* 4: 282cd */
			39 01 00 00 00 00 02 b2 1D /* 5: 265cd */
			39 01 00 00 00 00 02 b2 1E /* 6: 249cd */
			39 01 00 00 00 00 02 b2 1E /* 7: 234cd */
			39 01 00 00 00 00 02 b2 1E /* 8: 220cd */
			39 01 00 00 00 00 02 b2 1F /* 9: 207cd */
			39 01 00 00 00 00 02 b2 1F /* 10: 195cd */
			39 01 00 00 00 00 02 b2 1F /* 11: 183cd */
			39 01 00 00 00 00 02 b2 1F /* 12: 172cd */
			39 01 00 00 00 00 02 b2 20 /* 13: 162cd */
			39 01 00 00 00 00 02 b2 20 /* 14: 152cd */
			39 01 00 00 00 00 02 b2 21 /* 15: 143cd */
			39 01 00 00 00 00 02 b2 21 /* 16: 134cd */
			39 01 00 00 00 00 02 b2 21 /* 17: 126cd */
			39 01 00 00 00 00 02 b2 21 /* 18: 119cd */
			39 01 00 00 00 00 02 b2 21 /* 19: 111cd */
			39 01 00 00 00 00 02 b2 21 /* 20: 105-60cd */
			39 01 00 00 00 00 02 b2 21 /* 21: 56cd */
			39 01 00 00 00 00 02 b2 21 /* 22: 53cd */
			39 01 00 00 00 00 02 b2 21 /* 23: 50cd */
			39 01 00 00 00 00 02 b2 21 /* 24: 47cd */
			39 01 00 00 00 00 02 b2 21 /* 25: 44cd */
			39 01 00 00 00 00 02 b2 20 /* 26: 41cd */
			39 01 00 00 00 00 02 b2 20 /* 27: 39cd */
			39 01 00 00 00 00 02 b2 20 /* 28: 37cd */
			39 01 00 00 00 00 02 b2 1F /* 29: 34cd */
			39 01 00 00 00 00 02 b2 1F /* 30: 32cd */
			39 01 00 00 00 00 02 b2 1E /* 31: 30cd */
			39 01 00 00 00 00 02 b2 1E /* 32: 29cd */
			39 01 00 00 00 00 02 b2 1E /* 33: 27cd */
			39 01 00 00 00 00 02 b2 1D /* 34: 25-21cd */
			39 01 00 00 00 00 02 b2 1C /* 35: 20-16cd */
			39 01 00 00 00 00 02 b2 1B /* 36: 15-11cd */
			39 01 00 00 00 00 02 b2 1A /* 37: 10-5cd */
			39 01 00 00 00 00 02 b2 19 /* 38: 4-2cd */
		];

		samsung,elvss_lowtemp_tx_cmds_revA = [
			39 01 00 00 00 00 02 b2 0F /* 0: 360cd */
			39 01 00 00 00 00 02 b2 10 /* 1: 333cd */
			39 01 00 00 00 00 02 b2 11 /* 2: 316cd */
			39 01 00 00 00 00 02 b2 12 /* 3: 300cd */
			39 01 00 00 00 00 02 b2 13 /* 4: 282cd */
			39 01 00 00 00 00 02 b2 13 /* 5: 265cd */
			39 01 00 00 00 00 02 b2 14 /* 6: 249cd */
			39 01 00 00 00 00 02 b2 14 /* 7: 234cd */
			39 01 00 00 00 00 02 b2 14 /* 8: 220cd */
			39 01 00 00 00 00 02 b2 15 /* 9: 207cd */
			39 01 00 00 00 00 02 b2 15 /* 10: 195cd */
			39 01 00 00 00 00 02 b2 15 /* 11: 183cd */
			39 01 00 00 00 00 02 b2 15 /* 12: 172cd */
			39 01 00 00 00 00 02 b2 16 /* 13: 162cd */
			39 01 00 00 00 00 02 b2 16 /* 14: 152cd */
			39 01 00 00 00 00 02 b2 17 /* 15: 143cd */
			39 01 00 00 00 00 02 b2 17 /* 16: 134cd */
			39 01 00 00 00 00 02 b2 17 /* 17: 126cd */
			39 01 00 00 00 00 02 b2 17 /* 18: 119cd */
			39 01 00 00 00 00 02 b2 17 /* 19: 111cd */
			39 01 00 00 00 00 02 b2 17 /* 20: 105-60cd */
			39 01 00 00 00 00 02 b2 17 /* 21: 56cd */
			39 01 00 00 00 00 02 b2 17 /* 22: 53cd */
			39 01 00 00 00 00 02 b2 17 /* 23: 50cd */
			39 01 00 00 00 00 02 b2 17 /* 24: 47cd */
			39 01 00 00 00 00 02 b2 17 /* 25: 44cd */
			39 01 00 00 00 00 02 b2 16 /* 26: 41cd */
			39 01 00 00 00 00 02 b2 16 /* 27: 39cd */
			39 01 00 00 00 00 02 b2 16 /* 28: 37cd */
			39 01 00 00 00 00 02 b2 15 /* 29: 34cd */
			39 01 00 00 00 00 02 b2 15 /* 30: 32cd */
			39 01 00 00 00 00 02 b2 14 /* 31: 30cd */
			39 01 00 00 00 00 02 b2 14 /* 32: 29cd */
			39 01 00 00 00 00 02 b2 14 /* 33: 27cd */
			39 01 00 00 00 00 02 b2 13 /* 34: 25-21cd */
			39 01 00 00 00 00 02 b2 12 /* 35: 20-16cd */
			39 01 00 00 00 00 02 b2 11 /* 36: 15-11cd */
			39 01 00 00 00 00 02 b2 10 /* 37: 10-5cd */
			39 01 00 00 00 00 02 b2 0F /* 38: 4-2cd */
		];
		samsung,elvss_lowtemp2_tx_cmds_revA = [
			39 01 00 00 00 00 02 b2 0A /* 0: 360cd */
			39 01 00 00 00 00 02 b2 0B /* 1: 333cd */
			39 01 00 00 00 00 02 b2 0C /* 2: 316cd */
			39 01 00 00 00 00 02 b2 0D /* 3: 300cd */
			39 01 00 00 00 00 02 b2 0E /* 4: 282cd */
			39 01 00 00 00 00 02 b2 0E /* 5: 265cd */
			39 01 00 00 00 00 02 b2 0F /* 6: 249cd */
			39 01 00 00 00 00 02 b2 0F /* 7: 234cd */
			39 01 00 00 00 00 02 b2 0F /* 8: 220cd */
			39 01 00 00 00 00 02 b2 10 /* 9: 207cd */
			39 01 00 00 00 00 02 b2 10 /* 10: 195cd */
			39 01 00 00 00 00 02 b2 10 /* 11: 183cd */
			39 01 00 00 00 00 02 b2 10 /* 12: 172cd */
			39 01 00 00 00 00 02 b2 11 /* 13: 162cd */
			39 01 00 00 00 00 02 b2 11 /* 14: 152cd */
			39 01 00 00 00 00 02 b2 12 /* 15: 143cd */
			39 01 00 00 00 00 02 b2 12 /* 16: 134cd */
			39 01 00 00 00 00 02 b2 12 /* 17: 126cd */
			39 01 00 00 00 00 02 b2 12 /* 18: 119cd */
			39 01 00 00 00 00 02 b2 12 /* 19: 111cd */
			39 01 00 00 00 00 02 b2 12 /* 20: 105-60cd */
			39 01 00 00 00 00 02 b2 12 /* 21: 56cd */
			39 01 00 00 00 00 02 b2 12 /* 22: 53cd */
			39 01 00 00 00 00 02 b2 12 /* 23: 50cd */
			39 01 00 00 00 00 02 b2 12 /* 24: 47cd */
			39 01 00 00 00 00 02 b2 12 /* 25: 44cd */
			39 01 00 00 00 00 02 b2 11 /* 26: 41cd */
			39 01 00 00 00 00 02 b2 11 /* 27: 39cd */
			39 01 00 00 00 00 02 b2 11 /* 28: 37cd */
			39 01 00 00 00 00 02 b2 10 /* 29: 34cd */
			39 01 00 00 00 00 02 b2 10 /* 30: 32cd */
			39 01 00 00 00 00 02 b2 0F /* 31: 30cd */
			39 01 00 00 00 00 02 b2 0F /* 32: 29cd */
			39 01 00 00 00 00 02 b2 0F /* 33: 27cd */
			39 01 00 00 00 00 02 b2 0E /* 34: 25-21cd */
			39 01 00 00 00 00 02 b2 0D /* 35: 20-16cd */
			39 01 00 00 00 00 02 b2 0C /* 36: 15-11cd */
			39 01 00 00 00 00 02 b2 0B /* 37: 10-5cd */
			39 01 00 00 00 00 02 b2 0A /* 38: 4-2cd */
		];

		/* bl_level, Index in elvss command list */
		samsung,elvss_map_table_revA = <
		     /* candela elvss_tx_cmd_id */
			2	38
			3	38	
			4	38
			5	37
			6	37
			7	37
			8	37
			9	37
			10	37
			11	36
			12	36
			13	36
			14	36
			15	36
			16	35
			17	35
			19	35
			20	35
			21	34
			22	34
			24	34
			25	34
			27	33
			29	32
			30	31
			32	30
			34	29
			37	28
			39	27
			41	26
			44	25
			47	24
			50	23
			53	22
			56	21
			60	20
			64	20
			68	20
			72	20
			77	20
			82	20
			87	20
			93	20
			98	20
			105	20
			111	19
			119	18
			126	17
			134	16
			143	15
			152	14
			162	13
			172	12
			183	11
			195	10
			207	9
			220	8
			234	7
			249	6
			265	5
			282	4
			300	3
			316	2
			333	1
			360	0
		>;

		/*
		* ************************************************************************************************************************
		* SMART ACL(ACL On) ELVSS command list and mappings
		* ************************************************************************************************************************
		*/

		/* 0xB2 address 103rd parameter value*/
		samsung,smart_acl_elvss_tx_cmds_revA = [
			39 01 00 00 00 00 02 b2 1B /* 0: 360cd */
			39 01 00 00 00 00 02 b2 1C /* 1: 333cd */
			39 01 00 00 00 00 02 b2 1C /* 2: 316cd */
			39 01 00 00 00 00 02 b2 1D /* 3: 300cd */
			39 01 00 00 00 00 02 b2 1E /* 4: 282cd */
			39 01 00 00 00 00 02 b2 1E /* 5: 265cd */
			39 01 00 00 00 00 02 b2 1E /* 6: 249cd */
			39 01 00 00 00 00 02 b2 1E /* 7: 234cd */
			39 01 00 00 00 00 02 b2 1E /* 8: 220cd */
			39 01 00 00 00 00 02 b2 1F /* 9: 207cd */
			39 01 00 00 00 00 02 b2 1F /* 10: 195cd */
			39 01 00 00 00 00 02 b2 1F /* 11: 183cd */
			39 01 00 00 00 00 02 b2 1F /* 12: 172cd */
			39 01 00 00 00 00 02 b2 20 /* 13: 162cd */
			39 01 00 00 00 00 02 b2 20 /* 14: 152cd */
			39 01 00 00 00 00 02 b2 21 /* 15: 143cd */
			39 01 00 00 00 00 02 b2 21 /* 16: 134cd */
			39 01 00 00 00 00 02 b2 21 /* 17: 126cd */
			39 01 00 00 00 00 02 b2 21 /* 18: 119cd */
			39 01 00 00 00 00 02 b2 21 /* 19: 111cd */
			39 01 00 00 00 00 02 b2 21 /* 20: 105-60cd */
			39 01 00 00 00 00 02 b2 21 /* 21: 56cd */
			39 01 00 00 00 00 02 b2 21 /* 22: 53cd */
			39 01 00 00 00 00 02 b2 21 /* 23: 50cd */
			39 01 00 00 00 00 02 b2 21 /* 24: 47cd */
			39 01 00 00 00 00 02 b2 21 /* 25: 44cd */
			39 01 00 00 00 00 02 b2 20 /* 26: 41cd */
			39 01 00 00 00 00 02 b2 20 /* 27: 39cd */
			39 01 00 00 00 00 02 b2 20 /* 28: 37cd */
			39 01 00 00 00 00 02 b2 1F /* 29: 34cd */
			39 01 00 00 00 00 02 b2 1F /* 30: 32cd */
			39 01 00 00 00 00 02 b2 1E /* 31: 30cd */
			39 01 00 00 00 00 02 b2 1E /* 32: 29cd */
			39 01 00 00 00 00 02 b2 1E /* 33: 27cd */
			39 01 00 00 00 00 02 b2 1D /* 34: 25-21cd */
			39 01 00 00 00 00 02 b2 1C /* 35: 20-16cd */
			39 01 00 00 00 00 02 b2 1B /* 36: 15-11cd */
			39 01 00 00 00 00 02 b2 1A /* 37: 10-5cd */
			39 01 00 00 00 00 02 b2 19 /* 38: 4-2cd */
		];
		samsung,smart_acl_elvss_lowtemp_tx_cmds_revA = [
			39 01 00 00 00 00 02 b2 11 /* 0: 360cd */
			39 01 00 00 00 00 02 b2 12 /* 1: 333cd */
			39 01 00 00 00 00 02 b2 12 /* 2: 316cd */
			39 01 00 00 00 00 02 b2 13 /* 3: 300cd */
			39 01 00 00 00 00 02 b2 14 /* 4: 282cd */
			39 01 00 00 00 00 02 b2 14 /* 5: 265cd */
			39 01 00 00 00 00 02 b2 14 /* 6: 249cd */
			39 01 00 00 00 00 02 b2 14 /* 7: 234cd */
			39 01 00 00 00 00 02 b2 14 /* 8: 220cd */
			39 01 00 00 00 00 02 b2 15 /* 9: 207cd */
			39 01 00 00 00 00 02 b2 15 /* 10: 195cd */
			39 01 00 00 00 00 02 b2 15 /* 11: 183cd */
			39 01 00 00 00 00 02 b2 15 /* 12: 172cd */
			39 01 00 00 00 00 02 b2 16 /* 13: 162cd */
			39 01 00 00 00 00 02 b2 16 /* 14: 152cd */
			39 01 00 00 00 00 02 b2 17 /* 15: 143cd */
			39 01 00 00 00 00 02 b2 17 /* 16: 134cd */
			39 01 00 00 00 00 02 b2 17 /* 17: 126cd */
			39 01 00 00 00 00 02 b2 17 /* 18: 119cd */
			39 01 00 00 00 00 02 b2 17 /* 19: 111cd */
			39 01 00 00 00 00 02 b2 17 /* 20: 105-60cd */
			39 01 00 00 00 00 02 b2 17 /* 21: 56cd */
			39 01 00 00 00 00 02 b2 17 /* 22: 53cd */
			39 01 00 00 00 00 02 b2 17 /* 23: 50cd */
			39 01 00 00 00 00 02 b2 17 /* 24: 47cd */
			39 01 00 00 00 00 02 b2 17 /* 25: 44cd */
			39 01 00 00 00 00 02 b2 16 /* 26: 41cd */
			39 01 00 00 00 00 02 b2 16 /* 27: 39cd */
			39 01 00 00 00 00 02 b2 16 /* 28: 37cd */
			39 01 00 00 00 00 02 b2 15 /* 29: 34cd */
			39 01 00 00 00 00 02 b2 15 /* 30: 32cd */
			39 01 00 00 00 00 02 b2 14 /* 31: 30cd */
			39 01 00 00 00 00 02 b2 14 /* 32: 29cd */
			39 01 00 00 00 00 02 b2 14 /* 33: 27cd */
			39 01 00 00 00 00 02 b2 13 /* 34: 25-21cd */
			39 01 00 00 00 00 02 b2 12 /* 35: 20-16cd */
			39 01 00 00 00 00 02 b2 11 /* 36: 15-11cd */
			39 01 00 00 00 00 02 b2 10 /* 37: 10-5cd */
			39 01 00 00 00 00 02 b2 0F /* 38: 4-2cd */
		];
		samsung,smart_acl_elvss_lowtemp2_tx_cmds_revA = [
			39 01 00 00 00 00 02 b2 0A /* 0: 360cd */
			39 01 00 00 00 00 02 b2 0B /* 1: 333cd */
			39 01 00 00 00 00 02 b2 0C /* 2: 316cd */
			39 01 00 00 00 00 02 b2 0D /* 3: 300cd */
			39 01 00 00 00 00 02 b2 0E /* 4: 282cd */
			39 01 00 00 00 00 02 b2 0E /* 5: 265cd */
			39 01 00 00 00 00 02 b2 0F /* 6: 249cd */
			39 01 00 00 00 00 02 b2 0F /* 7: 234cd */
			39 01 00 00 00 00 02 b2 0F /* 8: 220cd */
			39 01 00 00 00 00 02 b2 10 /* 9: 207cd */
			39 01 00 00 00 00 02 b2 10 /* 10: 195cd */
			39 01 00 00 00 00 02 b2 10 /* 11: 183cd */
			39 01 00 00 00 00 02 b2 10 /* 12: 172cd */
			39 01 00 00 00 00 02 b2 11 /* 13: 162cd */
			39 01 00 00 00 00 02 b2 11 /* 14: 152cd */
			39 01 00 00 00 00 02 b2 12 /* 15: 143cd */
			39 01 00 00 00 00 02 b2 12 /* 16: 134cd */
			39 01 00 00 00 00 02 b2 12 /* 17: 126cd */
			39 01 00 00 00 00 02 b2 12 /* 18: 119cd */
			39 01 00 00 00 00 02 b2 12 /* 19: 111cd */
			39 01 00 00 00 00 02 b2 12 /* 20: 105-60cd */
			39 01 00 00 00 00 02 b2 12 /* 21: 56cd */
			39 01 00 00 00 00 02 b2 12 /* 22: 53cd */
			39 01 00 00 00 00 02 b2 12 /* 23: 50cd */
			39 01 00 00 00 00 02 b2 12 /* 24: 47cd */
			39 01 00 00 00 00 02 b2 12 /* 25: 44cd */
			39 01 00 00 00 00 02 b2 11 /* 26: 41cd */
			39 01 00 00 00 00 02 b2 11 /* 27: 39cd */
			39 01 00 00 00 00 02 b2 11 /* 28: 37cd */
			39 01 00 00 00 00 02 b2 10 /* 29: 34cd */
			39 01 00 00 00 00 02 b2 10 /* 30: 32cd */
			39 01 00 00 00 00 02 b2 0F /* 31: 30cd */
			39 01 00 00 00 00 02 b2 0F /* 32: 29cd */
			39 01 00 00 00 00 02 b2 0F /* 33: 27cd */
			39 01 00 00 00 00 02 b2 0E /* 34: 25-21cd */
			39 01 00 00 00 00 02 b2 0D /* 35: 20-16cd */
			39 01 00 00 00 00 02 b2 0C /* 36: 15-11cd */
			39 01 00 00 00 00 02 b2 0B /* 37: 10-5cd */
			39 01 00 00 00 00 02 b2 0A /* 38: 4-2cd */
		];

		/* bl_level, Index in elvss command list */
		samsung,smart_acl_elvss_map_table_revA = <
		     /* candela elvss_tx_cmd_id */
			2	38
			3	38	
			4	38
			5	37
			6	37
			7	37
			8	37
			9	37
			10	37
			11	36
			12	36
			13	36
			14	36
			15	36
			16	35
			17	35
			19	35
			20	35
			21	34
			22	34
			24	34
			25	34
			27	33
			29	32
			30	31
			32	30
			34	29
			37	28
			39	27
			41	26
			44	25
			47	24
			50	23
			53	22
			56	21
			60	20
			64	20
			68	20
			72	20
			77	20
			82	20
			87	20
			93	20
			98	20
			105	20
			111	19
			119	18
			126	17
			134	16
			143	15
			152	14
			162	13
			172	12
			183	11
			195	10
			207	9
			220	8
			234	7
			249	6
			265	5
			282	4
			300	3
			316	2
			333	1
			360	0

		>;
		/*
		* ************************************************************************************************************************
		* candela to index mappings
		* ************************************************************************************************************************
		*/
		samsung,candela_map_table_revA = <
		/*<idx>   <from>  <till> <candella> */
			0	1	2	2
			1	3	3	3
			2	4	4	4
			3	5	5	5
			4	6	6	6
			5	7	7	7
			6	8	8	8
			7	9	9	9
			8	10	10	10
			9	11	11	11
			10	12	12	12
			11	13	13	13
			12	14	14	14
			13	15	15	15
			14	16	16	16
			15	17	17	17
			16	18	18	17
			17	19	19	19
			18	20	20	20
			19	21	21	21
			20	22	22	22
			21	23	23	22
			22	24	24	25
			23	25	25	27
			24	26	26	29
			25	27	27	30
			26	28	28	32
			27	29	29	37
			28	30	30	39
			29	31	32	41
			30	33	34	44
			31	35	36	47
			32	37	38	50
			33	39	40	53
			34	41	43	56
			35	44	46	60
			36	47	49	64
			37	50	52	68
			38	53	56	72
			39	57	59	77
			40	60	63	82
			41	64	67	87
			42	68	71	93
			43	72	76	98
			44	77	80	105
			45	81	86	111
			46	87	91	119
			47	92	97	126
			48	98	104	134
			49	105	110	143
			50	111	118	152
			51	119	125	162
			52	126	133	172
			53	134	142	183
			54	143	150	195
			55	151	160	207
			56	161	170	220
			57	171	181	234
			58	182	193	249
			59	194	205	265
			60	206	218	282
			61	219	230	300
			62	231	242	316
			63	243	254	333
			64	255	255	360
		>;

		samsung,hbm_candela_map_table_revA = <
			0	305	312	430	6
			1	313	321	442	7
			2	322	329	454	8
			3	330	337	465	9
			4	338	345	477	10
			5	346	354	488	11
			6	355	355	500	12
		>;
	};
};
