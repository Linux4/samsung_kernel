## drivers/video/fbdev/exynos/panel/Kconfig
```kconfig
config EXYNOS_DECON_LCD
	tristate "Select LCD panel driver"

config EXYNOS_DECON_MDNIE
	depends on EXYNOS_DECON_LCD
	tristate "Support MDNIE"
	default n

config SUPPORT_AFC
	depends on EXYNOS_DECON_LCD && EXYNOS_DECON_MDNIE
	tristate "Support AFC"
	default n

config SUPPORT_ISC_TUNE_TEST
	depends on EXYNOS_DECON_LCD
	tristate "Support ISC TUNE TEST"
	default n

config EXYNOS_DECON_LCD_SYSFS
	depends on EXYNOS_DECON_LCD
	tristate "Support LCD SYSFS"
	default y

config EXYNOS_DECON_LCD_SPI
	depends on EXYNOS_DECON_LCD
	tristate "Support LCD SPI"
	default n

config EXYNOS_DECON_LCD_COPR
	depends on EXYNOS_DECON_LCD
	tristate "Support COPR"
	default n

config EXYNOS_DECON_LCD_TUNING
	depends on EXYNOS_DECON_LCD
	tristate "Support LCD TUNING"
	default n

config PANEL_AID_DIMMING
	depends on EXYNOS_DECON_LCD
	tristate "Support AID Dimming"
	default y

config PANEL_AID_DIMMING_DEBUG
	depends on PANEL_AID_DIMMING
	depends on !SAMSUNG_PRODUCT_SHIP
	tristate "Support AID Dimming Debug"
	default y

config SUPPORT_DSU
	tristate "Support DSU(Multi Resolution)"
	depends on EXYNOS_DECON_LCD
	default n

config SUPPORT_HMD
	tristate "Support HMD(Head Mount Display - VR)"
	depends on EXYNOS_DECON_LCD
	default n

config SUPPORT_DOZE
	depends on EXYNOS_DECON_LCD
	tristate "Support Panel AOD"
	default n

config SUPPORT_INDISPLAY
	depends on EXYNOS_DECON_LCD
	tristate "Support Panel indisplay FOD"
	default n

config EXTEND_LIVE_CLOCK
	tristate "Support Extend Live Clock Functions(For Always On Display)"
	depends on EXYNOS_DECON_LCD
	default n

config SUPPORT_AOD_BL
	depends on EXYNOS_DECON_LCD && SUPPORT_DOZE
	tristate "Support AOD(Active On Display) BL(BackLight) Driver"
	default n

config PANEL_BACKLIGHT_PAC_3_0
	depends on EXYNOS_DECON_LCD
	tristate "Support baclight PAC 3.0"
	default n

config DISPLAY_USE_INFO
	depends on EXYNOS_DECON_LCD
	tristate "Support display use info logging"
	default n

config PANEL_NOTIFY
	depends on EXYNOS_DECON_LCD
	tristate "Support panel notifier"
	default n

config SUPPORT_POC_SPI
	depends on EXYNOS_DECON_LCD
	tristate "Support poc SPI connection"
	default n

config SUPPORT_I2C
	depends on EXYNOS_DECON_LCD
	tristate "Support LCD I2C"
	default n

config DYNAMIC_FREQ
	depends on EXYNOS_DECON_LCD
	tristate "Support Dynamic Freq"
	default n

config SUPPORT_ERRFG_RECOVERY
	depends on EXYNOS_DECON_LCD
	tristate "Support ERRFG recovery"
	default n

config SUPPORT_ERRFG_RECOVERY_BY_FB_BLANK
	depends on SUPPORT_ERRFG_RECOVERY
	tristate "Support ERRFG recovery by fb blank"
	default n

config SMCDSD_LCD_DEBUG
	bool "Support LCD_DEBUG"
	default n

config SUPPORT_VCOM_TRIM_TEST
	bool "Support VCOM TRIM test"
	default n

config EXYNOS_DECON_LCD_DUMMY_LCD_V320
	depends on EXYNOS_DECON_LCD
	tristate "DUMMY_LCD_V320 LCD driver"

config EXYNOS_DECON_LCD_FT8203_BOE_T260
	depends on EXYNOS_DECON_LCD
	tristate "FT8203_BOE_T260 LCD driver"

config EXYNOS_DECON_LCD_HX83102_T270
	depends on EXYNOS_DECON_LCD
	tristate "HX83102_BOE_T270 LCD driver"

config EXYNOS_DECON_LCD_HX83112F_BOE_A13
	depends on EXYNOS_DECON_LCD
	tristate "HX83112F_BOE_A13 LCD driver"

config EXYNOS_DECON_LCD_NT36672C_CSOT_A13
	depends on EXYNOS_DECON_LCD
	tristate "NT36672C_CSOT_A13 LCD driver"

config EXYNOS_DECON_LCD_NT36672C_TIANMA_A13
	depends on EXYNOS_DECON_LCD
	tristate "NT36672C_TIANMA_A13 LCD driver"

config EXYNOS_DECON_LCD_TD4375_BOE_A13
	depends on EXYNOS_DECON_LCD
	tristate "TD4375_BOE_A13 LCD driver"

config EXYNOS_DECON_LCD_ILI7807_BOE_M13
	depends on EXYNOS_DECON_LCD
	tristate "ILI7807_BOE_M13 LCD driver"

config EXYNOS_DECON_LCD_HX83112F_BOE_M13
	depends on EXYNOS_DECON_LCD
	tristate "HX83112F_BOE_M13 LCD driver"

config EXYNOS_DECON_LCD_FT8720_DTC_M13
	depends on EXYNOS_DECON_LCD
	tristate "FT8720_DTC_M13 LCD driver"

config EXYNOS_DECON_LCD_TD4160_BOE_A04S
	depends on EXYNOS_DECON_LCD
	tristate "TD4160_BOE_A04S LCD driver"

config EXYNOS_DECON_LCD_NT36525C_SHARP_A04S
	depends on EXYNOS_DECON_LCD
	tristate "NT36525C_SHARP_A04S LCD driver"

config EXYNOS_DECON_LCD_NT36525C_SHARP_VE_A04S
	depends on EXYNOS_DECON_LCD
	tristate "NT36525C_SHARP_VE_A04S LCD driver"

config EXYNOS_DECON_LCD_TD4162_BOE_A04S
	depends on EXYNOS_DECON_LCD
	tristate "TD4162_BOE_A04S LCD driver"

config EXYNOS_DECON_LCD_NT36525C_TIANMA_A04S
	depends on EXYNOS_DECON_LCD
	tristate "NT36525C_TIANMA_A04S LCD driver"

config EXYNOS_DECON_LCD_NT36525C_DTC_A04S
	depends on EXYNOS_DECON_LCD
	tristate "NT36525C_DTC_A04S LCD driver"

config EXYNOS_DECON_LCD_NT36672C_TIANMA_A14
	depends on EXYNOS_DECON_LCD
	tristate "NT36672C_TIANMA_A14 LCD driver"

config EXYNOS_DECON_LCD_ILI7807_BOE_A14
	depends on EXYNOS_DECON_LCD
	tristate "ILI7807_BOE_A14 LCD driver"

config EXYNOS_DECON_LCD_NT36672C_CSOT_A14
	depends on EXYNOS_DECON_LCD
	tristate "NT36672C_CSOT_A14 LCD driver"

config EXYNOS_DECON_LCD_FT8720_SKYWORTH_A14
	depends on EXYNOS_DECON_LCD
	tristate "FT8720_SKYWORTH_A14 LCD driver"
```

## drivers/video/fbdev/exynos/panel/ea8076/Kconfig
```kconfig
menuconfig EXYNOS_DECON_LCD_EA8076
	tristate "EA8076 DDI Panel Driver"
	depends on EXYNOS_DECON_LCD && EXYNOS_MIPI_DSIM
	help
		This enables EA8076 DDI dependent panel drivers of
		common panel driver. say Y, if you have a panel based on
		the EA8076 DDI.
```

## drivers/video/fbdev/exynos/panel/ea8079/Kconfig
```kconfig
menuconfig EXYNOS_DECON_LCD_EA8079
	tristate "EA8079 DDI Panel Driver"
	depends on EXYNOS_DECON_LCD && EXYNOS_MIPI_DSIM
	help
		This enables EA8079 DDI dependent panel drivers of
		common panel driver. say Y, if you have a panel based on
		the EA8079 DDI.
```

## drivers/video/fbdev/exynos/panel/s6e3fa7/Kconfig
```kconfig
menuconfig EXYNOS_DECON_LCD_S6E3FA7
	tristate "S6E3FA7 DDI Panel Driver"
	depends on EXYNOS_DECON_LCD && EXYNOS_MIPI_DSIM
	help
		This enables S6E3FA7 DDI dependent panel drivers of
		common panel driver. say Y, if you have a panel based on
		the S6E3FA7 DDI.
```

## drivers/video/fbdev/msm/samsung/Kconfig
```kconfig
config SAMSUNG_DEBUG_DISPLAY
    bool "Add Samsung Debugging code"
    default n

config FB_MSM_MDSS_SAMSUNG
	depends on FB_MSM_MDSS
	bool "mdss config for samsung product"
	default n
	---help---
	Mdss config signature for samsung product

config DISPLAY_USE_INFO
	depends on FB_MSM_MDSS_SAMSUNG
	bool "Support display use info logging"
	default n

#
#	PANEL UNIQUE FEATURE
#
config DUAL_PANEL
	depends on FB_MSM_MDSS_SAMSUNG
	bool "dual paneloperation"
	default n
	---help---
	dual panel operation support

config PARTIAL_UPDATE
	depends on FB_MSM_MDSS_SAMSUNG
	bool "partial update operation"
	default n
	---help---
	partial update operation support

config CABC_FUNCTION
	depends on FB_MSM_MDSS_SAMSUNG
	bool "DDI cabc operation"
	default n
	---help---
	DDI cabc operation support

config SUPPORT_POC_FLASH
	depends on FB_MSM_MDSS_SAMSUNG
	bool "SUPPORT POC FLASH"
	default n
	---help---
	SUPPORT_POC_FLASH FOR DREAM2 ONLY

config SUPPORT_POC_2_0
	depends on FB_MSM_MDSS_SAMSUNG
	bool "SUPPORT POC_2_0"
	default n
	---help---
	POC_2_0 SUPPORT
	It used for Great Panel

config POC_33_COMPENSATION
	depends on FB_MSM_MDSS_SAMSUNG
	bool "POC 33 DEVICE COMPENSATION TO 64"
	default n
	---help---
	POC 33 DEVICE COMPENSATION TO 64
	It used for Dream2 USA & Dream2 other country

#
#	HOW TO MAKE DEF-CONFIG NAME FOR PANEL
#
#	PANEL_DDI-model_PANEL-model_RESOLUTION
#	PANEL_S6E3FA2    _AMS510CV01_FHD
#	PANEL_S6E3FA2_AMS510CV01_FHD
#

config PANEL_S6E3HA6_AMB632NF01_WQHD
	depends on FB_MSM_MDSS_SAMSUNG
	bool "LSI S6E3HA6 LDI"
	default n
	---help---
	LSI S6E3HA6 LDI 1440_2560 GREAT DSC


config PANEL_S6E3HA6_AMS622MR01_WQHD
	depends on FB_MSM_MDSS_SAMSUNG
	bool "LSI S6E3HA6 LDI"
	default n
	---help---
	LSI S6E3HA6 LDI 1440_2560 DREAM2 DSC

config PANEL_S6E3HA6_AMB577MQ01_WQHD
	depends on FB_MSM_MDSS_SAMSUNG
	bool "LSI S6E3HA6 LDI"
	default n
	---help---
	LSI S6E3HA6 LDI 1440_2560 DREAM DSC

config PANEL_S6E3FA5_AMS420MS01_FHD
	depends on FB_MSM_MDSS_SAMSUNG
	bool "LSI S6E3FA5 LDI"
	default n
	---help---
	LSI S6E3FA5 LDI 1080_1920 KELLY

config PANEL_S6E3FA5_AMS420QW01_FHD
	depends on FB_MSM_MDSS_SAMSUNG
	bool "LSI S6E3FA5 LDI"
	default n
	---help---
	LSI S6E3FA5 LDI 1080_1920 KELLY

config PANEL_S6E3FA5_AMS420MS07_FHD
	depends on FB_MSM_MDSS_SAMSUNG
	bool "LSI S6E3FA5 LDI"
	default n
	---help---
	LSI S6E3FA5 LDI 1080_1920 KELLY

config PANEL_ANA38401_AMS968HH01_QXGA
	depends on FB_MSM_MDSS_SAMSUNG
	bool "LSI ANA38401 LDI"
	default n
	---help---
	LSI ANA38401 LDI 2048_1536 TAB S3

config PANEL_ANA38401_AMSA05RB01_WQXGA
	depends on FB_MSM_MDSS_SAMSUNG
	bool "LSI ANA38401 LDI"
	default n
	---help---
	LSI ANA38401 LDI 2560_1600 TAB S4
```
