## drivers/video/fbdev/exynos/decon_7570/Kconfig
```kconfig
config EXYNOS_DECON_7570
	bool "Samsung Exynos7570 Display system (DECON, MIPI)"
	depends on FB

choice
	prompt "Select Display Operation Mode"
	depends on EXYNOS_DECON_7570
	default EXYNOS7570_DISPLAY_VIDEO_MODE
	help
	  Select the display operation mode (Command/Video).

config EXYNOS7570_DISPLAY_COMMAND_MODE
	bool "Command Mode"

config EXYNOS7570_DISPLAY_VIDEO_MODE
	bool "Video Mode"

endchoice

choice
	prompt "Select TE IRQ Mode"
	depends on EXYNOS_DECON_7570 && EXYNOS7570_DISPLAY_COMMAND_MODE
	default EXYNOS7570_DISPLAY_TE_IRQ_GPIO
	help
	  Select the TE IRQ mode.

config EXYNOS7570_DISPLAY_TE_IRQ_GPIO
	bool "Dual GPIO"

config EXYNOS7570_DISPLAY_TE_IRQ_GIC
	bool "GIC Interrupt"

endchoice

config USE_VSYNC_SKIP
   bool "Vsync Skip Enable"
   depends on EXYNOS_DECON_7570
   default n
   help
     Say Y here if you want to enable vsync skip feature for DFS solution.

config EXYNOS_DECON_FB
	bool "Samsung DECON Framebuffer driver"
	depends on EXYNOS_DECON_7570
	select MEDIA_EXYNOS
	default y
	help
	  Say Y here if you want support for the DECON in Samsung S5P SoCs.
	  This device produce image data to one of output interfaces.

config EXYNOS_MIPI_DSI
	bool "Samsung Exynos MIPI-DSI driver"
	depends on EXYNOS_DECON_7570
	default y
	help
	  Enable MIPI-DSI driver.

config DECON_MIPI_DSI_PKTGO
	bool "Samsung Exynos MIPI-DSI Packet Go"
	depends on EXYNOS_DECON_7570 && EXYNOS_MIPI_DSI
	default n
	help
	  Enable/disable MIPI-DSI Packet Go function

config DECON_LPD_DISPLAY
        bool "Decon Low Power Display MODE"
        depends on EXYNOS_DECON_7570
        depends on EXYNOS7570_DISPLAY_COMMAND_MODE
        default n

config DECON_LPD_DISPLAY_WITH_CAMERA
        bool "Decon Low Power Display MODE with Camera"
        depends on DECON_LPD_DISPLAY
        depends on EXYNOS7570_DISPLAY_COMMAND_MODE

config DECON_DEVFREQ
	bool "Decon devfreq implementation"
	depends on EXYNOS_DECON_7570

config FB_WINDOW_UPDATE
        bool "DECON window update mode"
        depends on EXYNOS_DECON_7570
        depends on EXYNOS7570_DISPLAY_COMMAND_MODE
        default n

config DECON_BLOCKING_MODE
	bool "DECON blocking mode"
        depends on EXYNOS_DECON_7570
        default n

config DECON_USE_BOOTLOADER_FB
	bool "DECON Bootloader Framebuffer support"
        depends on EXYNOS7570_DISPLAY_VIDEO_MODE
        default n

config DECON_EVENT_LOG
	bool "Display sub-system event logger (DECON/DSIM)"
        depends on DEBUG_INFO && EXYNOS_DECON_7570
        default y

config EXYNOS_MIPI_DSI_ENABLE_EARLY
	bool "Samsung Exynos MIPI-DSI Driver ENABLE EARLY"
	default n

source "drivers/video/fbdev/exynos/decon_7570/panels/Kconfig"
```

## drivers/video/fbdev/exynos/decon_7570/panels/Kconfig
```kconfig
config EXYNOS_DECON_LCD
	depends on EXYNOS_DECON_7570
	bool "Select LCD panel driver"

config EXYNOS_DECON_LCD_SYSFS
	depends on EXYNOS_DECON_LCD
	tristate "Support LCD SYSFS"
	default y

config PANEL_AID_DIMMING
	depends on EXYNOS_DECON_LCD
	tristate "Support AID Dimming"
	default n

config EXYNOS_DECON_MDNIE_LITE
	depends on EXYNOS_DECON_LCD
	tristate "Support MDNIE LITE"
	default n

config PANEL_S6E8AA5X01
	depends on EXYNOS_DECON_LCD
	bool "S6E8AA5X01 AMOLE HD LCD driver(720 x 1280)"

config PANEL_TD4100
	depends on EXYNOS_DECON_LCD
	bool "TD4100 TFT INCELL HD LCD driver(720 x 1280)"

config PANEL_TD4100_J3POP
	depends on EXYNOS_DECON_LCD
	bool "TD4100_J3POP TFT INCELL HD LCD driver(720 x 1280)"

config PANEL_S6D7AA0_XCOVER4
	depends on EXYNOS_DECON_LCD
	bool "S6d7AA0 TFT HD LCD driver(720 x 1280)"

config PANEL_TD4100_J3Y17
	depends on EXYNOS_DECON_LCD
	bool "TD4100_J3Y17 TFT INCELL HD LCD driver(720 x 1280)"
```

## drivers/video/fbdev/exynos/decon_7870/panels/Kconfig
```kconfig
config EXYNOS7870_DECON_DISP_LCD
	depends on EXYNOS_DECON_7870 && EXYNOS_MIPI_DSI
	bool "Select LCD panel driver"

config EXYNOS7870_DECON_DISP_LCD_NAME
	string
	default "s6d78a" if EXYNOS_DECON_LCD_S6D78A
	default "s6e8aa0" if EXYNOS_DECON_LCD_S6E8AA0
	default "s6e3fa0" if EXYNOS_DECON_LCD_S6E3FA0
	help
	  This string is compared with lcd name fron Device Tree.

choice
	prompt "Select Panel"
	depends on EXYNOS7870_DECON_DISP_LCD
	default EXYNOS_DECON_LCD_S6E3FA0
	help
		select the display panel.

config EXYNOS_DECON_LCD_S6D78A
	depends on EXYNOS7870_DECON_DISP_LCD
	depends on EXYNOS7870_DISPLAY_VIDEO_MODE
	bool "S6D78A AMOLED qHD LCD driver(540 x 960)"

config EXYNOS_DECON_LCD_S6E8AA0
	depends on EXYNOS7870_DECON_DISP_LCD
	depends on EXYNOS7870_DISPLAY_VIDEO_MODE
	bool "S6E8AA0 AMOLED HD LCD driver(800 x 1280)"

config EXYNOS_DECON_LCD_EA8064G
	depends on EXYNOS7870_DECON_DISP_LCD
	depends on EXYNOS7870_DISPLAY_COMMAND_MODE
	bool "EA8064G COMMAND MODE AMOLED FHD LCD driver(1080 x 1920)"

config EXYNOS_DECON_LCD_S6E3FA0
	depends on EXYNOS7870_DECON_DISP_LCD
	depends on EXYNOS7870_DISPLAY_COMMAND_MODE || EXYNOS7870_DISPLAY_VIDEO_MODE
	bool "S6E3FA0 COMMAND/VIDEO MODE AMOLED FHD LCD driver(1080 x 1920)"

endchoice
```

## drivers/video/fbdev/exynos/decon_7880/panels/Kconfig
```kconfig
config EXYNOS_DECON7880_LCD
	depends on EXYNOS_DECON_7880
	bool "Select LCD panel driver"

config EXYNOS_DECON_LCD_SYSFS
	depends on EXYNOS_DECON7880_LCD
	tristate "Support LCD SYSFS"
	default y

config PANEL_AID_DIMMING
	depends on EXYNOS_DECON7880_LCD
	tristate "Support AID Dimming"
	default n

config EXYNOS_DECON_MDNIE_LITE
	depends on EXYNOS_DECON7880_LCD
	tristate "Support MDNIE LITE"
	default n

config LCD_DOZE_MODE
	depends on EXYNOS_DECON7880_LCD
	tristate "Support DOZE MODE"
	default n

config LCD_HMT
	depends on EXYNOS_DECON7880_LCD
	tristate "Support HMT"
	default n

config DISPLAY_USE_INFO
	depends on EXYNOS_DECON7880_LCD
	tristate "Support display use info logging"
	default n

config PANEL_S6E3FA3_A7Y17
	depends on EXYNOS_DECON7880_LCD && EXYNOS_MIPI_DSI
	tristate "S6E3FA3 A7Y17 AMOLED driver"

config PANEL_S6E3FA3_A5Y17
	depends on EXYNOS_DECON7880_LCD && EXYNOS_MIPI_DSI
	tristate "S6E3FA3 A5Y17 AMOLED driver"
```

## drivers/video/fbdev/exynos/decon_7880/vpp/Kconfig
```kconfig
config EXYNOS_VPP
	bool "Samsung Exynos Video Post Processor driver"
	depends on EXYNOS_DECON_7880
	default y
	help
	  Enable VPP driver.
```

## drivers/video/fbdev/exynos/dpu30/Kconfig
```kconfig
config EXYNOS_DPU30
	bool "Samsung Exynos Display Sub-system (DPP, DECON, MIPI, DISPLAYPORT)"
	select EXYNOS_IOMMU
	select MEDIA_CAMERA_SUPPORT
	select PHY_EXYNOS_MIPI_DSIM
	default n
	depends on FB

if EXYNOS_DPU30
config EXYNOS_DPP
	bool "Samsung Exynos Display Post Processor driver"
	depends on EXYNOS_DPU30
	default y

config EXYNOS_MIPI_DSIM
	bool "Samsung Exynos MIPI-DSI driver"
	depends on EXYNOS_DPU30
	default y
	help
	  Enable MIPI-DSI driver.

config EXYNOS_DISPLAYPORT
	bool "Samsung Exynos DISPLAYPORT driver"
	depends on EXYNOS_DPU30
	default n
	help
	  Enable DISPLAYPORT driver.

config EXYNOS_DECON_DQE
	bool "Samsung Exynos DQE driver"
	depends on EXYNOS_DPU30
	default n
	help
	  Enable DQE driver.

config EXYNOS_WINDOW_UPDATE
        bool "Support Window Update Mode"
        depends on EXYNOS_DPU30
        default n

config EXYNOS_BLOCK_MODE
	bool "Support Blocking Mode"
        depends on EXYNOS_DPU30
        default y

if !EXYNOS_DECON_DQE
config EXYNOS_HIBERNATION
	bool "Support Display Hibernation Mode"
        depends on EXYNOS_DPU30
        default n
endif

config EXYNOS_CHANGE_HIBER_CNT
	bool "Change Hibernation Entry Count at Runtime"
        depends on EXYNOS_DPU30 && EXYNOS_HIBERNATION
        default n

config EXYNOS_DIRECT_PD_CTRL
	bool "Support Direct DPU Power Domain Control For Hibernation (EXPERIMENTAL)"
        depends on EXYNOS_DPU30 && EXYNOS_HIBERNATION
        default n

config EXYNOS_HIBERNATION_EARLY_WAKEUP
	bool "Support Hibernation Early Wakeup (EXPERIMENTAL)"
        depends on EXYNOS_DPU30 && EXYNOS_HIBERNATION
        default n

config EXYNOS_DOZE
	bool "Support DOZE mode"
        depends on EXYNOS_DPU30
        default n

config EXYNOS_DOZE_HIBERNATION
	bool "Support Display Hibernation Mode"
        depends on EXYNOS_DOZE && EXYNOS_HIBERNATION
        default n

config EXYNOS_AFBC_DEBUG
	bool "Support AFBC Decoder Debug"
        depends on EXYNOS_DPU30
        default n

config EXYNOS_MULTIRESOLUTION
	bool "Support Multi Resolution LCD"
	depends on EXYNOS_DPU30 && EXYNOS_WINDOW_UPDATE
	default n

config EXYNOS_VIRTUAL_DISPLAY
	bool "Support Virtual Display Mode"
	depends on EXYNOS_DPU30
	default n
	help
	  If this menu is enabled, you can boot up board without LCD.

config EXYNOS_READ_ESD_SOLUTION
	bool "Support ESD solution using read DDI power state"
	depends on EXYNOS_DPU30
	default n
	help
	  If this menu is enabled, you can detect ESD of panel.

config EXYNOS_READ_ESD_SOLUTION_TEST
	bool "Support ESD solution using read DDI power state"
	depends on EXYNOS_READ_ESD_SOLUTION
	default n
	help
	  If this menu is enabled, you can test ESD recovery.

config EXYNOS_LOW_PERSISTENCE
	bool "Support Low Persistence Mode"
        depends on EXYNOS_DPU30
	default n

config EXYNOS_CURSOR
	bool "Support Cursor Async Mode"
        depends on EXYNOS_DPU30
	default n

config EXYNOS_DSIM_DITHER
	bool "DSIM SSCG feature"
        depends on EXYNOS_MIPI_DSIM
        default n

config DECON_BTS_LEGACY
	bool "Legacy BTS scheme of display"
        depends on EXYNOS_DPU30
        default n

config DECON_BTS_VRR_ASYNC
	bool "BTS support VRR Async"
        depends on EXYNOS_DPU30
        default n

config DECON_VRR_MODULATION
	bool "Support VRR Modulation"
        depends on EXYNOS_DPU30
        default n

config FB_TEST
	bool "Framebuffer test only"
        depends on EXYNOS_DPU30
        default n

config DSIM_CMD_TEST
	bool "DSIM command test only"
        depends on EXYNOS_DPU30
        default n

config EXYNOS_FREQ_HOP
	bool "Support DPHY PLL Frequency Hopping"
        depends on EXYNOS_DPU30
        default n

config EXYNOS_PLL_SLEEP
	bool "Support DPHY PLL Sleep"
        depends on EXYNOS_DPU30
        default n

config EXYNOS_EWR
	bool "Support early wake up"
        depends on EXYNOS_DPU30
        default n

config EXYNOS_LIMIT_ROTATION
	bool "Limit Rotation based on Size and Bit-depth"
        depends on EXYNOS_DPU30
        default n

config EXYNOS_SUPPORT_READBACK
	bool "Support readback buffer"
		depends on EXYNOS_DPU30
		default n

config EXYNOS_SET_ACTIVE
	bool "Support Set active control for mres/vrr"
	depends on EXYNOS_DPU30
	default y

config EXYNOS_SET_ACTIVE_WITH_EMPTY_WINDOW
	bool "Support Set active control for mres/vrr"
	depends on EXYNOS_DPU30 && EXYNOS_SET_ACTIVE
	default n

config EXYNOS_LATENCY_MONITOR
	bool "Read Data Latency Monitor"
		depends on EXYNOS_DPU30
		default n

config EXYNOS_DPU_SYSTRACE
	bool "Support Systrace for DPU"
		depends on EXYNOS_DPU30
		default n

config EXYNOS_FPS_CHANGE_NOTIFY
	bool "Support fps change notify"
		depends on EXYNOS_DPU30
		default n

config USE_DISPLAYPORT_CCIC_EVENT_QUEUE
	bool "use queue for CCIC notifications"
        depends on EXYNOS_DISPLAYPORT
        default n

config SUPPORT_MCD_MOTTO_TUNE
	depends on EXYNOS_DPU30
	tristate "Support MOTTO features"
	default n

endif

config DISPLAYPORT_ENG
	bool "DISPLAYPORT eng bin"
	depends on EXYNOS_DISPLAYPORT
	default n
	help
	  For DISPLAYPORT eng binary.

config EXYNOS_DOZE_FIRST_FRAME_BLACK
	bool "Support DOZE first black frame"
        depends on EXYNOS_DPU30
        default n

source "drivers/video/fbdev/exynos/dpu30/panels/Kconfig"
source "drivers/video/fbdev/exynos/dpu30/mcd_hdr/Kconfig"
```

## drivers/video/fbdev/exynos/dpu30/panels/Kconfig
```kconfig
config EXYNOS_COMMON_PANEL
	depends on EXYNOS_DPU30
	select BACKLIGHT_CLASS_DEVICE
	default n
	bool "Support Exynos Common Panel Driver"

config EXYNOS_DECON_LCD_CABC
	bool "Support CABC using DDI command"
	depends on EXYNOS_COMMON_PANEL
	default n
	help
	  If this menu is enabled, you can control CABC mode of panel.
```

## drivers/video/fbdev/exynos/dpu_7885/panels/Kconfig
```kconfig
config EXYNOS_DECON_LCD
	depends on EXYNOS_DECON_7885
	bool "Select LCD panel driver"

config DISPLAY_USE_INFO
	depends on EXYNOS_DECON_LCD
	tristate "Support display use info logging"
	default n

config EXYNOS_DECON_MDNIE_LITE
	depends on EXYNOS_DECON_LCD
	tristate "Support MDNIE LITE"
	default n

config EXYNOS_DECON_LCD_S6E3FA0
	depends on EXYNOS_DECON_LCD && EXYNOS_MIPI_DSIM
	tristate "S6E3FA0 AMOLED FHD LCD driver"

config EXYNOS_DECON_LCD_S6E3FA3
	depends on EXYNOS_DECON_LCD && EXYNOS_MIPI_DSIM
	tristate "S6E3FA3 AMOLED FHD LCD driver"

config EXYNOS_DECON_LCD_S6E3FA7
	depends on EXYNOS_DECON_LCD && EXYNOS_MIPI_DSIM
	tristate "S6E3FA7 AMOLED FHD+ LCD driver"

config EXYNOS_DECON_LCD_S6E3FA7_JACKPOT2
	depends on EXYNOS_DECON_LCD
	tristate "S6E3FA7_JACKPOT2 LCD driver"

config EXYNOS_DECON_LCD_S6E3FA7_JACKPOT
	depends on EXYNOS_DECON_LCD
	tristate "S6E3FA7_JACKPOT LCD driver"

config EXYNOS_DECON_LCD_TD4100_J3TOPE
	depends on EXYNOS_DECON_LCD
	bool "TD4100_J3TOPE LCD driver"

config EXYNOS_DECON_LCD_S6D7AT0B_J7TOPE
	depends on EXYNOS_DECON_LCD
	bool "S6D7AT0B_J7TOPE LCD driver"

config EXYNOS_DECON_LCD_EA8061S_J7DUO
	depends on EXYNOS_DECON_LCD
	bool "EA8061S_J7DUO LCD driver"

config EXYNOS_DECON_LCD_S6E8AA5_A6ELTE
	depends on EXYNOS_DECON_LCD
	bool "S6E8AA5_A6ELTE LCD driver"

config EXYNOS_DECON_LCD_S6E8AA5_FEEL2
	depends on EXYNOS_DECON_LCD
	bool "S6E8AA5_FEEL2 LCD driver"

config EXYNOS_DECON_LCD_SN65DSI86_GVIEW2
	depends on EXYNOS_DECON_LCD
	bool "SN65DSI86_HX8876_VIEW2 LCD driver"

config EXYNOS_DECON_LCD_S6E3FA7_A7Y18
	depends on EXYNOS_DECON_LCD
	tristate "S6E3FA7_A7Y18 LCD driver"

config EXYNOS_DECON_LCD_TD4101_J2COREPELTE
	depends on EXYNOS_DECON_LCD
	bool "TD4101_J2COREPELTE LCD driver"

config EXYNOS_DECON_LCD_HX8279D_GTA3XLLTE
	depends on EXYNOS_DECON_LCD
	bool "HX8279D_GTA3XLLTE LCD driver"

config EXYNOS_DECON_LCD_NT36672A_M20
	depends on EXYNOS_DECON_LCD
	bool "NT36672A_M20 LCD driver"

config EXYNOS_DECON_LCD_HX83112A_M20
	depends on EXYNOS_DECON_LCD
	bool "HX83112A_M20 LCD driver"

config EXYNOS_DECON_LCD_EA8076_M30
	depends on EXYNOS_DECON_LCD
	bool "EA8076_M30 LCD driver"

config EXYNOS_DECON_LCD_EA8076_A30
	depends on EXYNOS_DECON_LCD
	bool "EA8076_A30 LCD driver"

config EXYNOS_DECON_LCD_A30_DTV_MIPI
	depends on EXYNOS_DECON_LCD
	tristate "Support A30 LTN DTV MIPI 1.1Gbps"
	default n

config EXYNOS_DECON_LCD_S6E3AA2_A40
	depends on EXYNOS_DECON_LCD
	bool "S6E3AA2_A40 LCD driver"

config EXYNOS_DECON_LCD_HX8279D_WISDOM
	depends on EXYNOS_DECON_LCD
	bool "HX8279D_WISDOM LCD driver"

config EXYNOS_DECON_LCD_S6E8FC0_A20
	depends on EXYNOS_DECON_LCD
	bool "S6E8FC0_A20 LCD driver"

config EXYNOS_DECON_LCD_S6E8FC0_A40
	depends on EXYNOS_DECON_LCD
	bool "S6E8FC0_A40 LCD driver"

config EXYNOS_DECON_LCD_S6D7AT0B_A10
	depends on EXYNOS_DECON_LCD
	bool "S6D7AT0B_A10 LCD driver"

config EXYNOS_DECON_LCD_HX83102D_A10E
	depends on EXYNOS_DECON_LCD
	bool "HX83102D_A10E LCD driver"

config EXYNOS_DECON_LCD_HX83102D_A20E
	depends on EXYNOS_DECON_LCD
	bool "HX83102D_A20E LCD driver"

config EXYNOS_DECON_LCD_S6D7AA0_XCOVER4S
	depends on EXYNOS_DECON_LCD
	bool "S6D7AA0_XCOVER4S LCD driver"

config EXYNOS_DECON_LCD_S6E8FC0_A30C
	depends on EXYNOS_DECON_LCD
	bool "S6E8FC0_A30C LCD driver"
```
