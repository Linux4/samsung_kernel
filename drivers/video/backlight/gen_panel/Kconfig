## drivers/video/backlight/gen_panel/Kconfig
```kconfig
#
# GENERIC PANEL
#

config GEN_PANEL_TFT
	bool "GENERIC TFT-LCD support"
	default n
	help
		MIPI Generic TFT-LCD support

config GEN_PANEL_OCTA
	bool "GENERIC AMOLED support"
	default n
	help
		MIPI Generic AMOLED support

config GEN_PANEL_BACKLIGHT
	bool "generic panel backlight support"
	default n
	help
		generic panel backlight support.
		It is controlled by command of LDI.

config GEN_PANEL_MDNIE
	bool "mDNIe-LITE support"
	default n
	help
		mDNIe-LITE support

config GEN_PANEL_TUNING
	bool "generic panel tuning support"
	default n
	help
		generic panel tuning in runtime support

config GEN_PANEL_SMART_MTP
	bool "generic panel smart mtp support"
	depends on GEN_PANEL_OCTA
	default n
	help
		generic panel smart mtp support


config GEN_PANEL_S6E88A0X02
	bool "MIPI samsung display panel s6e88a0x02 support"
	depends on GEN_PANEL_SMART_MTP
	default n
	help
		MIPI panel s6e88a0x02 support
```

## drivers/video/decon_display/Kconfig
```kconfig
config FB_HIBERNATION_DISPLAY
	bool "FB Hibernation Display MODE"
	depends on FB_I80_COMMAND_MODE
	default n

config FB_HIBERNATION_DISPLAY_CLOCK_GATING
	bool "Support clock-gating"
	depends on FB_HIBERNATION_DISPLAY
	default y

config FB_HIBERNATION_DISPLAY_POWER_GATING
	bool "Support power-gating"
	depends on FB_HIBERNATION_DISPLAY_CLOCK_GATING
	default n

config FB_HIBERNATION_DISPLAY_POWER_GATING_DEEPSTOP
	bool "Support power-gating with deep-stop"
	depends on FB_HIBERNATION_DISPLAY_POWER_GATING
	default n
```

## drivers/video/external_hdmi/Kconfig
```kconfig
config XO2_SPI
	bool "CONFIG_XO2_SPI"
	default n
	help
	  Support for FPGA XO2 MIPI2RGB driver.
	  If unsure, say N.

config HDMI_TX_SII9136 
	bool "CONFIG_HDMI_TX_SII9136"
	default n
	help
	  Support for SII9136 HDMI driver.
```

## drivers/video/exynos/decon/panels/Kconfig
```kconfig
config EXYNOS_DECON_LCD
	depends on EXYNOS_DECON
	bool "Select LCD panel driver"

config EXYNOS_DECON_MDNIE_LITE
	depends on EXYNOS_DECON_LCD
	tristate "Support MDNIE LITE"
	default n

config EXYNOS_DECON_LCD_SYSFS
	depends on EXYNOS_DECON_LCD
	tristate "Support LCD SYSFS"
	default y

config EXYNOS_DECON_LCD_MCD
	depends on EXYNOS_DECON_LCD_SYSFS
	tristate "Support MCD"
	default n

config LCD_HMT
	depends on EXYNOS_DECON_LCD
	tristate "Support HMT display"
	default n

config LCD_ALPM
	depends on EXYNOS_DECON_LCD
	tristate "Support ALPM display"
	default n

config LCD_BURNIN_CORRECTION
	depends on EXYNOS_DECON_LCD
	tristate "Support Burnin correction"
	default n

config LCD_HBM_INTERPOLATION
	depends on EXYNOS_DECON_LCD
	tristate "Support HBM brightness table"
	default n

config PANEL_AID_DIMMING
	depends on EXYNOS_DECON_LCD
	tristate "Support AID Dimming"
	default n

config LCD_DOZE_MODE
	depends on EXYNOS_DECON_LCD
	tristate "Support DOZE MODE"
	default n

config PANEL_S6E3HF2_DYNAMIC
	depends on EXYNOS_DECON_LCD && EXYNOS_MIPI_DSI
	tristate "S6E3HF2 AMOLED SUPPORT BOTH WQHD and WQXGA RESOLUTION"

config PANEL_S6E3HA2_DYNAMIC
	depends on EXYNOS_DECON_LCD && EXYNOS_MIPI_DSI
	tristate "S6E3HA2 AMOLED SUPPORT BOTE S6E3HA0 and S6E3HA2 (1440 x 2560)"

config PANEL_S6E3HA3_DYNAMIC
	depends on EXYNOS_DECON_LCD && EXYNOS_MIPI_DSI
	tristate "S6E3HA3 AMOLED SUPPORT BOTH S6E3HA2 and S6E3HA3 (1440 x 2560)"

config PANEL_S6E3HF3_DYNAMIC
	depends on EXYNOS_DECON_LCD && EXYNOS_MIPI_DSI
	tristate "S6E3HF3 AMOLED SUPPORT BOTH S6E3HA2 and S6E3HF3 (1440 x 2560)"

config PANEL_S6E3FA3_A8XE
	depends on EXYNOS_DECON_LCD && EXYNOS_MIPI_DSI
	tristate "S6E3FA3 AMOLED SUPPORT(1080 x 1920)"

config PANEL_DUALIZATION
	depends on PANEL_S6E3HF3_DYNAMIC
	tristate "S6E3HF3 A3 PANEL DUALIZATION"
```

## drivers/video/exynos/decon_3475/Kconfig
```kconfig
config EXYNOS_DECON_EXYNOS3475
	bool "Samsung Exynos Display system (DECON, MIPI)"
	depends on FB

choice
	prompt "Select Display Operation Mode"
	depends on EXYNOS_DECON_EXYNOS3475
	default EXYNOS3475_DISPLAY_VIDEO_MODE
	help
	  Select the display operation mode (Command/Video).

config EXYNOS3475_DISPLAY_COMMAND_MODE
	bool "Command Mode"

config EXYNOS3475_DISPLAY_VIDEO_MODE
	bool "Video Mode"

endchoice

config USE_VSYNC_SKIP
   bool "Vsync Skip Enable"
   depends on EXYNOS_DECON_EXYNOS3475
   default n
   help
     Say Y here if you want to enable vsync skip feature for DFS solution.

config EXYNOS_DECON_FB
	bool "Samsung DECON Framebuffer driver"
	depends on EXYNOS_DECON_EXYNOS3475
	select MEDIA_EXYNOS
	default y
	help
	  Say Y here if you want support for the DECON in Samsung S5P SoCs.
	  This device produce image data to one of output interfaces.

config EXYNOS_MIPI_DSI
	bool "Samsung Exynos MIPI-DSI driver"
	depends on EXYNOS_DECON_EXYNOS3475
	default y
	help
	  Enable MIPI-DSI driver.

config DECON_MIPI_DSI_PKTGO
	bool "Samsung Exynos MIPI-DSI Packet Go"
	depends on EXYNOS_DECON_EXYNOS3475 && EXYNOS_MIPI_DSI
	default n
	help
	  Enable/disable MIPI-DSI Packet Go function

config DECON_MIPI_DSI_CLK_SWITCH
	bool "Samsung Exynos MIPI-DSI HS CLK SWITCH"
	depends on EXYNOS_DECON_EXYNOS3475 && EXYNOS_MIPI_DSI
	default n
	help
	  Enable/disable MIPI-DSI HS CLK SWITCH When screen off/on

config DECON_LPD_DISPLAY
        bool "Decon Low Power Display MODE"
        depends on EXYNOS_DECON_EXYNOS3475
        depends on EXYNOS3475_DISPLAY_COMMAND_MODE
        default n

config DECON_LPD_DISPLAY_WITH_CAMERA
        bool "Decon Low Power Display MODE with Camera"
        depends on DECON_LPD_DISPLAY
        depends on EXYNOS3475_DISPLAY_COMMAND_MODE

config DECON_DEVFREQ
	bool "Decon devfreq implementation"
	depends on EXYNOS_DECON_EXYNOS3475

config FB_WINDOW_UPDATE
        bool "DECON window update mode"
        depends on EXYNOS_DECON_EXYNOS3475
        depends on EXYNOS3475_DISPLAY_COMMAND_MODE
        default n

config DECON_BLOCKING_MODE
	bool "DECON blocking mode"
        depends on EXYNOS_DECON_EXYNOS3475
        default n

config DECON_USE_BOOTLOADER_FB
	bool "DECON Bootloader Framebuffer support"
        depends on EXYNOS3475_DISPLAY_VIDEO_MODE
        default n

config DECON_EVENT_LOG
	bool "Display sub-system event logger (DECON/DSIM)"
        depends on DEBUG_INFO && EXYNOS_DECON_EXYNOS3475
        default n

source "drivers/video/exynos/decon_3475/panels/Kconfig"
```

## drivers/video/exynos/decon_3475/panels/Kconfig
```kconfig
config EXYNOS3475_DECON_DISP_LCD
	depends on EXYNOS_DECON_EXYNOS3475 && EXYNOS_MIPI_DSI
	bool "Select LCD panel driver"

config PANEL_AID_DIMMING
	depends on EXYNOS3475_DECON_DISP_LCD
	tristate "Support AID Dimming"
	default n

config EXYNOS_DECON_MDNIE_LITE
	depends on EXYNOS3475_DECON_DISP_LCD
	tristate "Support MDNIE LITE"
	default n

config EXYNOS_DECON_LCD_SYSFS
	depends on EXYNOS3475_DECON_DISP_LCD
	tristate "Support LCD SYSFS"

config EXYNOS3475_DECON_DISP_LCD_NAME
	string
	default "s6d78a" if EXYNOS3475_DECON_LCD_S6D78A
	default "s6e8aa0" if EXYNOS3475_DECON_LCD_S6E8AA0
	default "s6e3ha0" if EXYNOS3475_DECON_LCD_S6E3HA0
	default "s6e3ha2k" if EXYNOS3475_DECON_LCD_S6E3HA2K
	default "s6e3hf2" if EXYNOS3475_DECON_LCD_S6E3HF2
	default "s6e3fa0" if EXYNOS3475_DECON_LCD_S6E3FA0
	default "s6e3fa0_vid" if EXYNOS3475_DECON_LCD_S6E3FA0_VID
	default "s6e3fa2" if EXYNOS3475_DECON_LCD_S6E3FA2
	default "sc7798d" if EXYNOS3475_DECON_LCD_SC7798D
	default "sc7798d" if EXYNOS3475_DECON_LCD_SC7798D_J2
	default "s6e88a0" if CONFIG_EXYNOS3475_DECON_LCD_S6E88A0
	default "ili9881c" if CONFIG_EXYNOS3475_DECON_LCD_ILI9881C
	help
	  This string is compared with lcd name fron Device Tree.

choice
	prompt "Select Panel"
	depends on EXYNOS3475_DECON_DISP_LCD
	help
		select the display panel.

config EXYNOS3475_DECON_LCD_S6D78A
	depends on EXYNOS3475_DECON_DISP_LCD
	depends on EXYNOS3475_DISPLAY_VIDEO_MODE
	bool "S6D78A AMOLED qHD LCD driver(540 x 960)"

config EXYNOS3475_DECON_LCD_SC7798D
	depends on EXYNOS3475_DECON_DISP_LCD
	depends on EXYNOS3475_DISPLAY_VIDEO_MODE
	bool "SC7798D TFT WVGA LCD driver(480 x 800)"

config PANEL_S6D7AA0_DYNAMIC
	depends on EXYNOS3475_DECON_DISP_LCD
	depends on EXYNOS3475_DISPLAY_VIDEO_MODE
	tristate "S6d7AA0 TFT WXGA LCD driver(800 x 1280)"

config EXYNOS3475_DECON_LCD_SC7798D_J2
	depends on EXYNOS3475_DECON_DISP_LCD
	depends on EXYNOS3475_DISPLAY_VIDEO_MODE
	bool "SC7798D TFT WVGA LCD driver(480 x 800)"

config EXYNOS3475_DECON_LCD_S6E88A0
	depends on EXYNOS3475_DECON_DISP_LCD
	depends on EXYNOS3475_DISPLAY_VIDEO_MODE
	bool "S6E88A0 AMOLE qHD LCD driver(540 x 960)"

config EXYNOS3475_DECON_LCD_ILI9881C
	depends on EXYNOS3475_DECON_DISP_LCD
	depends on EXYNOS3475_DISPLAY_VIDEO_MODE
	bool "S6E88A0 TFT HD LCD driver(720 x 1280)"

config EXYNOS3475_DECON_LCD_S6E8AA0
	depends on EXYNOS3475_DECON_DISP_LCD
	depends on EXYNOS3475_DISPLAY_VIDEO_MODE
	bool "S6E8AA0 AMOLED HD LCD driver(800 x 1280)"

config EXYNOS3475_DECON_LCD_S6E3HA0
	depends on EXYNOS3475_DECON_DISP_LCD
	depends on EXYNOS3475_DISPLAY_COMMAND_MODE
	bool "S6E3HA0 AMOLED WQHD LCD driver(1440 x 2560)"

config EXYNOS3475_DECON_LCD_S6E3HA2K
	depends on EXYNOS3475_DECON_DISP_LCD
	depends on EXYNOS3475_DISPLAY_COMMAND_MODE
	bool "S6E3HA2K AMOLED WQHD LCD driver(1440 x 2560)"

config EXYNOS3475_DECON_LCD_S6E3HF2
	depends on EXYNOS3475_DECON_DISP_LCD
	depends on EXYNOS3475_DISPLAY_COMMAND_MODE
	bool "S6E3HF2 AMOLED WQXGA LCD driver(1600 x 2560)"

config EXYNOS3475_DECON_LCD_S6E3FA0
	depends on EXYNOS3475_DECON_DISP_LCD
	depends on EXYNOS3475_DISPLAY_COMMAND_MODE
	bool "S6E3FA0 COMMAND MODE AMOLED FHD LCD driver(1080 x 1920)"

config EXYNOS3475_DECON_LCD_S6E3FA0_VID
	depends on EXYNOS3475_DECON_DISP_LCD
	depends on EXYNOS3475_DISPLAY_VIDEO_MODE
	bool "S6E3FA0 VIDEO MODE AMOLED FHD LCD driver(1080 x 1920)"

config EXYNOS3475_DECON_LCD_S6E3FA2
	depends on EXYNOS3475_DECON_DISP_LCD
	depends on EXYNOS3475_DISPLAY_COMMAND_MODE
	bool "S6E3FA2 AMOLED FHD LCD driver(1080 x 1920)"

endchoice
```

## drivers/video/exynos/decon_7580/panels/Kconfig
```kconfig
config EXYNOS_DECON_LCD
	depends on EXYNOS_DECON_EXYNOS7580
	bool "Select LCD panel driver"

config EXYNOS_DECON_LCD_SYSFS
	depends on EXYNOS_DECON_LCD
	tristate "Support LCD SYSFS"
	default y

config PANEL_AID_DIMMING
	depends on EXYNOS_DECON_LCD
	tristate "Support AID Dimming"
	default n

config EXYNOS_DECON_MDNIE_LITE
	depends on EXYNOS_DECON_LCD
	tristate "Support MDNIE LITE"
	default n

config PANEL_LTM184HL01
	depends on EXYNOS_DECON_LCD && EXYNOS_MIPI_DSI
	tristate "ltm184hl01 FHD LCD driver(1920 x 1080)by Quicklogic lvds converter"

config PANEL_EA8061_DYNAMIC
	depends on EXYNOS_DECON_LCD && EXYNOS_MIPI_DSI
	tristate "EA8061 Amoled HD driver(720 x 1280)"

config PANEL_EA8064G_DYNAMIC
	depends on EXYNOS_DECON_LCD && EXYNOS_MIPI_DSI
	tristate "EA8064G Amoled FHD driver(1080 x 1920)"

config PANEL_S6E3AA2_A3XE
	depends on EXYNOS_DECON_LCD && EXYNOS_MIPI_DSI
	tristate "S6E3AA2 LCD driver"

config PANEL_S6E3FA3_A5XE
	depends on EXYNOS_DECON_LCD && EXYNOS_MIPI_DSI
	tristate "S6E3FA3 A5XE LCD driver"

config PANEL_S6E3FA3_A7XE
	depends on EXYNOS_DECON_LCD && EXYNOS_MIPI_DSI
	tristate "S6E3FA3 A7XE LCD driver"
	
config PANEL_S6E3FA3_J7XE
	depends on EXYNOS_DECON_LCD && EXYNOS_MIPI_DSI
	tristate "S6E3FA3 J7XE LCD driver"

config LCD_HMT
	depends on EXYNOS_DECON_LCD
	tristate "Support HMT display"
	default n
```

## drivers/video/exynos/decon_display_ext/Kconfig
```kconfig
config EXYNOS_DECON_DUAL_DISPLAY
	bool "Samsung decon dual display driver"
	depends on EXYNOS_DECON_DISPLAY
	default n
```

## drivers/video/exynos/decon_dual_dsi/panels/Kconfig
```kconfig
config EXYNOS_DECON_LCD
	depends on EXYNOS_DECON_DUAL_DSI
	bool "Select LCD panel driver"

config EXYNOS_DECON_MDNIE_LITE
	depends on EXYNOS_DECON_LCD
	tristate "Support MDNIE LITE"
	default n

config EXYNOS_DECON_LCD_SYSFS
	depends on EXYNOS_DECON_LCD
	tristate "Support LCD SYSFS"
	default y

config EXYNOS_DECON_LCD_MCD
	depends on EXYNOS_DECON_LCD_SYSFS
	tristate "Support MCD"
	default n

config LCD_HMT
	depends on EXYNOS_DECON_LCD
	tristate "Support HMT display"
	default n

config LCD_ALPM
	depends on EXYNOS_DECON_LCD
	tristate "Support ALPM display"
	default n

config PANEL_AID_DIMMING
	depends on EXYNOS_DECON_LCD
	tristate "Support AID Dimming"
	default n

config PANEL_S6E3FA3
	depends on EXYNOS_DECON_LCD && EXYNOS_MIPI_DSI
	tristate "S6E3FA3 AMOLED FHD LCD Driver"
```

## drivers/video/exynos/decon_dual_dsi/vpp/Kconfig
```kconfig
config EXYNOS_VPP
	bool "Samsung Exynos Video Post Processor driver"
	depends on EXYNOS_DECON_DUAL_DSI
	depends on !SOC_EXYNOS7580
	default y
	help
	  Enable VPP driver.
```

## drivers/video/exynos/panels/Kconfig
```kconfig
config DECON_LCD
	depends on EXYNOS_DECON
	bool "Select LCD panel driver"

config DECON_MDNIE_LITE
	depends on DECON_LCD && DECON_MIPI_DSI
	tristate "Support MDNIE LITE"
	default n

config DECON_MDNIE_LITE_CHAGALL
	depends on DECON_LCD && DECON_MIPI_DSI
	tristate "Support MDNIE LITE"
	default n

config LCD_HMT
	depends on DECON_LCD
	tristate "Support HMT display"
	default n

config LCD_ALPM
	depends on DECON_LCD
	tristate "Support ALPM mode"
	default n

config LCD_PCD
	depends on DECON_LCD
	tristate "Support PCD detection"
	default n

config DECON_LCD_S6E8AA0
	depends on DECON_LCD && DECON_MIPI_DSI
	tristate "S6E8AA0 driver"

config DECON_LCD_S6E3FA0
	depends on DECON_LCD && DECON_MIPI_DSI
	tristate "S6E3FA0 driver"

config DECON_LCD_S6E3HA0K
	depends on DECON_LCD && DECON_MIPI_DSI
	tristate "S6E3HA0K driver"

config DECON_LCD_S6E3FA2
	depends on DECON_LCD && DECON_MIPI_DSI
	tristate "S6E8FA2 driver"

config DECON_LCD_S6E3HA0
	depends on DECON_LCD && DECON_MIPI_DSI
	tristate "S6E3HA0 driver"

config DECON_LCD_EA8064G
	depends on DECON_LCD && DECON_MIPI_DSI
	tristate "EA8064G driver"

config DECON_LCD_S6E3HA2
	depends on DECON_LCD && DECON_MIPI_DSI
	tristate "S6E3HA2 driver"

config DECON_LCD_S6E3HF2
	depends on DECON_LCD && DECON_MIPI_DSI
	tristate "S6E3HA2 driver"

config DECON_LCD_S6TNMR7
	depends on DECON_LCD && DECON_MIPI_DSI
	tristate "S6TNMR7 driver"

config DECON_LCD_ANA38401
	depends on DECON_LCD && DECON_MIPI_DSI
	tristate "ANA38401 driver"

config DECON_LCD_S6E3HA2_TABS2
	depends on DECON_LCD && DECON_MIPI_DSI
	tristate "S6E3HA2 driver"
```

## drivers/video/fbdev/exynos/Kconfig
```kconfig
if SOC_S5E3830

source "drivers/video/fbdev/exynos/dpu30/Kconfig"
source "drivers/video/fbdev/exynos/panel/Kconfig"

endif # SOC_S5E3830
```
