## kernel-5.10/arch/arm64/configs/lego_defconfig
```kconfig
CONFIG_SEC_PANEL_NOTIFIER_V2=m
CONFIG_VIBRATOR_VIB_INFO=m
CONFIG_SEC_VIBRATOR=m
CONFIG_DEV_RIL_BRIDGE=m
# CONFIG_SECURITY_DEFEX is not set
CONFIG_IIO=y
CONFIG_IIO_BUFFER=y
CONFIG_SHUB=m
CONFIG_SEC_NFC_LOGGER=y
# CONFIG_SECURITY_DSMS is not set
CONFIG_SUPPORT_DROPDUMP=m
CONFIG_USDM_PANEL_OLED_COMMON=m
CONFIG_USDM_PANEL_S6E3FC3=m
CONFIG_VBUS_NOTIFIER=m
CONFIG_SEC_STI=y
CONFIG_ZRAM=m
CONFIG_SEC_INPUT_BOOSTER=m
CONFIG_SEC_INPUT_BOOSTER_MTK=y
CONFIG_SB_CORE=m
CONFIG_SB_PQUEUE=y
CONFIG_SB_NOTIFY=y
CONFIG_SB_SYSFS=y
CONFIG_SB_VOTE=y
CONFIG_MUIC_NOTIFIER=m
CONFIG_HICCUP_CC_DISABLE=y
CONFIG_HICCUP_CHARGER=y
CONFIG_MUIC_AFC_RETRY=y
CONFIG_MUIC_HV=y
CONFIG_MUIC_SUPPORT_PDIC=y
CONFIG_MUIC_USE_MODULE_PARAM=y
CONFIG_USE_MUIC=y
CONFIG_ANDROID_SWITCH=m
# CONFIG_ANDROID_SWITCH_GPIO is not set
CONFIG_USB_TYPEC_MANAGER_NOTIFIER=m
CONFIG_IF_CB_MANAGER=m
CONFIG_INPUT_SEC_INPUT=m
CONFIG_SEC_DEBUG_TSP_LOG=m
# CONFIG_INPUT_SEC_SECURE_TOUCH is not set
CONFIG_TOUCHSCREEN_DUMP_MODE=m
# CONFIG_INPUT_TOUCHSCREEN_TCLMV2 is not set
# CONFIG_TOUCHSCREEN_DUAL_FOLDABLE is not set
# CONFIG_INPUT_SEC_NOTIFIER is not set
CONFIG_SENSORS_FINGERPRINT=m
CONFIG_CHARGER_SM5714=m
CONFIG_SEC_ABC_SPEC_TYPE1=m
CONFIG_DRM_PANEL_MCD_COMMON=m
# CONFIG_DRM_PANEL_SAMSUNG_COMMON is not set
CONFIG_USDM_PANEL_JSON=y
CONFIG_SHUB_MODULE=y
CONFIG_SHUB_AP_STATUS_CMD=y
CONFIG_SHUB_MTK=y
CONFIG_PDIC_NOTIFIER=m
CONFIG_PDIC_USE_MODULE_PARAM=y
CONFIG_SEC_ABC=m
CONFIG_SEC_ABC_HUB=m
CONFIG_SEC_ABC_COMMON=m
CONFIG_SEC_ABC_HUB_CORE=m
CONFIG_SEC_ABC_HUB_BOOTC=m
# CONFIG_SEC_ABC_MOTTO is not set
CONFIG_FUELGAUGE_SM5714=m
CONFIG_UI_SOC_PROLONGING=y
CONFIG_I2C_GPIO=m
CONFIG_SEC_PM_THERMISTOR=m
CONFIG_MFD_SM5714=m
CONFIG_CHARGER_HL7132=m
CONFIG_MST_LDO=m
CONFIG_MST_ARCH_MTK=y
CONFIG_MST_TEEGRIS=y
CONFIG_MST_DUMMY_DRV=y
CONFIG_SENSORS_EC6XX=m
CONFIG_SENSORS_FINGERPRINT_MODULE=y
CONFIG_FINGERPRINT_SECURE=y
CONFIG_SENSORS_FINGERPRINT_MTK=y
CONFIG_REGULATOR_FIXED_VOLTAGE=y
CONFIG_REGULATOR_S2MPB03=m
CONFIG_DIRECT_CHARGING=m
CONFIG_MUIC_SM5714=m
CONFIG_MUIC_BCD_RESCAN=y
CONFIG_PDIC_SM5714=m
CONFIG_SM5714_FACTORY_MODE=y
CONFIG_SUPPORT_USB_TYPEC_OPS=y
CONFIG_DC_VIBRATOR=m
# CONFIG_MTK_VIBRATOR is not set
CONFIG_SENSORS_SX9380=m
# CONFIG_SENSORS_SX9380_SUB is not set
# CONFIG_SENSORS_COMMON_VDD_SUB is not set
# CONFIG_SENSORS_SX9380_SUB2 is not set
# CONFIG_SENSORS_CORE_AP is not set
CONFIG_SAMSUNG_NFC=m
CONFIG_NFC_PN547=y
# CONFIG_NFC_PN547_ESE_SUPPORT is not set
CONFIG_NFC_FEATURE_SN100U=y
# CONFIG_ESE_SECURE is not set
CONFIG_MTK_NFC_CLKBUF_ENABLE=y
CONFIG_MTK_CLKBUF_NFC=y
CONFIG_SEC_NFC_WAKELOCK_METHOD=0
CONFIG_NFC_PVDD_LATE_ENABLE=y
CONFIG_SEC_NFC_COMPAT_IOCTL=y
# CONFIG_MAKE_NODE_USING_PLATFORM_DEVICE is not set
CONFIG_TOUCHSCREEN_GOODIX_BRL=m
CONFIG_BATTERY_SAMSUNG=m
CONFIG_SEC_PD=m
CONFIG_BATTERY_GKI=y
CONFIG_BATTERY_AGE_FORECAST=y
CONFIG_BATTERY_CISD=y
CONFIG_AFC_CHARGER_MODE=y
CONFIG_BATTERY_LOGGING=y
CONFIG_ENABLE_FULL_BY_SOC=y
CONFIG_STEP_CHARGING=y
CONFIG_SUPPORT_HV_CTRL=y
```
