## drivers/video/sprdfb/Kconfig
```kconfig
if FB
config FB_SC8825
	boolean "SC8825 frame buffer support "
	depends on FB && ARCH_SC8825
	select FB_CFB_FILLRECT
	select FB_CFB_COPYAREA
	select FB_CFB_IMAGEBLIT
	help
          Frame buffer driver for sc8825 based boards.

config FB_SCX35
	boolean "SC8830 frame buffer support "
	depends on FB && ARCH_SCX35 && (!ARCH_SCX30G)
	select FB_CFB_FILLRECT
	select FB_CFB_COPYAREA
	select FB_CFB_IMAGEBLIT
	help
          Frame buffer driver for sc8830 based boards.
config FB_SCX30G
	boolean "SC8830G frame buffer support "
	depends on FB && ARCH_SCX30G
	select FB_CFB_FILLRECT
	select FB_CFB_COPYAREA
	select FB_CFB_IMAGEBLIT
	help
          Frame buffer driver for sc8830G based boards.

config FB_SCX15
	boolean "SC7715 frame buffer support "
	depends on FB && ARCH_SCX15
	select FB_CFB_FILLRECT
	select FB_CFB_COPYAREA
	select FB_CFB_IMAGEBLIT
	help
          Frame buffer driver for sc7715 based boards.

config SPRD_FB_SIZE
	int "MB size for frame buffer, should larger or equal lcd_w*lcd_h*4*2"
	range 1 16
	default 8
	depends on FB_SC8825 || FB_SCX35 || FB_SCX15 || FB_SCX30G

config FB_LCD_HX8363_MCU
	boolean "support HX8363 panel mcu"
	depends on FB_SC8825 || FB_SCX35 || FB_SCX15
	default n

config FB_LCD_HX8363_RGB_SPI
	boolean "support HX8363 panel rgb spi"
	depends on FB_SC8825 || FB_SCX35 || FB_SCX15
	default n

config FB_LCD_VIVA_RGB_SPI
	boolean "support VIVA panel rgb spi"
	depends on FB_SC8825 || FB_SCX35 || FB_SCX15
	default n

config FB_LCD_HX8369
	boolean "support HX8369 panel"
	depends on FB_SC8825 || FB_SCX35
	default n

config FB_LCD_HX8369B_MIPI
	boolean "support HX8369B MIPI panel"
	depends on FB_SC8825 || FB_SCX35 || FB_SCX30G
	default n
	
config FB_LCD_S6D77A1A01_MIPI
	boolean "support S6D77A1A01 MIPI panel"
	depends on FB_SC8825 || FB_SCX35 || FB_SCX30G
	default n

config FB_LCD_HX8369B_MIPI_GRAND_NEO
	boolean "support HX8369B MIPI panel for grand neo"
	depends on FB_SC8825 || FB_SCX35 || FB_SCX30G
	default n

config FB_LCD_S6D0139
	boolean "support S6D0139 panel"
	depends on FB_SC8825 || FB_SCX35
	default n

config FB_LCD_NT35516_MIPI
	boolean "support NT35516 mipi panel"
	depends on FB_SC8825 || FB_SCX35 || FB_SCX30G
	default n

config FB_LCD_DUMMY
	boolean "support DUMMY panel"
	depends on FB_SC8825 || FB_SCX35 || FB_SCX30G
	default y

config FB_LCD_NT35502_MIPI
	boolean "support NT35502 mipi panel"
	depends on FB_SC8825 || FB_SCX35 || FB_SCX30G
	default n

config FB_LCD_VX5B3D_MIPI
	boolean "support VX5B3D mipi panel"
	depends on FB_SC8825 || FB_SCX35 || FB_SCX30G
	default n

config FB_LCD_ILI9486S1_MIPI
	boolean "support ILI9486S1 mipi panel"
	depends on FB_SCX35 || FB_SCX15 || FB_SCX30G
	default n

config FB_LCD_NT35516_RGB_I2C
	boolean "support NT35516 rgb (i2c) panel"
	depends on FB_SC8825 || FB_SCX35
	default n

config FB_LCD_NT35516_RGB_SPI
	boolean "support NT35516 rgb (spi) panel"
	depends on FB_SC8825 || FB_SCX35 || FB_SCX15
	default n

config FB_LCD_NT35516_MCU
	boolean "support NT35516 mcu panel"
	depends on FB_SC8825 || FB_SCX35 || FB_SCX15 || FB_SCX30G
	default n

config FB_LCD_NT35510_MIPI
	boolean "support NT35510 mipi panel"
	depends on FB_SC8825 || FB_SCX35
	default n

config FB_LCD_NT35512_MIPI
	boolean "support NT35512 mipi panel"
	depends on FB_SC8825 || FB_SCX35
	default n

config FB_LCD_OTM8018B_MIPI
	boolean "support otm 8018b mipi panel"
	depends on FB_SC8825 || FB_SCX35
	default n

config FB_LCD_SSD2075_MIPI
	boolean "support ssd2075 mipi panel"
	depends on FB_SC8825 || FB_SCX35
	default n

config FB_LCD_ILI9486
	boolean "support ILI9486 mcu panel"
	depends on FB_SC8825 || FB_SCX35 || FB_SCX15
	default n

config FB_LCD_ILI9486_RGB_SPI
	boolean "support ILI9486 rgb spi panel"
	depends on FB_SC8825 || FB_SCX35 || FB_SCX15
	default n

config FB_LCD_SC7798_RGB_SPI
        boolean "support SC7798 rgb spi panel"
        depends on FB_SC8825 || FB_SCX35 || FB_SCX15
        default n

config FB_LCD_ILI9341
	boolean "support ILI9341 mcu panel"
	depends on FB_SC8825 || FB_SCX35 || FB_SCX15
	default n

config FB_LCD_ST7789V_MCU
	boolean "support ST7789V mcu panel"
	depends on FB_SC8825 || FB_SCX35 || FB_SCX15
	default n

config FB_LCD_NT51017_MIPI_LVDS
        boolean "support nt51017 lvds panel"
        depends on FB_SC8825 || FB_SCX35
        default n

config FB_LCD_HX8369B_MIPI
	boolean "support hx8369b mipi panel"
	depends on FB_SC8825 || FB_SCX35
	default n

config FB_LCD_OTM1283A_MIPI
	boolean "support otm 1283a mipi panel"
	depends on FB_SC8825 || FB_SCX35
	default n

config FB_LCD_ILI9806E_MIPI
	boolean "support ili9806e mipi panel"
	depends on FB_SC8825 || FB_SCX35
	default n

config FB_LCD_T8861_MIPI
	boolean "support t8861 mipi panel"
	depends on FB_SC8825 || FB_SCX35
	default n

config FB_LCD_HX8379A_MIPI
	boolean "support hx8379a mipi panel"
	depends on FB_SC8825 || FB_SCX35 || FB_SCX30G
	default n

config FB_LCD_HX8389C_MIPI
	boolean "support hx8389c mipi panel"
	depends on FB_SC8825 || FB_SCX35 || FB_SCX30G
	default n

config FB_LCD_RESERVE_MEM
        boolean "support FB reserve mem"
        depends on FB_SC8825 || FB_SCX35 || FB_SCX15 || FB_SCX30G
        default n

config FB_LCD_OVERLAY_SUPPORT
	boolean "support lcd overlay"
	depends on FB_SC8825 || FB_SCX35 || FB_SCX15 || FB_SCX30G
	default n

config FB_VSYNC_SUPPORT
	boolean "support wait for vsync io"
	depends on FB_SC8825 || FB_SCX35 || FB_SCX15 || FB_SCX30G
	default y

config FB_ESD_SUPPORT
	boolean "support esd check"
	depends on FB_SC8825 || FB_SCX35 || FB_SCX30G
	default n

config FB_DYNAMIC_CLK_SUPPORT
	boolean "support close clk dynamically"
	depends on FB_SC8825 || FB_SCX35 || FB_SCX30G
	default n

config FB_DYNAMIC_FREQ_SCALING
	boolean "support change mipi clk/fps/dpi clk dynamically"
	depends on FB_SC8825 || FB_SCX35 || FB_SCX15 || FB_SCX30G
	default n

config FB_MMAP_CACHED
	boolean "support fb_mmap with cach"
	depends on FB_SC8825 || FB_SCX35 ||FB_SCX15
	default n

config FB_LOW_RES_SIMU
	boolean "support low resolution simulator"
	depends on FB_SC8825 || FB_SCX35 ||FB_SCX15 || FB_SCX30G
	default n

config LCD_ESD_RECOVERY
	boolean "support esd detection for lcd"
	default n	

config FB_TRIPLE_FRAMEBUFFER
	boolean "support triple buffer"
	depends on FB_SC8825 || FB_SCX35 ||FB_SCX15 || FB_SCX30G
	default y

config FB_BL_EVENT_CTRL
	boolean "support esd detection for lcd"
	default n

config LCD_MIPI_CONTINOUS_CLK
	boolean "support continous clock"
	default n

config SPRDFB_GEN_PANEL
	bool "support gen-panel"
	default n
	help
		support generic panel driver on sprdfb
endif
```

## drivers/vision/dsp/Kconfig
```kconfig
menuconfig EXYNOS_DSP
	bool "EXYNOS dsp common driver"
	depends on ARCH_EXYNOS
	select EXYNOS_DSP_HARDWARE

if EXYNOS_DSP

source "drivers/vision/dsp/hardware/Kconfig"

endif
```

## drivers/vision/dsp/hardware/Kconfig
```kconfig
menuconfig EXYNOS_DSP_HARDWARE
	bool "hardware dependent driver"

config EXYNOS_DSP_EXYNOS9630
	bool "Use Exynos9630 platform"
	depends on EXYNOS_DSP_HARDWARE
	depends on SOC_EXYNOS9630
```

## drivers/vision/npu/core/Kconfig
```kconfig
menuconfig EXYNOS_NPU
	bool "Exynos NPU driver (TEST)"
	depends on VISION_CORE
	help
		Exynos NPU Test device driver

menuconfig EXYNOS_NPU_DRAM_FW_LOG_BUF
	bool "DRAM buffer for firmware test and debugging"
	depends on EXYNOS_NPU
	default y
	help
		When this option is enabled, 1MB buffer will be reserved at the start of
		device virtual address space to support firmware test and debugging.

menuconfig EXYNOS_NPU_PUBLISH_NPU_BUILD_VER
	bool "Print out update log on initialization."
	depends on EXYNOS_NPU
	default n
	help
		When this option is enabled, last git log messages and stash information
		is printed on NPU initialization, to track source code update.

menuconfig EXYNOS_NPU_DEBUG_SRAM_DUMP
	bool "SRAM dump interface"
	depends on EXYNOS_NPU
	default n
	help
		When this option is enabled, SRAM dump file is created on debugfs
		and the SRAM can be dumpted.

menuconfig EXYNOS_NPU_EXPOSE_KERNEL_ADDR
	bool "Expose kernel address value in log message"
	depends on EXYNOS_NPU
	default n
	help
		When this option is enabled, all kernel address logging is
		changed to %p instead of %pK, so the value will be visible without
		setting kptr_restrict. Enabling this option is dangerous and
		THIS OPTION MUST BE DISABLED ON PRODUCTION BINARY.

if EXYNOS_NPU

config NPU_ZEBU_EMULATION
bool
default n

config NPU_GOLDEN_MATCH
bool
default y

config NPU_ZEBU_SYSMMU
bool
default y

config FIRMWARE_SRAM_DUMP_DEBUGFS
bool
default y

source "drivers/vision/npu/core/interface/Kconfig"

config NPU_USE_MBR
	bool "use Master Boot Record for FW booting"
	default n
	help
		Because of lack of memory allocation by remapper limitation,
		use Master Boot Record for FW booting

endif
```

## drivers/vision/vipx_vertex/Kconfig
```kconfig
menuconfig EXYNOS_VIPX_VERTEX
	bool "Exynos VIPx driver"
	select EXYNOS_VIPX_VERTEX_PLATFORM
	help
	  This is a vision image processing unit

if EXYNOS_VIPX_VERTEX

source "drivers/vision/vipx_vertex/platform/Kconfig"

endif
```

## drivers/vision/vipx_vertex/platform/Kconfig
```kconfig
menuconfig EXYNOS_VIPX_VERTEX_PLATFORM
	bool "Select Platform"
	help
	  This is a selection of platform

config EXYNOS_VIPX_VERTEX_EXYNOS9610
	bool "Use Exynos9610 platform"
	depends on EXYNOS_VIPX_VERTEX_PLATFORM
	depends on SOC_EXYNOS9610
	help
	  This is a exynos9610 platform
```

## drivers/vision/vision-core/Kconfig
```kconfig
config VISION_CORE
        bool "Vision Core"
        help
	  Vision core module enablement

          Vision core module handles all vision related
          modules.
	  Enabling this module enables NPU, and related
	  support code.


menuconfig VISION_UNITTEST
        bool "Build unittest for Vision"
        depends on VISION_CORE
        help
	  Include unittest code into the vision-core
```

## drivers/w1/slaves/w1_ds28el35/Kconfig
```kconfig
#
# Copyright (C) MAXIM Integranted
#

menu "DS28EL35 ECDSA driver"

config DS28EL35_ECDSA
	tristate "DS28EL35 driver for ECDSA"
	help
	 If you enable this, you will have ECDSA algorithm API for DS28EL35.

endmenu	 
```

## drivers/wt_sys/Kconfig
```kconfig
config WT_BOOTLOADER_LOG
	tristate "CONFIG_WT_BOOTLOADER_LOG"
	default n

config WT_PM_DEBUG
	tristate "CONFIG_WT_PM_DEBUG"
	default n
```

## fs/exfat/Kconfig
```kconfig
config EXFAT_FS
	tristate
	default y
	select NLS
	select NLS_UTF8
	help
	  If you want to use the exFAT file systems, then you must say Y or M here
	  to inlucde exFAT support.

config EXFAT_FS_VIRTUAL_XATTR
	bool "Virtual xattr support for exFAT filesystem"
	default n
	depends on EXFAT_FS
	help
	  Modification of exFAT filesystem for virtual xattr	  	  
```

## fs/iodebug/Kconfig
```kconfig
config SPRD_IODEBUG
	bool "SPRD IO debug function."
	depends on DEBUG_FS
	help
	  Support for SPRD IO debug feature.

config SPRD_IODEBUG_HOTPOINT
	bool "SPRD hotpoint debug function."
	depends on SPRD_IODEBUG
	help
	  For IO debug, support for IO hotpoint monitor.

config SPRD_IODEBUG_IOSCHEDULE
	bool "SPRD page&buffer lock debug function."
	depends on SPRD_IODEBUG
	help
	  debug for a longtime locked on a page&buffer.

config SPRD_IODEBUG_VFS
	bool "SPRD iodebug vfs function."
	depends on SPRD_IODEBUG
	default y
	help
	  For IO debug in VFS.

config SPRD_IODEBUG_BDI
	bool "SPRD iodebug bdi function."
	depends on SPRD_IODEBUG
	default y
	help
	  For IO debug in BDI.
```

## fs/proc/sprd_debug/Kconfig
```kconfig
config SPRD_DEBUG_FRAME
	bool "sprd debug proc interface support"
	depends on DEBUG_FS && SPRD_DEBUG
	default y

config SPRD_DEBUG_PHYMEM_INFO
	bool "physical memory show support"
	depends on SPRD_DEBUG_FRAME
	default n

config SPRD_DEBUG_USRPROCMEM_INFO
	bool "user proc's memory show support"
	depends on SPRD_DEBUG_FRAME
	default n

config SPRD_DEBUG_USRPROCSTACK_INFO
	bool "user proc's current stack show support"
	depends on SPRD_DEBUG_FRAME
	default n

config SPRD_DEBUG_CPU_RATE
	bool "open sprd cpu rate compute"
	depends on SPRD_DEBUG_FRAME
	default y

config SPRD_DEBUG_MORE_SMAPS_INFO
	default n
	depends on PROC_FS && MMU
	bool "Enable more smaps info" if EXPERT
	help
	  Add more infos in /proc/pid/smaps

config SPRD_UBOOT_LOG_DUMP
        bool  "Spreadtrum u-boot log dump"
        depends on SPRD_SYSDUMP && PROC_FS
        default y
        help
          Enable this option to support dumping u-boot log via sysfs from
          userspace
```

## kernel-5.10/Kconfig
```kconfig
# SPDX-License-Identifier: GPL-2.0
#
# For a description of the syntax of this configuration file,
# see Documentation/kbuild/kconfig-language.rst.
#
mainmenu "Linux/$(ARCH) $(KERNELVERSION) Kernel Configuration"

source "scripts/Kconfig.include"

source "init/Kconfig"

source "kernel/Kconfig.freezer"

source "fs/Kconfig.binfmt"

source "mm/Kconfig"

source "net/Kconfig"

source "drivers/Kconfig"

source "fs/Kconfig"

source "security/Kconfig"

source "crypto/Kconfig"

source "lib/Kconfig"

source "lib/Kconfig.debug"

source "Documentation/Kconfig"

config CUSTOM_PROJECT_OT11
    bool "CONFIG CUSTOM PROJECT OT11"

config CUSTOM_PROJECT_OT11_WIFI
    bool "CONFIG CUSTOM PROJECT OT11 WIFI"

config CUSTOM_PROJECT_OT11_DATA
    bool "CONFIG CUSTOM PROJECT OT11 DATA"

config ODM_CUSTOM_BUILD
    bool "CONFIG ODM CUSTOM BUILD"

config ODM_CUSTOM_FACTORY_BUILD
    bool "CONFIG ODM CUSTOM FACTORY BUILD"

config ODM_CUSTOM_D85_BUILD
    bool "CONFIG ODM CUSTOM D85 BUILD"
```
