## drivers/video/mhl/Kconfig
```kconfig
#
# Copyright (c) 2013 Samsung Electronics Co., Ltd.
# 		http://www.samsung.com/

config VIDEO_MHL_V2
	bool "Samsung Mobile HD Link Interface"
	default n
	---help---
	Support for MHL(SII8240) version2 chipset driver. This is a new
	version of mhl which has the required functionality to support
	mhl 2.0 spec required. Say Y here if this support mhl_version2

config VIDEO_MHL_SII8246
        bool "Samsung Mobile HD Link Interface"
        default n
        ---help---
        Support for MHL(SII8246) version2 chipset driver. This is a new
        version of mhl which has the required functionality to support
        mhl 2.0 spec required. Say Y here if this support mhl_version2

config PANEL_IT6681
	tristate "it6681 hdmi2mhl device"
	help
	  it6611 HDMI to MHL device
```

## drivers/video/mmp/Kconfig
```kconfig
menuconfig MMP_DISP
        tristate "Marvell MMP Display Subsystem support"
        depends on ARCH_MMP
        help
	  Marvell Display Subsystem support.

if MMP_DISP
source "drivers/video/mmp/hw/Kconfig"
source "drivers/video/mmp/panel/Kconfig"
source "drivers/video/mmp/fb/Kconfig"
endif
```

## drivers/video/mmp/fb/Kconfig
```kconfig
if MMP_DISP

config MMP_FB
	bool "fb driver for Marvell MMP Display Subsystem"
	depends on FB
	select FB_CFB_FILLRECT
	select FB_CFB_COPYAREA
	select FB_CFB_IMAGEBLIT
	default y
	help
		fb driver for Marvell MMP Display Subsystem

config MMP_FENCE
	bool "enable fence for Marvell MMP Display Subsystem"
	depends on SW_SYNC
	default y
	help
		fence driver for Marvell MMP Display Subsystem
endif
```

## drivers/video/mmp/hw/Kconfig
```kconfig
if MMP_DISP

config MMP_DISP_CONTROLLER
	bool "mmp display controller hw support"
	default y
	help
		Marvell MMP display hw controller support

config MMP_DISP_SPI
	bool "mmp display controller spi port"
	depends on MMP_DISP_CONTROLLER && SPI_MASTER
	default y
	help
		Marvell MMP display hw controller spi port support
		will register as a spi master for panel usage

endif
```

## drivers/video/mmp/panel/Kconfig
```kconfig
config MMP_PANEL_GENERIC
	bool "MIPI generic panel support"
	default n
	help
		MIPI general panel support

config MMP_PANEL_TPOHVGA
	bool "tpohvga panel TJ032MD01BW support"
	depends on SPI_MASTER
	default n
	help
		tpohvga panel support

config MMP_PANEL_HX8394_IPS3P5071
	bool "MIPI panel hx8394-ips3p5071 support"
	default n
	help
		MIPI panel hx8394-ips3p5071 support

config MMP_PANEL_R63311
	bool "MIPI Sharp panel R63311 support"
	default n
	help
		MIPI Sharp 1080p panel support

config MMP_PANEL_COMMON
	bool "MIPI common panel support"
	default n
	help
		MIPI common panel support

config MMP_PANEL_LG4591
	bool "MIPI panel LG4591 support"
	default n
	help
		MIPI panel LG4591 support

config MMP_PANEL_OTM1281A
	bool "MIPI panel OTM1281A support"
	default n
	help
		MIPI panel OTM1281A support

config MMP_PANEL_OTM8018B
	bool "MIPI panel OTM8018B support"
	default n
	help
		MIPI panel OTM8018B support

config MMP_PANEL_OTM1283A
	bool "MIPI panel OTM1283A support"
	default n
	help
		MIPI panel OTM1283A support

config MMP_PANEL_TD043MGEA1
	bool "parallel panel TD043MGEA1 support"
	default n
	help
		parallel panel TD043MGEA1 support

config MMP_PANEL_HX8394
	bool "MIPI panel hx8394 support"
	default n
	help
		MIPI panel hx8394 support

config MMP_PANEL_FL10802
	bool "MIPI panel fl10802 support"
	default n
	help
		MIPI panel fl10802 support

config MMP_PANEL_JD9365
	bool "MIPI Fiti panel JD9365 support"
	default n
	help
		MIPI panel JD9365 support

config MMP_PANEL_JD9161_HSD5
	bool "MIPI Fiti JD9161_HSD5 support"
	default n
	help
		MIPI panel JD9161_HSD5 support

config MMP_PANEL_OTM1284
	bool "MIPI panel OTM1284 support"
	default n
	help
		MIPI panel OTM1284 support

config MMP_PANEL_R63317
	bool "MIPI panel R63317 support"
	default n
	help
		MIPI panel R63317 support

config MMP_PANEL_S6D7AA0X62
	bool "MIPI panel S6D7AA0X62 support"
	default n
	help
		MIPI panel S6D7AA0X62 support
```

## drivers/video/msm/mdss/Kconfig
```kconfig
config FB_MSM_MDSS_WRITEBACK
	bool "MDSS Writeback Panel"
	---help---
	The MDSS Writeback Panel provides support for routing the output of
	MDSS frame buffer driver and MDP processing to memory.

config FB_MSM_MDSS_HDMI_PANEL
	depends on FB_MSM_MDSS
	bool "MDSS HDMI Tx Panel"
	default n
	---help---
	The MDSS HDMI Panel provides support for transmitting TMDS signals of
	MDSS frame buffer data to connected hdmi compliant TVs, monitors etc.

config FB_MSM_MDSS_HDMI_MHL_SII8334
	depends on FB_MSM_MDSS_HDMI_PANEL
	bool 'MHL SII8334 support '
	default n
	---help---
	  Support the HDMI to MHL conversion.
	  MHL (Mobile High-Definition Link) technology
	  uses USB connector to output HDMI content

config FB_MSM_MDSS_DSI_CTRL_STATUS
	tristate "DSI controller status check feature"
	---help---
	  Check DSI controller status periodically (default period is 5
	  seconds) by sending Bus-Turn-Around (BTA) command. If DSI controller
	  fails to acknowledge the BTA command, it sends PANEL_ALIVE=0 status
	  to HAL layer to reset the controller.

config FB_MSM_MDSS_EDP_PANEL
	depends on FB_MSM_MDSS
	bool "MDSS eDP Panel"
	---help---
	The MDSS eDP Panel provides support for eDP host controller driver
	which runs in Video mode only and is responsible for transmitting
	frame buffer from host SOC to eDP display panel.

config FB_MSM_MDSS_MDP3
	depends on FB_MSM_MDSS
	bool "MDP3 display controller"
	---help---
	The MDP3 provides support for an older version display controller
	included in latest display sub-system, known as MDSS.

config FB_MSM_MIPI_HIMAX_WVGA_VIDEO_PANEL
	depends on FB_MSM_MDSS
	bool "Support BOE WVGA VIDEO (hx8369b) Panel"
	default n

config FB_MSM_MIPI_HX8389C_QHD_VIDEO_PANEL
	depends on FB_MSM_MDSS
	bool "Support qHD VIDEO (HX8389C) Panel"
	default n

config FB_MSM_MIPI_S6D2AA0X_HD_VIDEO_PANEL
	depends on FB_MSM_MDSS
	bool "Support Sharp Panel"
	default n

config BL_ISL98611
	bool "Support Backlight ISL98611"
	default n

config MDNIE_TFT_MSM8X16
	bool "MDNIe tft panel tuning"
	default n

config MDNIE_TFT_HIMAX
	bool "MDNIe Himax tft panel tuning"
	default n


config CABC_TUNING
	bool "CABC panel tuning"
	default n
```

## drivers/video/msm/mdss/samsung/Kconfig
```kconfig
config SAMSUNG_DEBUG_DISPLAY
    bool "Add Samsung Debugging code"
    default n

config FB_MSM_MDSS_SAMSUNG
	depends on FB_MSM_MDSS
	bool "mdss config for samsung product"
	default n
	---help---
	Mdss config signature for samsung product

#
#	PANEL UNIQUE FEATURE
#
config DUAL_PANEL
	depends on FB_MSM_MDSS_SAMSUNG
	bool "dual paneloperation"
	default n
	---help---
	dual panel operation support

config PARTIAL_UPDATE
	depends on FB_MSM_MDSS_SAMSUNG
	bool "partial update operation"
	default n
	---help---
	partial update operation support

config CABC_FUNCTION
	depends on FB_MSM_MDSS_SAMSUNG
	bool "DDI cabc operation"
	default n
	---help---
	DDI cabc operation support

#
#	HOW TO MAKE DEF-CONFIG NAME FOR PANEL
#
#	PANEL_DDI-model_PANEL-model_RESOLUTION
#	PANEL_S6E3FA2    _AMS510CV01_FHD
#	PANEL_S6E3FA2_AMS510CV01_FHD
#

config PANEL_S6E3HF4_AMB526JS01_WQHD
	depends on FB_MSM_MDSS_SAMSUNG
	bool "LSI S6E3HF4 LDI"
	default n
	---help---
	LSI S6E3HF4 LDI 1440_2560 HERO DSC

config PANEL_S6E3HA2_AMS509ES01_WQHD
	depends on FB_MSM_MDSS_SAMSUNG
	bool "LSI S6E3HA2 LDI"
	default n
	---help---
	LSI S6E3HF2 LDI 1440_2560 HERO

config PANEL_S6E3HA3_AMS567JA01_WQHD
	depends on FB_MSM_MDSS_SAMSUNG
	bool "LSI S6E3HA3 LDI"
	default n
	---help---
	LSI S6E3HA3 LDI 1440_2560 HERO DSC TEST

config PANEL_S6E3HF4_AMB509ME01_WQHD
	depends on FB_MSM_MDSS_SAMSUNG
	bool "LSI S6E3HF4 LDI"
	default n
	---help---
	LSI S6E3HF4 LDI 1440_2560 HERO ACTIVE

config PANEL_S6E3HA5_AMB567MK01_WQHD
	depends on FB_MSM_MDSS_SAMSUNG
	bool "LSI S6E3HA5 LDI"
	default n
	---help---
	LSI S6E3HA5 LDI 1440_2560 GRACE DSC

config PANEL_S6E3FA5_AMS420MS01_FHD
	depends on FB_MSM_MDSS_SAMSUNG
	bool "LSI S6E3FA5 LDI"
	default n
	---help---
	LSI S6E3FA5 LDI 1080_1920 VEYRON

config PANEL_ANA38401_AMS968HH01_QXGA
	depends on FB_MSM_MDSS_SAMSUNG
	bool "LSI ANA38401 LDI"
	default n
	---help---
	LSI ANA38401 LDI 2048_1536 TAB S2 LTE-U VZW
```

## drivers/video/msm/mhl_v2/Kconfig
```kconfig
#
# Copyright (c) 2013 Samsung Electronics Co., Ltd.
#	http://www.samsung.com/

config VIDEO_MHL_V2
	tristate
	prompt "Silicon Image 8240 HDMI to MHL Tx"
	select SEC_MHL_SII8240
	default n

config SEC_MHL_SII8240
	tristate
	prompt "Silicon Image 8240 HDMI to MHL Tx"
	select SEC_MHL_SUPPORT
	select SEC_MHL_AP_HDCP_PART1
	select SEC_MHL_EDID
	default n
	---help---
	Support for MHL(SII8240) version2 chipset driver. This is a new
	version of mhl which has the required functionality to support
	mhl 2.0 spec required. Say Y here if this support mhl_version2

config MHL_VERSION
	depends on SEC_MHL_SII8240
	hex "Number of MHL Version"
	default 0x20
	---help---
	MHL Version
	For example, those device compliant
	with MHL Specification version 2.0
	shell set this MHL_VERSION to 0x20

config SEC_MHL_SUPPORT
	bool "Enable samsung MHL"
	default n
	---help---
	Say Y here if you want to enable the samsung MHL feature in HDMI driver.

config SEC_MHL_AP_HDCP
	bool "Enable HDCP in AP side"
	default n
	---help---
	Say Y here if you want to enable HDCP in AP side.

config SEC_MHL_AP_HDCP_PART1
	bool "Enable only HDCP part1 in Ap side for DRM playback"
	default n
	---help---
	Say Y here if you want to enable DDC workaround code.

config SEC_MHL_EDID
	bool "Use EDID which read by MHL"
	default n
	---help---
	Say Y here if you want to use the edid which read by MHL driver.
```

## drivers/video/msm/mhl_v3/Kconfig
```kconfig
config MEDIA_DATA_TUNNEL_SUPPORT
	bool
	prompt "MHL Media Data Tunneling Support"
	default n
	---help---
	  This option controls whether or not Silicon Image MHL transmitter
	  drivers include support for Media Data Tunneling (MDT).  MDT
	  support enables HID events generated by HID devices attached to
	  an MDT capable MHL sink to be passed over the MHL connection
	  to the system.

config SII8620_MHL_TX
	tristate
	prompt "Silicon Image 8620 HDMI to MHL Tx"
	select SEC_MHL_SII8620
	default n

config SEC_MHL_SII8620
	tristate
	prompt "Silicon Image 8620 HDMI to MHL Tx"
	select SEC_MHL_SUPPORT
	select SEC_MHL_AP_HDCP_PART1
	select SEC_MHL_EDID
	default n
        ---help---
        Support for MHL(SII8620) version3 chipset driver. This is a new
        version of mhl which has the required functionality to support
        mhl 3.0 spec required. Say Y here if this support mhl_version3

config MHL_VERSION
	depends on SEC_MHL_SII8620
	hex "Number of MHL Version"
	default 0x32
	---help---
	MHL Version
	For example, those device compliant
	with MHL Specification version 3.2
	shell set this MHL_VERSION to 0x32

config SEC_MHL_SUPPORT
	bool "Enable samsung MHL"
	default n
	---help---
	Say Y here if you want to enable the samsung MHL feature in HDMI driver.

config SEC_MHL_AP_HDCP
	bool "Enable HDCP in AP side"
	default n
	---help---
	Say Y here if you want to enable HDCP in AP side.

config SEC_MHL_AP_HDCP_PART1
	bool "Enable only HDCP part1 in Ap side for DRM playback"
	default n
	---help---
	Say Y here if you want to enable DDC workaround code.

config SEC_MHL_EDID
	bool "Use EDID which read by MHL"
	default n
	---help---
	Say Y here if you want to use the edid which read by MHL driver.
```
