/* Copyright (c) 2013-14, Samsung Electronics Corporation. All rights reserved.
 *
 * This program is free software; you can redistribute it and/or modify
 * it under the terms of the GNU General Public License version 2 and
 * only version 2 as published by the Free Software Foundation.
 *
 * This program is distributed in the hope that it will be useful,
 * but WITHOUT ANY WARRANTY; without even the implied warranty of
 * MERCHANTABILITY or FITNESS FOR A PARTICULAR PURPOSE.  See the
 * GNU General Public License for more details.
 */

/*---------------------------------------------------------------------------
 * This file is autogenerated file using gcdb parser. Please do not edit it.
 * Update input XML file to add a new entry or update variable in this file
 * VERSION = "1.0"
 *---------------------------------------------------------------------------*/
&mdss_mdp {
	ss_dsi_panel_NT36672A_B6TMA60_FHD: ss_dsi_panel_NT36672A_B6TMA60_FHD {
		qcom,mdss-dsi-panel-name = "ss_dsi_panel_NT36672A_B6TMA60_FHD";
		label = "ss_dsi_panel_NT36672A_B6TMA60_FHD";
		qcom,mdss-dsi-panel-type = "dsi_video_mode";
		qcom,mdss-dsi-virtual-channel-id = <0>;
		qcom,mdss-dsi-stream = <0>;
		qcom,mdss-dsi-bpp = <24>;
		qcom,mdss-dsi-underflow-color = <0xff>;
		qcom,mdss-dsi-border-color = <0>;
		qcom,mdss-dsi-traffic-mode = "burst_mode";
		qcom,mdss-dsi-bllp-eof-power-mode;
		qcom,mdss-dsi-bllp-power-mode;
		qcom,mdss-dsi-lane-0-state;
		qcom,mdss-dsi-lane-1-state;
		qcom,mdss-dsi-lane-2-state;
		qcom,mdss-dsi-lane-3-state;
		qcom,mdss-dsi-bl-min-level = <1>;
		qcom,mdss-dsi-bl-max-level = <256>;
		qcom,mdss-brightness-max-level = <256>;
		qcom,mdss-brightness-default-level = <255>;
		qcom,mdss-dsi-mdp-trigger = "none";
		qcom,mdss-dsi-dma-trigger = "trigger_sw";

		qcom,mdss-dsi-h-left-border = <0>;
		qcom,mdss-dsi-h-right-border = <0>;
		qcom,mdss-dsi-v-top-border = <0>;
		qcom,mdss-dsi-v-bottom-border = <0>;
		qcom,mdss-dsi-bl-pmic-control-type = "bl_ctrl_dcs";
		qcom,mdss-dsi-reset-sequence = <1 10>, <0 10>, <1 10>;

		qcom,mdss-dsi-h-sync-pulse = <0>;
		qcom,mdss-dsi-pixel-packing = "loose";
		qcom,mdss-dsi-color-order = "rgb_swap_rgb";

		qcom,mdss-pan-physical-width-dimension = <68>; /* 68.04mm, round-off */
		qcom,mdss-pan-physical-height-dimension = <147>; /* 147.42mm, round-off */

		qcom,mdss-dsi-rx-eot-ignore;
		qcom,mdss-dsi-tx-eot-append;

		qcom,mdss-dsi-t-clk-pre = <0x34>;
		qcom,mdss-dsi-t-clk-post = <0x0E>;

/*		qcom,esd-check-enabled;*/
/*		qcom,mdss-dsi-panel-status-check-mode="reg_read_irq";*/
/*		qcom,mdss-dsi-panel-status-value=<1>;*/
/*		qcom,mdss-dsi-panel-status-irq-trigger1="rising";*/
/*
 * ************************************************************************************************************************************
 *
 *
 *			Below  parameters are samsung dependent thigs
 *
 *
 * ************************************************************************************************************************************
 */
		samsung,support_panel_max = <1>;
		samsung,hw-config = "single_dsi";
		samsung,support_factory_panel_swap;

		samsung,panel-vendor = "BOE";
		samsung,tft-module-name = "B6P064";
		samsung,tft-common-support;
		samsung,enter_hbm_lux = <20000>;

		/* To use device_resume & device_suspend for optimizing display on time */

/*		samsung,dsi_force_clock_lane_hs;*/

		samsung,wait_after_reset_delay = <10>; /* reset -> 10ms -> send on_cmds */
		samsung,wait_after_sleep_out_delay = <100>; /* send sleep_out cmd (included in on_cmds) -> 100ms -> send display_on (29h) cmd */
		samsung,dsi-lp11-reset-off;

		/* BRIGHTNESS_MAX_PACKET = 50 */
		samsung,brightness_tx_cmds_revA = [
			15 01 00 00 00 00 01 00
			15 01 00 00 00 00 01 00
			15 01 00 00 00 00 01 00
			15 01 00 00 00 00 01 00
			15 01 00 00 00 00 01 00
			15 01 00 00 00 00 01 00
			15 01 00 00 00 00 01 00
			15 01 00 00 00 00 01 00
			15 01 00 00 00 00 01 00
			15 01 00 00 00 00 01 00
			15 01 00 00 00 00 01 00
			15 01 00 00 00 00 01 00
			15 01 00 00 00 00 01 00
			15 01 00 00 00 00 01 00
			15 01 00 00 00 00 01 00
			15 01 00 00 00 00 01 00
			15 01 00 00 00 00 01 00
			15 01 00 00 00 00 01 00
			15 01 00 00 00 00 01 00
			15 01 00 00 00 00 01 00
			15 01 00 00 00 00 01 00
			15 01 00 00 00 00 01 00
			15 01 00 00 00 00 01 00
			15 01 00 00 00 00 01 00
			15 01 00 00 00 00 01 00
			15 01 00 00 00 00 01 00
			15 01 00 00 00 00 01 00
			15 01 00 00 00 00 01 00
			15 01 00 00 00 00 01 00
			15 01 00 00 00 00 01 00
			15 01 00 00 00 00 01 00
			15 01 00 00 00 00 01 00
			15 01 00 00 00 00 01 00
			15 01 00 00 00 00 01 00
			15 01 00 00 00 00 01 00
			15 01 00 00 00 00 01 00
			15 01 00 00 00 00 01 00
			15 01 00 00 00 00 01 00
			15 01 00 00 00 00 01 00
			15 01 00 00 00 00 01 00
			15 01 00 00 00 00 01 00
			15 01 00 00 00 00 01 00
			15 01 00 00 00 00 01 00
			15 01 00 00 00 00 01 00
			15 01 00 00 00 00 01 00
			15 01 00 00 00 00 01 00
			15 01 00 00 00 00 01 00
			15 01 00 00 00 00 01 00
			15 01 00 00 00 00 01 00
			15 01 00 00 00 00 01 00
		];

		samsung,mdnie_tx_cmds_revA = [
			15 01 00 00 00 00 00 00 00
		];
#if 0
		samsung,level1_key_enable_tx_cmds_revA = [
			29 01 00 00 00 00 02 B0 04
		];
		samsung,level1_key_disable_tx_cmds_revA = [
			29 01 00 00 00 00 02 B0 03
		];
#endif
		samsung,packet_size_tx_cmds_revA = [
			37 01 00 00 00 00 02 07 00
		];

		samsung,display_on_tx_cmds_revA = [
			05 01 00 00 00 00 02 29 00
		];

		samsung,display_off_tx_cmds_revA = [05 01 00 00 00 00 02 28 00];

		/*
		 * First parameters can be changed
		 * by function of samsung_nv_read()
		 * because of that means offset of
		 * read position
		 */
		samsung,reg_read_pos_tx_cmds_revA = [
			15 01 00 00 00 00 02 B0 00
		];

		samsung,manufacture_id0_rx_cmds_revA = [06 01 00 00 00 00 01 da 01 00];
		samsung,manufacture_id1_rx_cmds_revA = [06 01 00 00 00 00 01 db 01 00];
		samsung,manufacture_id2_rx_cmds_revA = [06 01 00 00 00 00 01 dc 01 00];
		samsung,manufacture_id_rx_cmds_revA	= [06 01 00 00 00 00 01 04 03 00];

		samsung,mtp_read_sysfs_rx_cmds_revA = [06 01 00 00 00 00 01 00 00 00];
		samsung,mtp_write_sysfs_tx_cmds_revA = [39 01 00 00 00 00 0A 00 00 00 00 00 00 00 00 00 00];

		samsung,tft_pwm_tx_cmds_revA=[
			15 01 00 00 00 00 02 51 FF/*First command should be PWM duty change command*/
		];
		samsung,cabc_on_tx_cmds_revA = [
			15 01 00 00 00 00 02 55 01
		];
		samsung,cabc_off_tx_cmds_revA = [
			15 01 00 00 00 00 02 55 00
		];
		/*
		* ************************************************************************************************************************
		* Scaled level to index mappings
		* ************************************************************************************************************************
		*/
		samsung,candela_map_table_revA = <
		  /*<idx>   <from>  <till> <scaled_level> */
		     0  0  0  0
		     1  1  2  1  /*min*/
		     2  3  4  2 /* 7nits */
		     3  5  7  4 /* 12nits */
		     4  8  10  6 /* 17nits */
		     5  11  13  7 /*dimming*/
		     6  14  16  9
		     7  17  19  11
		     8  20  22  13
		     9  23  25  14
		     10  26  28  15
		     11  29  31  16
		     12  32  34  17
		     13  35  37  18
		     14  38  40  19
		     15  41  43  20
		     16  44  45  21
		     17  46  47  22
		     18  48  49  24
		     19  50  52  26
		     20  53  55  28
		     21  56  58  30
		     22  59  61  31
		     23  62  63  32
		     24  64  65  33
		     25  66  67  34
		     26  68  69  35
		     27  70  71  36
		     28  72  74  37
		     29  75  77  38
		     30  78  80  39
		     31  81  83  40
		     32  84  86  42
		     33  87  89  44
		     34  90  92  46
		     35  93  94  48
		     36  95  96  50
		     37  97  98  51
		     38  99  100  52
		     39  101  103  53
		     40  104  106  54
		     41  107  109  55
		     42  110  112  56
		     43  113  115  57
		     44  116  117  58
		     45  118  119  59
		     46  120  121  60
		     47  122  123  61
		     48  124  125  62
		     49  126  127  63
		     50  128  129  64 /*default*/
		     51  130  131  68
		     52  132  133  72
		     53  134  136  76
		     54  137  139  80
		     55  140  142  83
		     56  143  145  86
		     57  146  148  89
		     58  149  150  92
		     59  151  152  96
		     60  153  154  100
		     61  155  156  104
		     62  157  158  108
		     63  159  161  112
		     64  162  164  116
		     65  165  167  120
		     66  168  170  123
		     67  171  173  126
		     68  174  176  129
		     69  177  178  132
		     70  179  180  135
		     71  181  182  138
		     72  183  184  141
		     73  185  186  144
		     74  187  189  147
		     75  190  192  150
		     76  193  195  153
		     77  196  197  155
		     78  198  200  158
		     79  201  202  161
		     80  203  204  164
		     81  205  206  167
		     82  207  208  170
		     83  209  211  173
		     84  212  214  176
		     85  215  217  179
		     86  218  220  181
		     87  221  223  182
		     88  224  226  183
		     89  227  229  184
		     90  230  231  185
		     91  232  233  186
		     92  234  235  187
		     93  236  237  188
		     94  238  239  189
		     95  240  241  190
		     96  242  243  191
		     97  244  246  192
		     98  247  249  193
		     99  250  252  194
		     100  253  255  195/*max*/
		     101  256  256  255/*outdoor 100%*/
		>;

		/*
		* ************************************************************************************************************************
		* MULTI_RESOLUTION (DSC configs were moved all to below timing set)
		* ************************************************************************************************************************
		*/

		qcom,mdss-dsi-display-timings {
			fhd {
				qcom,display-topology = <1 0 1>;
				qcom,default-topology-index = <0>;

				qcom,mdss-dsi-timing-default;

				qcom,mdss-dsi-panel-width = <1080>;
				qcom,mdss-dsi-panel-height = <2340>;
				
				qcom,mdss-dsi-panel-phy-timings = [25 1f 09 0a 06 02 04 a0
													25 1f 09 0a 06 02 04 a0
													25 1f 09 0a 06 02 04 a0
													25 1f 09 0a 06 02 04 a0
													25 1e 08 0a 06 02 04 a0];

				qcom,mdss-dsi-panel-framerate = <60>;
				qcom,mdss-dsi-panel-clockrate = <987000000>;
				qcom,mdss-dsi-h-pulse-width = <16>;
				qcom,mdss-dsi-h-back-porch = <24>;
				qcom,mdss-dsi-h-front-porch = <40>;
				qcom,mdss-dsi-h-sync-skew = <0>;
				qcom,mdss-dsi-v-pulse-width = <5>;
				qcom,mdss-dsi-v-back-porch = <10>;
				qcom,mdss-dsi-v-front-porch = <10>;

				/*qcom,mdss-dsi-timing-switch-command; use samsung,panel_multires_XXX instead*/
				/*qcom,mdss-dsi-timing-switch-command-state;*/

				qcom,mdss-dsi-on-command = [
					15 01 00 00 00 00 02 FF 23
					15 01 00 00 00 00 02 FB 01
					15 01 00 00 00 00 02 07 00
					15 01 00 00 00 00 02 08 0A
					15 01 00 00 00 00 02 FF 10
					15 01 00 00 00 00 02 FB 01
					15 01 00 00 00 00 02 53 2C
					15 01 00 00 00 00 02 51 00
					15 01 00 00 00 00 02 FF 10
					
					15 01 00 00 00 00 02 11 00
				];

				qcom,mdss-dsi-on-command-state = "dsi_lp_mode";
				qcom,mdss-dsi-off-command-state = "dsi_hs_mode";
				qcom,mdss-dsi-off-command = [
					05 01 00 00 00 00 02 28 00
					05 01 00 00 43 00 02 10 00	/* wait 67ms: 4frames(0x43) */
				];
			};
		};
	};
};

