/* Copyright (c) 2012, Samsung Electronics Corporation. All rights reserved.
 *
 * This program is free software; you can redistribute it and/or modify
 * it under the terms of the GNU General Public License version 2 and
 * only version 2 as published by the Free Software Foundation.
 *
 * This program is distributed in the hope that it will be useful,
 * but WITHOUT ANY WARRANTY; without even the implied warranty of
 * MERCHANTABILITY or FITNESS FOR A PARTICULAR PURPOSE.  See the
 * GNU General Public License for more details.
 */

&mdss_mdp {
	ss_dsi_panel_S6E3FA9_AMB667UM01_FHD: ss_dsi_panel_S6E3FA9_AMB667UM01_FHD {
		qcom,mdss-dsi-panel-name = "ss_dsi_panel_S6E3FA9_AMB667UM01_FHD";
		label = "ss_dsi_panel_S6E3FA9_AMB667UM01_FHD";

		qcom,mdss-dsi-bpp = <24>;

		/*qcom,cmd-sync-wait-broadcast;*/

		qcom,mdss-dsi-h-pulse-width = <88>;
		qcom,mdss-dsi-h-back-porch = <92>;
		qcom,mdss-dsi-h-front-porch = <91>;
		qcom,mdss-dsi-h-sync-skew = <0>;

		qcom,mdss-dsi-v-pulse-width = <2>;
		qcom,mdss-dsi-v-back-porch = <2>;
		qcom,mdss-dsi-v-front-porch = <16>;

		qcom,mdss-dsi-h-left-border = <0>;
		qcom,mdss-dsi-h-right-border = <0>;
		qcom,mdss-dsi-v-top-border = <0>;
		qcom,mdss-dsi-v-bottom-border = <0>;

		qcom,mdss-dsi-panel-framerate = <60>;
		qcom,mdss-dsi-panel-clockrate = <1176500000>;
		//qcom,mdss-dsi-panel-phy-timings = [00 27 0A 0A 27 25 0A 0B 07 03 04 00];		/* SM7150 : dsi_phy_v3_0 */
		//qcom,mdss-dsi-panel-phy-timings = [00 27 0A 0A 27 25 0A 0B 07 02 04 00 20 1A];		/* SM8150 : dsi_phy_v4_0 */
		//qcom,mdss-dsi-panel-phy-timings = [00 1E 08 08 24 22 08 08 05 02 04 00 19 18];		/* SM8150 : dsi_phy_v4_0 */
		qcom,mdss-dsi-panel-phy-timings = [00 25 0A 0A 27 24 0A 0A 07 02 04 00 1F 1A];	// 1176.5 Mbps

		qcom,mdss-dsi-underflow-color = <0xFF>;
		qcom,mdss-dsi-border-color = <0>;

		qcom,mdss-dsi-bl-pmic-control-type = "bl_ctrl_dcs";

		qcom,mdss-dsi-bl-min-level = <1>;
		qcom,mdss-dsi-bl-max-level = <425>;
		qcom,mdss-brightness-max-level = <425>;
		qcom,mdss-brightness-default-level = <255>;
		qcom,mdss-dsi-interleave-mode = <0>;
		qcom,mdss-dsi-panel-type = "dsi_cmd_mode";

		qcom,mdss-dsi-te-check-enable;
		qcom,mdss-dsi-te-using-te-pin;
		qcom,mdss-dsi-te-pin-select = <1>;

		/*qcom,dynamic-mode-switch-enabled;*/
		/*qcom,dynamic-mode-switch-type = "dynamic-resolution-switch-immediate";*/

		qcom,mdss-dsi-te-dcs-command = <1>;
		qcom,mdss-dsi-wr-mem-start = <0x2C>;
		qcom,mdss-dsi-wr-mem-continue = <0x3C>;

		qcom,mdss-dsi-pixel-packing = "loose";

		qcom,mdss-dsi-virtual-channel-id = <0>;
		qcom,mdss-dsi-color-order = "rgb_swap_rgb";
		qcom,mdss-dsi-lane-0-state;
		qcom,mdss-dsi-lane-1-state;
		qcom,mdss-dsi-lane-2-state;
		qcom,mdss-dsi-lane-3-state;
		//qcom,mdss-dsi-lane-map = "lane_map_0123";

		qcom,mdss-dsi-t-clk-pre = <0x1F>;
		qcom,mdss-dsi-t-clk-post = <0x1A>;

		qcom,mdss-dsi-stream = <0>;
		qcom,mdss-dsi-mdp-trigger = "none";
		qcom,mdss-dsi-dma-trigger = "trigger_sw";

		qcom,mdss-pan-physical-width-dimension = <70>;
		qcom,mdss-pan-physical-height-dimension = <155>;

		qcom,mdss-dsi-reset-sequence = <0 10>, <1 10>;

		/*qcom,mdss-dsi-lp11-init;*/
		/*qcom,mdss-dsi-init-delay-us = <1000>;*/

		qcom,mdss-dsi-rx-eot-ignore;
		qcom,mdss-dsi-tx-eot-append;

		/* HDR Setting */
		qcom,mdss-dsi-panel-hdr-enabled;
		qcom,mdss-dsi-panel-hdr-color-primaries = <15635 16450 34000 16000 13250 34500 7500 3000>;
		qcom,mdss-dsi-panel-peak-brightness = <5400000>;
		qcom,mdss-dsi-panel-average-brightness = <2000000>;
		qcom,mdss-dsi-panel-blackness-level = <2000>;

		qcom,ulps-enabled;
		/* qcom,suspend-ulps-enabled; */
		//qcom,esd-check-enabled;
		//qcom,mdss-dsi-panel-status-check-mode ="irq_check";
		/*qcom,mdss-dsi-panel-status-read-length;*/
		/*qcom,mdss-dsi-panel-status-value;*/
		/*qcom,mdss-dsi-panel-status-irq-trigger1 = "rising";*/
		//qcom,mdss-dsi-panel-status-irq-trigger1 = "falling";

		/* *************************************************************
		 * Below  parameters are samsung dependent thigs
		 * *************************************************************
		 */
		samsung,panel-vendor = "SDC";
		samsung,disp-model = "AMB667UM01";
		samsung,panel-lpm-enable;
		//samsung,support_irc;
		//samsung,elvss_interpolation_temperature = <(-15)>;
		samsung,support_factory_panel_swap;
		//samsung,support_gct;
		//samsung,support_pac;
		//samsung,support_gpara;
		// samsung,support_poc_driver;
		samsung,support_dynamic_mipi_clk;
		samsung,pll_ssc_disabled;

		/* *************************************************************
		 *  Tx
		 * *************************************************************
		 */
		samsung,level0_key_enable_tx_cmds_revA	= [29 01 00 00 00 00 03 9F A5 A5]; /* PASSWD0 */
		samsung,level0_key_disable_tx_cmds_revA	= [29 01 00 00 00 00 03 9F 5A 5A]; /* PASSWD0 */
		samsung,level1_key_enable_tx_cmds_revA	= [29 01 00 00 00 00 03 F0 5A 5A]; /* PASSWD1 */
		samsung,level1_key_disable_tx_cmds_revA	= [29 01 00 00 00 00 03 F0 A5 A5]; /* PASSWD1 */
		samsung,level2_key_enable_tx_cmds_revA	= [29 01 00 00 00 00 03 FC 5A 5A];
		samsung,level2_key_disable_tx_cmds_revA	= [29 01 00 00 00 00 03 FC A5 A5];

		/* BRIGHTNESS_MAX_PACKET = 50 */
		samsung,brightness_tx_cmds_revA = [
			39 01 00 00 00 00 01 00
			39 01 00 00 00 00 01 00
			39 01 00 00 00 00 01 00
			39 01 00 00 00 00 01 00
			39 01 00 00 00 00 01 00
			39 01 00 00 00 00 01 00
			39 01 00 00 00 00 01 00
			39 01 00 00 00 00 01 00
			39 01 00 00 00 00 01 00
			39 01 00 00 00 00 01 00
			39 01 00 00 00 00 01 00
			39 01 00 00 00 00 01 00
			39 01 00 00 00 00 01 00
			39 01 00 00 00 00 01 00
			39 01 00 00 00 00 01 00
			39 01 00 00 00 00 01 00
			39 01 00 00 00 00 01 00
			39 01 00 00 00 00 01 00
			39 01 00 00 00 00 01 00
			39 01 00 00 00 00 01 00
			39 01 00 00 00 00 01 00
			39 01 00 00 00 00 01 00
			39 01 00 00 00 00 01 00
			39 01 00 00 00 00 01 00
			39 01 00 00 00 00 01 00
			39 01 00 00 00 00 01 00
			39 01 00 00 00 00 01 00
			39 01 00 00 00 00 01 00
			39 01 00 00 00 00 01 00
			39 01 00 00 00 00 01 00
			39 01 00 00 00 00 01 00
			39 01 00 00 00 00 01 00
			39 01 00 00 00 00 01 00
			39 01 00 00 00 00 01 00
			39 01 00 00 00 00 01 00
			39 01 00 00 00 00 01 00
			39 01 00 00 00 00 01 00
			39 01 00 00 00 00 01 00
			39 01 00 00 00 00 01 00
			39 01 00 00 00 00 01 00
			39 01 00 00 00 00 01 00
			39 01 00 00 00 00 01 00
			39 01 00 00 00 00 01 00
			39 01 00 00 00 00 01 00
			39 01 00 00 00 00 01 00
			39 01 00 00 00 00 01 00
			39 01 00 00 00 00 01 00
			39 01 00 00 00 00 01 00
			39 01 00 00 00 00 01 00
			39 01 00 00 00 00 01 00
		];

		//samsung,mdnie_tx_cmds_revA = [
		//	39 01 00 00 00 00 00 00 00
		//];

		//amsung,packet_size_tx_cmds_revA = [
		//7 01 00 00 00 00 02 07 00
		//];

		//samsung,reg_read_pos_tx_cmds_revA = [
		//	15 01 00 00 00 00 02 B0 00
		//];

		//samsung,manufacture_read_pre_tx_cmds_revA = [
		//	05 01 00 00 14 00 02 11 00			/* Sleep out, wait 20ms(0x14) */
		//];

		samsung,display_on_tx_cmds_revA = [
			05 01 00 00 00 00 02 29 00
		];

		samsung,display_off_tx_cmds_revA = [05 01 00 00 00 00 02 28 00];

		/* *************************************************************
		 *  Rx (Module Information READ)
		 * *************************************************************
		 */
		samsung,mdnie_read_rx_cmds_revA		= [06 01 00 00 00 00 01 A1 04 00]; /* White color position */
		samsung,manufacture_date_rx_cmds_revA	= [06 01 00 00 00 00 01 A1 04 04]; /* manufacture data 4 byte*/
		samsung,octa_id_rx_cmds_revA		= [06 01 00 00 00 00 01 A1 14 0E]; /* manufacture information */
		samsung,cell_id_rx_cmds_revA		= [06 01 00 00 00 00 01 A1 07 04]; /* manufacture data 7 byte*/

		samsung,manufacture_id0_rx_cmds_revA	= [06 01 00 00 00 00 01 da 01 00];
		samsung,manufacture_id1_rx_cmds_revA	= [06 01 00 00 00 00 01 db 01 00];
		samsung,manufacture_id2_rx_cmds_revA	= [06 01 00 00 00 00 01 dc 01 00];

		//samsung,smart_dimming_mtp_rx_cmds_revA	= [06 01 00 00 00 00 01 c8 20 00];

		//samsung,ldi_debug0_rx_cmds_revA		= [06 01 00 00 00 00 01 0A 01 00]; /* rddpm */
		//samsung,ldi_debug1_rx_cmds_revA		= [06 01 00 00 00 00 01 0E 01 00]; /* no operation */
		//samsung,ldi_debug2_rx_cmds_revA		= [06 01 00 00 00 00 01 0E 01 00]; /* errfg */
		//samsung,ldi_debug3_rx_cmds_revA		= [06 01 00 00 00 00 01 0E 01 00]; /* rddsm*/
		//samsung,ldi_debug4_rx_cmds_revA		= [06 01 00 00 00 00 01 05 01 00]; /* dsierr */
		//samsung,ldi_debug5_rx_cmds_revA		= [06 01 00 00 00 00 01 0F 01 00]; /* self_diag*/

		/* 255 bytes, its ddi max size is 512, and sw limit is 0xff = 255... */
		//samsung,ldi_debug_logbuf_rx_cmds_revA	= [06 01 00 00 00 00 01 9C FF 00];

		samsung,mtp_read_sysfs_rx_cmds_revA	= [06 01 00 00 00 00 01 00 00 00];


		/* *************************************************************
		 *  COPR
		 * *************************************************************
		 */
		samsung,copr_enable_tx_cmds_revA = [
			29 01 00 00 00 00 03 F0 5A 5A
			29 01 00 00 00 00 1D E1
				09 15 15 00 00 00 00 00 00 00
				03 03 01 E9 00 C7 02 03 00 E3
				00 00 00 00 04 37 09 5F
			29 01 00 00 00 00 03 F0 A5 A5
		];

		samsung,copr_disable_tx_cmds_revA = [
			29 01 00 00 00 00 03 F0 5A 5A
			29 01 00 00 00 00 02 E1 00
			29 01 00 00 00 00 03 F0 A5 A5
		];

		/* *************************************************************
		 *  SELF DISPLAY
		 * *************************************************************
		 */
		samsung,support_self_display;
		ss,self_display = <&self_display_FA9_dtsi>;

		/* *************************************************************
		 * TEST MODE
		 * **************************************************************
		 */
		/* MCD TEST */
		samsung,mcd_on_tx_cmds_revA = [
			29 01 00 00 00 00 03 F0 5A 5A
			29 01 00 00 00 00 2B CB
				00 00 42 0F 00 02 00 00
				00 00 00 00 00 00 00 00
				00 00 50 00 00 40 47 00
				4D 00 00 00 20 07 28 38
				51 00 00 00 00 00 F0 F0
				0B 46
			29 01 00 00 00 00 03 B0 18 F6
			29 01 00 00 00 00 02 F6 00
			29 01 00 00 00 00 03 B0 04 CC
			29 01 00 00 00 00 02 CC 12
			29 01 00 00 64 00 02 F7 03			/* 100 ms Delay */
			29 01 00 00 00 00 03 F0 A5 A5
		];

		samsung,mcd_off_tx_cmds_revA = [
			29 01 00 00 00 00 03 F0 5A 5A
			29 01 00 00 00 00 2B CB
				00 00 42 0B 00 06 00 00
				00 00 00 00 00 00 00 00
				00 00 50 00 00 40 47 00
				4D 00 00 00 20 07 28 38
				51 00 00 00 00 00 F0 F0
				00 00
			29 01 00 00 00 00 03 B0 05 F6
			29 01 00 00 00 00 02 F6 90
			29 01 00 00 00 00 03 B0 04 CC
			29 01 00 00 00 00 02 CC 00
			29 01 00 00 64 00 02 F7 03			/* 100 ms Delay */
			29 01 00 00 00 00 03 F0 A5 A5
		];

#if 0
		/* GRAY SPOT TEST */
		samsung,gray_spot_test_on_tx_cmds_revA = [
			29 01 00 00 00 00 03 F0 5A 5A
			29 01 00 00 00 00 03 B0 05 F6
			29 01 00 00 00 00 02 F6 00
			29 01 00 00 00 00 03 B0 11 F4
			29 01 00 00 00 00 02 F4 1E
			29 01 00 00 00 00 05 B5	19 89 35 00
			29 01 00 00 00 00 02 F7 03

			// TBD
			//29 01 00 00 00 00 05 F2 00 E4 3C 90
			//29 01 00 00 00 00 03 F4 EB 23
			//29 01 00 00 00 00 03 B0 38 B5
			//29 01 00 00 00 00 02 B5 14
			//29 01 00 00 64 00 02 F7 03
			29 01 00 00 00 00 03 F0 A5 A5
		];

		samsung,gray_spot_test_off_tx_cmds_revA = [
			29 01 00 00 00 00 03 F0 5A 5A
			29 01 00 00 00 00 03 B0 05 F6
			29 01 00 00 00 00 02 F6 90
			29 01 00 00 00 00 03 B0 11 F4
			29 01 00 00 00 00 02 F4 1E
			29 01 00 00 00 00 05 B5	19 89 35 00
			29 01 00 00 64 00 02 F7 03
			29 01 00 00 64 00 03 F0 A5 A5
		];

#endif

		/* MICRO CRACK Test */
		samsung,micro_short_test_on_tx_cmds_revA = [
			29 00 00 00 00 00 03 F0 5A 5A
			29 01 00 00 00 00 03 B0 03 F6
			29 01 00 00 00 00 04 F6 3B 00 78
			29 00 00 00 00 00 03 BF 33 25
			29 01 00 00 00 00 03 F0 A5 A5
		];

		samsung,micro_short_test_off_tx_cmds_revA = [
			29 00 00 00 00 00 03 F0 5A 5A
			29 01 00 00 00 00 03 B0 03 F6
			29 01 00 00 00 00 04 F6 00 00 90
			29 00 00 00 00 00 03 BF 00 07
			29 01 00 00 00 00 03 F0 A5 A5
		];

		/* CCD TEST */
		samsung,ccd_test_on_tx_cmds_revA = [
			29 00 00 00 00 00 03 F0 5A 5A
			29 01 00 00 00 00 03 B0 02 CC
			29 01 00 00 01 00 02 CC 01	/* wait 1 ms */
			29 01 00 00 00 00 03 F0 A5 A5
		];

		samsung,ccd_pass_val = <0x00>;
		samsung,ccd_fail_val = <0x04>;

		samsung,ccd_state_rx_cmds_revA= [06 01 00 00 00 00 01 CD 01 0E];

		samsung,ccd_test_off_tx_cmds_revA = [
			29 00 00 00 00 00 03 F0 5A 5A
			29 01 00 00 00 00 03 B0 02 CC
			29 01 00 00 00 00 02 CC 00
			29 01 00 00 00 00 03 F0 A5 A5
		];

		/* *************************************************************
		 * ACL command list and mappings
		 * **************************************************************
		 */
		samsung,acl_on_tx_cmds_revA = [
			/* 32 frame AVG ACL ON, Start 50%, ACL 15%, 32Frame AVG */
			29 01 00 00 00 00 02 55 02	/* ACL ON */
		];

		samsung,acl_off_tx_cmds_revA = [
			/* 16 Frame AVG ACL OFF, Start Point 60%, ACL 0%*/
			29 01 00 00 00 00 02 55 00	/* ACL OFF */
		];

		samsung,elvss_rx_cmds_revA = [ 06 01 00 00 00 00 01 B7 02 08];	/* read B7 9th, 10th para */

		/* *************************************************************
		 * Dynamic MIPI Clock
		 * **************************************************************
		 */
		samsung,ffc_cmds_line_position = <2>;
		samsung,ffc_tx_cmds_revA = [
			29 00 00 00 00 00 03 F0 5A 5A
			29 00 00 00 00 00 03 FC 5A 5A
			29 00 00 00 00 00 0A C5 0D 10 64 1E AF 05 00 26 B0	/* 1176.5 Mbps (588.25) */
			29 01 00 00 00 00 03 F0 A5 A5
			29 01 00 00 00 00 03 FC A5 A5
		];

		samsung,dyn_mipi_clk_ffc_cmds_revA = [
			29 00 00 00 00 00 0A C5 0D 10 64 1E AF 05 00 26 B0	/* 0 : 1176.5 Mbps (588.25) */
			29 00 00 00 00 00 0A C5 0D 10 64 1E AF 05 00 26 B0	/* 1 : 1176.5 Mbps (588.25) */
			29 00 00 00 00 00 0A C5 0D 10 64 1E 32 05 00 26 B0	/* 2 : 1195.5 Mbps (597.75) */
			29 00 00 00 00 00 0A C5 0D 10 64 1F 61 05 00 26 B0	/* 3 : 1150.5 Mbps (572.25) */
			29 00 00 00 00 00 0A C5 0D 10 64 1F 34 05 00 26 B0	/* 4 : 1157   Mbps (578.5)  */
		];

		samsung,dynamic_mipi_clk_timing_table = <
			/*<bitclk><>*/
			1176500000 /* clk id 0 default */
			1176500000 /* clk id 1 A */
			1195500000 /* clk id 2 B */
			1150500000 /* clk id 3 C */
			1157000000 /* clk id 4 D */
		>;

		samsung,dynamic_mipi_clk_sel_table = <
			/*<RAT><BAND><from><end><clk index>*/
			1	1	0	0	3
			1	2	0	0	4
			1	3	0	0	1
			1	4	0	0	3
			2	11	10562	10576	2
			2	11	10577	10747	1
			2	11	10748	10822	2
			2	11	10823	10838	1
			2	12	9662	9766	1
			2	12	9767	9841	2
			2	12	9842	9938	1
			2	13	1162	1231	2
			2	13	1232	1401	1
			2	13	1402	1476	2
			2	13	1477	1513	1
			2	14	1537	1551	2
			2	14	1552	1722	1
			2	14	1723	1738	2
			2	15	4357	4374	1
			2	15	4375	4445	2
			2	15	4446	4449	3
			2	15	4450	4458	1
			2	17	2237	2323	1
			2	17	2324	2345	4
			2	17	2346	2362	3
			2	17	2363	2398	2
			2	17	2399	2563	1
			2	18	2937	2994	2
			2	18	2995	3088	1
			3	91	0	53	2
			3	91	54	394	1
			3	91	395	544	2
			3	91	545	599	1
			3	92	600	833	1
			3	92	834	983	2
			3	92	984	1199	1
			3	93	1200	1212	1
			3	93	1213	1362	2
			3	93	1363	1702	1
			3	93	1703	1852	2
			3	93	1853	1949	1
			3	94	1950	2003	2
			3	94	2004	2344	1
			3	94	2345	2399	2
			3	95	2400	2458	1
			3	95	2459	2601	2
			3	95	2602	2608	3
			3	95	2609	2649	1
			3	97	2750	2946	1
			3	97	2947	2990	4
			3	97	2991	3025	3
			3	97	3026	3096	2
			3	97	3097	3436	1
			3	97	3437	3449	4
			3	98	3450	3588	2
			3	98	3589	3799	1
			3	102	5010	5116	2
			3	102	5117	5148	3
			3	102	5149	5179	1
			3	103	5180	5279	1
			3	104	5280	5379	1
			3	107	5730	5786	2
			3	107	5787	5818	3
			3	107	5819	5849	1
			3	108	5850	5999	1
			3	109	6000	6141	2
			3	109	6142	6149	3
			3	110	6150	6158	3
			3	110	6159	6449	1
			3	111	6450	6599	1
			3	115	8040	8273	1
			3	115	8274	8423	2
			3	115	8424	8689	1
			3	116	8690	8848	1
			3	116	8849	8991	2
			3	116	8992	8998	3
			3	116	8999	9039	1
			3	118	9210	9398	1
			3	118	9399	9524	2
			3	118	9525	9548	3
			3	118	9549	9659	1
			3	119	9660	9769	1
			3	120	9770	9869	2
			3	122	9920	10031	1
			3	122	10032	10181	2
			3	122	10182	10359	1
			3	124	36200	36273	2
			3	124	36274	36349	1
			3	128	37750	37956	1
			3	128	37957	38009	4
			3	128	39010	38027	3
			3	128	38028	38106	2
			3	128	38107	38249	1
			3	129	38250	38493	1
			3	129	38494	38643	2
			3	129	38644	38649	1
			3	130	38650	38764	2
			3	130	38765	39104	1
			3	130	39105	39136	4
			3	130	39137	39254	2
			3	130	39255	39595	1
			3	130	39596	39634	4
			3	130	39635	39649	2
			3	131	39650	39671	4
			3	131	39672	39765	2
			3	131	39766	40105	1
			3	131	40106	40167	4
			3	131	40168	40255	2
			3	131	40256	40596	1
			3	131	40597	40648	4
			3	131	40649	40667	3
			3	131	40668	40746	2
			3	131	40747	41086	1
			3	131	41087	41130	4
			3	131	41131	41165	3
			3	131	41166	41236	2
			3	131	41237	41576	1
			3	131	41577	41589	4
			3	132	41590	41829	1
			3	132	41830	41885	2
			3	132	41886	41979	3
			3	132	41980	42319	1
			3	132	42320	42383	2
			3	132	42384	42469	3
			3	132	42470	42810	1
			3	132	42811	42881	2
			3	132	42882	42960	3
			3	132	42961	43300	1
			3	132	43301	43380	2
			3	132	43381	43450	3
			3	132	43451	43589	1
			3	138	55240	55450	1
			3	138	55451	55530	2
			3	138	55531	55600	3
			3	138	55601	55940	1
			3	138	55941	56028	2
			3	138	56029	56090	3
			3	138	56091	56430	1
			3	138	56431	56526	2
			3	138	56527	56576	3
			3	138	56577	56580	4
			3	138	56581	56739	1
			3	156	66436	66489	2
			3	156	66490	66830	1
			3	156	66831	66980	2
			3	156	66981	67320	1
			3	156	67321	67328	4
			3	156	67329	67335	2
			3	161	68586	68713	1
			3	161	68714	68816	2
			3	161	68817	68863	3
			3	161	68864	68935	1
			4	51	0	0	2
			4	52	0	0	1
			4	53	0	0	2
			4	54	0	0	1
			4	55	0	0	4
			4	56	0	0	2
			5	61	0	0	2
			5	62	0	0	1
			5	71	0	0	1
		>;

		/* *************************************************************
		 * candela to index mappings
		 * **************************************************************
		 */
		samsung,candela_map_table_revA = < /* THIS TABLE USED FOR DIMMING */
		/*<idx>	  <from>  <till> <scaled_level> */
			0		0		0		3
			1		1		1		6
			2		2		2		9
			3		3		3		12
			4		4		4		15
			5		5		5		18
			6		6		6		21
			7		7		7		24
			8		8		8		27
			9		9		9		30
			10		10		10		33
			11		11		11		36
			12		12		12		39
			13		13		13		42
			14		14		14		45
			15		15		15		48
			16		16		16		52
			17		17		17		55
			18		18		18		59
			19		19		19		62
			20		20		20		66
			21		21		21		69
			22		22		22		73
			23		23		23		76
			24		24		24		80
			25		25		25		83
			26		26		26		87
			27		27		27		90
			28		28		28		94
			29		29		29		98
			30		30		30		101
			31		31		31		105
			32		32		32		108
			33		33		33		112
			34		34		34		115
			35		35		35		119
			36		36		36		122
			37		37		37		126
			38		38		38		129
			39		39		39		133
			40		40		40		136
			41		41		41		140
			42		42		42		144
			43		43		43		147
			44		44		44		151
			45		45		45		154
			46		46		46		158
			47		47		47		161
			48		48		48		165
			49		49		49		168
			50		50		50		172
			51		51		51		175
			52		52		52		179
			53		53		53		182
			54		54		54		186
			55		55		55		190
			56		56		56		193
			57		57		57		197
			58		58		58		200
			59		59		59		204
			60		60		60		207
			61		61		61		211
			62		62		62		214
			63		63		63		218
			64		64		64		221
			65		65		65		225
			66		66		66		229
			67		67		67		232
			68		68		68		236
			69		69		69		239
			70		70		70		243
			71		71		71		246
			72		72		72		250
			73		73		73		253
			74		74		74		257
			75		75		75		260
			76		76		76		264
			77		77		77		267
			78		78		78		271
			79		79		79		275
			80		80		80		278
			81		81		81		282
			82		82		82		285
			83		83		83		289
			84		84		84		292
			85		85		85		296
			86		86		86		299
			87		87		87		303
			88		88		88		306
			89		89		89		310
			90		90		90		313
			91		91		91		317
			92		92		92		321
			93		93		93		324
			94		94		94		328
			95		95		95		331
			96		96		96		335
			97		97		97		338
			98		98		98		342
			99		99		99		345
			100		100		100		349
			101		101		101		352
			102		102		102		356
			103		103		103		359
			104		104		104		363
			105		105		105		367
			106		106		106		370
			107		107		107		374
			108		108		108		377
			109		109		109		381
			110		110		110		384
			111		111		111		388
			112		112		112		391
			113		113		113		395
			114		114		114		398
			115		115		115		402
			116		116		116		406
			117		117		117		409
			118		118		118		413
			119		119		119		416
			120		120		120		420
			121		121		121		423
			122		122		122		427
			123		123		123		430
			124		124		124		434
			125		125		125		437
			126		126		126		441
			127		127		127		444
			128		128		128		448
			129		129		129		453
			130		130		130		457
			131		131		131		462
			132		132		132		466
			133		133		133		471
			134		134		134		475
			135		135		135		480
			136		136		136		484
			137		137		137		489
			138		138		138		493
			139		139		139		498
			140		140		140		502
			141		141		141		507
			142		142		142		511
			143		143		143		516
			144		144		144		520
			145		145		145		525
			146		146		146		529
			147		147		147		534
			148		148		148		539
			149		149		149		543
			150		150		150		548
			151		151		151		552
			152		152		152		557
			153		153		153		561
			154		154		154		566
			155		155		155		570
			156		156		156		575
			157		157		157		579
			158		158		158		584
			159		159		159		588
			160		160		160		593
			161		161		161		597
			162		162		162		602
			163		163		163		606
			164		164		164		611
			165		165		165		615
			166		166		166		620
			167		167		167		625
			168		168		168		629
			169		169		169		634
			170		170		170		638
			171		171		171		643
			172		172		172		647
			173		173		173		652
			174		174		174		656
			175		175		175		661
			176		176		176		665
			177		177		177		670
			178		178		178		674
			179		179		179		679
			180		180		180		683
			181		181		181		688
			182		182		182		692
			183		183		183		697
			184		184		184		702
			185		185		185		706
			186		186		186		711
			187		187		187		715
			188		188		188		720
			189		189		189		724
			190		190		190		729
			191		191		191		733
			192		192		192		738
			193		193		193		742
			194		194		194		747
			195		195		195		751
			196		196		196		756
			197		197		197		760
			198		198		198		765
			199		199		199		769
			200		200		200		774
			201		201		201		778
			202		202		202		783
			203		203		203		788
			204		204		204		792
			205		205		205		797
			206		206		206		801
			207		207		207		806
			208		208		208		810
			209		209		209		815
			210		210		210		819
			211		211		211		824
			212		212		212		828
			213		213		213		833
			214		214		214		837
			215		215		215		842
			216		216		216		846
			217		217		217		851
			218		218		218		855
			219		219		219		860
			220		220		220		865
			221		221		221		869
			222		222		222		874
			223		223		223		878
			224		224		224		883
			225		225		225		887
			226		226		226		892
			227		227		227		896
			228		228		228		901
			229		229		229		905
			230		230		230		910
			231		231		231		914
			232		232		232		919
			233		233		233		923
			234		234		234		928
			235		235		235		932
			236		236		236		937
			237		237		237		941
			238		238		238		946
			239		239		239		951
			240		240		240		955
			241		241		241		960
			242		242		242		964
			243		243		243		969
			244		244		244		973
			245		245		245		978
			246		246		246		982
			247		247		247		987
			248		248		248		991
			249		249		249		996
			250		250		250		1000
			251		251		251		1005
			252		252		252		1009
			253		253		253		1014
			254		254		254		1018
			255		255		255		1023
			256		256		256		2
			257		257		257		5
			258		258		258		7
			259		259		259		9
			260		260		260		12
			261		261		261		14
			262		262		262		17
			263		263		263		19
			264		264		264		21
			265		265		265		24
			266		266		266		26
			267		267		267		29
			268		268		268		31
			269		269		269		33
			270		270		270		36
			271		271		271		38
			272		272		272		40
			273		273		273		43
			274		274		274		45
			275		275		275		48
			276		276		276		50
			277		277		277		52
			278		278		278		55
			279		279		279		57
			280		280		280		59
			281		281		281		62
			282		282		282		64
			283		283		283		67
			284		284		284		69
			285		285		285		71
			286		286		286		74
			287		287		287		76
			288		288		288		78
			289		289		289		81
			290		290		290		83
			291		291		291		86
			292		292		292		88
			293		293		293		90
			294		294		294		93
			295		295		295		95
			296		296		296		97
			297		297		297		100
			298		298		298		102
			299		299		299		105
			300		300		300		107
			301		301		301		109
			302		302		302		112
			303		303		303		114
			304		304		304		116
			305		305		305		119
			306		306		306		121
			307		307		307		124
			308		308		308		126
			309		309		309		128
			310		310		310		131
			311		311		311		133
			312		312		312		135
			313		313		313		138
			314		314		314		140
			315		315		315		143
			316		316		316		145
			317		317		317		147
			318		318		318		150
			319		319		319		152
			320		320		320		154
			321		321		321		157
			322		322		322		159
			323		323		323		162
			324		324		324		164
			325		325		325		166
			326		326		326		169
			327		327		327		171
			328		328		328		173
			329		329		329		176
			330		330		330		178
			331		331		331		181
			332		332		332		183
			333		333		333		185
			334		334		334		188
			335		335		335		190
			336		336		336		192
			337		337		337		195
			338		338		338		197
			339		339		339		200
			340		340		340		202
			341		341		341		204
			342		342		342		207
			343		343		343		209
			344		344		344		211
			345		345		345		214
			346		346		346		216
			347		347		347		219
			348		348		348		221
			349		349		349		223
			350		350		350		226
			351		351		351		228
			352		352		352		231
			353		353		353		233
			354		354		354		235
			355		355		355		238
			356		356		356		240
			357		357		357		242
			358		358		358		245
			359		359		359		247
			360		360		360		250
			361		361		361		252
			362		362		362		254
			363		363		363		257
			364		364		364		259
			365		365		365		261
			366		366		366		264
			367		367		367		266
			368		368		368		269
			369		369		369		271
			370		370		370		273
			371		371		371		276
			372		372		372		278
			373		373		373		280
			374		374		374		283
			375		375		375		285
			376		376		376		288
			377		377		377		290
			378		378		378		292
			379		379		379		295
			380		380		380		297
			381		381		381		299
			382		382		382		302
			383		383		383		304
			384		384		384		307
			385		385		385		309
			386		386		386		311
			387		387		387		314
			388		388		388		316
			389		389		389		318
			390		390		390		321
			391		391		391		323
			392		392		392		326
			393		393		393		328
			394		394		394		330
			395		395		395		333
			396		396		396		335
			397		397		397		337
			398		398		398		340
			399		399		399		342
			400		400		400		345
			401		401		401		347
			402		402		402		349
			403		403		403		352
			404		404		404		354
			405		405		405		356
			406		406		406		359
			407		407		407		361
			408		408		408		364
			409		409		409		366
			410		410		410		368
			411		411		411		371
			412		412		412		373
			413		413		413		375
			414		414		414		378
			415		415		415		380
			416		416		416		383
			417		417		417		385
			418		418		418		387
			419		419		419		390
			420		420		420		392
			421		421		421		394
			422		422		422		397
			423		423		423		399
			424		424		424		402
			425		425		425		404
		>;

		samsung,aod_candela_map_table_revA = <
			/*<idx>   <from>  <till> <candella> */
			0	0	39	2
			1	40	70	10
			2	71	93	30
			3	94	255	60
		>;

		samsung,gamma_mode2_tx_cmds_revA=[
			39 00 00 00 00 00 02 53 20
			39 00 00 00 00 00 04 B5 19 89 10
			39 01 00 00 00 00 03 51 03 FF
		]; /* B5 1th para: TSET */

		/*
		 * ************************************************************************************************************************
		 *  FD Settings
		 * ************************************************************************************************************************
		 */

		samsung,fd_on_tx_cmds_revA = [
			29 01 00 00 00 00 03 F0 5A 5A
			29 01 00 00 00 00 03 B0 0B B5
			29 01 00 00 00 00 02 B5 40
			29 01 00 00 00 00 03 F0 A5 A5
		];

		samsung,fd_off_tx_cmds_revA = [
			29 01 00 00 00 00 03 F0 5A 5A
			29 01 00 00 00 00 03 B0 0B B5
			29 01 00 00 00 00 02 B5 80
			29 01 00 00 00 00 03 F0 A5 A5
		];

		/* *************************************************************
		 *   APLPM
		 * *************************************************************
		 */

		samsung,lpm_on_tx_cmds_revA = [ // TX_LPM_ON
			/* Image write for HLPM/ALPM Mode */
			29 00 00 00 00 00 03 F0 5A 5A	/* TEST KEY Enable */
			29 00 00 00 00 00 03 B0 02 BB	/* Global Para */
			29 00 00 00 00 00 03 BB 09 18	/* HLPM AOR SETTING */
			29 00 00 00 01 00 02 53 22	/* HLPM On Setting */
			29 01 00 00 00 00 03 F0 A5 A5	/* TEST KEY Disable */
		];

		samsung,lpm_off_tx_cmds_revA = [
			/* Image write for Normal Mode */
			29 00 00 00 00 00 03 F0 5A 5A	/* TEST KEY Enable */
			29 00 00 00 01 00 02 53 20	/* ALPM/HLPM off */
			29 01 00 00 00 00 03 F0 A5 A5	/* TEST KEY Disable */
		];

		/* ALPM/HLPM 2nit or 60nit On Commands */
		samsung,lpm_2nit_tx_cmds_revA  = [29 01 00 00 00 00 02 53 23];
		samsung,lpm_10nit_tx_cmds_revA = [29 01 00 00 00 00 02 53 22];
		samsung,lpm_30nit_tx_cmds_revA = [29 01 00 00 00 00 02 53 22];
		samsung,lpm_60nit_tx_cmds_revA = [29 01 00 00 00 00 02 53 22];

		/* HLPM / ALPM Control Commands */
		samsung,lpm_ctrl_hlpm_2nit_tx_cmds_revA  = [29 01 00 00 00 00 03 BB 89 0C];
		samsung,lpm_ctrl_hlpm_10nit_tx_cmds_revA = [29 01 00 00 00 00 03 BB 89 07];
		samsung,lpm_ctrl_hlpm_30nit_tx_cmds_revA = [29 01 00 00 00 00 03 BB 59 0C];
		samsung,lpm_ctrl_hlpm_60nit_tx_cmds_revA = [29 01 00 00 00 00 03 BB 09 18];

		/* HLPM / ALPM brightness Commands: default alpm 2nit */
		samsung,lpm_brightnes_tx_cmds_revA = [
			29 00 00 00 00 00 03 F0 5A 5A	/* TEST KEY Enable */
			29 00 00 00 01 00 02 53 22	/* HLPM On Setting */
			29 00 00 00 00 00 03 B0 02 BB	/* Global Para */
			29 00 00 00 00 00 03 BB 09 18	/* HLPM AOR SETTING */
			29 01 00 00 00 00 03 F0 A5 A5	/* TEST KEY Disable */
		];

		/* AOR Control(97.3%) Commands */
		//samsung,lpm_ctrl_hlpm_off_tx_cmds_revA		= [29 01 00 00 00 00 02 53 20];
		samsung,lpm-init-delay-ms = <124>; /* used AOD Sequnce. error flag case: Panel OFF => AOD ON case */

		/*
		* ************************************************************************************************************************
		*  DMS (Dynamic Mode Switch)
		* ************************************************************************************************************************
		*/

		qcom,mdss-dsi-display-timings {
			fhd {
				qcom,display-topology = <1 0 1>;
				qcom,default-topology-index = <0>;
				qcom,mdss-dsi-timing-default;
				qcom,mdss-dsi-panel-width = <1080>;
				qcom,mdss-dsi-panel-height = <2400>;

				qcom,mdss-dsi-h-pulse-width = <88>;
				qcom,mdss-dsi-h-back-porch = <92>;
				qcom,mdss-dsi-h-front-porch = <91>;
				qcom,mdss-dsi-h-sync-skew = <0>;

				qcom,mdss-dsi-v-pulse-width = <2>;
				qcom,mdss-dsi-v-back-porch = <2>;
				qcom,mdss-dsi-v-front-porch = <16>;

				qcom,mdss-dsi-panel-framerate = <60>;

				qcom,mdss-dsi-panel-clockrate = <1176500000>; /* 1176.5 Mbps*/
				//qcom,mdss-dsi-panel-phy-timings = [00 27 0A 0A 27 25 0A 0B 07 03 04 00];		/* SM7150 : dsi_phy_v3_0 */
				//qcom,mdss-dsi-panel-phy-timings = [00 27 0A 0A 27 25 0A 0B 07 02 04 00 20 1A];	/* SM8150 : dsi_phy_v4_0 */
				//qcom,mdss-dsi-panel-phy-timings = [00 1E 08 08 24 22 08 08 05 02 04 00 19 18];	/* SM8150 : dsi_phy_v4_0 */
				qcom,mdss-dsi-panel-phy-timings = [00 25 0A 0A 27 24 0A 0A 07 02 04 00 1F 1A];	// 1176.5 Mbps

				/*qcom,mdss-dsi-timing-switch-command; use samsung,panel_multires_XXX instead*/
				/*qcom,mdss-dsi-timing-switch-command-state;*/

				qcom,mdss-dsi-t-clk-pre = <0x1F>;
				qcom,mdss-dsi-t-clk-post = <0x1A>;

				/*only for factory binary*/
				qcom,mdss-fd-on-command = [
					29 01 00 00 00 00 03 F1 5A 5A	/* TEST KEY Enable */
					29 01 00 00 00 00 02 D0 08
					29 01 00 00 00 00 03 F1 A5 A5
					29 01 00 00 00 00 03 F0 5A 5A
					29 01 00 00 00 00 02 B0 03
					29 01 00 00 00 00 02 CD 04
					29 01 00 00 00 00 03 F0 A5 A5	/* TEST KEY Disable */
				];

				qcom,mdss-dsi-on-command = [
					/* Sleep out, wait 120ms(0x78) */
					05 01 00 00 78 00 02 11 00

					/* TE Vsync On */
					29 00 00 00 00 00 03 F0 5A 5A
					29 00 00 00 00 00 02 35 00
					29 00 00 00 00 00 03 F0 A5 A5

					/* PAGE Address Setting */
					29 00 00 00 00 00 05 2A 00 00 04 37
					29 00 00 00 00 00 05 2B 00 00 09 5F

					/* FFC SET */
					//29 00 00 00 00 00 03 F0 5A 5A
					//29 00 00 00 00 00 03 FC 5A 5A
					//29 00 00 00 00 00 0A C5 09 30 95 3E 23 05 00 26 D0	/* 1176.5 Mbps */
					//29 00 00 00 00 00 03 F0 A5 A5
					//29 00 00 00 00 00 03 FC A5 A5

					/* ERR_FG Setting */
					29 00 00 00 00 00 03 F0 5A 5A
					29 00 00 00 00 00 03 FC 5A 5A
					29 00 00 00 00 00 03 ED 00 4C
					29 00 00 00 00 00 03 F0 A5 A5
					29 00 00 00 00 00 03 FC A5 A5

					/* ACL Setting Value */
					29 00 00 00 00 00 03 F0 5A 5A
					29 00 00 00 00 00 03 B0 04 B4
					29 00 00 00 00 00 03 B4 52 9A
					29 00 00 00 00 00 03 F0 A5 A5

					/* Partial update (MIC Setting) */
					/* Brightness */
					29 00 00 00 00 00 03 F0 5A 5A
					29 00 00 00 00 00 02 53 20
					29 00 00 00 00 00 03 51 03 FF	/* 420 Nit */
					29 01 00 00 00 00 03 F0 A5 A5

					/* TSP HSYNC Setting  */
					29 00 00 00 00 00 03 F0 5A 5A
					29 00 00 00 00 00 0A B9 00 80 E8 09 00 00 00 11 03
					29 00 00 00 00 00 03 F0 A5 A5
				];

				qcom,mdss-dsi-off-command=[
					05 01 00 00 14 00 02 28 00
					05 00 00 00 00 00 02 10 00	/* wait 120ms(0x78) */
					29 00 00 00 00 00 03 F0 5A 5A
					29 00 00 00 00 00 02 B0 05
					29 00 00 00 00 00 02 F4 01
					29 01 00 00 78 00 03 F0 A5 A5
				];

				qcom,mdss-dsi-on-command-state = "dsi_lp_mode";
				qcom,mdss-dsi-off-command-state = "dsi_hs_mode";

				// JUN_TEMP : Partial-update is not support yet.
				//qcom,partial-update-enabled = "single_roi";
				//qcom,panel-roi-alignment=<360 60 360 60 360 60>;
			};
		};
	};
};
