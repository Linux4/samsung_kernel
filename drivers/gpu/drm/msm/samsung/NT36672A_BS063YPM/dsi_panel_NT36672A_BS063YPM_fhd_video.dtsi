/* Copyright (c) 2013-14, Samsung Electronics Corporation. All rights reserved.
 *
 * This program is free software; you can redistribute it and/or modify
 * it under the terms of the GNU General Public License version 2 and
 * only version 2 as published by the Free Software Foundation.
 *
 * This program is distributed in the hope that it will be useful,
 * but WITHOUT ANY WARRANTY; without even the implied warranty of
 * MERCHANTABILITY or FITNESS FOR A PARTICULAR PURPOSE.  See the
 * GNU General Public License for more details.
 */

/*---------------------------------------------------------------------------
 * This file is autogenerated file using gcdb parser. Please do not edit it.
 * Update input XML file to add a new entry or update variable in this file
 * VERSION = "1.0"
 *---------------------------------------------------------------------------*/
&mdss_mdp {
	ss_dsi_panel_NT36672A_BS063YPM_FHD: ss_dsi_panel_NT36672A_BS063YPM_FHD {
		qcom,mdss-dsi-panel-name = "ss_dsi_panel_NT36672A_BS063YPM_FHD";
		label = "ss_dsi_panel_NT36672A_BS063YPM_FHD";
		qcom,mdss-dsi-panel-type = "dsi_video_mode";
		qcom,mdss-dsi-virtual-channel-id = <0>;
		qcom,mdss-dsi-stream = <0>;
		qcom,mdss-dsi-bpp = <24>;
		qcom,mdss-dsi-underflow-color = <0xff>;
		qcom,mdss-dsi-border-color = <0>;
		qcom,mdss-dsi-traffic-mode = "burst_mode";
		qcom,mdss-dsi-bllp-eof-power-mode;
		qcom,mdss-dsi-bllp-power-mode;
		qcom,mdss-dsi-lane-0-state;
		qcom,mdss-dsi-lane-1-state;
		qcom,mdss-dsi-lane-2-state;
		qcom,mdss-dsi-lane-3-state;
		qcom,mdss-dsi-bl-min-level = <1>;
		qcom,mdss-dsi-bl-max-level = <256>;
		qcom,mdss-brightness-max-level = <256>;
		qcom,mdss-brightness-default-level = <255>;
		qcom,mdss-dsi-mdp-trigger = "none";
		qcom,mdss-dsi-dma-trigger = "trigger_sw";

		qcom,mdss-dsi-panel-width = <1080>;
		qcom,mdss-dsi-panel-height = <2280>;

		qcom,mdss-dsi-t-clk-pre = <0x31>;
		qcom,mdss-dsi-t-clk-post = <0x0E>;
		qcom,mdss-dsi-panel-phy-timings = [00 20 08 08 24 23 08 08 05 02 04 00];
		qcom,mdss-dsi-panel-framerate = <60>;
/*		qcom,mdss-dsi-panel-clockrate = <950000000>;*/
//		qcom,mdss-dsi-h-pulse-width = <6>;
//		qcom,mdss-dsi-h-back-porch = <16>;
//		qcom,mdss-dsi-h-front-porch = <30>;
//		qcom,mdss-dsi-h-sync-skew = <0>;
//		qcom,mdss-dsi-v-pulse-width = <10>;
//		qcom,mdss-dsi-v-back-porch = <25>;
//		qcom,mdss-dsi-v-front-porch = <16>;

		qcom,mdss-dsi-h-left-border = <0>;
		qcom,mdss-dsi-h-right-border = <0>;
		qcom,mdss-dsi-v-top-border = <0>;
		qcom,mdss-dsi-v-bottom-border = <0>;
		qcom,mdss-dsi-bl-pmic-control-type = "bl_ctrl_dcs";
		qcom,mdss-dsi-reset-sequence = <1 10>, <0 10>, <1 10>;

		qcom,mdss-dsi-h-sync-pulse = <0>;
		qcom,mdss-dsi-pixel-packing = "loose";
		qcom,mdss-dsi-color-order = "rgb_swap_rgb";

		qcom,mdss-pan-physical-width-dimension = <68>;
		qcom,mdss-pan-physical-height-dimension = <121>;

		qcom,mdss-dsi-rx-eot-ignore;
		qcom,mdss-dsi-tx-eot-append;

/*		qcom,esd-check-enabled;*/
/*		qcom,mdss-dsi-panel-status-check-mode="reg_read_irq";*/
/*		qcom,mdss-dsi-panel-status-value=<1>;*/
/*		qcom,mdss-dsi-panel-status-irq-trigger1="rising";*/
/*
 * ************************************************************************************************************************************
 *
 *
 *			Below  parameters are samsung dependent thigs
 *
 *
 * ************************************************************************************************************************************
 */
		samsung,support_panel_max = <1>;
		samsung,hw-config = "single_dsi";
		samsung,support_factory_panel_swap;

		samsung,panel-vendor = "BOE";
		samsung,tft-common-support;
		samsung,enter_hbm_lux = <20000>;

		/* To use device_resume & device_suspend for optimizing display on time */

/*		samsung,dsi_force_clock_lane_hs;*/

		samsung,wait_after_reset_delay = <20>; /* temp Flash loading time */
		samsung,wait_after_sleep_out_delay = <120>; /* 6frame 16.6 * 6 = about 100ms*/

		/* BRIGHTNESS_MAX_PACKET = 50 */
		samsung,brightness_tx_cmds_revA = [
			15 01 00 00 00 00 01 00
			15 01 00 00 00 00 01 00
			15 01 00 00 00 00 01 00
			15 01 00 00 00 00 01 00
			15 01 00 00 00 00 01 00
			15 01 00 00 00 00 01 00
			15 01 00 00 00 00 01 00
			15 01 00 00 00 00 01 00
			15 01 00 00 00 00 01 00
			15 01 00 00 00 00 01 00
			15 01 00 00 00 00 01 00
			15 01 00 00 00 00 01 00
			15 01 00 00 00 00 01 00
			15 01 00 00 00 00 01 00
			15 01 00 00 00 00 01 00
			15 01 00 00 00 00 01 00
			15 01 00 00 00 00 01 00
			15 01 00 00 00 00 01 00
			15 01 00 00 00 00 01 00
			15 01 00 00 00 00 01 00
			15 01 00 00 00 00 01 00
			15 01 00 00 00 00 01 00
			15 01 00 00 00 00 01 00
			15 01 00 00 00 00 01 00
			15 01 00 00 00 00 01 00
			15 01 00 00 00 00 01 00
			15 01 00 00 00 00 01 00
			15 01 00 00 00 00 01 00
			15 01 00 00 00 00 01 00
			15 01 00 00 00 00 01 00
			15 01 00 00 00 00 01 00
			15 01 00 00 00 00 01 00
			15 01 00 00 00 00 01 00
			15 01 00 00 00 00 01 00
			15 01 00 00 00 00 01 00
			15 01 00 00 00 00 01 00
			15 01 00 00 00 00 01 00
			15 01 00 00 00 00 01 00
			15 01 00 00 00 00 01 00
			15 01 00 00 00 00 01 00
			15 01 00 00 00 00 01 00
			15 01 00 00 00 00 01 00
			15 01 00 00 00 00 01 00
			15 01 00 00 00 00 01 00
			15 01 00 00 00 00 01 00
			15 01 00 00 00 00 01 00
			15 01 00 00 00 00 01 00
			15 01 00 00 00 00 01 00
			15 01 00 00 00 00 01 00
			15 01 00 00 00 00 01 00
		];

		samsung,mdnie_tx_cmds_revA = [
			15 01 00 00 00 00 00 00 00
		];
#if 0
		samsung,level1_key_enable_tx_cmds_revA = [
			29 01 00 00 00 00 02 B0 04
		];
		samsung,level1_key_disable_tx_cmds_revA = [
			29 01 00 00 00 00 02 B0 03
		];
#endif
		samsung,packet_size_tx_cmds_revA = [
			37 01 00 00 00 00 02 07 00
		];

		samsung,display_on_tx_cmds_revA = [
			05 01 00 00 00 00 02 29 00
		];

		samsung,display_off_tx_cmds_revA = [05 01 00 00 00 00 02 28 00];

		/*
		 * First parameters can be changed
		 * by function of samsung_nv_read()
		 * because of that means offset of
		 * read position
		 */
		samsung,reg_read_pos_tx_cmds_revA = [
			15 01 00 00 00 00 02 B0 00
		];

		samsung,manufacture_id0_rx_cmds_revA = [06 01 00 00 00 00 01 da 01 00];
		samsung,manufacture_id1_rx_cmds_revA = [06 01 00 00 00 00 01 db 01 00];
		samsung,manufacture_id2_rx_cmds_revA = [06 01 00 00 00 00 01 dc 01 00];
		samsung,manufacture_id_rx_cmds_revA	= [06 01 00 00 00 00 01 04 03 00];

		samsung,mtp_read_sysfs_rx_cmds_revA = [06 01 00 00 00 00 01 00 00 00];

		samsung,tft_pwm_tx_cmds_revA=[
			15 01 00 00 00 00 02 51 FF/*First command should be PWM duty change command*/
		];
		samsung,cabc_on_tx_cmds_revA = [
			15 01 00 00 00 00 02 55 01
		];
		samsung,cabc_off_tx_cmds_revA = [
			15 01 00 00 00 00 02 55 00
		];
		/*
		* ************************************************************************************************************************
		* Scaled level to index mappings
		* ************************************************************************************************************************
		*/
		samsung,candela_map_table_revA = <
		/*<idx>	  <from>  <till> <scaled_level> */
			0		0		0		0
			1		1		2		2	/*min*/
			2		3		4		4
			3		5		7		6
			4		8		10		8	/*dimming*/
			5		11		13		10
			6		14		16		11
			7		17		19		12
			8		20		22		13
			9		23		25		14
			10		26		28		15
			11		29		31		16
			12		32		34		17
			13		35		37		18
			14		38		40		19
			15		41		43		20
			16		44		45		21
			17		46		47		22
			18		48		49		24
			19		50		52		26
			20		53		55		28
			21		56		58		30
			22		59		61		31
			23		62		63		32
			24		64		65		33
			25		66		67		34
			26		68		69		35
			27		70		71		36
			28		72		74		37
			29		75		77		38
			30		78		80		39
			31		81		83		40
			32		84		86		42
			33		87		89		44
			34		90		92		46
			35		93		94		48
			36		95		96		50
			37		97		98		52
			38		99		100		53
			39		101		103		54
			40		104		106		56
			41		107		109		57
			42		110		112		58
			43		113		115		59
			44		116		117		60
			45		118		119		61
			46		120		121		62
			47		122		123		63
			48		124		125		64
			49		126		127		65	/*default*/
			50		128		129		68
			51		130		131		69
			52		132		133		70
			53		134		136		72
			54		137		139		74
			55		140		142		76
			56		143		145		78
			57		146		148		80
			58		149		150		84
			59		151		152		86
			60		153		154		88
			61		155		156		90
			62		157		158		92
			63		159		161		94
			64		162		164		96
			65		165		167		98
			66		168		170		100
			67		171		173		102
			68		174		176		104
			69		177		178		106
			70		179		180		108
			71		181		182		110
			72		183		184		112
			73		185		186		114
			74		187		189		116
			75		190		192		118
			76		193		195		120
			77		196		197		122
			78		198		200		124
			79		201		202		126
			80		203		204		128
			81		205		206		130
			82		207		208		132
			83		209		211		134
			84		212		214		136
			85		215		217		138
			86		218		220		140
			87		221		223		142
			88		224		226		144
			89		227		229		146
			90		230		231		148
			91		232		233		150
			92		234		235		152
			93		236		237		153
			94		238		239		154
			95		240		241		155
			96		242		243		156
			97		244		246		157
			98		247		249		158
			99		250		252		159
			100		253		255		160	/*max*/
			101		256		256		191	/*outdoor*/
		>;

		/*
		* ************************************************************************************************************************
		* MULTI_RESOLUTION (DSC configs were moved all to below timing set)
		* ************************************************************************************************************************
		*/

		qcom,mdss-dsi-display-timings {
			timing@0{
				qcom,display-topology = <1 0 1>;
				qcom,default-topology-index = <0>;

				qcom,mdss-dsi-timing-default;

				qcom,mdss-dsi-panel-width = <1080>;
				qcom,mdss-dsi-panel-height = <2280>;
				qcom,mdss-dsi-t-clk-pre = <0x31>;
				qcom,mdss-dsi-t-clk-post = <0x0E>;
				qcom,mdss-dsi-panel-phy-timings = [00 22 08 09 25 23 09 09 06 02 04 00];
				qcom,mdss-dsi-panel-framerate = <60>;
				qcom,mdss-dsi-panel-clockrate = <950000000>;
				qcom,mdss-dsi-h-pulse-width = <6>;
				qcom,mdss-dsi-h-back-porch = <16>;
				qcom,mdss-dsi-h-front-porch = <30>;
				qcom,mdss-dsi-h-sync-skew = <0>;
				qcom,mdss-dsi-v-pulse-width = <10>;
				qcom,mdss-dsi-v-back-porch = <25>;
				qcom,mdss-dsi-v-front-porch = <16>;

				/*qcom,mdss-dsi-timing-switch-command; use samsung,panel_multires_XXX instead*/
				/*qcom,mdss-dsi-timing-switch-command-state;*/

				qcom,mdss-dsi-on-command = [
					15 01 00 00 00 00 02 FF 10
					15 01 00 00 00 00 02 FB 01

					15 01 00 00 00 00 02 FF 20
					15 01 00 00 00 00 02 FB 01
					15 01 00 00 00 00 02 06 99
					15 01 00 00 00 00 02 07 A3
					15 01 00 00 00 00 02 0E AB
					15 01 00 00 00 00 02 0F AE
					15 01 00 00 00 00 02 62 AC
					15 01 00 00 00 00 02 6D 44
					15 01 00 00 00 00 02 78 01
					15 01 00 00 00 00 02 95 E1
					15 01 00 00 00 00 02 96 E1

					15 01 00 00 00 00 02 FF 24
					15 01 00 00 00 00 02 FB 01

					15 01 00 00 00 00 02 00 1C
					15 01 00 00 00 00 02 01 1C
					15 01 00 00 00 00 02 02 1C
					15 01 00 00 00 00 02 03 1C
					15 01 00 00 00 00 02 04 1C
					15 01 00 00 00 00 02 05 1C
					15 01 00 00 00 00 02 06 1C
					15 01 00 00 00 00 02 07 1C
					15 01 00 00 00 00 02 08 1C
					15 01 00 00 00 00 02 09 01
					15 01 00 00 00 00 02 0A 0A
					15 01 00 00 00 00 02 0B 09
					15 01 00 00 00 00 02 0C 20
					15 01 00 00 00 00 02 0D 0E
					15 01 00 00 00 00 02 0E 24
					15 01 00 00 00 00 02 0F 0D
					15 01 00 00 00 00 02 10 04
					15 01 00 00 00 00 02 11 03
					15 01 00 00 00 00 02 12 1C
					15 01 00 00 00 00 02 13 1E
					15 01 00 00 00 00 02 14 10
					15 01 00 00 00 00 02 15 12
					15 01 00 00 00 00 02 16 14
					15 01 00 00 00 00 02 17 1C
					15 01 00 00 00 00 02 18 1C
					15 01 00 00 00 00 02 19 1C
					15 01 00 00 00 00 02 1A 1C
					15 01 00 00 00 00 02 1B 1C
					15 01 00 00 00 00 02 1C 1C
					15 01 00 00 00 00 02 1D 1C
					15 01 00 00 00 00 02 1E 1C
					15 01 00 00 00 00 02 1F 1C
					15 01 00 00 00 00 02 20 01
					15 01 00 00 00 00 02 21 0A
					15 01 00 00 00 00 02 22 09
					15 01 00 00 00 00 02 23 20
					15 01 00 00 00 00 02 24 0E
					15 01 00 00 00 00 02 25 24
					15 01 00 00 00 00 02 26 0D
					15 01 00 00 00 00 02 27 04
					15 01 00 00 00 00 02 28 03
					15 01 00 00 00 00 02 29 1E
					15 01 00 00 00 00 02 2A 10
					15 01 00 00 00 00 02 2B 12
					15 01 00 00 00 00 02 2D 14
					15 01 00 00 00 00 02 4D 9F

					15 01 00 00 00 00 02 31 02
					15 01 00 00 00 00 02 32 03
					15 01 00 00 00 00 02 33 0A
					15 01 00 00 00 00 02 34 05
					15 01 00 00 00 00 02 37 00
					15 01 00 00 00 00 02 38 68
					15 01 00 00 00 00 02 39 68
					15 01 00 00 00 00 02 3F 68
					15 01 00 00 00 00 02 41 02
					15 01 00 00 00 00 02 42 03

					15 01 00 00 00 00 02 60 90
					15 01 00 00 00 00 02 61 24

					15 01 00 00 00 00 02 72 00
					15 01 00 00 00 00 02 73 00
					15 01 00 00 00 00 02 74 00
					15 01 00 00 00 00 02 75 00
					15 01 00 00 00 00 02 79 00
					15 01 00 00 00 00 02 7A 07
					15 01 00 00 00 00 02 7B 1B
					15 01 00 00 00 00 02 7D 05
					15 01 00 00 00 00 02 80 42
					15 01 00 00 00 00 02 82 13
					15 01 00 00 00 00 02 83 22
					15 01 00 00 00 00 02 84 31
					15 01 00 00 00 00 02 85 00
					15 01 00 00 00 00 02 86 00
					15 01 00 00 00 00 02 87 00
					15 01 00 00 00 00 02 88 13
					15 01 00 00 00 00 02 89 22
					15 01 00 00 00 00 02 8A 31
					15 01 00 00 00 00 02 8B 00
					15 01 00 00 00 00 02 8C 00
					15 01 00 00 00 00 02 8D 00
					15 01 00 00 00 00 02 8E F4
					15 01 00 00 00 00 02 8F 01
					15 01 00 00 00 00 02 EB 07

					15 01 00 00 00 00 02 90 80
					15 01 00 00 00 00 02 92 70
					15 01 00 00 00 00 02 93 10
					15 01 00 00 00 00 02 94 23

					15 01 00 00 00 00 02 9D B1

					15 01 00 00 00 00 02 B3 02
					15 01 00 00 00 00 02 B4 00
					15 01 00 00 00 00 02 B5 04

					15 01 00 00 00 00 02 DC 25
					15 01 00 00 00 00 02 DD 02
					15 01 00 00 00 00 02 DE 00
					15 01 00 00 00 00 02 DF 01

					15 01 00 00 00 00 02 E0 01
					15 01 00 00 00 00 02 E1 2B

					15 01 00 00 00 00 02 FF 25
					15 01 00 00 00 00 02 FB 01

					15 01 00 00 00 00 02 21 1B
					15 01 00 00 00 00 02 22 1B
					15 01 00 00 00 00 02 24 70
					15 01 00 00 00 00 02 25 70

					15 01 00 00 00 00 02 30 2E
					15 01 00 00 00 00 02 31 2E
					15 01 00 00 00 00 02 38 2E
					15 01 00 00 00 00 02 3F 11
					15 01 00 00 00 00 02 40 6D
					15 01 00 00 00 00 02 41 6D
					15 01 00 00 00 00 02 4B 21
					15 01 00 00 00 00 02 4C 6D

					15 01 00 00 00 00 02 66 D8
					15 01 00 00 00 00 02 67 01
					15 01 00 00 00 00 02 68 58
					15 01 00 00 00 00 02 69 10
					15 01 00 00 00 00 02 6B 00
					15 01 00 00 00 00 02 6C 15
					15 01 00 00 00 00 02 71 1D
					15 01 00 00 00 00 02 77 62
					15 01 00 00 00 00 02 7E 15
					15 01 00 00 00 00 02 7F 00
					15 01 00 00 00 00 02 81 00
					15 01 00 00 00 00 02 84 6D
					15 01 00 00 00 00 02 89 00
					15 01 00 00 00 00 02 8D 00
					15 01 00 00 00 00 02 8E 00
					15 01 00 00 00 00 02 BF 00
					15 01 00 00 00 00 02 C0 D5
					15 01 00 00 00 00 02 C1 11
					15 01 00 00 00 00 02 C2 51
					15 01 00 00 00 00 02 C3 00

					15 01 00 00 00 00 02 D9 48
					15 01 00 00 00 00 02 DB 22

					15 01 00 00 00 00 02 FF 26
					15 01 00 00 00 00 02 FB 01

					15 01 00 00 00 00 02 06 FF
					15 01 00 00 00 00 02 12 74
					15 01 00 00 00 00 02 1A 68
					15 01 00 00 00 00 02 1C AF
					15 01 00 00 00 00 02 1E EB
					15 01 00 00 00 00 02 98 F1
					15 01 00 00 00 00 02 A9 11
					15 01 00 00 00 00 02 AA 11
					15 01 00 00 00 00 02 AE 8A

					15 01 00 00 00 00 02 FF 27
					15 01 00 00 00 00 02 FB 01

					15 01 00 00 00 00 02 13 00
					15 01 00 00 00 00 02 1E 15
					15 01 00 00 00 00 02 B3 01
					15 01 00 00 00 00 02 B5 7D
					15 01 00 00 00 00 02 D1 0F
					15 01 00 00 00 00 02 D4 00
					15 01 00 00 00 00 02 D5 21
					15 01 00 00 00 00 02 D6 02
					15 01 00 00 00 00 02 D7 23

					15 01 00 00 00 00 02 FF F0
					15 01 00 00 00 00 02 FB 01
					15 01 00 00 00 00 02 A2 00

					15 01 00 00 00 00 02 FF 20
					15 01 00 00 00 00 02 FB 01
					39 01 00 00 00 00 11 B0 00 10 00 49 00 85 00 AF 00 CE 00 E8 00 FE 01 10
					39 01 00 00 00 00 11 B1 01 21 01 57 01 7D 01 B9 01 E4 02 25 02 4B 02 5E
					39 01 00 00 00 00 11 B2 02 78 02 B8 02 DC 03 1B 03 3A 03 5E 03 6E 03 7C
					39 01 00 00 00 00 0F B3 03 8F 03 A4 03 B7 03 C5 03 CC 03 F6 00 00
					39 01 00 00 00 00 11 B4 00 10 00 49 00 85 00 AF 00 CE 00 E8 00 FE 01 10
					39 01 00 00 00 00 11 B5 01 21 01 57 01 7D 01 B9 01 E4 02 25 02 4B 02 5E
					39 01 00 00 00 00 11 B6 02 78 02 B8 02 DC 03 1B 03 3A 03 5E 03 6E 03 7C
					39 01 00 00 00 00 0F B7 03 8F 03 A4 03 B7 03 C5 03 CC 03 F6 00 00
					39 01 00 00 00 00 11 B8 00 10 00 49 00 85 00 AF 00 CE 00 E8 00 FE 01 10
					39 01 00 00 00 00 11 B9 01 21 01 57 01 7D 01 B9 01 E4 02 25 02 4B 02 5E
					39 01 00 00 00 00 11 BA 02 78 02 B8 02 DC 03 1B 03 3A 03 5E 03 6E 03 7C
					39 01 00 00 00 00 0F BB 03 8F 03 A4 03 B7 03 C5 03 CC 03 F6 00 00

					15 00 00 00 00 00 02 FF 21
					15 00 00 00 00 00 02 FB 01
					39 01 00 00 00 00 11 B0 00 18 00 49 00 85 00 AF 00 CE 00 E8 00 FE 01 10
					39 01 00 00 00 00 11 B1 01 21 01 57 01 7D 01 B9 01 E4 02 2D 02 6D 02 5E
					39 01 00 00 00 00 11 B2 02 AA 02 D8 03 01 03 1B 03 3A 03 5E 03 6E 03 7C
					39 01 00 00 00 00 0F B3 03 8F 03 A4 03 B7 03 C5 03 CC 03 F6 00 00
					39 01 00 00 00 00 11 B4 00 18 00 49 00 85 00 AF 00 CE 00 E8 00 FE 01 10
					39 01 00 00 00 00 11 B5 01 21 01 57 01 7D 01 B9 01 E4 02 2D 02 6D 02 5E
					39 01 00 00 00 00 11 B6 02 AA 02 D8 03 01 03 1B 03 3A 03 5E 03 6E 03 7C
					39 01 00 00 00 00 0F B7 03 8F 03 A4 03 B7 03 C5 03 CC 03 F6 00 00
					39 01 00 00 00 00 11 B8 00 18 00 49 00 85 00 AF 00 CE 00 E8 00 FE 01 10
					39 01 00 00 00 00 11 B9 01 21 01 57 01 7D 01 B9 01 E4 02 2D 02 6D 02 5E
					39 01 00 00 00 00 11 BA 02 AA 02 D8 03 01 03 1B 03 3A 03 5E 03 6E 03 7C
					39 01 00 00 00 00 0F BB 03 8F 03 A4 03 B7 03 C5 03 CC 03 F6 00 00

					15 00 00 00 00 00 02 FF 10

					15 00 00 00 00 00 02 11 00
				];

				qcom,mdss-dsi-on-command-state = "dsi_lp_mode";
				qcom,mdss-dsi-off-command-state = "dsi_lp_mode";
				qcom,mdss-dsi-off-command = [
					05 01 00 00 00 00 02 28 00
					05 01 00 00 43 00 02 10 00	/* wait 67ms: 4frames(0x43) */
				];
			};
		};
	};
};

