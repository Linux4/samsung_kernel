/* Copyright (c) 2013-14, Samsung Electronics Corporation. All rights reserved.
 *
 * This program is free software; you can redistribute it and/or modify
 * it under the terms of the GNU General Public License version 2 and
 * only version 2 as published by the Free Software Foundation.
 *
 * This program is distributed in the hope that it will be useful,
 * but WITHOUT ANY WARRANTY; without even the implied warranty of
 * MERCHANTABILITY or FITNESS FOR A PARTICULAR PURPOSE.  See the
 * GNU General Public License for more details.
 */

/*---------------------------------------------------------------------------
 * This file is autogenerated file using gcdb parser. Please do not edit it.
 * Update input XML file to add a new entry or update variable in this file
 * VERSION = "1.0"
 *---------------------------------------------------------------------------*/
&mdss_mdp {
	ss_dsi_panel_NT36672A_PM6300JB1_FHD: ss_dsi_panel_NT36672A_PM6300JB1_FHD {
		qcom,mdss-dsi-panel-name = "ss_dsi_panel_NT36672A_PM6300JB1_FHD";
		label = "ss_dsi_panel_NT36672A_PM6300JB1_FHD";
		qcom,mdss-dsi-panel-type = "dsi_video_mode";
		qcom,mdss-dsi-virtual-channel-id = <0>;
		qcom,mdss-dsi-stream = <0>;
		qcom,mdss-dsi-bpp = <24>;
		qcom,mdss-dsi-underflow-color = <0xff>;
		qcom,mdss-dsi-border-color = <0>;
		qcom,mdss-dsi-traffic-mode = "non_burst_sync_event";
		qcom,mdss-dsi-bllp-eof-power-mode;
		qcom,mdss-dsi-bllp-power-mode;
		qcom,mdss-dsi-lane-0-state;
		qcom,mdss-dsi-lane-1-state;
		qcom,mdss-dsi-lane-2-state;
		qcom,mdss-dsi-lane-3-state;
		qcom,mdss-dsi-bl-min-level = <1>;
		qcom,mdss-dsi-bl-max-level = <256>;
		qcom,mdss-brightness-max-level = <256>;
		qcom,mdss-brightness-default-level = <255>;
		qcom,mdss-dsi-mdp-trigger = "none";
		qcom,mdss-dsi-dma-trigger = "trigger_sw";

		qcom,mdss-dsi-h-left-border = <0>;
		qcom,mdss-dsi-h-right-border = <0>;
		qcom,mdss-dsi-v-top-border = <0>;
		qcom,mdss-dsi-v-bottom-border = <0>;
		qcom,mdss-dsi-bl-pmic-control-type = "bl_ctrl_dcs";
		qcom,mdss-dsi-reset-sequence = <1 10>, <0 10>, <1 10>;

		qcom,mdss-dsi-h-sync-pulse = <0>;
		qcom,mdss-dsi-pixel-packing = "loose";
		qcom,mdss-dsi-color-order = "rgb_swap_rgb";

		qcom,mdss-pan-physical-width-dimension = <67>; /* 67.068mm */
		qcom,mdss-pan-physical-height-dimension = <145>; /* 145.314mm */

		qcom,mdss-dsi-rx-eot-ignore;
		qcom,mdss-dsi-tx-eot-append;

		qcom,mdss-dsi-t-clk-pre = <0x35>;
		qcom,mdss-dsi-t-clk-post = <0x0E>;

/*		qcom,esd-check-enabled;*/
/*		qcom,mdss-dsi-panel-status-check-mode="reg_read_irq";*/
/*		qcom,mdss-dsi-panel-status-value=<1>;*/
/*		qcom,mdss-dsi-panel-status-irq-trigger1="rising";*/
/*
 * ************************************************************************************************************************************
 *
 *
 *			Below  parameters are samsung dependent thigs
 *
 *
 * ************************************************************************************************************************************
 */
		samsung,support_panel_max = <1>;
		samsung,hw-config = "single_dsi";
		samsung,support_factory_panel_swap;

		samsung,panel-vendor = "CSO";
		/*samsung,tft-module-name = "PM6300JB1";*/
		samsung,tft-common-support;
		samsung,enter_hbm_lux = <20000>;

		/* To use device_resume & device_suspend for optimizing display on time */

/*		samsung,dsi_force_clock_lane_hs;*/

		samsung,wait_after_reset_delay = <10>; /* reset -> 10ms -> send on_cmds */
		samsung,wait_after_sleep_out_delay = <120>; /* send sleep_out cmd (included in on_cmds) -> 120ms -> send display_on (29h) cmd */
		samsung,dsi-lp11-reset-off;

		/* BRIGHTNESS_MAX_PACKET = 50 */
		samsung,brightness_tx_cmds_revA = [
			15 01 00 00 00 00 01 00
			15 01 00 00 00 00 01 00
			15 01 00 00 00 00 01 00
			15 01 00 00 00 00 01 00
			15 01 00 00 00 00 01 00
			15 01 00 00 00 00 01 00
			15 01 00 00 00 00 01 00
			15 01 00 00 00 00 01 00
			15 01 00 00 00 00 01 00
			15 01 00 00 00 00 01 00
			15 01 00 00 00 00 01 00
			15 01 00 00 00 00 01 00
			15 01 00 00 00 00 01 00
			15 01 00 00 00 00 01 00
			15 01 00 00 00 00 01 00
			15 01 00 00 00 00 01 00
			15 01 00 00 00 00 01 00
			15 01 00 00 00 00 01 00
			15 01 00 00 00 00 01 00
			15 01 00 00 00 00 01 00
			15 01 00 00 00 00 01 00
			15 01 00 00 00 00 01 00
			15 01 00 00 00 00 01 00
			15 01 00 00 00 00 01 00
			15 01 00 00 00 00 01 00
			15 01 00 00 00 00 01 00
			15 01 00 00 00 00 01 00
			15 01 00 00 00 00 01 00
			15 01 00 00 00 00 01 00
			15 01 00 00 00 00 01 00
			15 01 00 00 00 00 01 00
			15 01 00 00 00 00 01 00
			15 01 00 00 00 00 01 00
			15 01 00 00 00 00 01 00
			15 01 00 00 00 00 01 00
			15 01 00 00 00 00 01 00
			15 01 00 00 00 00 01 00
			15 01 00 00 00 00 01 00
			15 01 00 00 00 00 01 00
			15 01 00 00 00 00 01 00
			15 01 00 00 00 00 01 00
			15 01 00 00 00 00 01 00
			15 01 00 00 00 00 01 00
			15 01 00 00 00 00 01 00
			15 01 00 00 00 00 01 00
			15 01 00 00 00 00 01 00
			15 01 00 00 00 00 01 00
			15 01 00 00 00 00 01 00
			15 01 00 00 00 00 01 00
			15 01 00 00 00 00 01 00
		];

		samsung,mdnie_tx_cmds_revA = [
			15 01 00 00 00 00 00 00 00
		];

		samsung,reading_mode_tx_cmds_revA = [
			15 01 00 00 00 00 00 00 00
		];
#if 0
		samsung,level1_key_enable_tx_cmds_revA = [
			29 01 00 00 00 00 02 B0 04
		];
		samsung,level1_key_disable_tx_cmds_revA = [
			29 01 00 00 00 00 02 B0 03
		];
#endif
		samsung,packet_size_tx_cmds_revA = [
			37 01 00 00 00 00 02 07 00
		];

		samsung,display_on_tx_cmds_revA = [
			05 01 00 00 00 00 02 29 00
		];

		samsung,display_off_tx_cmds_revA = [05 01 00 00 00 00 02 28 00];

		/*
		 * First parameters can be changed
		 * by function of samsung_nv_read()
		 * because of that means offset of
		 * read position
		 */
		samsung,reg_read_pos_tx_cmds_revA = [
			15 01 00 00 00 00 02 B0 00
		];

		samsung,manufacture_id0_rx_cmds_revA = [06 01 00 00 00 00 01 da 01 00];
		samsung,manufacture_id1_rx_cmds_revA = [06 01 00 00 00 00 01 db 01 00];
		samsung,manufacture_id2_rx_cmds_revA = [06 01 00 00 00 00 01 dc 01 00];
		samsung,manufacture_id_rx_cmds_revA	= [06 01 00 00 00 00 01 04 03 00];

		samsung,mtp_read_sysfs_rx_cmds_revA = [06 01 00 00 00 00 01 00 00 00];
		samsung,mtp_write_sysfs_tx_cmds_revA = [39 01 00 00 00 00 0A 00 00 00 00 00 00 00 00 00 00];

		samsung,tft_pwm_tx_cmds_revA=[
			15 01 00 00 00 00 02 51 FF/*First command should be PWM duty change command*/
		];
		samsung,cabc_on_tx_cmds_revA = [
			15 01 00 00 00 00 02 55 01
		];
		samsung,cabc_off_tx_cmds_revA = [
			15 01 00 00 00 00 02 55 00
		];
		/*
		* ************************************************************************************************************************
		* Scaled level to index mappings
		* ************************************************************************************************************************
		*/
		samsung,candela_map_table_revA = <
			/*<idx>   <from>  <till> <scaled_level> */
			0 0 0 0
			1 1 2 1 /*min*/
			2 3 4 2 /* 7nits */
			3 5 7 4 /* 12nits */
			4 8 10 6 /* 17nits */
			5 11 13 7 /*dimming*/
			6 14 16 9
			7 17 19 11
			8 20 22 13
			9 23 25 14
			10 26 28 15
			11 29 31 16
			12 32 34 17
			13 35 37 18
			14 38 40 19
			15 41 43 20
			16 44 45 21
			17 46 47 22
			18 48 49 23
			19 50 52 24
			20 53 55 26
			21 56 58 28
			22 59 61 30
			23 62 63 31
			24 64 65 32
			25 66 67 33
			26 68 69 34
			27 70 71 35
			28 72 74 36
			29 75 77 37
			30 78 80 38
			31 81 83 39
			32 84 86 40
			33 87 89 41
			34 90 92 42
			35 93 94 43
			36 95 96 44
			37 97 98 45
			38 99 100 46
			39 101 103 47
			40 104 106 48
			41 107 109 49
			42 110 112 50
			43 113 115 51
			44 116 117 52
			45 118 119 53
			46 120 121 54
			47 122 123 55
			48 124 125 56
			49 126 127 57
			50 128 129 58 /*default*/
			51 130 131 59
			52 132 133 61
			53 134 136 63
			54 137 139 66
			55 140 142 69
			56 143 145 72
			57 146 148 76
			58 149 150 79
			59 151 152 83
			60 153 154 87
			61 155 156 91
			62 157 158 95
			63 159 161 99
			64 162 164 103
			65 165 167 107
			66 168 170 109
			67 171 173 111
			68 174 176 115
			69 177 178 119
			70 179 180 122
			71 181 182 126
			72 183 184 130
			73 185 186 133
			74 187 189 136
			75 190 192 140
			76 193 195 143
			77 196 197 146
			78 198 200 148
			79 201 202 150
			80 203 204 152
			81 205 206 154
			82 207 208 155
			83 209 211 156
			84 212 214 157
			85 215 217 158
			86 218 220 159
			87 221 223 160
			88 224 226 161
			89 227 229 163
			90 230 231 165
			91 232 233 167
			92 234 235 169
			93 236 237 171
			94 238 239 173
			95 240 241 175
			96 242 243 177
			97 244 246 178
			98 247 249 179
			99 250 252 180
			100 253 255 181/*max*/
			101 256 256 255/*outdoor 100%*/
		>;

		/*
		* ************************************************************************************************************************
		* MULTI_RESOLUTION (DSC configs were moved all to below timing set)
		* ************************************************************************************************************************
		*/

		qcom,mdss-dsi-display-timings {
			fhd {
				qcom,display-topology = <1 0 1>;
				qcom,default-topology-index = <0>;

				qcom,mdss-dsi-timing-default;

				qcom,mdss-dsi-panel-width = <1080>;
				qcom,mdss-dsi-panel-height = <2340>;
				
				qcom,mdss-dsi-panel-phy-timings = [25 20 09 0a 06 02 04 a0
													25 20 09 0a 06 02 04 a0
													25 20 09 0a 06 02 04 a0
													25 20 09 0a 06 02 04 a0
													25 1e 09 0a 06 02 04 a0];

				qcom,mdss-dsi-panel-framerate = <60>;
				qcom,mdss-dsi-panel-clockrate = <1030000000>;
				qcom,mdss-dsi-h-pulse-width = <48>;
				qcom,mdss-dsi-h-back-porch = <32>;
				qcom,mdss-dsi-h-front-porch = <32>;
				qcom,mdss-dsi-h-sync-skew = <0>;
				qcom,mdss-dsi-v-pulse-width = <4>;
				qcom,mdss-dsi-v-back-porch = <10>;
				qcom,mdss-dsi-v-front-porch = <12>;

				/*qcom,mdss-dsi-timing-switch-command; use samsung,panel_multires_XXX instead*/
				/*qcom,mdss-dsi-timing-switch-command-state;*/

				qcom,mdss-dsi-on-command = [
					// SEC6.3
					15 01 00 00 00 00 02 FF 10
					15 01 00 00 00 00 02 FB 01
					15 01 00 00 00 00 02 FF 20
					15 01 00 00 00 00 02 FB 01
					
					15 01 00 00 00 00 02 07 9E
					15 01 00 00 00 00 02 0F A4
					15 01 00 00 00 00 02 62 B2
					15 01 00 00 00 00 02 6D 44
					15 01 00 00 00 00 02 78 01
					
					15 01 00 00 00 00 02 95 E1	//GVDDP   
					15 01 00 00 00 00 02 96 E1	//GVDDN  
					
					15 01 00 00 00 00 02 FF 24
					15 01 00 00 00 00 02 FB 01
					15 01 00 00 00 00 02 00 1C
					15 01 00 00 00 00 02 01 1C
					15 01 00 00 00 00 02 02 1C
					15 01 00 00 00 00 02 03 0E
					15 01 00 00 00 00 02 04 20
					15 01 00 00 00 00 02 05 1C
					15 01 00 00 00 00 02 06 1C
					15 01 00 00 00 00 02 07 01
					15 01 00 00 00 00 02 08 09
					15 01 00 00 00 00 02 09 1C
					15 01 00 00 00 00 02 0A 0A
					15 01 00 00 00 00 02 0B 0D
					15 01 00 00 00 00 02 0C 1E
					15 01 00 00 00 00 02 0D 03
					15 01 00 00 00 00 02 0E 04
					15 01 00 00 00 00 02 0F 05
					15 01 00 00 00 00 02 10 06
					15 01 00 00 00 00 02 11 1C
					15 01 00 00 00 00 02 12 14
					15 01 00 00 00 00 02 13 12
					15 01 00 00 00 00 02 14 10
					15 01 00 00 00 00 02 15 1C
					15 01 00 00 00 00 02 16 1C
					15 01 00 00 00 00 02 17 1C
					15 01 00 00 00 00 02 18 1C
					15 01 00 00 00 00 02 19 1C
					15 01 00 00 00 00 02 1A 20
					15 01 00 00 00 00 02 1B 20
					15 01 00 00 00 00 02 1C 1C
					15 01 00 00 00 00 02 1D 1C
					15 01 00 00 00 00 02 1E 01
					15 01 00 00 00 00 02 1F 09
					15 01 00 00 00 00 02 20 1C
					15 01 00 00 00 00 02 21 0A
					15 01 00 00 00 00 02 22 0D
					15 01 00 00 00 00 02 23 1E
					15 01 00 00 00 00 02 24 03
					15 01 00 00 00 00 02 25 04
					15 01 00 00 00 00 02 26 05
					15 01 00 00 00 00 02 27 06
					15 01 00 00 00 00 02 28 1C
					15 01 00 00 00 00 02 29 14
					15 01 00 00 00 00 02 2A 12
					15 01 00 00 00 00 02 2B 10
					15 01 00 00 00 00 02 2D 1C
					15 01 00 00 00 00 02 2F 1C
					15 01 00 00 00 00 02 31 04
					15 01 00 00 00 00 02 32 0A
					15 01 00 00 00 00 02 33 04
					15 01 00 00 00 00 02 34 03
					15 01 00 00 00 00 02 37 03
					15 01 00 00 00 00 02 38 6E
					15 01 00 00 00 00 02 39 6E
					15 01 00 00 00 00 02 3F 6E
					15 01 00 00 00 00 02 41 04
					15 01 00 00 00 00 02 42 0A
					15 01 00 00 00 00 02 4C 1C
					15 01 00 00 00 00 02 4D 1C
					15 01 00 00 00 00 02 60 90
					15 01 00 00 00 00 02 61 24
					15 01 00 00 00 00 02 72 00
					15 01 00 00 00 00 02 73 00
					15 01 00 00 00 00 02 74 00
					15 01 00 00 00 00 02 75 00
					15 01 00 00 00 00 02 79 87
					15 01 00 00 00 00 02 7A 0B
					15 01 00 00 00 00 02 7B 9C
					15 01 00 00 00 00 02 7C 80
					15 01 00 00 00 00 02 7D 06
					15 01 00 00 00 00 02 80 45
					15 01 00 00 00 00 02 81 05
					15 01 00 00 00 00 02 82 13
					15 01 00 00 00 00 02 83 22
					15 01 00 00 00 00 02 84 31
					15 01 00 00 00 00 02 85 00
					15 01 00 00 00 00 02 86 00
					15 01 00 00 00 00 02 87 00
					15 01 00 00 00 00 02 88 13
					15 01 00 00 00 00 02 89 22
					15 01 00 00 00 00 02 8A 31
					15 01 00 00 00 00 02 8B 00
					15 01 00 00 00 00 02 8C 00
					15 01 00 00 00 00 02 8D 00
					15 01 00 00 00 00 02 8E F4
					15 01 00 00 00 00 02 8F 01
					15 01 00 00 00 00 02 90 80
					15 01 00 00 00 00 02 92 73
					15 01 00 00 00 00 02 9D B1
					15 01 00 00 00 00 02 B3 0A
					15 01 00 00 00 00 02 B4 04
					15 01 00 00 00 00 02 DC 25
					15 01 00 00 00 00 02 DD 04
					15 01 00 00 00 00 02 DE 02
					15 01 00 00 00 00 02 DF 72
					15 01 00 00 00 00 02 E0 01
					15 01 00 00 00 00 02 EB 0B
											
					15 01 00 00 00 00 02 FF 25
					15 01 00 00 00 00 02 FB 01
					15 01 00 00 00 00 02 21 1C
					15 01 00 00 00 00 02 22 1C
					15 01 00 00 00 00 02 24 73
					15 01 00 00 00 00 02 25 73
					15 01 00 00 00 00 02 30 2F
					15 01 00 00 00 00 02 38 2F
					15 01 00 00 00 00 02 3F 21
					15 01 00 00 00 00 02 40 5F
					15 01 00 00 00 00 02 4B 21
					15 01 00 00 00 00 02 4C 5F
					15 01 00 00 00 00 02 69 10
					15 01 00 00 00 00 02 84 78
					15 01 00 00 00 00 02 85 75
					15 01 00 00 00 00 02 8D 00
					15 01 00 00 00 00 02 BF 00
					15 01 00 00 00 00 02 C2 5A
					15 01 00 00 00 00 02 C3 13
					15 01 00 00 00 00 02 D9 48
					15 01 00 00 00 00 02 DB 22
											
					15 01 00 00 00 00 02 FF 26
					15 01 00 00 00 00 02 FB 01
					15 01 00 00 00 00 02 06 FF
					15 01 00 00 00 00 02 12 75
					15 01 00 00 00 00 02 19 0A
					15 01 00 00 00 00 02 1A F7
					15 01 00 00 00 00 02 1C AF
					15 01 00 00 00 00 02 1E 7A
					15 01 00 00 00 00 02 98 F1
					15 01 00 00 00 00 02 A9 11
					15 01 00 00 00 00 02 AA 11
					15 01 00 00 00 00 02 AE 8A
											
					15 01 00 00 00 00 02 FF 27
					15 01 00 00 00 00 02 FB 01
					15 01 00 00 00 00 02 13 00
					15 01 00 00 00 00 02 1E 14
											
					15 01 00 00 00 00 02 FF F0
					15 01 00 00 00 00 02 FB 01
					15 01 00 00 00 00 02 A2 00
											
					15 01 00 00 00 00 02 FF 20
					15 01 00 00 00 00 02 FB 01
					//R(-)
					39 01 00 00 00 00 11 B0 00 10 00 32 00 65 00 8B 00 A9 00 C2 00 D9 00 EB
					39 01 00 00 00 00 11 B1 00 FB 01 35 01 5E 01 9B 01 C9 02 0E 02 45 02 47
					39 01 00 00 00 00 11 B2 02 6C 02 A8 02 CC 03 0B 03 2A 03 50 03 5D 03 6A
					39 01 00 00 00 00 0D B3 03 7A 03 8A 03 A1 03 B7 03 CE 03 D3
					//G(-)
					39 01 00 00 00 00 11 B4 00 10 00 32 00 65 00 8B 00 A9 00 C2 00 D9 00 EB
					39 01 00 00 00 00 11 B5 00 FB 01 35 01 5E 01 9B 01 C9 02 0E 02 45 02 47
					39 01 00 00 00 00 11 B6 02 6C 02 A8 02 CC 03 0B 03 2A 03 50 03 5D 03 6A
					39 01 00 00 00 00 0D B7 03 7A 03 8A 03 A1 03 B7 03 CE 03 D3
					//B(-)
					39 01 00 00 00 00 11 B8 00 10 00 32 00 65 00 8B 00 A9 00 C2 00 D9 00 EB
					39 01 00 00 00 00 11 B9 00 FB 01 35 01 5E 01 9B 01 C9 02 0E 02 45 02 47
					39 01 00 00 00 00 11 BA 02 6C 02 A8 02 CC 03 0B 03 2A 03 50 03 5D 03 6A
					39 01 00 00 00 00 0D BB 03 7A 03 8A 03 A1 03 B7 03 CE 03 D3
					
					15 01 00 00 00 00 02 FF 21
					15 01 00 00 00 00 02 FB 01
					//R(+)
					39 01 00 00 00 00 11 B0 00 18 00 3A 00 6D 00 93 00 B1 00 CA 00 E1 00 F3
					39 01 00 00 00 00 11 B1 01 03 01 3D 01 66 01 A3 01 D1 02 16 02 4D 02 4F
					39 01 00 00 00 00 11 B2 02 8E 02 CA 02 EE 03 13 03 32 03 58 03 65 03 72
					39 01 00 00 00 00 0D B3 03 82 03 92 03 A9 03 BF 03 D6 03 DB
					//G(+)				 
					39 01 00 00 00 00 11 B4 00 18 00 3A 00 6D 00 93 00 B1 00 CA 00 E1 00 F3
					39 01 00 00 00 00 11 B5 01 03 01 3D 01 66 01 A3 01 D1 02 16 02 4D 02 4F
					39 01 00 00 00 00 11 B6 02 8E 02 CA 02 EE 03 13 03 32 03 58 03 65 03 72
					39 01 00 00 00 00 0D B7 03 82 03 92 03 A9 03 BF 03 D6 03 DB
					//B(+)				 
					39 01 00 00 00 00 11 B8 00 18 00 3A 00 6D 00 93 00 B1 00 CA 00 E1 00 F3
					39 01 00 00 00 00 11 B9 01 03 01 3D 01 66 01 A3 01 D1 02 16 02 4D 02 4F
					39 01 00 00 00 00 11 BA 02 8E 02 CA 02 EE 03 13 03 32 03 58 03 65 03 72
					39 01 00 00 00 00 0D BB 03 82 03 92 03 A9 03 BF 03 D6 03 DB
					
					15 01 00 00 00 00 02 FF 20
					15 01 00 00 00 00 02 FB 01
					15 01 00 00 00 00 02 62 AF
					15 01 00 00 00 00 02 5D 07

					15 01 00 00 00 00 02 FF 24
					15 01 00 00 00 00 02 FB 01
					15 01 00 00 00 00 02 93 0C
					15 01 00 00 00 00 02 94 0E
											
					15 01 00 00 00 00 02 FF 10
					15 01 00 00 00 00 02 FB 01
					15 01 00 00 00 00 02 35 00

					15 01 00 00 00 00 02 FF 23
					15 01 00 00 00 00 02 FB 01
					15 01 00 00 00 00 02 07 00
					15 01 00 00 00 00 02 08 0C
					15 01 00 00 00 00 02 FF 10
					15 01 00 00 00 00 02 FB 01
					15 01 00 00 00 00 02 53 24
					15 01 00 00 00 00 02 51 00
					15 01 00 00 00 00 02 FF 10

					15 01 00 00 00 00 02 11 00
				];

				qcom,mdss-dsi-on-command-state = "dsi_lp_mode";
				qcom,mdss-dsi-off-command-state = "dsi_hs_mode";
				qcom,mdss-dsi-off-command = [
					05 01 00 00 00 00 02 28 00
					05 01 00 00 43 00 02 10 00	/* wait 67ms: 4frames(0x43) */
				];
			};
		};
	};
};

