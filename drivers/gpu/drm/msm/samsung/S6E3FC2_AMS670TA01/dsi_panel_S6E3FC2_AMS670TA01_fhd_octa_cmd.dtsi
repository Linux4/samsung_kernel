/* Copyright (c) 2012, Samsung Electronics Corporation. All rights reserved.
 *
 * This program is free software; you can redistribute it and/or modify
 * it under the terms of the GNU General Public License version 2 and
 * only version 2 as published by the Free Software Foundation.
 *
 * This program is distributed in the hope that it will be useful,
 * but WITHOUT ANY WARRANTY; without even the implied warranty of
 * MERCHANTABILITY or FITNESS FOR A PARTICULAR PURPOSE.  See the
 * GNU General Public License for more details.
 */

&mdss_mdp {
	ss_dsi_panel_S6E3FC2_AMS670TA01_FHD: ss_dsi_panel_S6E3FC2_AMS670TA01_FHD {
		qcom,mdss-dsi-panel-name = "ss_dsi_panel_S6E3FC2_AMS670TA01_FHD";
		label = "ss_dsi_panel_S6E3FC2_AMS670TA01_FHD";

		qcom,mdss-dsi-bpp = <24>;

		/*qcom,cmd-sync-wait-broadcast;*/

		qcom,mdss-dsi-h-pulse-width = <120>;
		qcom,mdss-dsi-h-back-porch = <124>;
		qcom,mdss-dsi-h-front-porch = <120>;
		qcom,mdss-dsi-h-sync-skew = <0>;

		qcom,mdss-dsi-v-pulse-width = <2>;
		qcom,mdss-dsi-v-back-porch = <2>;
		qcom,mdss-dsi-v-front-porch = <16>;

		qcom,mdss-dsi-h-left-border = <0>;
		qcom,mdss-dsi-h-right-border = <0>;
		qcom,mdss-dsi-v-top-border = <0>;
		qcom,mdss-dsi-v-bottom-border = <0>;

		qcom,mdss-dsi-panel-framerate = <60>;
		qcom,mdss-dsi-panel-clockrate = <1200000000>;
		//qcom,mdss-dsi-panel-phy-timings = [00 27 0A 0A 27 25 0A 0B 07 03 04 00];	/* SM7150 : dsi_phy_v3_0 */
		qcom,mdss-dsi-panel-phy-timings = [00 27 0A 0A 27 25 0A 0B 07 02 04 00 20 1A];	/* SM8150 : dsi_phy_v4_0 */

		qcom,mdss-dsi-underflow-color = <0xFF>;
		qcom,mdss-dsi-border-color = <0>;

		qcom,mdss-dsi-bl-pmic-control-type = "bl_ctrl_dcs";

		qcom,mdss-dsi-bl-min-level = <1>;
		qcom,mdss-dsi-bl-max-level = <365>;
		qcom,mdss-brightness-max-level = <365>;
		qcom,mdss-brightness-default-level = <255>;
		qcom,mdss-dsi-interleave-mode = <0>;
		qcom,mdss-dsi-panel-type = "dsi_cmd_mode";

		qcom,mdss-dsi-te-check-enable;
		qcom,mdss-dsi-te-using-te-pin;
		qcom,mdss-dsi-te-pin-select = <1>;

		/*qcom,dynamic-mode-switch-enabled;*/
		/*qcom,dynamic-mode-switch-type = "dynamic-resolution-switch-immediate";*/

		qcom,mdss-dsi-te-dcs-command = <1>;
		qcom,mdss-dsi-wr-mem-start = <0x2C>;
		qcom,mdss-dsi-wr-mem-continue = <0x3C>;

		qcom,mdss-dsi-pixel-packing = "loose";

		qcom,mdss-dsi-virtual-channel-id = <0>;
		qcom,mdss-dsi-color-order = "rgb_swap_rgb";
		qcom,mdss-dsi-lane-0-state;
		qcom,mdss-dsi-lane-1-state;
		qcom,mdss-dsi-lane-2-state;
		qcom,mdss-dsi-lane-3-state;
		//qcom,mdss-dsi-lane-map = "lane_map_0123";

		qcom,mdss-dsi-t-clk-pre = <0x20>;
		qcom,mdss-dsi-t-clk-post = <0x1a>;

		qcom,mdss-dsi-stream = <0>;
		qcom,mdss-dsi-mdp-trigger = "none";
		qcom,mdss-dsi-dma-trigger = "trigger_sw";

		qcom,mdss-pan-physical-width-dimension = <70>; /* 69.87 */
		qcom,mdss-pan-physical-height-dimension = <155>; /* 155.28 */

		qcom,mdss-dsi-reset-sequence = <0 10>, <1 10>;

		/*qcom,mdss-dsi-lp11-init;*/
		/*qcom,mdss-dsi-init-delay-us = <1000>;*/

		qcom,mdss-dsi-rx-eot-ignore;
		qcom,mdss-dsi-tx-eot-append;

		/* HDR Setting */
		qcom,mdss-dsi-panel-hdr-enabled;
		qcom,mdss-dsi-panel-hdr-color-primaries = <15635 16450 34000 16000 13250 34500 7500 3000>;
		qcom,mdss-dsi-panel-peak-brightness = <5400000>;
		qcom,mdss-dsi-panel-average-brightness = <2000000>;
		qcom,mdss-dsi-panel-blackness-level = <2000>;

		qcom,ulps-enabled;
		/* qcom,suspend-ulps-enabled; */
		//qcom,esd-check-enabled;
		//qcom,mdss-dsi-panel-status-check-mode ="irq_check";
		/*qcom,mdss-dsi-panel-status-read-length;*/
		/*qcom,mdss-dsi-panel-status-value;*/
		/*qcom,mdss-dsi-panel-status-irq-trigger1 = "rising";*/
		//qcom,mdss-dsi-panel-status-irq-trigger1 = "falling";

		/* *************************************************************
		 * Below  parameters are samsung dependent thigs
		 * *************************************************************
		 */
		samsung,panel-vendor = "SDC";
		samsung,disp-model = "AMS607TA01";
		samsung,panel-lpm-enable;
		//samsung,support_irc;
		//samsung,elvss_interpolation_temperature = <(-15)>;
		samsung,support_factory_panel_swap;
		//samsung,support_gct;
		//samsung,support_pac;
		//samsung,support_gpara;
		// samsung,support_poc_driver;
		//samsung,support_dynamic_mipi_clk;
		//samsung,pll_ssc_disabled;
		samsung,disp_en_gpio_use;

		/* *************************************************************
		 *  Tx
		 * *************************************************************
		 */
		samsung,level0_key_enable_tx_cmds_revA	= [29 01 00 00 00 00 03 9F A5 A5]; /* PASSWD0 */
		samsung,level0_key_disable_tx_cmds_revA	= [29 01 00 00 00 00 03 9F 5A 5A]; /* PASSWD0 */
		samsung,level1_key_enable_tx_cmds_revA	= [29 01 00 00 00 00 03 F0 5A 5A]; /* PASSWD1 */
		samsung,level1_key_disable_tx_cmds_revA	= [29 01 00 00 00 00 03 F0 A5 A5]; /* PASSWD1 */
		samsung,level2_key_enable_tx_cmds_revA	= [29 01 00 00 00 00 03 FC 5A 5A];
		samsung,level2_key_disable_tx_cmds_revA	= [29 01 00 00 00 00 03 FC A5 A5];

		/* BRIGHTNESS_MAX_PACKET = 50 */
		samsung,brightness_tx_cmds_revA = [
			39 01 00 00 00 00 01 00
			39 01 00 00 00 00 01 00
			39 01 00 00 00 00 01 00
			39 01 00 00 00 00 01 00
			39 01 00 00 00 00 01 00
			39 01 00 00 00 00 01 00
			39 01 00 00 00 00 01 00
			39 01 00 00 00 00 01 00
			39 01 00 00 00 00 01 00
			39 01 00 00 00 00 01 00
			39 01 00 00 00 00 01 00
			39 01 00 00 00 00 01 00
			39 01 00 00 00 00 01 00
			39 01 00 00 00 00 01 00
			39 01 00 00 00 00 01 00
			39 01 00 00 00 00 01 00
			39 01 00 00 00 00 01 00
			39 01 00 00 00 00 01 00
			39 01 00 00 00 00 01 00
			39 01 00 00 00 00 01 00
			39 01 00 00 00 00 01 00
			39 01 00 00 00 00 01 00
			39 01 00 00 00 00 01 00
			39 01 00 00 00 00 01 00
			39 01 00 00 00 00 01 00
			39 01 00 00 00 00 01 00
			39 01 00 00 00 00 01 00
			39 01 00 00 00 00 01 00
			39 01 00 00 00 00 01 00
			39 01 00 00 00 00 01 00
			39 01 00 00 00 00 01 00
			39 01 00 00 00 00 01 00
			39 01 00 00 00 00 01 00
			39 01 00 00 00 00 01 00
			39 01 00 00 00 00 01 00
			39 01 00 00 00 00 01 00
			39 01 00 00 00 00 01 00
			39 01 00 00 00 00 01 00
			39 01 00 00 00 00 01 00
			39 01 00 00 00 00 01 00
			39 01 00 00 00 00 01 00
			39 01 00 00 00 00 01 00
			39 01 00 00 00 00 01 00
			39 01 00 00 00 00 01 00
			39 01 00 00 00 00 01 00
			39 01 00 00 00 00 01 00
			39 01 00 00 00 00 01 00
			39 01 00 00 00 00 01 00
			39 01 00 00 00 00 01 00
			39 01 00 00 00 00 01 00
		];

		//samsung,mdnie_tx_cmds_revA = [
		//	39 01 00 00 00 00 00 00 00
		//];

		//amsung,packet_size_tx_cmds_revA = [
		//7 01 00 00 00 00 02 07 00
		//];

		//samsung,reg_read_pos_tx_cmds_revA = [
		//	15 01 00 00 00 00 02 B0 00
		//];

		//samsung,manufacture_read_pre_tx_cmds_revA = [
		//	05 01 00 00 14 00 02 11 00			/* Sleep out, wait 20ms(0x14) */
		//];

		samsung,display_on_tx_cmds_revA = [
			05 01 00 00 00 00 02 29 00
		];

		samsung,display_off_tx_cmds_revA = [05 01 00 00 00 00 02 28 00];

		/* *************************************************************
		 *  Rx (Module Information READ)
		 * *************************************************************
		 */
		samsung,mdnie_read_rx_cmds_revA		= [06 01 00 00 00 00 01 A1 04 00]; /* White color position */
		samsung,manufacture_date_rx_cmds_revA	= [06 01 00 00 00 00 01 A1 04 04]; /* manufacture data 4 byte*/
		samsung,octa_id_rx_cmds_revA		= [06 01 00 00 00 00 01 A1 14 0E]; /* manufacture information */
		samsung,cell_id_rx_cmds_revA		= [06 01 00 00 00 00 01 A1 07 04]; /* manufacture data 7 byte*/

		samsung,manufacture_id0_rx_cmds_revA	= [06 01 00 00 00 00 01 da 01 00];
		samsung,manufacture_id1_rx_cmds_revA	= [06 01 00 00 00 00 01 db 01 00];
		samsung,manufacture_id2_rx_cmds_revA	= [06 01 00 00 00 00 01 dc 01 00];

		//samsung,smart_dimming_mtp_rx_cmds_revA	= [06 01 00 00 00 00 01 c8 20 00];

		//samsung,ldi_debug0_rx_cmds_revA		= [06 01 00 00 00 00 01 0A 01 00]; /* rddpm */
		//samsung,ldi_debug1_rx_cmds_revA		= [06 01 00 00 00 00 01 0E 01 00]; /* no operation */
		//samsung,ldi_debug2_rx_cmds_revA		= [06 01 00 00 00 00 01 0E 01 00]; /* errfg */
		//samsung,ldi_debug3_rx_cmds_revA		= [06 01 00 00 00 00 01 0E 01 00]; /* rddsm*/
		//samsung,ldi_debug4_rx_cmds_revA		= [06 01 00 00 00 00 01 05 01 00]; /* dsierr */
		//samsung,ldi_debug5_rx_cmds_revA		= [06 01 00 00 00 00 01 0F 01 00]; /* self_diag*/

		/* 255 bytes, its ddi max size is 512, and sw limit is 0xff = 255... */
		//samsung,ldi_debug_logbuf_rx_cmds_revA	= [06 01 00 00 00 00 01 9C FF 00];

		samsung,mtp_read_sysfs_rx_cmds_revA	= [06 01 00 00 00 00 01 00 00 00];

		/* *************************************************************
		 *  SELF DISPLAY
		 * *************************************************************
		 */
		//samsung,support_self_display;
		//ss,self_display = <&self_display_FA7_AMS628RF05_dtsi>;

		/* *************************************************************
		 * ACL command list and mappings
		 * **************************************************************
		 */
		samsung,acl_on_tx_cmds_revA = [
			29 01 00 00 00 00 02 B0 D8	/* Global Para */
			29 01 00 00 00 00 02 B9 02	/* HBM ACL OFF */
			/* 32 frame AVG ACL ON, Start 50%, ACL 15%, 32Frame AVG */
			29 01 00 00 00 00 02 55 03	/* ACL ON */
		];

		samsung,acl_off_tx_cmds_revA = [
			/* 16 Frame AVG ACL OFF, Start Point 60%, ACL 0%*/
			29 01 00 00 00 00 02 55 00	/* ACL OFF */
		];

		samsung,elvss_rx_cmds_revA = [ 06 01 00 00 00 00 01 B7 02 08];	/* read B7 9th, 10th para */

		/* *************************************************************
		 * Dynamic MIPI Clock
		 * **************************************************************
		 */

		samsung,ffc_tx_cmds_revA = [
			29 00 00 00 00 00 03 F0 5A 5A
			//29 00 00 00 00 00 16 DF 0B 30 95 3F F5 05 00 26 D0 2E 4F 7A 77 10 3D 73 00 FF 01 8B 08	/* 1143 Mbps (571.5) : Default */
			29 00 00 00 00 00 16 DF 0B 30 95 3C EB 05 00 26 D0 2E 4F 7A 77 10 3D 73 00 FF 01 8B 08	/* 1.2 GBps  */
			29 01 00 00 00 00 03 F0 A5 A5
		];

		samsung,dyn_mipi_clk_ffc_cmds_revA = [
			29 00 00 00 00 00 16 DF 0B 30 95 3F F5 05 00 26 D0 2E 4F 7A 77 10 3D 73 00 FF 01 8B 08	/* 0 : 1143    Mbps (571.5)  */
			29 00 00 00 00 00 16 DF 0B 30 95 3F 8A 05 00 26 D0 2E 4F 7A 77 10 3D 73 00 FF 01 8B 08	/* 1 : 1150.5 Mbps (572.25) */
			29 00 00 00 00 00 16 DF 0B 30 95 3F 2F 05 00 26 D0 2E 4F 7A 77 10 3D 73 00 FF 01 8B 08	/* 2 : 1157    Mbps (578.5)  */
			29 00 00 00 00 00 16 DF 0B 30 95 3E 23 05 00 26 D0 2E 4F 7A 77 10 3D 73 00 FF 01 8B 08	/* 3 : 1176.5 Mbps (588.25) */
			29 00 00 00 00 00 16 DF 0B 30 95 3F F5 05 00 26 D0 2E 4F 7A 77 10 3D 73 00 FF 01 8B 08	/* 4 : 1143    Mbps (571.5)  */
		];

		samsung,dynamic_mipi_clk_timing_table = <
			/*<bitclk><>*/
			1143000000 /* clk id 0 default */
			1150500000 /* clk id 1 A */
			1157000000 /* clk id 2 B */
			1176500000 /* clk id 3 C */
			1143000000 /* clk id 4 D */
		>;

		samsung,dynamic_mipi_clk_sel_table = <
			/*<RAT><BAND><from><end><clk index>*/
			1	1	0	0	4
			1	2	0	0	2
			1	3	0	0	3
			1	4	0	0	4
			2	11	10562	10665	4
			2	11	10666	10796	2
			2	11	10797	10838	4
			2	12	9662	9776	1
			2	12	9777	9832	2
			2	12	9833	9938	4
			2	13	1162	1234	2
			2	13	1235	1361	4
			2	13	1362	1475	2
			2	13	1476	1513	4
			2	14	1537	1640	4
			2	14	1641	1738	2
			2	15	4357	4458	4
			2	17	2237	2331	2
			2	17	2332	2409	4
			2	17	2410	2496	1
			2	17	2497	2563	2
			2	18	2937	3011	4
			2	18	3012	3088	3
			3	91	0	231	4
			3	91	232	493	2
			3	91	494	599	4
			3	92	600	854	1
			3	92	855	965	2
			3	92	966	1199	4
			3	93	1200	1369	2
			3	93	1370	1623	4
			3	93	1624	1851	2
			3	93	1852	1949	4
			3	94	1950	2181	4
			3	94	2182	2399	2
			3	95	2400	2649	4
			3	97	2750	2964	2
			3	97	2965	3119	4
			3	97	3120	3294	1
			3	97	3295	3449	2
			3	98	3450	3624	4
			3	98	3625	3799	3
			3	102	5010	5179	4
			3	103	5180	5279	3
			3	104	5280	5379	3
			3	107	5730	5849	4
			3	108	5850	5947	3
			3	108	5948	5999	4
			3	109	6000	6149	4
			3	110	6150	6236	4
			3	110	6237	6449	3
			3	111	6450	6599	4
			3	115	8040	8294	1
			3	115	8295	8405	2
			3	115	8406	8642	4
			3	115	8643	8689	1
			3	116	8690	8798	3
			3	116	8799	9039	4
			3	118	9210	9361	3
			3	118	9362	9600	4
			3	118	9601	9659	2
			3	119	9660	9738	3
			3	119	9739	9769	4
			3	120	9770	9869	4
			3	122	9920	10160	1
			3	122	10161	10244	2
			3	122	10245	10359	3
			3	124	36200	36349	4
			3	128	37750	37982	2
			3	128	37983	38143	4
			3	128	38144	38249	1
			3	129	38250	38524	1
			3	129	38525	38649	2
			3	130	38650	38889	4
			3	130	38890	39172	2
			3	130	39173	39367	4
			3	130	39368	39649	2
			3	131	39650	39831	4
			3	131	39832	40080	3
			3	131	40081	40307	4
			3	131	40308	40571	3
			3	131	40572	40783	4
			3	131	40784	41061	3
			3	131	41062	41259	4
			3	131	41260	41434	1
			3	131	41435	41589	2
			3	132	41590	41804	3
			3	132	41805	42005	1
			3	132	42006	42294	3
			3	132	42295	42484	1
			3	132	42485	42732	4
			3	132	42733	42963	1
			3	132	42964	43208	4
			3	132	43209	43443	1
			3	132	43444	43589	4
			3	138	55240	55425	3
			3	138	55426	55593	1
			3	138	55594	55835	4
			3	138	55836	56072	1
			3	138	56073	56311	4
			3	138	56312	56551	1
			3	138	56552	56739	4
			3	156	66436	66667	4
			3	156	66668	66929	2
			3	156	66930	67143	4
			3	156	67144	67335	2
			3	161	68586	68698	3
			3	161	68699	68935	4
			4	51	0	0	4
			4	52	0	0	3
			4	53	0	0	4
			4	54	0	0	3
			4	55	0	0	4
			4	56	0	0	4
			5	61	0	0	4
			5	62	0	0	4
			5	71	0	0	3
		>;

		/* *************************************************************
		 * candela to index mappings
		 * **************************************************************
		 */
		samsung,candela_map_table_revA = < /* THIS TABLE USED FOR DIMMING */
		/*<idx>	  <from>  <till> <scaled_level> */
			0		0		0		3
			1		1		1		6
			2		2		2		9
			3		3		3		12
			4		4		4		15
			5		5		5		18
			6		6		6		21
			7		7		7		24
			8		8		8		27
			9		9		9		30
			10		10		10		33
			11		11		11		36
			12		12		12		39
			13		13		13		42
			14		14		14		45
			15		15		15		48
			16		16		16		53
			17		17		17		56
			18		18		18		60
			19		19		19		63
			20		20		20		67
			21		21		21		70
			22		22		22		74
			23		23		23		77
			24		24		24		81
			25		25		25		84
			26		26		26		88
			27		27		27		91
			28		28		28		95
			29		29		29		98
			30		30		30		102
			31		31		31		105
			32		32		32		109
			33		33		33		112
			34		34		34		116
			35		35		35		120
			36		36		36		123
			37		37		37		127
			38		38		38		130
			39		39		39		134
			40		40		40		137
			41		41		41		141
			42		42		42		144
			43		43		43		148
			44		44		44		151
			45		45		45		155
			46		46		46		158
			47		47		47		162
			48		48		48		165
			49		49		49		169
			50		50		50		172
			51		51		51		176
			52		52		52		179
			53		53		53		183
			54		54		54		186
			55		55		55		190
			56		56		56		193
			57		57		57		197
			58		58		58		200
			59		59		59		204
			60		60		60		207
			61		61		61		211
			62		62		62		214
			63		63		63		218
			64		64		64		221
			65		65		65		225
			66		66		66		228
			67		67		67		232
			68		68		68		235
			69		69		69		239
			70		70		70		242
			71		71		71		246
			72		72		72		249
			73		73		73		253
			74		74		74		257
			75		75		75		260
			76		76		76		264
			77		77		77		267
			78		78		78		271
			79		79		79		274
			80		80		80		278
			81		81		81		281
			82		82		82		285
			83		83		83		288
			84		84		84		292
			85		85		85		295
			86		86		86		299
			87		87		87		302
			88		88		88		306
			89		89		89		309
			90		90		90		313
			91		91		91		316
			92		92		92		320
			93		93		93		323
			94		94		94		327
			95		95		95		330
			96		96		96		334
			97		97		97		337
			98		98		98		341
			99		99		99		344
			100		100		100		348
			101		101		101		351
			102		102		102		355
			103		103		103		358
			104		104		104		362
			105		105		105		365
			106		106		106		369
			107		107		107		372
			108		108		108		376
			109		109		109		379
			110		110		110		383
			111		111		111		387
			112		112		112		390
			113		113		113		394
			114		114		114		397
			115		115		115		401
			116		116		116		404
			117		117		117		408
			118		118		118		411
			119		119		119		415
			120		120		120		418
			121		121		121		422
			122		122		122		425
			123		123		123		429
			124		124		124		432
			125		125		125		436
			126		126		126		439
			127		127		127		443
			128		128		128		445
			129		129		129		451
			130		130		130		456
			131		131		131		460
			132		132		132		465
			133		133		133		470
			134		134		134		474
			135		135		135		479
			136		136		136		483
			137		137		137		488
			138		138		138		492
			139		139		139		497
			140		140		140		500
			141		141		141		506
			142		142		142		510
			143		143		143		515
			144		144		144		520
			145		145		145		524
			146		146		146		529
			147		147		147		533
			148		148		148		538
			149		149		149		542
			150		150		150		547
			151		151		151		551
			152		152		152		556
			153		153		153		561
			154		154		154		565
			155		155		155		570
			156		156		156		574
			157		157		157		579
			158		158		158		583
			159		159		159		588
			160		160		160		592
			161		161		161		597
			162		162		162		601
			163		163		163		606
			164		164		164		611
			165		165		165		615
			166		166		166		620
			167		167		167		624
			168		168		168		629
			169		169		169		633
			170		170		170		638
			171		171		171		642
			172		172		172		647
			173		173		173		652
			174		174		174		656
			175		175		175		661
			176		176		176		665
			177		177		177		670
			178		178		178		674
			179		179		179		679
			180		180		180		683
			181		181		181		688
			182		182		182		693
			183		183		183		697
			184		184		184		702
			185		185		185		706
			186		186		186		711
			187		187		187		715
			188		188		188		720
			189		189		189		724
			190		190		190		729
			191		191		191		733
			192		192		192		738
			193		193		193		743
			194		194		194		747
			195		195		195		752
			196		196		196		756
			197		197		197		761
			198		198		198		765
			199		199		199		770
			200		200		200		774
			201		201		201		779
			202		202		202		784
			203		203		203		788
			204		204		204		793
			205		205		205		797
			206		206		206		802
			207		207		207		806
			208		208		208		811
			209		209		209		815
			210		210		210		820
			211		211		211		825
			212		212		212		829
			213		213		213		834
			214		214		214		838
			215		215		215		843
			216		216		216		847
			217		217		217		852
			218		218		218		856
			219		219		219		861
			220		220		220		865
			221		221		221		870
			222		222		222		875
			223		223		223		879
			224		224		224		884
			225		225		225		888
			226		226		226		893
			227		227		227		897
			228		228		228		902
			229		229		229		906
			230		230		230		911
			231		231		231		916
			232		232		232		920
			233		233		233		925
			234		234		234		929
			235		235		235		934
			236		236		236		938
			237		237		237		943
			238		238		238		947
			239		239		239		952
			240		240		240		956
			241		241		241		961
			242		242		242		966
			243		243		243		970
			244		244		244		975
			245		245		245		979
			246		246		246		984
			247		247		247		988
			248		248		248		993
			249		249		249		997
			250		250		250		1002
			251		251		251		1007
			252		252		252		1011
			253		253		253		1016
			254		254		254		1020
			255		255		255		1023
			256		256		256		5
			257		257		257		9
			258		258		258		12
			259		259		259		16
			260		260		260		20
			261		261		261		23
			262		262		262		27
			263		263		263		31
			264		264		264		34
			265		265		265		38
			266		266		266		42
			267		267		267		45
			268		268		268		49
			269		269		269		53
			270		270		270		55
			271		271		271		60
			272		272		272		64
			273		273		273		67
			274		274		274		71
			275		275		275		75
			276		276		276		78
			277		277		277		82
			278		278		278		86
			279		279		279		89
			280		280		280		93
			281		281		281		97
			282		282		282		100
			283		283		283		104
			284		284		284		108
			285		285		285		111
			286		286		286		115
			287		287		287		119
			288		288		288		123
			289		289		289		126
			290		290		290		130
			291		291		291		134
			292		292		292		137
			293		293		293		141
			294		294		294		145
			295		295		295		148
			296		296		296		152
			297		297		297		156
			298		298		298		159
			299		299		299		163
			300		300		300		167
			301		301		301		170
			302		302		302		174
			303		303		303		178
			304		304		304		181
			305		305		305		185
			306		306		306		189
			307		307		307		192
			308		308		308		196
			309		309		309		200
			310		310		310		203
			311		311		311		207
			312		312		312		211
			313		313		313		214
			314		314		314		218
			315		315		315		222
			316		316		316		225
			317		317		317		229
			318		318		318		233
			319		319		319		236
			320		320		320		240
			321		321		321		244
			322		322		322		247
			323		323		323		251
			324		324		324		255
			325		325		325		258
			326		326		326		262
			327		327		327		266
			328		328		328		269
			329		329		329		273
			330		330		330		277
			331		331		331		280
			332		332		332		284
			333		333		333		288
			334		334		334		291
			335		335		335		295
			336		336		336		299
			337		337		337		302
			338		338		338		306
			339		339		339		310
			340		340		340		313
			341		341		341		317
			342		342		342		321
			343		343		343		325
			344		344		344		328
			345		345		345		332
			346		346		346		336
			347		347		347		339
			348		348		348		343
			349		349		349		347
			350		350		350		350
			351		351		351		354
			352		352		352		358
			353		353		353		361
			354		354		354		365
			355		355		355		369
			356		356		356		372
			357		357		357		376
			358		358		358		380
			359		359		359		383
			360		360		360		387
			361		361		361		391
			362		362		362		394
			363		363		363		398
			364		364		364		402
			365		365		365		404
		>;

		samsung,aod_candela_map_table_revA = <
			/*<idx>   <from>  <till> <candella> */
			0	0	39	2
			1	40	70	10
			2	71	93	30
			3	94	255	60
		>;

		samsung,gamma_mode2_tx_cmds_revA=[
			39 00 00 00 00 00 02 53 28
			39 00 00 00 00 00 30 B7 00 01 53 28 4D 00 90 04 00 00 1D 00 00 01 01 02 02 42 43 43 43 43 43 83 C3 83 C3 83 C3 03 03 03 03 03 03 03 03 03 00 00 00 00 00 00 00 00 00
			39 01 00 00 00 00 03 51 03 FF
		]; /* B7 9th para:(Normal Elvss Offset),10th para:(HBM Elvss Offset) OTP, 47th para: TSET */

		/*
		 * ************************************************************************************************************************
		 *  FD Settings
		 * ************************************************************************************************************************
		 */

		samsung,fd_on_tx_cmds_revA = [
			29 01 00 00 00 00 03 F1 5A 5A	/* TEST KEY Enable */
			29 01 00 00 00 00 02 D0 08
			29 01 00 00 00 00 03 F1 A5 A5
			29 01 00 00 00 00 03 F0 5A 5A
			29 01 00 00 00 00 02 B0 03
			29 01 00 00 00 00 02 CD 04
			29 01 00 00 00 00 03 F0 A5 A5	/* TEST KEY Disable */
		];

		samsung,fd_off_tx_cmds_revA = [
			29 01 00 00 00 00 03 F1 5A 5A	/* TEST KEY Enable */
			29 01 00 00 00 00 02 D0 08
			29 01 00 00 00 00 03 F1 A5 A5
			29 01 00 00 00 00 03 F0 5A 5A
			29 01 00 00 00 00 02 B0 03
			29 01 00 00 00 00 02 CD 08
			29 01 00 00 00 00 03 F0 A5 A5	/* TEST KEY Disable */
		];

		/* *************************************************************
		 *  HMT
		 * **************************************************************
		 */
		samsung,hmt_enabled;
		samsung,hmt_aid_tx_cmds_revA = [
			29 01 00 00 00 00 04 B9 01 E5 40	// AOR 80 %
		];

		samsung,hmt_gamma_mode2_bright_tx_cmds_revA = [
			29 01 00 00 00 00 03 51 02 74		// 130
		];

		samsung,hmt_candela_map_table_revA = <
		/*<idx>	  <from>  <till> <candella> */
			0	0	3	268
			1	4	6	278
			2	7	10	288
			3	11	13	298
			4	14	17	308
			5	18	21	318
			6	22	24	328
			7	25	28	338
			8	29	31	348
			9	32	35	358
			10	36	39	368
			11	40	42	378
			12	43	46	388
			13	47	49	398
			14	50	53	408
			15	54	57	418
			16	58	60	428
			17	61	64	438
			18	65	68	448
			19	69	71	458
			20	72	75	468
			21	76	78	478
			22	79	82	488
			23	83	86	498
			24	87	89	508
			25	90	93	518
			26	94	96	528
			27	97	100	538
			28	101	104	548
			29	105	107	558
			30	108	111	568
			31	112	114	578
			32	115	118	588
			33	119	122	598
			34	123	125	608
			35	126	129	618
			36	130	132	628
			37	133	136	638
			38	137	140	648
			39	141	143	658
			40	144	147	668
			41	148	150	678
			42	151	154	688
			43	155	158	698
			44	159	161	708
			45	162	165	718
			46	166	169	728
			47	170	172	738
			48	173	176	748
			49	177	179	758
			50	180	183	768
			51	184	187	778
			52	188	190	788
			53	191	194	798
			54	195	197	808
			55	198	201	818
			56	202	205	828
			57	206	208	838
			58	209	212	848
			59	213	215	858
			60	216	219	868
			61	220	223	878
			62	224	226	888
			63	227	230	898
			64	231	233	908
			65	234	237	918
			66	238	241	928
			67	242	244	938
			68	245	248	948
			69	249	251	958
			70	252	254	968
			71	255	255	975
		>;

		samsung,hmt_enable_tx_cmds_revA = [
			29 01 00 00 00 00 03 F0 5A 5A
			29 01 00 00 00 00 02 B0 60 		// Global Para
			29 01 00 00 00 00 04 B9 01 E5 40	// AOR 80 %
			29 01 00 00 00 00 75 C0			// AID Setting
				00 00 02 03 00 0E 00 00
				00 00 00 00 00 00 00 00 00
				00 50 00 00 40 44 00 51 00
				00 00 20 07 25 35 46 00 18
				00 00 00 00 F0 0B 7A C4 00
				00 00 00 FC 7F 7F 7F F6 98
				EF FD E6 DD A5 E1 8B EC FD
				FD FD 9D FF 6A 0F 68 FD 6D
				51 BC DD DD 00 00 0F 00 00
				20 00 00 00 00 00 00 00 00
				00 00 00 00 70 29 00 00 04
				29 37 20 90 00 00 00 00 00
				06 8A 00 00 00 00 00 00 00
			29 01 00 00 00 00 03 C0 00 01
			29 01 00 00 00 00 03 F0 A5 A5
		];

		samsung,hmt_disable_tx_cmds_revA = [
			29 01 00 00 00 00 03 F0 5A 5A
			29 01 00 00 00 00 02 B0 60 		// Global Para
			29 01 00 00 00 00 04 B9 00 18 4A	// AOR 0 %
			29 01 00 00 00 00 75 C0			// AID Setting
				00 00 02 0B 00 06 00 00
				00 00 00 00 00 00 00 00 00
				00 50 00 00 40 44 00 51 00
				00 00 20 07 25 35 46 00 00
				00 00 00 00 F0 0B 7A C4 00
				00 00 00 FC 7F 7F 7F F6 98
				EF FD E6 DD A5 E1 8B EC FD
 				FD FD 1D FF 6A 0F 68 FD 6D
				51 BC DD DD 00 00 0F 00 00
				20 00 00 00 00 00 00 00 00
				00 00 00 00 70 29 00 00 04
				29 37 20 90 00 00 00 00 00
				06 8A 00 00 00 00 00 00 00
			29 01 00 00 00 00 03 C0 00 01
			29 01 00 00 00 00 03 F0 A5 A5
		];

		/* *************************************************************
		 *   APLPM
		 * *************************************************************
		 */

		samsung,lpm_on_tx_cmds_revA = [
			/* Image write for HLPM/ALPM Mode */
			29 00 00 00 00 00 03 F0 5A 5A	/* TEST KEY Enable */
			29 00 00 00 00 00 02 B0 A5	/*Global Para */
			29 01 00 00 00 00 02 C7 00	/* 00-HLPM 01-ALPM */
			29 00 00 00 00 00 02 B0 69	/*Global Para */
			29 00 00 00 00 00 03 B9 01 89	/*HLPM AOR SETTING */
			29 00 00 00 01 00 02 53 00	/*HLPM On Setting */
			29 01 00 00 00 00 03 F0 A5 A5	/* TEST KEY Disable */
		];

		samsung,lpm_off_tx_cmds_revA = [
			/* Image write for Normal Mode */
			29 00 00 00 00 00 03 F0 5A 5A	/* TEST KEY Enable */
			29 00 00 00 01 00 02 53 28	/* ALPM/HLPM off */
			29 01 00 00 00 00 03 F0 A5 A5	/* TEST KEY Disable */
		];

		/* ALPM/HLPM 2nit or 60nit On Commands */
		samsung,lpm_2nit_tx_cmds_revA = [29 01 00 00 00 00 02 53 23];
		samsung,lpm_10nit_tx_cmds_revA = [29 01 00 00 00 00 02 53 22];
		samsung,lpm_30nit_tx_cmds_revA = [29 01 00 00 00 00 02 53 22];
		samsung,lpm_60nit_tx_cmds_revA = [29 01 00 00 00 00 02 53 22];

		/* HLPM / ALPM Control Commands */
		samsung,lpm_ctrl_hlpm_2nit_tx_cmds_revA	= [29 01 00 00 00 00 03 B9 80 C9];
		samsung,lpm_ctrl_hlpm_10nit_tx_cmds_revA	= [29 01 00 00 00 00 03 B9 80 C9];
		samsung,lpm_ctrl_hlpm_30nit_tx_cmds_revA	= [29 01 00 00 00 00 03 B9 50 C9];
		samsung,lpm_ctrl_hlpm_60nit_tx_cmds_revA	= [29 01 00 00 00 00 03 B9 01 89];

		/* HLPM / ALPM brightness Commands: default alpm 2nit */
		samsung,lpm_brightnes_tx_cmds_revA = [
			29 00 00 00 00 00 03 F0 5A 5A	/* TEST KEY Enable */
			29 00 00 00 00 00 02 53 22
			29 00 00 00 00 00 02 B0 69		/*Global Para */
			29 00 00 00 00 00 03 B9 01 89
			29 01 00 00 00 00 03 F0 A5 A5
		];

		/* AOR Control(97.3%) Commands */
		//samsung,lpm_ctrl_hlpm_off_tx_cmds_revA		= [29 01 00 00 00 00 02 53 20];
		samsung,lpm-init-delay-ms = <124>; /* used AOD Sequnce. error flag case: Panel OFF => AOD ON case */

		/*
		* ************************************************************************************************************************
		*  DMS (Dynamic Mode Switch)
		* ************************************************************************************************************************
		*/

		qcom,mdss-dsi-display-timings {
			fhd {
				qcom,display-topology = <1 0 1>;
				qcom,default-topology-index = <0>;
				qcom,mdss-dsi-timing-default;
				qcom,mdss-dsi-panel-width = <1080>;
				qcom,mdss-dsi-panel-height = <2400>;

				qcom,mdss-dsi-h-pulse-width = <120>;
				qcom,mdss-dsi-h-back-porch = <124>;
				qcom,mdss-dsi-h-front-porch = <120>;
				qcom,mdss-dsi-h-sync-skew = <0>;

				qcom,mdss-dsi-v-pulse-width = <2>;
				qcom,mdss-dsi-v-back-porch = <2>;
				qcom,mdss-dsi-v-front-porch = <16>;

				qcom,mdss-dsi-panel-framerate = <60>;

				qcom,mdss-dsi-panel-clockrate = <1200000000>; /* 1200Mhz*/
				//qcom,mdss-dsi-panel-phy-timings = [00 27 0A 0A 27 25 0A 0B 07 03 04 00];		/* SM7150 : dsi_phy_v3_0 */
				qcom,mdss-dsi-panel-phy-timings = [00 27 0A 0A 27 25 0A 0B 07 02 04 00 20 1A];	/* SM8150 : dsi_phy_v4_0 */

				/*qcom,mdss-dsi-timing-switch-command; use samsung,panel_multires_XXX instead*/
				/*qcom,mdss-dsi-timing-switch-command-state;*/

				qcom,mdss-dsi-t-clk-pre = <0x20>;
				qcom,mdss-dsi-t-clk-post = <0x1a>;

				/*only for factory binary*/
				qcom,mdss-fd-on-command = [
					29 01 00 00 00 00 03 F1 5A 5A	/* TEST KEY Enable */
					29 01 00 00 00 00 02 D0 08
					29 01 00 00 00 00 03 F1 A5 A5
					29 01 00 00 00 00 03 F0 5A 5A
					29 01 00 00 00 00 02 B0 03
					29 01 00 00 00 00 02 CD 04
					29 01 00 00 00 00 03 F0 A5 A5	/* TEST KEY Disable */
				];

				qcom,mdss-dsi-on-command = [
					/* Sleep out, wait 120ms(0x78) */
					05 01 00 00 78 00 02 11 00

					/* TE Vsync On */
					29 00 00 00 00 00 03 F0 5A 5A
					29 00 00 00 00 00 02 35 00
					29 00 00 00 00 00 03 F0 A5 A5

					/* PAGE Address Setting */
					29 00 00 00 00 00 05 2A 00 00 04 37
					29 00 00 00 00 00 05 2B 00 00 09 5F

					/* FFC Setting */
					29 00 00 00 00 00 03 F0 5A 5A
					29 00 00 00 00 00 16 DF 0B 30 95 3C EB 05 00 26 D0 2E 4F 7A 77 10 3D 73 00 FF 01 8B 08	/* 1.2 GBps  */
					29 00 00 00 00 00 03 F0 A5 A5

					/* ERR_FG Setting */
					29 00 00 00 00 00 03 F0 5A 5A
					29 00 00 00 00 00 03 FC 5A 5A
					29 00 00 00 00 00 03 ED 00 4C
					29 00 00 00 00 00 03 F0 A5 A5
					29 00 00 00 00 00 03 FC A5 A5

					/* Partial update (MIC Setting) */
					29 00 00 00 00 00 03 F0 5A 5A
					29 00 00 00 00 00 0A EB 1B 41 B0 0E 00 1E 5A 1E 1E
					29 00 00 00 00 00 03 F0 A5 A5

					/* Brightness */
					29 00 00 00 00 00 03 F0 5A 5A
					29 00 00 00 00 00 02 53 20			/* Normal Transition */
					39 00 00 00 00 00 09 B7 00 01 53 28 4D 00 90 04
					29 00 00 00 00 00 03 51 03 FF		/* MAX Brightness */
					29 01 00 00 00 00 03 F0 A5 A5
				];

				qcom,mdss-dsi-off-command=[
					05 01 00 00 14 00 02 28 00
					05 00 00 00 00 00 02 10 00	/* wait 120ms(0x78) */
					29 00 00 00 00 00 03 F0 5A 5A
					29 00 00 00 00 00 02 B0 05
					29 00 00 00 00 00 02 F4 01
					29 01 00 00 78 00 03 F0 A5 A5
				];

				qcom,mdss-dsi-on-command-state = "dsi_lp_mode";
				qcom,mdss-dsi-off-command-state = "dsi_hs_mode";

				qcom,partial-update-enabled = "single_roi";
				qcom,panel-roi-alignment=<360 60 360 60 360 60>;
			};
		};
	};
};
