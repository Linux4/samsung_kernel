/* Copyright (c) 2012, Samsung Electronics Corporation. All rights reserved.
 *
 * This program is free software; you can redistribute it and/or modify
 * it under the terms of the GNU General Public License version 2 and
 * only version 2 as published by the Free Software Foundation.
 *
 * This program is distributed in the hope that it will be useful,
 * but WITHOUT ANY WARRANTY; without even the implied warranty of
 * MERCHANTABILITY or FITNESS FOR A PARTICULAR PURPOSE.  See the
 * GNU General Public License for more details.
 */

&mdss_mdp {
	ss_dsi_panel_S6E3FC2_AMS670TA01_FHD {

		qcom,mdss-dsi-panel-phy-timings = [27 22 0B 0D 07 02 04 a0
										27 22 0B 0D 07 02 04 a0
										27 22 0B 0D 07 02 04 a0
										27 22 0B 0D 07 02 04 a0
										27 22 0B 0D 07 02 04 a0];

		qcom,mdss-dsi-t-clk-pre = <0x3E>;
		qcom,mdss-dsi-t-clk-post = <0x10>;
		/*
		* ************************************************************************************************************************
		*  DMS (Dynamic Mode Switch)
		* ************************************************************************************************************************
		*/

		qcom,mdss-dsi-display-timings {
			fhd {
		qcom,mdss-dsi-panel-phy-timings = [27 22 0B 0D 07 02 04 a0
										27 22 0B 0D 07 02 04 a0
										27 22 0B 0D 07 02 04 a0
										27 22 0B 0D 07 02 04 a0
										27 22 0B 0D 07 02 04 a0];

				qcom,mdss-dsi-t-clk-pre = <0x3E>;
				qcom,mdss-dsi-t-clk-post = <0x10>;
				
			};
		};
	};
};
