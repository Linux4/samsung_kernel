/* Copyright (c) 2012, Samsung Electronics Corporation. All rights reserved.
 *
 * This program is free software; you can redistribute it and/or modify
 * it under the terms of the GNU General Public License version 2 and
 * only version 2 as published by the Free Software Foundation.
 *
 * This program is distributed in the hope that it will be useful,
 * but WITHOUT ANY WARRANTY; without even the implied warranty of
 * MERCHANTABILITY or FITNESS FOR A PARTICULAR PURPOSE.  See the
 * GNU General Public License for more details.
 */

&soc {
	self_display_FA9_dtsi: self_display_FA9_dtsi {
		label = "self_display_FA9_dtsi";

		/*
		 *************************************************************************************************************************
		 * Self Display Operation (Enable/Disable)
		 *************************************************************************************************************************
		 */

		samsung,self_dispaly_on = [ // AOD ENTER
			29 01 00 00 00 00 03 F0 5A 5A	/* TEST KEY Enable */
			29 01 00 00 00 00 03 75 00 01
			29 01 00 00 00 00 03 F0 A5 A5	/* TEST KEY Disable */
		];

		samsung,self_dispaly_off = [ // AOD EXIT
			29 01 00 00 00 00 03 F0 5A 5A	/* TEST KEY Enable */
			29 01 00 00 00 00 03 75 00 00
			29 01 00 00 00 00 02 85 00	/* Partial HLPM & Scan Off */
			29 01 00 00 00 00 03 F0 A5 A5	/* TEST KEY Disable */
		];

		/*
		 *************************************************************************************************************************
		 * Self Display Operation (SELF MASK)
		 *************************************************************************************************************************
		//ss_send_cmd(vdd, TX_LEVEL1_KEY_ENABLE);
		//ss_send_cmd(vdd, TX_SELF_MASK_SET_PRE);
		//ss_send_cmd(vdd, TX_SELF_MASK_IMAGE);
		//ss_send_cmd(vdd, TX_SELF_MASK_SET_POST);
		//ss_send_cmd(vdd, TX_LEVEL1_KEY_DISABLE);
		 */

		samsung,self_mask_setting_pre = [
			29 01 00 00 00 00 02 75 10	/* MA_SEL(1), IC_SEL, VI_SEL, DC_SEL, AC_SEL */
			/* image data (4C,5C) ... */
		];

		samsung,self_mask_setting_post = [
			29 01 00 00 00 00 02 75 00	/* MA_SEL(0), IC_SEL, VI_SEL, DC_SEL, AC_SEL */
		];

		samsung,self_mask_on = [
			29 01 00 00 00 00 03 F0 5A 5A	/* TEST KEY Enable */
			29 01 00 00 00 00 1C 7A
					23 00 00 00 95 07 9E 09
					5F 01 00 07 9E 03 00 08
					CA 0A 10 00 00 00 00 00
					0F FC 00
			29 01 00 00 00 00 03 F0 A5 A5	/* TEST KEY Disable */
		];

		samsung,self_mask_on_factory = [
			29 01 00 00 00 00 03 F0 5A 5A	/* TEST KEY Enable */
			29 01 00 00 00 00 14 7A
					23 09 60 09 F5 09 F6 0A
					8B 00 00 00 00 00 00 00
					00 0A 10
			29 01 00 00 00 00 03 F0 A5 A5	/* TEST KEY Disable */
		];

		samsung,self_mask_off = [
			29 01 00 00 00 00 03 F0 5A 5A	/* TEST KEY Enable  */
			29 01 00 00 00 00 02 7A 00	/* SM_MASK_EN(0)  */
			29 01 00 00 00 00 03 F0 A5 A5	/* TEST KEY Disable */
		];

		samsung,self_mask_green_circle_on_factory = [
			29 01 00 00 00 00 03 F0 5A 5A
			29 01 00 00 00 00 1C 7A
					21 00 00 00 95 07 9E 09
					5F 01 00 07 9E 03 00 08
					CA 0A 10 00 00 00 00 00 
					0F FC 00
			29 01 00 00 00 00 03 F0 A5 A5
		];

		samsung,self_mask_green_circle_off_factory = [
			29 01 00 00 00 00 03 F0 5A 5A
			29 01 00 00 00 00 14 7A
					23 09 60 09 F5 09 F6 0A
					8B 00 00 00 00 00 00 00
					00 0A 10
			29 01 00 00 00 00 03 F0 A5 A5
		];

		/*
		 *************************************************************************************************************************
		 * Self Display Operation (SELF PARTIAL HLPM/SCAN)
		 *************************************************************************************************************************
		 */

		samsung,self_partial_hlpm_scan_set = [
			29 01 00 00 00 00 03 F0 5A 5A	/* TEST KEY Enable */
			29 01 00 00 00 00 11 85
					03 1B 0F 0F 00 00 00 00 00
					00 00 00 00 00 00 00 00 00
			29 01 00 00 00 00 03 F0 A5 A5	/* TEST KEY Disable */
		];

		/*
		 *************************************************************************************************************************
		 * Self Display Operation (DEBUGGING FEATURE)
		 *************************************************************************************************************************
		 */

		samsung,self_disp_debug_rx_cmds = [ 06 01 00 00 00 00 01 7F 21 00];	/* read 7F 1st ~ 33th */
	};
};
