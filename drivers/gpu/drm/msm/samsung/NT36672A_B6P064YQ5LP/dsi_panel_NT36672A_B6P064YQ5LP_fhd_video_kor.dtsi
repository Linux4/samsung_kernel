/* Copyright (c) 2013-14, Samsung Electronics Corporation. All rights reserved.
 *
 * This program is free software; you can redistribute it and/or modify
 * it under the terms of the GNU General Public License version 2 and
 * only version 2 as published by the Free Software Foundation.
 *
 * This program is distributed in the hope that it will be useful,
 * but WITHOUT ANY WARRANTY; without even the implied warranty of
 * MERCHANTABILITY or FITNESS FOR A PARTICULAR PURPOSE.  See the
 * GNU General Public License for more details.
 */

/*---------------------------------------------------------------------------
 * This file is autogenerated file using gcdb parser. Please do not edit it.
 * Update input XML file to add a new entry or update variable in this file
 * VERSION = "1.0"
 *---------------------------------------------------------------------------*/
&mdss_mdp {
	ss_dsi_panel_NT36672A_B6P064YQ5LP_FHD: ss_dsi_panel_NT36672A_B6P064YQ5LP_FHD {
		qcom,mdss-dsi-t-clk-pre = <0x31>;
		qcom,mdss-dsi-t-clk-post = <0x0E>;

		qcom,mdss-dsi-display-timings {
			timing@0{
				qcom,display-topology = <1 0 1>;
				qcom,default-topology-index = <0>;

				qcom,mdss-dsi-timing-default;

				qcom,mdss-dsi-panel-width = <1080>;
				qcom,mdss-dsi-panel-height = <2340>;
				qcom,mdss-dsi-panel-phy-timings = [00 20 08 08 24 23 08 08 05 03 04 00];

				qcom,mdss-dsi-panel-framerate = <60>;
				qcom,mdss-dsi-panel-clockrate = <946000000>; // 946 Mbps for KOR
				qcom,mdss-dsi-h-pulse-width = <2>;
				qcom,mdss-dsi-h-back-porch = <16>;
				qcom,mdss-dsi-h-front-porch = <12>;
				qcom,mdss-dsi-h-sync-skew = <0>;
				qcom,mdss-dsi-v-pulse-width = <2>;
				qcom,mdss-dsi-v-back-porch = <12>;
				qcom,mdss-dsi-v-front-porch = <14>;

				/*qcom,mdss-dsi-timing-switch-command; use samsung,panel_multires_XXX instead*/
				/*qcom,mdss-dsi-timing-switch-command-state;*/

				qcom,mdss-dsi-on-command = [
					15 01 00 00 00 00 02 FF 10
					15 01 00 00 00 00 02 FB 01
					15 01 00 00 00 00 02 B0 01 // burst noise issue improve

					15 01 00 00 00 00 02 FF 20
					15 01 00 00 00 00 02 FB 01
					15 01 00 00 00 00 02 06 99
					15 01 00 00 00 00 02 07 A3
					15 01 00 00 00 00 02 0E AB
					15 01 00 00 00 00 02 0F AE
					15 01 00 00 00 00 02 62 B0 // OSC control
					15 01 00 00 00 00 02 6D 44
					15 01 00 00 00 00 02 78 01
					15 01 00 00 00 00 02 95 E1
					15 01 00 00 00 00 02 96 E1

					15 01 00 00 00 00 02 FF 24
					15 01 00 00 00 00 02 FB 01

					15 01 00 00 00 00 02 00 1C
					15 01 00 00 00 00 02 01 1C
					15 01 00 00 00 00 02 02 1C
					15 01 00 00 00 00 02 03 1C
					15 01 00 00 00 00 02 04 1C
					15 01 00 00 00 00 02 05 1C
					15 01 00 00 00 00 02 06 1C
					15 01 00 00 00 00 02 07 1C
					15 01 00 00 00 00 02 08 1C
					15 01 00 00 00 00 02 09 01
					15 01 00 00 00 00 02 0A 0A
					15 01 00 00 00 00 02 0B 09
					15 01 00 00 00 00 02 0C 20
					15 01 00 00 00 00 02 0D 0E
					15 01 00 00 00 00 02 0E 24
					15 01 00 00 00 00 02 0F 0D
					15 01 00 00 00 00 02 10 04
					15 01 00 00 00 00 02 11 03
					15 01 00 00 00 00 02 12 1C
					15 01 00 00 00 00 02 13 1E
					15 01 00 00 00 00 02 14 10
					15 01 00 00 00 00 02 15 12
					15 01 00 00 00 00 02 16 14
					15 01 00 00 00 00 02 17 1C
					15 01 00 00 00 00 02 18 1C
					15 01 00 00 00 00 02 19 1C
					15 01 00 00 00 00 02 1A 1C
					15 01 00 00 00 00 02 1B 1C
					15 01 00 00 00 00 02 1C 1C
					15 01 00 00 00 00 02 1D 1C
					15 01 00 00 00 00 02 1E 1C
					15 01 00 00 00 00 02 1F 1C
					15 01 00 00 00 00 02 20 01
					15 01 00 00 00 00 02 21 0A
					15 01 00 00 00 00 02 22 09
					15 01 00 00 00 00 02 23 20
					15 01 00 00 00 00 02 24 0E
					15 01 00 00 00 00 02 25 24
					15 01 00 00 00 00 02 26 0D
					15 01 00 00 00 00 02 27 04
					15 01 00 00 00 00 02 28 03
					15 01 00 00 00 00 02 29 1E
					15 01 00 00 00 00 02 2A 10
					15 01 00 00 00 00 02 2B 12
					15 01 00 00 00 00 02 2D 14
					15 01 00 00 00 00 02 4D 9F

					15 01 00 00 00 00 02 31 02
					15 01 00 00 00 00 02 32 03
					15 01 00 00 00 00 02 33 0A
					15 01 00 00 00 00 02 34 05
					15 01 00 00 00 00 02 37 00
					15 01 00 00 00 00 02 38 68
					15 01 00 00 00 00 02 39 68
					15 01 00 00 00 00 02 3F 68
					15 01 00 00 00 00 02 41 02
					15 01 00 00 00 00 02 42 03

					15 01 00 00 00 00 02 60 90
					15 01 00 00 00 00 02 61 24

					15 01 00 00 00 00 02 72 00
					15 01 00 00 00 00 02 73 00
					15 01 00 00 00 00 02 74 00
					15 01 00 00 00 00 02 75 00
					15 01 00 00 00 00 02 79 00
					15 01 00 00 00 00 02 7A 07
					15 01 00 00 00 00 02 7B 1B
					15 01 00 00 00 00 02 7D 05
					15 01 00 00 00 00 02 80 42
					15 01 00 00 00 00 02 82 13
					15 01 00 00 00 00 02 83 22
					15 01 00 00 00 00 02 84 31
					15 01 00 00 00 00 02 85 00
					15 01 00 00 00 00 02 86 00
					15 01 00 00 00 00 02 87 00
					15 01 00 00 00 00 02 88 13
					15 01 00 00 00 00 02 89 22
					15 01 00 00 00 00 02 8A 31
					15 01 00 00 00 00 02 8B 00
					15 01 00 00 00 00 02 8C 00
					15 01 00 00 00 00 02 8D 00
					15 01 00 00 00 00 02 8E F4
					15 01 00 00 00 00 02 8F 01
					15 01 00 00 00 00 02 EB 07

					15 01 00 00 00 00 02 90 80 // RTN setting
					15 01 00 00 00 00 02 92 70
					15 01 00 00 00 00 02 93 0E
					15 01 00 00 00 00 02 94 0E

					15 01 00 00 00 00 02 9D B1

					15 01 00 00 00 00 02 B3 02
					15 01 00 00 00 00 02 B4 00
					15 01 00 00 00 00 02 B5 04

					15 01 00 00 00 00 02 DC 25
					15 01 00 00 00 00 02 DD 02
					15 01 00 00 00 00 02 DE 00
					15 01 00 00 00 00 02 DF 01

					15 01 00 00 00 00 02 E0 01
					15 01 00 00 00 00 02 E1 2B

					15 01 00 00 00 00 02 FF 25
					15 01 00 00 00 00 02 FB 01

					15 01 00 00 00 00 02 18 96 // burst noise issue improve
					15 01 00 00 00 00 02 19 0F

					15 01 00 00 00 00 02 21 1B
					15 01 00 00 00 00 02 22 1B
					15 01 00 00 00 00 02 24 70
					15 01 00 00 00 00 02 25 70

					15 01 00 00 00 00 02 30 2E // GOFF & GPWT setting
					15 01 00 00 00 00 02 31 2E
					15 01 00 00 00 00 02 38 2E
					15 01 00 00 00 00 02 3F 11
					15 01 00 00 00 00 02 40 81
					15 01 00 00 00 00 02 41 81
					15 01 00 00 00 00 02 4B 21
					15 01 00 00 00 00 02 4C 81

					15 01 00 00 00 00 02 66 D8
					15 01 00 00 00 00 02 67 01
					15 01 00 00 00 00 02 68 58
					15 01 00 00 00 00 02 69 10
					15 01 00 00 00 00 02 6B 00
					15 01 00 00 00 00 02 6C 15
					15 01 00 00 00 00 02 71 1D
					15 01 00 00 00 00 02 77 62
					15 01 00 00 00 00 02 7E 15
					15 01 00 00 00 00 02 7F 00
					15 01 00 00 00 00 02 81 00
					15 01 00 00 00 00 02 84 6D
					15 01 00 00 00 00 02 89 00
					15 01 00 00 00 00 02 8D 00
					15 01 00 00 00 00 02 8E 00
					15 01 00 00 00 00 02 BF 00
					15 01 00 00 00 00 02 C0 D5
					15 01 00 00 00 00 02 C1 11
					15 01 00 00 00 00 02 C2 51
					15 01 00 00 00 00 02 C3 00

					15 01 00 00 00 00 02 D9 48
					15 01 00 00 00 00 02 DB 22

					15 01 00 00 00 00 02 FF 26
					15 01 00 00 00 00 02 FB 01

					15 01 00 00 00 00 02 06 FF // TP timing
					15 01 00 00 00 00 02 12 74
					15 01 00 00 00 00 02 19 0C
					15 01 00 00 00 00 02 1A 06
					15 01 00 00 00 00 02 1C AF
					15 01 00 00 00 00 02 1D 0B
					15 01 00 00 00 00 02 1E 89
					15 01 00 00 00 00 02 98 F1
					15 01 00 00 00 00 02 A9 11
					15 01 00 00 00 00 02 AA 11
					15 01 00 00 00 00 02 AE 8A

					15 01 00 00 00 00 02 FF 27
					15 01 00 00 00 00 02 FB 01

					15 01 00 00 00 00 02 13 00
					15 01 00 00 00 00 02 1E 15
					15 01 00 00 00 00 02 B3 01
					15 01 00 00 00 00 02 B5 7D
					15 01 00 00 00 00 02 D1 0F
					15 01 00 00 00 00 02 D4 00
					15 01 00 00 00 00 02 D5 21
					15 01 00 00 00 00 02 D6 02
					15 01 00 00 00 00 02 D7 23

					15 01 00 00 00 00 02 FF F0
					15 01 00 00 00 00 02 FB 01
					15 01 00 00 00 00 02 A2 00

					15 01 00 00 00 00 02 FF 20
					15 01 00 00 00 00 02 FB 01
					39 01 00 00 00 00 11 B0 00 10 00 49 00 85 00 AF 00 CE 00 E8 00 FE 01 10
					39 01 00 00 00 00 11 B1 01 21 01 57 01 7D 01 B9 01 E4 02 25 02 4B 02 5E
					39 01 00 00 00 00 11 B2 02 78 02 B8 02 DA 03 1B 03 3A 03 5E 03 6E 03 7C
					39 01 00 00 00 00 0F B3 03 8F 03 A4 03 B7 03 C5 03 CC 03 F6 00 00
					39 01 00 00 00 00 11 B4 00 10 00 49 00 85 00 AF 00 CE 00 E8 00 FE 01 10
					39 01 00 00 00 00 11 B5 01 21 01 57 01 7D 01 B9 01 E4 02 25 02 4B 02 5E
					39 01 00 00 00 00 11 B6 02 78 02 B8 02 DA 03 1B 03 3A 03 5E 03 6E 03 7C
					39 01 00 00 00 00 0F B7 03 8F 03 A4 03 B7 03 C5 03 CC 03 F6 00 00
					39 01 00 00 00 00 11 B8 00 10 00 49 00 85 00 AF 00 CE 00 E8 00 FE 01 10
					39 01 00 00 00 00 11 B9 01 21 01 57 01 7D 01 B9 01 E4 02 25 02 4B 02 5E
					39 01 00 00 00 00 11 BA 02 78 02 B8 02 DA 03 1B 03 3A 03 5E 03 6E 03 7C
					39 01 00 00 00 00 0F BB 03 8F 03 A4 03 B7 03 C5 03 CC 03 F6 00 00

					15 01 00 00 00 00 02 FF 21
					15 01 00 00 00 00 02 FB 01
					39 01 00 00 00 00 11 B0 00 18 00 49 00 85 00 AF 00 CE 00 E8 00 FE 01 10
					39 01 00 00 00 00 11 B1 01 21 01 57 01 7D 01 B9 01 E4 02 2D 02 6D 02 5E
					39 01 00 00 00 00 11 B2 02 AA 02 D8 03 03 03 1B 03 3A 03 5E 03 6E 03 7C
					39 01 00 00 00 00 0F B3 03 8F 03 A4 03 B7 03 C5 03 CC 03 F6 00 00
					39 01 00 00 00 00 11 B4 00 18 00 49 00 85 00 AF 00 CE 00 E8 00 FE 01 10
					39 01 00 00 00 00 11 B5 01 21 01 57 01 7D 01 B9 01 E4 02 2D 02 6D 02 5E
					39 01 00 00 00 00 11 B6 02 AA 02 D8 03 03 03 1B 03 3A 03 5E 03 6E 03 7C
					39 01 00 00 00 00 0F B7 03 8F 03 A4 03 B7 03 C5 03 CC 03 F6 00 00
					39 01 00 00 00 00 11 B8 00 18 00 49 00 85 00 AF 00 CE 00 E8 00 FE 01 10
					39 01 00 00 00 00 11 B9 01 21 01 57 01 7D 01 B9 01 E4 02 2D 02 6D 02 5E
					39 01 00 00 00 00 11 BA 02 AA 02 D8 03 03 03 1B 03 3A 03 5E 03 6E 03 7C
					39 01 00 00 00 00 0F BB 03 8F 03 A4 03 B7 03 C5 03 CC 03 F6 00 00

					15 01 00 00 00 00 02 FF 10//?

					15 01 00 00 00 00 02 FF 23
					15 01 00 00 00 00 02 FB 01
					15 01 00 00 00 00 02 07 00
					15 01 00 00 00 00 02 08 0A
					15 01 00 00 00 00 02 FF 10
					15 01 00 00 00 00 02 FB 01
					15 01 00 00 00 00 02 53 24
					15 01 00 00 00 00 02 51 00

					15 01 00 00 00 00 02 FF 10
					15 01 00 00 00 00 02 11 00
				];

				qcom,mdss-dsi-on-command-state = "dsi_lp_mode";
				qcom,mdss-dsi-off-command-state = "dsi_lp_mode";
				qcom,mdss-dsi-off-command = [
					05 01 00 00 00 00 02 28 00
					05 01 00 00 43 00 02 10 00	/* wait 67ms: 4frames(0x43) */
				];
			};
		};
	};
};
