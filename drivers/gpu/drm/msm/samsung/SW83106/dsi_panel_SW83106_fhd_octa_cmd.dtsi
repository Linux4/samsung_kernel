/* Copyright (c) 2012, Samsung Electronics Corporation. All rights reserved.
 *
 * This program is free software; you can redistribute it and/or modify
 * it under the terms of the GNU General Public License version 2 and
 * only version 2 as published by the Free Software Foundation.
 *
 * This program is distributed in the hope that it will be useful,
 * but WITHOUT ANY WARRANTY; without even the implied warranty of
 * MERCHANTABILITY or FITNESS FOR A PARTICULAR PURPOSE.  See the
 * GNU General Public License for more details.
 */

&mdss_mdp {
	ss_dsi_panel_SW83106_FHD: ss_dsi_panel_SW83106_FHD {
		qcom,mdss-dsi-panel-name = "ss_dsi_panel_SW83106_FHD";
		label = "ss_dsi_panel_SW83106_FHD";

		qcom,mdss-dsi-bpp = <24>;

		qcom,mdss-dsi-h-pulse-width = <32>;
		qcom,mdss-dsi-h-back-porch = <20>;
		qcom,mdss-dsi-h-front-porch = <20>;
		qcom,mdss-dsi-h-sync-skew = <0>;

		qcom,mdss-dsi-v-pulse-width = <4>;
		qcom,mdss-dsi-v-back-porch = <20>;
		qcom,mdss-dsi-v-front-porch = <40>;

		qcom,mdss-dsi-h-left-border = <0>;
		qcom,mdss-dsi-h-right-border = <0>;
		qcom,mdss-dsi-v-top-border = <0>;
		qcom,mdss-dsi-v-bottom-border = <0>;

		qcom,mdss-dsi-panel-framerate = <60>;
		qcom,mdss-dsi-panel-clockrate = <1176000000>;
		qcom,mdss-dsi-panel-phy-timings = [00 27 0A 0A 27 25 0A 0A 07 02 04 00];		/* SM7150 : dsi_phy_v3_0 */

		qcom,mdss-dsi-underflow-color = <0xFF>;
		qcom,mdss-dsi-border-color = <0>;

		qcom,mdss-dsi-bl-pmic-control-type = "bl_ctrl_dcs";

		qcom,mdss-dsi-bl-min-level = <1>;
		qcom,mdss-dsi-bl-max-level = <425>;
		qcom,mdss-brightness-max-level = <425>;
		qcom,mdss-brightness-default-level = <255>;
		qcom,mdss-dsi-interleave-mode = <0>;
		qcom,mdss-dsi-panel-type = "dsi_cmd_mode";

		qcom,mdss-dsi-te-pin-select = <1>;

		qcom,mdss-dsi-te-dcs-command = <1>;
		qcom,mdss-dsi-wr-mem-start = <0x2C>;
		qcom,mdss-dsi-wr-mem-continue = <0x3C>;

		qcom,mdss-dsi-pixel-packing = "loose";

		qcom,mdss-dsi-virtual-channel-id = <0>;
		qcom,mdss-dsi-color-order = "rgb_swap_rgb";
		qcom,mdss-dsi-lane-0-state;
		qcom,mdss-dsi-lane-1-state;
		qcom,mdss-dsi-lane-2-state;
		qcom,mdss-dsi-lane-3-state;
		qcom,mdss-dsi-lane-map = "lane_map_0123";

		qcom,mdss-dsi-t-clk-pre = <0x3B>;
		qcom,mdss-dsi-t-clk-post = <0x0F>;

		qcom,mdss-dsi-stream = <0>;
		qcom,mdss-dsi-mdp-trigger = "none";
		qcom,mdss-dsi-dma-trigger = "trigger_sw";

		qcom,mdss-pan-physical-width-dimension = <70>;
		qcom,mdss-pan-physical-height-dimension = <155>;

		/*samsung,mdss-dsi-off-reset-delay-us = <1000>;*/
		qcom,mdss-dsi-reset-sequence = <0 10>, <1 10>;

		samsung,mdss-reset-before-dsi-off; /*used for power off sequence Reset off-> (LP11->LP00) -> VCI(VPNL) off -> VDDI Off in panel SW83106 */
		samsung,mdss-reset-after-dsi-on;   /*used for power on sequence VDDI On -> VCI(VPNL) On -> min 1ms -> (LP00->LP11)  -> Reset On in panel SW83106 */

		/*samsung,mdss-dsi-poweroff-delay;*/
		/*qcom,mdss-dsi-lp11-init;
		qcom,mdss-dsi-init-delay-us = <1000>;*/

		qcom,mdss-dsi-rx-eot-ignore;
		qcom,mdss-dsi-tx-eot-append;

		/* *************************************************************
		 * Below  parameters are samsung dependent things
		 * *************************************************************
		 */
		samsung,panel-vendor = "CST";
		samsung,disp-model = "SW83106";
		samsung,support_factory_panel_swap;
		samsung,ub-fd-on-count = <25>;
		samsung,ub-fd-off-count = <26>;


		/* *************************************************************
		 * GRAM Checksum Test (Memory checksum test)
		 * *************************************************************
		 */
		samsung,support_gct;

		samsung,gct_checksum_rx_cmds_revA = [06 01 00 00 00 00 01 FE 04 00]; /*read memory checksum 3rd and 4th para */

		samsung,gct_enter_tx_cmds_revA = [	/*memory check enable*/
			39 01 00 00 00 00 02 B0 A1
			39 01 00 00 00 00 05 BB 27 12 08 80
			39 01 00 00 00 00 02 B0 A6
			39 01 00 00 14 00 0A FB 00 09 00 FF 43 04 00 00 00 /*delay 20 ms*/
		];

		samsung,gct_exit_tx_cmds_revA = [	/*memory check disable*/
			39 01 00 00 00 00 02 B0 A1
			39 01 00 00 00 00 05 BB 27 10 08 80
		];

		/* *************************************************************
		 *  Tx
		 * *************************************************************
		 */

		samsung,level1_key_enable_tx_cmds_revA	= [29 01 00 00 00 00 02 B0 A5]; /*Level 6 key open*/
		samsung,level2_key_enable_tx_cmds_revA	= [29 01 00 00 00 00 02 B0 A6]; /*Level 6 key open*/


		/* BRIGHTNESS_MAX_PACKET = 50 */
		samsung,brightness_tx_cmds_revA = [
			39 01 00 00 00 00 01 00
			39 01 00 00 00 00 01 00
			39 01 00 00 00 00 01 00
			39 01 00 00 00 00 01 00
			39 01 00 00 00 00 01 00
			39 01 00 00 00 00 01 00
			39 01 00 00 00 00 01 00
			39 01 00 00 00 00 01 00
			39 01 00 00 00 00 01 00
			39 01 00 00 00 00 01 00
			39 01 00 00 00 00 01 00
			39 01 00 00 00 00 01 00
			39 01 00 00 00 00 01 00
			39 01 00 00 00 00 01 00
			39 01 00 00 00 00 01 00
			39 01 00 00 00 00 01 00
			39 01 00 00 00 00 01 00
			39 01 00 00 00 00 01 00
			39 01 00 00 00 00 01 00
			39 01 00 00 00 00 01 00
			39 01 00 00 00 00 01 00
			39 01 00 00 00 00 01 00
			39 01 00 00 00 00 01 00
			39 01 00 00 00 00 01 00
			39 01 00 00 00 00 01 00
			39 01 00 00 00 00 01 00
			39 01 00 00 00 00 01 00
			39 01 00 00 00 00 01 00
			39 01 00 00 00 00 01 00
			39 01 00 00 00 00 01 00
			39 01 00 00 00 00 01 00
			39 01 00 00 00 00 01 00
			39 01 00 00 00 00 01 00
			39 01 00 00 00 00 01 00
			39 01 00 00 00 00 01 00
			39 01 00 00 00 00 01 00
			39 01 00 00 00 00 01 00
			39 01 00 00 00 00 01 00
			39 01 00 00 00 00 01 00
			39 01 00 00 00 00 01 00
			39 01 00 00 00 00 01 00
			39 01 00 00 00 00 01 00
			39 01 00 00 00 00 01 00
			39 01 00 00 00 00 01 00
			39 01 00 00 00 00 01 00
			39 01 00 00 00 00 01 00
			39 01 00 00 00 00 01 00
			39 01 00 00 00 00 01 00
			39 01 00 00 00 00 01 00
			39 01 00 00 00 00 01 00
		];


		samsung,display_on_tx_cmds_revA = [
			05 01 00 00 00 00 02 29 00
		];

		samsung,display_off_tx_cmds_revA = [05 01 00 00 00 00 02 28 00];

		/* *************************************************************
		 *  Rx (Module Information READ)
		 * *************************************************************
		 */

		samsung,ddi_id_rx_cmds_revA		= [06 01 00 00 00 00 01 F1 0A 00]; /* CHIP ID : read F1h 1~10th -> unique for each DDI  */
		samsung,cell_id_rx_cmds_revA	= [06 01 00 00 00 00 01 DD 0D 00]; /* CELL ID : read DDh 1~13th -> unique data for each UB module*/

		samsung,manufacture_id0_rx_cmds_revA	= [06 01 00 00 00 00 01 da 01 00];
		samsung,manufacture_id1_rx_cmds_revA	= [06 01 00 00 00 00 01 db 01 00];
		samsung,manufacture_id2_rx_cmds_revA	= [06 01 00 00 00 00 01 dc 01 00];

		samsung,mtp_read_sysfs_rx_cmds_revA	= [06 01 00 00 00 00 01 00 00 00];
		samsung,mtp_write_sysfs_tx_cmds_revA	= [
			29 01 00 00 00 00 3D 00
						00 00 00 00 00 00 00 00 00 00
						00 00 00 00 00 00 00 00 00 00
						00 00 00 00 00 00 00 00 00 00
						00 00 00 00 00 00 00 00 00 00
						00 00 00 00 00 00 00 00 00 00
						00 00 00 00 00 00 00 00 00 00
		];

		/* *************************************************************
		 * TEST MODE
		 * **************************************************************
		 */
		/* Module Crack Detection (MCD) TEST */
		samsung,mcd_on_tx_cmds_revA = [
			39 01 00 00 00 00 03 51 00 00
			39 01 00 00 00 00 02 B0 A2
			39 01 00 00 00 00 09 B2 00 00 00 00 00 00 00 00
			39 01 00 00 00 00 0D BD 08 07 06 0C 01 0E 00 02 40 41 44 00
			39 01 00 00 00 00 0D BE 08 07 06 0C 01 0E 00 02 40 41 44 00
			39 01 00 00 00 00 03 51 06 A9
		];

		samsung,mcd_off_tx_cmds_revA = [
			39 01 00 00 00 00 03 51 00 00
			39 01 00 00 00 00 02 B0 A2
			39 01 00 00 00 00 09 B2 05 05 79 79 C3 C3 1B 1B
			39 01 00 00 00 00 0D BD 08 07 06 0C 01 0C 00 02 40 41 44 00
			39 01 00 00 00 00 0D BE 08 07 06 0C 01 0C 00 02 40 41 44 00
			39 01 00 00 00 00 03 51 06 A9
		];

		/* *************************************************************
		 * ACL command list and mappings
		 * **************************************************************
		 */
		samsung,acl_on_tx_cmds_revA = [
			39 01 00 00 00 00 02 B0 A5
			39 01 00 00 00 00 07 CE 14 20 77 77 77 77
			39 01 00 00 00 00 0B CF 05 AF 7F FF 7F FF 7F FF 7F FF
			39 01 00 00 00 00 0B D0 05 AF 7F FF 7F FF 6A DE 4C BE
			39 01 00 00 00 00 02 B0 A1
			39 01 00 00 00 00 05 69 40 00 00 00 /*ACL on*/
		];

		samsung,acl_off_tx_cmds_revA = [
			39 01 00 00 00 00 02 B0 A1
			39 01 00 00 00 00 05 69 00 00 00 00 /*ACL off*/
		];


		/* **************************************************************
		 * Dynamic MIPI Clock
		 * **************************************************************
		 */

		/*samsung,support_dynamic_mipi_clk;*/

		samsung,ffc_cmds_line_position = <1>;

		samsung,ffc_tx_cmds_revA = [
			39 01 00 00 00 00 02 B0 A1
			39 01 00 00 00 00 0A F0 22 00 5C 5D 00 2E 2F 80 00	/* 0 Default : 1176.5 Mbps (588.25) */
		];

		samsung,dyn_mipi_clk_ffc_cmds_revA = [
			39 01 00 00 00 00 0A F0 22 00 5C 5D 00 2E 2F 80 00	/* 0 Default : 1176.5 Mbps (588.25) */
			39 01 00 00 00 00 0A F0 22 00 5C 5D 00 2E 2F 80 00	/* 1 : 1176.5 Mbps (588.25) */
			39 01 00 00 00 00 0A F0 22 00 5A 5B 00 2D 2E 80 00	/* 2 : 1195.5 Mbps (597.75) */
			39 01 00 00 00 00 0A F0 22 00 5E 5F 00 2F 30 80 00	/* 3 : 1150.5 Mbps (575.25) */
			39 01 00 00 00 00 0A F0 22 00 5D 5E 00 2F 30 80 00	/* 4 : 1157 Mbps (578.5) */
		];

		samsung,dynamic_mipi_clk_timing_table = <
			/*<bitclk><>*/
			1176500000 /* clk id 0 default */
			1176500000 /* clk id 1 A */
			1195500000 /* clk id 2 B */
			1150500000 /* clk id 3 C */
			1157000000 /* clk id 4 D */
		>;

		samsung,dynamic_mipi_clk_sel_table = <
			/*<RAT><BAND><from><end><clk index>*/
			1	1	0	0	3
			1	2	0	0	4
			1	3	0	0	1
			1	4	0	0	3
			2	11	10562	10576	2
			2	11	10577	10747	1
			2	11	10748	10822	2
			2	11	10823	10838	1
			2	12	9662	9766	1
			2	12	9767	9841	2
			2	12	9842	9938	1
			2	13	1162	1231	2
			2	13	1232	1401	1
			2	13	1402	1476	2
			2	13	1477	1513	1
			2	14	1537	1551	2
			2	14	1552	1722	1
			2	14	1723	1738	2
			2	15	4357	4374	1
			2	15	4375	4445	2
			2	15	4446	4449	3
			2	15	4450	4458	1
			2	17	2237	2323	1
			2	17	2324	2345	4
			2	17	2346	2362	3
			2	17	2363	2398	2
			2	17	2399	2563	1
			2	18	2937	2994	2
			2	18	2995	3088	1
			3	91	0	53	2
			3	91	54	394	1
			3	91	395	544	2
			3	91	545	599	1
			3	92	600	833	1
			3	92	834	983	2
			3	92	984	1199	1
			3	93	1200	1212	1
			3	93	1213	1362	2
			3	93	1363	1702	1
			3	93	1703	1852	2
			3	93	1853	1949	1
			3	94	1950	2003	2
			3	94	2004	2344	1
			3	94	2345	2399	2
			3	95	2400	2458	1
			3	95	2459	2601	2
			3	95	2602	2608	3
			3	95	2609	2649	1
			3	97	2750	2946	1
			3	97	2947	2990	4
			3	97	2991	3025	3
			3	97	3026	3096	2
			3	97	3097	3436	1
			3	97	3437	3449	4
			3	98	3450	3588	2
			3	98	3589	3799	1
			3	102	5010	5116	2
			3	102	5117	5148	3
			3	102	5149	5179	1
			3	103	5180	5279	1
			3	104	5280	5379	1
			3	107	5730	5786	2
			3	107	5787	5818	3
			3	107	5819	5849	1
			3	108	5850	5999	1
			3	109	6000	6141	2
			3	109	6142	6149	3
			3	110	6150	6158	3
			3	110	6159	6449	1
			3	111	6450	6599	1
			3	115	8040	8273	1
			3	115	8274	8423	2
			3	115	8424	8689	1
			3	116	8690	8848	1
			3	116	8849	8991	2
			3	116	8992	8998	3
			3	116	8999	9039	1
			3	118	9210	9398	1
			3	118	9399	9524	2
			3	118	9525	9548	3
			3	118	9549	9659	1
			3	119	9660	9769	1
			3	120	9770	9869	2
			3	122	9920	10031	1
			3	122	10032	10181	2
			3	122	10182	10359	1
			3	124	36200	36273	2
			3	124	36274	36349	1
			3	128	37750	37956	1
			3	128	37957	38009	4
			3	128	39010	38027	3
			3	128	38028	38106	2
			3	128	38107	38249	1
			3	129	38250	38493	1
			3	129	38494	38643	2
			3	129	38644	38649	1
			3	130	38650	38764	2
			3	130	38765	39104	1
			3	130	39105	39136	4
			3	130	39137	39254	2
			3	130	39255	39595	1
			3	130	39596	39634	4
			3	130	39635	39649	2
			3	131	39650	39671	4
			3	131	39672	39765	2
			3	131	39766	40105	1
			3	131	40106	40167	4
			3	131	40168	40255	2
			3	131	40256	40596	1
			3	131	40597	40648	4
			3	131	40649	40667	3
			3	131	40668	40746	2
			3	131	40747	41086	1
			3	131	41087	41130	4
			3	131	41131	41165	3
			3	131	41166	41236	2
			3	131	41237	41576	1
			3	131	41577	41589	4
			3	132	41590	41829	1
			3	132	41830	41885	2
			3	132	41886	41979	3
			3	132	41980	42319	1
			3	132	42320	42383	2
			3	132	42384	42469	3
			3	132	42470	42810	1
			3	132	42811	42881	2
			3	132	42882	42960	3
			3	132	42961	43300	1
			3	132	43301	43380	2
			3	132	43381	43450	3
			3	132	43451	43589	1
			3	138	55240	55450	1
			3	138	55451	55530	2
			3	138	55531	55600	3
			3	138	55601	55940	1
			3	138	55941	56028	2
			3	138	56029	56090	3
			3	138	56091	56430	1
			3	138	56431	56526	2
			3	138	56527	56576	3
			3	138	56577	56580	4
			3	138	56581	56739	1
			3	156	66436	66489	2
			3	156	66490	66830	1
			3	156	66831	66980	2
			3	156	66981	67320	1
			3	156	67321	67328	4
			3	156	67329	67335	2
			3	161	68586	68713	1
			3	161	68714	68816	2
			3	161	68817	68863	3
			3	161	68864	68935	1
			4	51	0	0	2
			4	52	0	0	1
			4	53	0	0	2
			4	54	0	0	1
			4	55	0	0	4
			4	56	0	0	2
			5	61	0	0	2
			5	62	0	0	1
			5	71	0	0	1
		>;

		/* *************************************************************
		 * candela to index mappings
		 * **************************************************************
		 */
		samsung,support_gamma_mode2;
		samsung,gamma_mode2_candela_map_table_revA = < /* THIS TABLE USED FOR DIMMING */
		/*<idx>	  <from>  <till> <scaled_level>  <Panel_Real_CD> */
			0		0		0		8		2
			1		1		1		12		3
			2		2		2		16		4
			3		3		3		24		6
			4		4		4		28		7
			5		5		5		32		8
			6		6		6		37		9
			7		7		7		41		10
			8		8		8		49		12
			9		9		9		53		13
			10		10		10		57		14
			11		11		11		61		15
			12		12		12		65		16
			13		13		13		73		18
			14		14		14		77		19
			15		15		15		81		20
			16		16		16		89		22
			17		17		17		93		23
			18		18		18		97		24
			19		19		19		106		26
			20		20		20		110		27
			21		21		21		118		29
			22		22		22		122		30
			23		23		23		130		32
			24		24		24		134		33
			25		25		25		138		34
			26		26		26		146		36
			27		27		27		150		37
			28		28		28		158		39
			29		29		29		162		40
			30		30		30		171		42
			31		31		31		175		43
			32		32		32		179		44
			33		33		33		187		46
			34		34		34		191		47
			35		35		35		199		49
			36		36		36		203		50
			37		37		37		211		52
			38		38		38		215		53
			39		39		39		219		54
			40		40		40		227		56
			41		41		41		235		58
			42		42		42		240		59
			43		43		43		244		60
			44		44		44		252		62
			45		45		45		256		63
			46		46		46		264		65
			47		47		47		268		66
			48		48		48		276		68
			49		49		49		280		69
			50		50		50		284		70
			51		51		51		292		72
			52		52		52		296		73
			53		53		53		304		75
			54		54		54		309		76
			55		55		55		317		78
			56		56		56		321		79
			57		57		57		325		80
			58		58		58		333		82
			59		59		59		337		83
			60		60		60		345		85
			61		61		61		349		86
			62		62		62		357		88
			63		63		63		361		89
			64		64		64		365		90
			65		65		65		373		92
			66		66		66		382		94
			67		67		67		386		95
			68		68		68		394		97
			69		69		69		398		98
			70		70		70		402		99
			71		71		71		410		101
			72		72		72		414		102
			73		73		73		422		104
			74		74		74		426		105
			75		75		75		434		107
			76		76		76		438		108
			77		77		77		442		109
			78		78		78		451		111
			79		79		79		455		112
			80		80		80		463		114
			81		81		81		467		115
			82		82		82		475		117
			83		83		83		479		118
			84		84		84		487		120
			85		85		85		491		121
			86		86		86		499		123
			87		87		87		503		124
			88		88		88		507		125
			89		89		89		516		127
			90		90		90		520		128
			91		91		91		528		130
			92		92		92		532		131
			93		93		93		540		133
			94		94		94		544		134
			95		95		95		548		135
			96		96		96		556		137
			97		97		97		560		138
			98		98		98		568		140
			99		99		99		572		141
			100		100		100		581		143
			101		101		101		585		144
			102		102		102		589		145
			103		103		103		597		147
			104		104		104		605		149
			105		105		105		609		150
			106		106		106		613		151
			107		107		107		621		153
			108		108		108		625		154
			109		109		109		633		156
			110		110		110		637		157
			111		111		111		645		159
			112		112		112		650		160
			113		113		113		654		161
			114		114		114		662		163
			115		115		115		666		164
			116		116		116		674		166
			117		117		117		678		167
			118		118		118		686		169
			119		119		119		690		170
			120		120		120		694		171
			121		121		121		702		173
			122		122		122		706		174
			123		123		123		714		176
			124		124		124		719		177
			125		125		125		727		179
			126		126		126		731		180
			127		127		127		735		181
			128		128		128		743		183
			129		129		129		751		185
			130		130		130		759		187
			131		131		131		763		188
			132		132		132		775		191
			133		133		133		779		192
			134		134		134		788		194
			135		135		135		796		196
			136		136		136		804		198
			137		137		137		812		200
			138		138		138		820		202
			139		139		139		824		203
			140		140		140		836		206
			141		141		141		840		207
			142		142		142		848		209
			143		143		143		857		211
			144		144		144		865		213
			145		145		145		873		215
			146		146		146		877		216
			147		147		147		885		218
			148		148		148		893		220
			149		149		149		901		222
			150		150		150		909		224
			151		151		151		917		226
			152		152		152		926		228
			153		153		153		934		230
			154		154		154		938		231
			155		155		155		946		233
			156		156		156		954		235
			157		157		157		962		237
			158		158		158		970		239
			159		159		159		978		241
			160		160		160		986		243
			161		161		161		995		245
			162		162		162		999		246
			163		163		163		1011		249
			164		164		164		1015		250
			165		165		165		1023		252
			166		166		166		1031		254
			167		167		167		1039		256
			168		168		168		1047		258
			169		169		169		1051		259
			170		170		170		1060		261
			171		171		171		1068		263
			172		172		172		1076		265
			173		173		173		1084		267
			174		174		174		1092		269
			175		175		175		1100		271
			176		176		176		1108		273
			177		177		177		1112		274
			178		178		178		1120		276
			179		179		179		1129		278
			180		180		180		1137		280
			181		181		181		1145		282
			182		182		182		1153		284
			183		183		183		1161		286
			184		184		184		1165		287
			185		185		185		1173		289
			186		186		186		1181		291
			187		187		187		1189		293
			188		188		188		1198		295
			189		189		189		1206		297
			190		190		190		1214		299
			191		191		191		1222		301
			192		192		192		1226		302
			193		193		193		1234		304
			194		194		194		1242		306
			195		195		195		1250		308
			196		196		196		1258		310
			197		197		197		1267		312
			198		198		198		1275		314
			199		199		199		1283		316
			200		200		200		1287		317
			201		201		201		1295		319
			202		202		202		1303		321
			203		203		203		1311		323
			204		204		204		1319		325
			205		205		205		1327		327
			206		206		206		1336		329
			207		207		207		1340		330
			208		208		208		1348		332
			209		209		209		1356		334
			210		210		210		1364		336
			211		211		211		1372		338
			212		212		212		1380		340
			213		213		213		1388		342
			214		214		214		1396		344
			215		215		215		1401		345
			216		216		216		1409		347
			217		217		217		1417		349
			218		218		218		1425		351
			219		219		219		1433		353
			220		220		220		1437		354
			221		221		221		1449		357
			222		222		222		1453		358
			223		223		223		1461		360
			224		224		224		1470		362
			225		225		225		1478		364
			226		226		226		1486		366
			227		227		227		1494		368
			228		228		228		1502		370
			229		229		229		1510		372
			230		230		230		1514		373
			231		231		231		1522		375
			232		232		232		1530		377
			233		233		233		1539		379
			234		234		234		1547		381
			235		235		235		1555		383
			236		236		236		1563		385
			237		237		237		1567		386
			238		238		238		1575		388
			239		239		239		1583		390
			240		240		240		1591		392
			241		241		241		1599		394
			242		242		242		1608		396
			243		243		243		1612		397
			244		244		244		1624		400
			245		245		245		1628		401
			246		246		246		1636		403
			247		247		247		1644		405
			248		248		248		1652		407
			249		249		249		1660		409
			250		250		250		1668		411
			251		251		251		1673		412
			252		252		252		1685		415
			253		253		253		1689		416
			254		254		254		1697		418
			255		255		255		1705		420
			256		256		256		1706		421
			257		257		257		1709		423
			258		258		258		1710		424
			259		259		259		1711		425
			260		260		260		1715		428
			261		261		261		1716		429
			262		262		262		1718		431
			263		263		263		1720		432
			264		264		264		1722		434
			265		265		265		1725		436
			266		266		266		1726		437
			267		267		267		1728		439
			268		268		268		1731		441
			269		269		269		1732		442
			270		270		270		1734		444
			271		271		271		1737		446
			272		272		272		1738		447
			273		273		273		1740		449
			274		274		274		1742		450
			275		275		275		1745		453
			276		276		276		1747		454
			277		277		277		1748		455
			278		278		278		1750		457
			279		279		279		1753		459
			280		280		280		1754		460
			281		281		281		1756		462
			282		282		282		1759		464
			283		283		283		1761		466
			284		284		284		1762		467
			285		285		285		1765		469
			286		286		286		1767		471
			287		287		287		1769		472
			288		288		288		1770		473
			289		289		289		1773		476
			290		290		290		1775		477
			291		291		291		1777		479
			292		292		292		1778		480
			293		293		293		1781		482
			294		294		294		1783		484
			295		295		295		1784		485
			296		296		296		1787		487
			297		297		297		1789		489
			298		298		298		1791		490
			299		299		299		1793		492
			300		300		300		1795		494
			301		301		301		1797		495
			302		302		302		1799		497
			303		303		303		1800		498
			304		304		304		1803		500
			305		305		305		1805		502
			306		306		306		1806		503
			307		307		307		1809		505
			308		308		308		1811		507
			309		309		309		1812		508
			310		310		310		1815		510
			311		311		311		1817		512
			312		312		312		1819		513
			313		313		313		1821		515
			314		314		314		1823		517
			315		315		315		1826		519
			316		316		316		1827		520
			317		317		317		1828		521
			318		318		318		1831		523
			319		319		319		1833		525
			320		320		320		1834		526
			321		321		321		1837		528
			322		322		322		1839		530
			323		323		323		1842		532
			324		324		324		1843		533
			325		325		325		1845		535
			326		326		326		1848		537
			327		327		327		1849		538
			328		328		328		1850		539
			329		329		329		1854		542
			330		330		330		1855		543
			331		331		331		1858		545
			332		332		332		1859		546
			333		333		333		1861		548
			334		334		334		1864		550
			335		335		335		1865		551
			336		336		336		1867		553
			337		337		337		1870		555
			338		338		338		1871		556
			339		339		339		1874		558
			340		340		340		1876		560
			341		341		341		1877		561
			342		342		342		1880		563
			343		343		343		1881		564
			344		344		344		1883		566
			345		345		345		1886		568
			346		346		346		1887		569
			347		347		347		1889		571
			348		348		348		1892		573
			349		349		349		1893		574
			350		350		350		1896		576
			351		351		351		1898		578
			352		352		352		1900		580
			353		353		353		1902		581
			354		354		354		1904		583
			355		355		355		1907		585
			356		356		356		1908		586
			357		357		357		1909		587
			358		358		358		1911		589
			359		359		359		1914		591
			360		360		360		1916		593
			361		361		361		1918		594
			362		362		362		1920		596
			363		363		363		1922		598
			364		364		364		1924		599
			365		365		365		1926		601
			366		366		366		1929		603
			367		367		367		1930		604
			368		368		368		1932		606
			369		369		369		1935		608
			370		370		370		1936		609
			371		371		371		1938		611
			372		372		372		1940		612
			373		373		373		1942		614
			374		374		374		1944		616
			375		375		375		1946		617
			376		376		376		1948		619
			377		377		377		1951		621
			378		378		378		1952		622
			379		379		379		1954		624
			380		380		380		1957		626
			381		381		381		1958		627
			382		382		382		1960		629
			383		383		383		1962		630
			384		384		384		1965		633
			385		385		385		1966		634
			386		386		386		1968		635
			387		387		387		1970		637
			388		388		388		1972		639
			389		389		389		1974		640
			390		390		390		1976		642
			391		391		391		1979		644
			392		392		392		1981		646
			393		393		393		1982		647
			394		394		394		1985		649
			395		395		395		1987		651
			396		396		396		1988		652
			397		397		397		1990		653
			398		398		398		1993		656
			399		399		399		1994		657
			400		400		400		1997		659
			401		401		401		1998		660
			402		402		402		2001		662
			403		403		403		2003		664
			404		404		404		2004		665
			405		405		405		2007		667
			406		406		406		2009		669
			407		407		407		2010		670
			408		408		408		2013		672
			409		409		409		2015		674
			410		410		410		2016		675
			411		411		411		2019		677
			412		412		412		2020		678
			413		413		413		2023		680
			414		414		414		2025		682
			415		415		415		2026		683
			416		416		416		2029		685
			417		417		417		2031		687
			418		418		418		2032		688
			419		419		419		2035		690
			420		420		420		2037		692
			421		421		421		2038		693
			422		422		422		2041		695
			423		423		423		2043		697
			424		424		424		2046		699
			425		425		425		2047		700
		>;


		samsung,gamma_mode2_tx_cmds_revA=[
			39 01 00 00 00 00 03 51 03 FF
			15 01 00 00 00 00 02 4C 99
		]; /* B5 1th para: TSET */

		/* *************************************************************
		 *   APLPM
		 * *************************************************************
		 */
		samsung,panel-lpm-enable;

		samsung,lpm_on_tx_cmds_revA = [ /* TX_LPM_ON*/
			05 01 00 00 00 00 02 12 00
			39 01 00 00 11 00 03 51 00 10 /*16.7 ms delay*/
		];

		samsung,lpm_off_tx_cmds_revA = [	/* TX_LPM_OFF */
			05 01 00 00 22 00 02 13 00	/*33.4 ms delay*/
		];

		/* ALPM/HLPM 2nit or 60nit On Commands */
		samsung,lpm_60nit_tx_cmds_revA = [39 01 00 00 00 00 03 51 07 FF]; //60nit
		samsung,lpm_30nit_tx_cmds_revA = [39 01 00 00 00 00 03 51 02 34]; //30nit
		samsung,lpm_10nit_tx_cmds_revA = [39 01 00 00 00 00 03 51 01 00]; //10nit
		samsung,lpm_2nit_tx_cmds_revA = [39 01 00 00 00 00 03 51 00 10]; //2nit

		samsung,lpm_brightnes_tx_cmds_revA = [
			39 01 00 00 00 00 03 51 00 10
		];

		samsung,aod_candela_map_table_revA = <
			/*<idx>   <from>  <till> <candella> */
			0	0	39	2
			1	40	70	10
			2	71	93	30
			3	94	255	60
		>;

		/*
		* ************************************************************************************************************************
		*  DMS (Dynamic Mode Switch)
		* ************************************************************************************************************************
		*/

		qcom,mdss-dsi-display-timings {
			fhd {
				qcom,display-topology = <2 2 1>;
				qcom,default-topology-index = <0>;

				qcom,mdss-dsi-panel-width = <1080>;
				qcom,mdss-dsi-panel-height = <2400>;

				qcom,mdss-dsi-h-pulse-width = <32>;
				qcom,mdss-dsi-h-back-porch = <20>;
				qcom,mdss-dsi-h-front-porch = <20>;
				qcom,mdss-dsi-h-sync-skew = <0>;

				qcom,mdss-dsi-v-pulse-width = <4>;
				qcom,mdss-dsi-v-back-porch = <20>;
				qcom,mdss-dsi-v-front-porch = <40>;

				qcom,mdss-dsi-panel-framerate = <60>;

				qcom,mdss-dsi-panel-clockrate = <1176500000>;
				qcom,mdss-dsi-panel-phy-timings = [00 27 0A 0A 27 25 0A 0B 07 02 04 00];		/* SM7150 : dsi_phy_v3_0 */

				qcom,mdss-dsi-t-clk-pre = <0x3B>;
				qcom,mdss-dsi-t-clk-post = <0x0F>;

				qcom,mdss-dsi-on-command = [
				39 01 00 00 00 00 81 0A 11 00 00 89 30 80 09 60 04 38 00 1E 02 1C 02 1C 02 00 02 0E 00 20 02 E3 00 07 00 0C 03 50 03 64 18 00 10 F0 03 0C 20 00 06 0B 0B 33 0E 1C 2A 38 46 54 62 69 70 77 79 7B 7D 7E 01 02 01 00 09 40 09 BE 19 FC 19 FA 19 F8 1A 38 1A 78 1A B6 2A F6 2B 34 2B 74 3B 74 6B F4 00 00 00 00 00 00 00 00 00 00 00 00 00 00 00 00 00 00 00 00 00 00 00 00 00 00 00 00 00 00 00 00 00 00 00 00 00 00 00 00
				39 01 00 00 00 00 02 B0 A1
				39 01 00 00 00 00 05 2A 00 00 04 37
				39 01 00 00 00 00 05 2B 00 00 09 5F
				39 01 00 00 00 00 02 B0 A6
				39 01 00 00 00 00 05 FC 00 00 40 41
				15 01 00 00 00 00 02 53 00
				39 01 00 00 00 00 0B 55 08 00 82 A8 1C 61 0A 90 04 00
				39 01 00 00 00 00 05 30 00 00 09 5F
				39 01 00 00 00 00 05 31 00 00 04 37
				15 01 00 00 00 00 02 35 00
				//display setting 2
				05 01 00 00 64 00 01 11   // sleep out
				39 01 00 00 00 00 02 B0 A1
				39 01 00 00 00 00 0D B3 99 4C 00 2F 27 00 2F 27 28 00 06 14
				//elvss temparature compensation
				39 01 00 00 00 00 02 B0 A1
				15 01 00 00 00 00 02 4C A8
				39 01 00 00 00 00 12 C1 C9 68 60 0F 00 00 00 00 00 00 39 06 00 00 00 00 02
				39 01 00 00 00 00 1F C3 1B 23 23 23 23 23 23 23 23 23 1B 29 29 29 29 29 29 29 29 29 1B 29 29 29 29 29 29 29 29 29
				39 01 00 00 00 00 03 C5 BC 77
				39 01 00 00 00 00 02 B0 A1
				39 01 00 00 00 00 0D B3 99 4C 00 30 28 00 30 28 28 00 06 14 //porch setting
				39 01 00 00 00 00 02 F0 00 //FFC
				//Timing settings
				39 01 00 00 00 00 02 B0 A2
				39 01 00 00 00 00 15 B1 12 82 82 11 51 41 41 41 94 04 0F 11 B4 00 03 02 0D 00 02 40
				39 01 00 00 00 00 1B B2 05 05 7B 7B D7 D7 10 10 82 00 2B 1D 72 A6 72 A6 2B 1D 03 1D 8C A6 8C A6 03 1D
				39 01 00 00 00 00 20 B3 11 02 56 40 05 55 6A 6A 6A 6A 14 00 00 14 36 40 0A 00 44 6A 0F 6A 0F 04 00 00 FF 00 00 00 00
				39 01 00 00 00 00 23 B4 05 07 40 09 09 55 6A 6A 6A 6A 94 00 00 01 32 37 40 0A 00 44 6A 4C 6A 4C 04 00 00 00 00 00 00 00 00 00
				39 01 00 00 00 00 12 B6 05 00 09 00 21 E8 8C 21 00 00 21 E8 8C 21 00 04 00
				//De-mura compensation
				39 01 00 00 00 00 02 B0 A5
				39 01 00 00 00 00 05 C8 E3 00 43 04
				//GIRC on
				39 01 00 00 14 00 08 B1 60 C0 80 00 00 10 FF
				];

				qcom,mdss-dsi-off-command=[
					05 01 00 00 14 00 02 28 00
					05 01 00 00 96 00 02 10 00	/* wait 150ms(0x78) */
				];

				qcom,mdss-dsi-on-command-state = "dsi_hs_mode";
				qcom,mdss-dsi-off-command-state = "dsi_lp_mode";
/*
				qcom,compression-mode = "dsc";
				qcom,lm-split = <540 540>;
				qcom,mdss-dsc-encoders = <2>;
				qcom,mdss-dsc-slice-height = <30>;
				qcom,mdss-dsc-slice-width = <540>;
				qcom,mdss-dsc-slice-per-pkt = <2>;
				qcom,mdss-dsc-bit-per-component = <8>;
				qcom,mdss-dsc-bit-per-pixel = <8>;
*/
				qcom,compression-mode = "dsc";
				qcom,mdss-dsc-slice-height = <30>;
				qcom,mdss-dsc-slice-width = <540>;
				qcom,mdss-dsc-slice-per-pkt = <1>;
				qcom,mdss-dsc-bit-per-component = <8>;
				qcom,mdss-dsc-bit-per-pixel = <8>;
				qcom,mdss-dsc-block-prediction-enable;

			};
		};
	};
};
