/* Copyright (c) 2013-14, Samsung Electronics Corporation. All rights reserved.
 *
 * This program is free software; you can redistribute it and/or modify
 * it under the terms of the GNU General Public License version 2 and
 * only version 2 as published by the Free Software Foundation.
 *
 * This program is distributed in the hope that it will be useful,
 * but WITHOUT ANY WARRANTY; without even the implied warranty of
 * MERCHANTABILITY or FITNESS FOR A PARTICULAR PURPOSE.  See the
 * GNU General Public License for more details.
 */

/*---------------------------------------------------------------------------
 * This file is autogenerated file using gcdb parser. Please do not edit it.
 * Update input XML file to add a new entry or update variable in this file
 * VERSION = "1.0"
 *---------------------------------------------------------------------------*/
&mdss_mdp {
	ss_dsi_panel_HX8279_TV101WUM_WUXGA: ss_dsi_panel_HX8279_TV101WUM_WUXGA {
		qcom,mdss-dsi-panel-name = "ss_dsi_panel_HX8279_TV101WUM_WUXGA";
		label = "ss_dsi_panel_HX8279_TV101WUM_WUXGA";

		qcom,mdss-dsi-panel-type = "dsi_video_mode";
		qcom,mdss-dsi-panel-width = <1200>;
		qcom,mdss-dsi-panel-height = <1920>;
		qcom,mdss-pan-physical-width-dimension = <135>; /* Round off 135.36 */
		qcom,mdss-pan-physical-height-dimension = <216>;/* Round off 216.576*/
		qcom,mdss-dsi-bpp = <24>;
		/*qcom,mdss-dsi-panel-clockrate = <959000000>;*/

		qcom,mdss-dsi-h-pulse-width = <10>;
		qcom,mdss-dsi-h-back-porch = <40>;
		qcom,mdss-dsi-h-front-porch = <111>;
		qcom,mdss-dsi-h-sync-skew = <0>;
		qcom,mdss-dsi-v-pulse-width = <4>;
		qcom,mdss-dsi-v-back-porch = <18>;
		qcom,mdss-dsi-v-front-porch = <16>;

		qcom,mdss-dsi-t-clk-pre = <0x31>;
		qcom,mdss-dsi-t-clk-post = <0x0E>;
		qcom,mdss-dsi-panel-phy-timings = [00 20 08 08 24 23 08 08 05 02 04 00];
		qcom,mdss-dsi-panel-framerate = <60>;
		qcom,mdss-dsi-on-command-state = "dsi_lp_mode";
		qcom,mdss-dsi-off-command-state = "dsi_lp_mode";
		
		qcom,mdss-dsi-h-left-border = <0>;
		qcom,mdss-dsi-h-right-border = <0>;
		qcom,mdss-dsi-v-top-border = <0>;
		qcom,mdss-dsi-v-bottom-border = <0>;

		qcom,mdss-dsi-underflow-color = <0xff>;
		qcom,mdss-dsi-border-color = <0>;

		qcom,mdss-dsi-bl-pmic-control-type = "bl_ctrl_dcs";
		qcom,mdss-dsi-bl-min-level = <1>;
		qcom,mdss-dsi-bl-max-level = <306>;
		qcom,mdss-brightness-max-level = <306>;
		
		qcom,mdss-dsi-reset-sequence = <1 10>;

		qcom,mdss-dsi-h-sync-pulse = <0>;
		qcom,mdss-dsi-bllp-eof-power-mode;
		qcom,mdss-dsi-bllp-power-mode;
		qcom,mdss-dsi-traffic-mode = "burst_mode";
		qcom,mdss-dsi-pixel-packing = "loose";
		qcom,mdss-dsi-virtual-channel-id = <0>;
		qcom,mdss-dsi-color-order = "rgb_swap_rgb";
		qcom,mdss-dsi-lane-0-state;
		qcom,mdss-dsi-lane-1-state;
		qcom,mdss-dsi-lane-2-state;
		qcom,mdss-dsi-lane-3-state;

		qcom,mdss-dsi-stream = <0>;
		qcom,mdss-dsi-mdp-trigger = "none";
		qcom,mdss-dsi-dma-trigger = "trigger_sw";
		
		qcom,mdss-dsi-panel-mode-gpio-state = "invalid";

		qcom,mdss-dsi-lp11-init;
		qcom,mdss-dsi-init-delay-us = <100>;
		qcom,mdss-dsi-rx-eot-ignore;
		qcom,mdss-dsi-tx-eot-append;

		qcom,mdss-dsi-on-command = [
			39 01 00 00 00 00 02 B0 05
			39 01 00 00 00 00 02 B3	52

			39 01 00 00 00 00 02 B0	06
			39 01 00 00 00 00 02 B8	A5
			39 01 00 00 00 00 02 BC	00
			39 01 00 00 00 00 02 C0	A5
			39 01 00 00 00 00 02 C7	0F
			39 01 00 00 00 00 02 D5	32
			39 01 00 00 00 00 02 B8	00
			39 01 00 00 00 00 02 C0	00
			39 01 00 00 00 00 02 B0	01
			39 01 00 00 00 00 02 E0	26
			39 01 00 00 00 00 02 E1	26
			39 01 00 00 00 00 02 DC	00
			39 01 00 00 00 00 02 DD	00
			39 01 00 00 00 00 02 CC	26
			39 01 00 00 00 00 02 CD	26
			39 01 00 00 00 00 02 C8	00
			39 01 00 00 00 00 02 C9	00
			39 01 00 00 00 00 02 D2	03
			39 01 00 00 00 00 02 D3	03
			39 01 00 00 00 00 02 E6	04
			39 01 00 00 00 00 02 E7	04
			39 01 00 00 00 00 02 C4	09
			39 01 00 00 00 00 02 C5	09
			39 01 00 00 00 00 02 D8	0A
			39 01 00 00 00 00 02 D9	0A
			39 01 00 00 00 00 02 C2	0B
			39 01 00 00 00 00 02 C3	0B
			39 01 00 00 00 00 02 D6	0C
			39 01 00 00 00 00 02 D7	0C
			39 01 00 00 00 00 02 C0	05
			39 01 00 00 00 00 02 C1	05
			39 01 00 00 00 00 02 D4	06
			39 01 00 00 00 00 02 D5	06
			39 01 00 00 00 00 02 CA	07
			39 01 00 00 00 00 02 CB	07
			39 01 00 00 00 00 02 DE	08
			39 01 00 00 00 00 02 DF	08
			39 01 00 00 00 00 02 B0	03
			39 01 00 00 00 00 02 C8	0B
			39 01 00 00 00 00 02 C9	07
			39 01 00 00 00 00 02 C3	00
			39 01 00 00 00 00 02 E7	00
			39 01 00 00 00 00 02 C5	2A
			39 01 00 00 00 00 02 DE	2A
			39 01 00 00 00 00 02 CA	43
			39 01 00 00 00 00 02 E4	C0
			39 01 00 00 00 00 02 E5	0D
			39 01 00 00 00 00 02 CB	28
			39 01 00 00 00 00 02 B0	00
			39 01 00 00 00 00 02 B6	03
			39 01 00 00 00 00 02 BA	87
			39 01 00 00 00 00 02 BF	15
			39 01 00 00 00 00 02 C0	0F
			39 01 00 00 00 00 02 C2	09
			39 01 00 00 00 00 02 C3	02
			39 01 00 00 00 00 02 C4	0F
			39 01 00 00 00 00 02 C5	02
			39 01 00 00 00 00 02 B0	02
			39 01 00 00 00 00 02 C0	00
			39 01 00 00 00 00 02 C1	04
			39 01 00 00 00 00 02 C2	15
			39 01 00 00 00 00 02 C3	26
			39 01 00 00 00 00 02 C4	2A
			39 01 00 00 00 00 02 C5	2F
			39 01 00 00 00 00 02 C6	32
			39 01 00 00 00 00 02 C7	36
			39 01 00 00 00 00 02 C8	3A
			39 01 00 00 00 00 02 C9	37
			39 01 00 00 00 00 02 CA	38
			39 01 00 00 00 00 02 CB	37
			39 01 00 00 00 00 02 CC	3F
			39 01 00 00 00 00 02 CD	32
			39 01 00 00 00 00 02 CE	34
			39 01 00 00 00 00 02 CF	33
			39 01 00 00 00 00 02 D0	07
			39 01 00 00 00 00 02 D2	04
			39 01 00 00 00 00 02 D3	0B
			39 01 00 00 00 00 02 D4	17
			39 01 00 00 00 00 02 D5	2B
			39 01 00 00 00 00 02 D6	38
			39 01 00 00 00 00 02 D7	3B
			39 01 00 00 00 00 02 D8	3D
			39 01 00 00 00 00 02 D9	3E
			39 01 00 00 00 00 02 DA	3E
			39 01 00 00 00 00 02 DB	3F
			39 01 00 00 00 00 02 DC	3F
			39 01 00 00 00 00 02 DD	3F
			39 01 00 00 00 00 02 DE	3F
			39 01 00 00 00 00 02 DF	32
			39 01 00 00 00 00 02 E0	30
			39 01 00 00 00 00 02 E1	2F
			39 01 00 00 00 00 02 E2	00
			39 01 00 00 00 00 02 B0	07
			39 01 00 00 00 00 02 B1	00
			39 01 00 00 00 00 02 B2	00
			39 01 00 00 00 00 02 B3	0E
			39 01 00 00 00 00 02 B4	1B
			39 01 00 00 00 00 02 B5	2C
			39 01 00 00 00 00 02 B6	39
			39 01 00 00 00 00 02 B7	5B
			39 01 00 00 00 00 02 B8	7C
			39 01 00 00 00 00 02 B9	BC
			39 01 00 00 00 00 02 BA	FB
			39 01 00 00 00 00 02 BB	75
			39 01 00 00 00 00 02 BC	F5
			39 01 00 00 00 00 02 BD	F9
			39 01 00 00 00 00 02 BE	7B
			39 01 00 00 00 00 02 BF	01
			39 01 00 00 00 00 02 C0	45
			39 01 00 00 00 00 02 C1	85
			39 01 00 00 00 00 02 C2	A1
			39 01 00 00 00 00 02 C3	BF
			39 01 00 00 00 00 02 C4	CF
			39 01 00 00 00 00 02 C5	DE
			39 01 00 00 00 00 02 C6	EE
			39 01 00 00 00 00 02 C7	F8
			39 01 00 00 00 00 02 C8	FC
			39 01 00 00 00 00 02 C9	00
			39 01 00 00 00 00 02 CA	00
			39 01 00 00 00 00 02 CB	05
			39 01 00 00 00 00 02 CC	6F
			39 01 00 00 00 00 02 CD	FF
			39 01 00 00 00 00 02 CE	FF
			39 01 00 00 00 00 02 B0	08
			39 01 00 00 00 00 02 B1	00
			39 01 00 00 00 00 02 B2	02
			39 01 00 00 00 00 02 B3	13
			39 01 00 00 00 00 02 B4	1E
			39 01 00 00 00 00 02 B5	2C
			39 01 00 00 00 00 02 B6	38
			39 01 00 00 00 00 02 B7	5B
			39 01 00 00 00 00 02 B8	7B
			39 01 00 00 00 00 02 B9	BA
			39 01 00 00 00 00 02 BA	F9
			39 01 00 00 00 00 02 BB	72
			39 01 00 00 00 00 02 BC	F1
			39 01 00 00 00 00 02 BD	F5
			39 01 00 00 00 00 02 BE	76
			39 01 00 00 00 00 02 BF	FA
			39 01 00 00 00 00 02 C0	3D
			39 01 00 00 00 00 02 C1	7D
			39 01 00 00 00 00 02 C2	9A
			39 01 00 00 00 00 02 C3	B6
			39 01 00 00 00 00 02 C4	C5
			39 01 00 00 00 00 02 C5	D5
			39 01 00 00 00 00 02 C6	E4
			39 01 00 00 00 00 02 C7	EC
			39 01 00 00 00 00 02 C8	F0
			39 01 00 00 00 00 02 C9	00
			39 01 00 00 00 00 02 CA	00
			39 01 00 00 00 00 02 CB	05
			39 01 00 00 00 00 02 CC	6B
			39 01 00 00 00 00 02 CD	FF
			39 01 00 00 00 00 02 CE	FF
			39 01 00 00 00 00 02 B0	09
			39 01 00 00 00 00 02 B1	00
			39 01 00 00 00 00 02 B2	10
			39 01 00 00 00 00 02 B3	14
			39 01 00 00 00 00 02 B4	1D
			39 01 00 00 00 00 02 B5	2B
			39 01 00 00 00 00 02 B6	37
			39 01 00 00 00 00 02 B7	5A
			39 01 00 00 00 00 02 B8	7B
			39 01 00 00 00 00 02 B9	BB
			39 01 00 00 00 00 02 BA	FB
			39 01 00 00 00 00 02 BB	74
			39 01 00 00 00 00 02 BC	F4
			39 01 00 00 00 00 02 BD	F8
			39 01 00 00 00 00 02 BE	79
			39 01 00 00 00 00 02 BF	FB
			39 01 00 00 00 00 02 C0	3C
			39 01 00 00 00 00 02 C1	7B
			39 01 00 00 00 00 02 C2	97
			39 01 00 00 00 00 02 C3	B2
			39 01 00 00 00 00 02 C4	C0
			39 01 00 00 00 00 02 C5	CF
			39 01 00 00 00 00 02 C6	DC
			39 01 00 00 00 00 02 C7	E4
			39 01 00 00 00 00 02 C8	E8
			39 01 00 00 00 00 02 C9	00
			39 01 00 00 00 00 02 CA	00
			39 01 00 00 00 00 02 CB	05
			39 01 00 00 00 00 02 CC	6B
			39 01 00 00 00 00 02 CD	FF
			39 01 00 00 00 00 02 CE	FF
			39 01 00 00 00 00 02 B0	0A
			39 01 00 00 00 00 02 B1	00
			39 01 00 00 00 00 02 B2	00
			39 01 00 00 00 00 02 B3	0E
			39 01 00 00 00 00 02 B4	1B
			39 01 00 00 00 00 02 B5	2C
			39 01 00 00 00 00 02 B6	39
			39 01 00 00 00 00 02 B7	5B
			39 01 00 00 00 00 02 B8	7C
			39 01 00 00 00 00 02 B9	BC
			39 01 00 00 00 00 02 BA	FB
			39 01 00 00 00 00 02 BB	75
			39 01 00 00 00 00 02 BC	F5
			39 01 00 00 00 00 02 BD	F9
			39 01 00 00 00 00 02 BE	7B
			39 01 00 00 00 00 02 BF	01
			39 01 00 00 00 00 02 C0	45
			39 01 00 00 00 00 02 C1	85
			39 01 00 00 00 00 02 C2	A1
			39 01 00 00 00 00 02 C3	BF
			39 01 00 00 00 00 02 C4	CF
			39 01 00 00 00 00 02 C5	DE
			39 01 00 00 00 00 02 C6	EE
			39 01 00 00 00 00 02 C7	F8
			39 01 00 00 00 00 02 C8	FC
			39 01 00 00 00 00 02 C9	00
			39 01 00 00 00 00 02 CA	00
			39 01 00 00 00 00 02 CB	05
			39 01 00 00 00 00 02 CC	6F
			39 01 00 00 00 00 02 CD	FF
			39 01 00 00 00 00 02 CE	FF
			39 01 00 00 00 00 02 B0	0B
			39 01 00 00 00 00 02 B1	00
			39 01 00 00 00 00 02 B2	02
			39 01 00 00 00 00 02 B3	13
			39 01 00 00 00 00 02 B4	1E
			39 01 00 00 00 00 02 B5	2C
			39 01 00 00 00 00 02 B6	38
			39 01 00 00 00 00 02 B7	5B
			39 01 00 00 00 00 02 B8	7B
			39 01 00 00 00 00 02 B9	BA
			39 01 00 00 00 00 02 BA	F9
			39 01 00 00 00 00 02 BB	72
			39 01 00 00 00 00 02 BC	F1
			39 01 00 00 00 00 02 BD	F5
			39 01 00 00 00 00 02 BE	76
			39 01 00 00 00 00 02 BF	FA
			39 01 00 00 00 00 02 C0	3D
			39 01 00 00 00 00 02 C1	7D
			39 01 00 00 00 00 02 C2	9A
			39 01 00 00 00 00 02 C3	B6
			39 01 00 00 00 00 02 C4	C5
			39 01 00 00 00 00 02 C5	D5
			39 01 00 00 00 00 02 C6	E4
			39 01 00 00 00 00 02 C7	EC
			39 01 00 00 00 00 02 C8	F0
			39 01 00 00 00 00 02 C9	00
			39 01 00 00 00 00 02 CA	00
			39 01 00 00 00 00 02 CB	05
			39 01 00 00 00 00 02 CC	6B
			39 01 00 00 00 00 02 CD	FF
			39 01 00 00 00 00 02 CE	FF
			39 01 00 00 00 00 02 B0	0C
			39 01 00 00 00 00 02 B1	00
			39 01 00 00 00 00 02 B2	10
			39 01 00 00 00 00 02 B3	14
			39 01 00 00 00 00 02 B4	1D
			39 01 00 00 00 00 02 B5	2B
			39 01 00 00 00 00 02 B6	37
			39 01 00 00 00 00 02 B7	5A
			39 01 00 00 00 00 02 B8	7B
			39 01 00 00 00 00 02 B9	BB
			39 01 00 00 00 00 02 BA	FB
			39 01 00 00 00 00 02 BB	74
			39 01 00 00 00 00 02 BC	F4
			39 01 00 00 00 00 02 BD	F8
			39 01 00 00 00 00 02 BE	79
			39 01 00 00 00 00 02 BF	FB
			39 01 00 00 00 00 02 C0	3C
			39 01 00 00 00 00 02 C1	7B
			39 01 00 00 00 00 02 C2	97
			39 01 00 00 00 00 02 C3	B2
			39 01 00 00 00 00 02 C4	C0
			39 01 00 00 00 00 02 C5	CF
			39 01 00 00 00 00 02 C6	DC
			39 01 00 00 00 00 02 C7	E4
			39 01 00 00 00 00 02 C8	E8
			39 01 00 00 00 00 02 C9	00
			39 01 00 00 00 00 02 CA	00
			39 01 00 00 00 00 02 CB	05
			39 01 00 00 00 00 02 CC	6B
			39 01 00 00 00 00 02 CD	FF
			39 01 00 00 00 00 02 CE	FF
			39 01 00 00 00 00 02 B0 06
			39 01 00 00 00 00 02 C0 A5
			39 01 00 00 00 00 02 CA 09
			39 01 00 00 00 00 02 C0 00
			39 01 00 00 78 00 02 35 00 /* 120ms delay */
		];

		qcom,mdss-dsi-off-command = [
			05 01 00 00 78 00 02 10 00  /* 120ms delay */
		];

/*
 * ************************************************************************************************************************************
 *
 *
 *			Below  parameters are samsung dependent thigs
 *
 *
 * ************************************************************************************************************************************
 */
		samsung,support_panel_max = <1>;
		samsung,hw-config = "single_dsi";

		samsung,panel-vendor = "BOE";
		samsung,tft-module-name = "8279D";
		samsung,tft-common-support;

		samsung,manufacture_id0_rx_cmds_revA = [06 01 00 00 00 00 01 da 01 00];
		samsung,manufacture_id1_rx_cmds_revA = [06 01 00 00 00 00 01 db 01 00];
		samsung,manufacture_id2_rx_cmds_revA = [06 01 00 00 00 00 01 dc 01 00];
		
		samsung,mtp_read_sysfs_rx_cmds_revA = [06 01 00 00 00 00 01 00 00 00];

		samsung,tft_pwm_tx_cmds_revA=[
			39 01 00 00 00 00 02 B0 04
			39 01 00 00 00 00 02 B8 00
		];
		
				/* BRIGHTNESS_MAX_PACKET = 50 */
		samsung,brightness_tx_cmds_revA = [
			15 01 00 00 00 00 01 00
			15 01 00 00 00 00 01 00
			15 01 00 00 00 00 01 00
			15 01 00 00 00 00 01 00
			15 01 00 00 00 00 01 00
			15 01 00 00 00 00 01 00
			15 01 00 00 00 00 01 00
			15 01 00 00 00 00 01 00
			15 01 00 00 00 00 01 00
			15 01 00 00 00 00 01 00
			15 01 00 00 00 00 01 00
			15 01 00 00 00 00 01 00
			15 01 00 00 00 00 01 00
			15 01 00 00 00 00 01 00
			15 01 00 00 00 00 01 00
			15 01 00 00 00 00 01 00
			15 01 00 00 00 00 01 00
			15 01 00 00 00 00 01 00
			15 01 00 00 00 00 01 00
			15 01 00 00 00 00 01 00
			15 01 00 00 00 00 01 00
			15 01 00 00 00 00 01 00
			15 01 00 00 00 00 01 00
			15 01 00 00 00 00 01 00
			15 01 00 00 00 00 01 00
			15 01 00 00 00 00 01 00
			15 01 00 00 00 00 01 00
			15 01 00 00 00 00 01 00
			15 01 00 00 00 00 01 00
			15 01 00 00 00 00 01 00
			15 01 00 00 00 00 01 00
			15 01 00 00 00 00 01 00
			15 01 00 00 00 00 01 00
			15 01 00 00 00 00 01 00
			15 01 00 00 00 00 01 00
			15 01 00 00 00 00 01 00
			15 01 00 00 00 00 01 00
			15 01 00 00 00 00 01 00
			15 01 00 00 00 00 01 00
			15 01 00 00 00 00 01 00
			15 01 00 00 00 00 01 00
			15 01 00 00 00 00 01 00
			15 01 00 00 00 00 01 00
			15 01 00 00 00 00 01 00
			15 01 00 00 00 00 01 00
			15 01 00 00 00 00 01 00
			15 01 00 00 00 00 01 00
			15 01 00 00 00 00 01 00
			15 01 00 00 00 00 01 00
			15 01 00 00 00 00 01 00
		];
		
		/*
		* ************************************************************************************************************************
		* Scaled level to index mappings
		* ************************************************************************************************************************
		*/
		samsung,candela_map_table_revA = <
		/*<idx>	  <from>  <till> <scaled_level> */
			0   0   0	0		/* off */
			1   1   2	1
			2   3   4	2		/* min */
			3   5   5	3
			4   6   7	4
			5   8   9	5
			6   10	10	6
			7   11	12	7
			8   13	13	8
			9   14	15	9		/* dimming */
			10  16	17	10
			11  18	18	11
			12  19	20	12
			13  21	22	13
			14  23	23	14
			15  24	25	15
			16  26	27	16
			17  28	28	17
			18  29	30	18
			19  31	31	19
			20  32	33	20
			21  34	35	21
			22  36	36	22
			23  37	38	23
			24  39	40	24
			25  41	41	25
			26  42	43	26
			27  44	45	27
			28  46	46	28
			29  47	48	29
			30  49	50	30
			31  51	51	31
			32  52	53	32
			33  54	54	33
			34  55	56	34
			35  57	58	35
			36  59	59	36
			37  60	61	37
			38  62	63	38
			39  64	64	39
			40  65	66	40
			41  67	68	41
			42  69	69	42
			43  70	71	43
			44  72	73	44
			45  74	74	45
			46  75	76	46
			47  77	77	47
			48  78	79	48
			49  80	81	49
			50  82	82	50
			51  83	84	51
			52  85	86	52
			53  87	87	53
			54  88	89	54
			55  90	91	55
			56  92	92	56
			57  93	94	57
			58  95	95	58
			59  96	97	59
			60  98	99	60
			61  100	100	61
			62  101	102	62
			63  103	104	63
			64  105	105	64
			65  106	107	65
			66  108	109	66
			67  110	110	67
			68  111	112	68
			69  113	114	69
			70  115	115	70
			71  116	117	71
			72  118	118	72
			73  119	120	73
			74  121	122	74
			75  123	123	75
			76  124	125	76
			77  126	127	77
			78  128	128	78		/* default */
			79  129	129	79
			80  130	130	80
			81  131	131	81
			82  132	132	82
			83  133	133	83
			84  134	134	84
			85  135	135	85
			86  136	136	86
			87  137	137	87
			88  138	138	88
			89  139	139	89
			90  140	140	90
			91  141	141	91
			92  142	142	92
			93  143	143	93
			94  144	144	94
			95  145	145	95
			96  146	146	96
			97  147	147	97
			98  148	148	98
			99  149	150	99
			100 151	151	100
			101 152	152	101
			102 153	153	102
			103 154	154	103
			104 155	155	104
			105 156	156	105
			106 157	157	106
			107 158	158	107
			108 159	159	108
			109 160	160	109
			110 161	161	110
			111 162	162	111
			112 163	163	112
			113 164	164	113
			114 165	165	114
			115 166	166	115
			116 167	167	116
			117 168	168	117
			118 169	169	118
			119 170	170	119
			120 171	171	120
			121 172	172	121
			122 173	173	122
			123 174	174	123
			124 175	175	124
			125 176	176	125
			126 177	177	126
			127 178	178	127
			128 179	179	128
			129 180	180	129
			130 181	181	130
			131 182	182	131
			132 183	183	132
			133 184	184	133
			134 185	185	134
			135 186	186	135
			136 187	187	136
			137 188	188	137
			138 189	189	138
			139 190	190	139
			140 191	192	140
			141 193	193	141
			142 194	194	142
			143 195	195	143
			144 196	196	144
			145 197	197	145
			146 198	198	146
			147 199	199	147
			148 200	200	148
			149 201	201	149
			150 202	202	150
			151 203	203	151
			152 204	204	152
			153 205	205	153
			154 206	206	154
			155 207	207	155
			156 208	208	156
			157 209	209	157
			158 210	210	158
			159 211	211	159
			160 212	212	160
			161 213	213	161
			162 214	214	162
			163 215	215	163
			164 216	216	164
			165 217	217	165
			166 218	218	166
			167 219	219	167
			168 220	220	168
			169 221	221	169
			170 222	222	170
			171 223	223	171
			172 224	224	172
			173 225	225	173
			174 226	226	174
			175 227	227	175
			176 228	228	176
			177 229	229	177
			178 230	230	178
			179 231	231	179
			180 232	232	180
			181 233	234	181
			182 235	235	182
			183 236	236	183
			184 237	237	184
			185 238	238	185
			186 239	239	186
			187 240	240	187
			188 241	241	188
			189 242	242	189
			190 243	243	190
			191 244	244	191
			192 245	245	192
			193 246	246	193
			194 247	247	194
			195 248	248	195
			196 249	249	196
			197 250	250	197
			198 251	251	198
			199 252	252	199
			200 253	253	200
			201 254	254	201
			202 255	255	202		/* Normal Max */
			203 256	257	203
			204 258	259	204
			205 260	261	205
			206 262	263	206
			207 264	265	207
			208 266	267	208
			209 268	268	209
			210 269	270	210
			211 271	272	211
			212 273	274	212
			213 275	276	213
			214 277	278	214
			215 279	280	215
			216 281	281	216
			217 282	283	217
			218 284	285	218
			219 286	287	219
			220 288	289	220
			221 290	291	221
			222 292	293	222
			223 294	294	223
			224 295	296	224
			225 297	298	225
			226 299	300	226
			227 301	302	227
			228 303	304	228
			229 305	305	229
			230 306	306	230		/* HBM Max */
		>;
			/*
		* ************************************************************************************************************************
		* MULTI_RESOLUTION (DSC configs were moved all to below timing set)
		* ************************************************************************************************************************
		*/

		qcom,mdss-dsi-display-timings {
			timing@0{
				qcom,display-topology = <1 0 1>;
				qcom,default-topology-index = <0>;

				qcom,mdss-dsi-timing-default;

				qcom,mdss-dsi-panel-width = <1200>;
				qcom,mdss-dsi-panel-height = <1920>;
				qcom,mdss-dsi-t-clk-pre = <0x31>;
				qcom,mdss-dsi-t-clk-post = <0x0E>;
				qcom,mdss-dsi-panel-phy-timings = [00 20 08 08 24 23 08 08 05 02 04 00];

				qcom,mdss-dsi-panel-framerate = <60>;
				/*qcom,mdss-dsi-panel-clockrate = <959000000>;*/
				qcom,mdss-dsi-h-pulse-width = <10>;
				qcom,mdss-dsi-h-back-porch = <40>;
				qcom,mdss-dsi-h-front-porch = <111>;
				qcom,mdss-dsi-h-sync-skew = <0>;
				qcom,mdss-dsi-v-pulse-width = <4>;
				qcom,mdss-dsi-v-back-porch = <18>;
				qcom,mdss-dsi-v-front-porch = <16>;

				/*qcom,mdss-dsi-timing-switch-command; use samsung,panel_multires_XXX instead*/
				/*qcom,mdss-dsi-timing-switch-command-state;*/

				qcom,mdss-dsi-on-command = [
				
					39 01 00 00 00 00 02 B0 05
					39 01 00 00 00 00 02 B3	52

					39 01 00 00 00 00 02 B0	06
					39 01 00 00 00 00 02 B8	A5
					39 01 00 00 00 00 02 BC	00
					39 01 00 00 00 00 02 C0	A5
					39 01 00 00 00 00 02 C7	0F
					39 01 00 00 00 00 02 D5	32
					39 01 00 00 00 00 02 B8	00
					39 01 00 00 00 00 02 C0	00
					39 01 00 00 00 00 02 B0	01
					39 01 00 00 00 00 02 E0	26
					39 01 00 00 00 00 02 E1	26
					39 01 00 00 00 00 02 DC	00
					39 01 00 00 00 00 02 DD	00
					39 01 00 00 00 00 02 CC	26
					39 01 00 00 00 00 02 CD	26
					39 01 00 00 00 00 02 C8	00
					39 01 00 00 00 00 02 C9	00
					39 01 00 00 00 00 02 D2	03
					39 01 00 00 00 00 02 D3	03
					39 01 00 00 00 00 02 E6	04
					39 01 00 00 00 00 02 E7	04
					39 01 00 00 00 00 02 C4	09
					39 01 00 00 00 00 02 C5	09
					39 01 00 00 00 00 02 D8	0A
					39 01 00 00 00 00 02 D9	0A
					39 01 00 00 00 00 02 C2	0B
					39 01 00 00 00 00 02 C3	0B
					39 01 00 00 00 00 02 D6	0C
					39 01 00 00 00 00 02 D7	0C
					39 01 00 00 00 00 02 C0	05
					39 01 00 00 00 00 02 C1	05
					39 01 00 00 00 00 02 D4	06
					39 01 00 00 00 00 02 D5	06
					39 01 00 00 00 00 02 CA	07
					39 01 00 00 00 00 02 CB	07
					39 01 00 00 00 00 02 DE	08
					39 01 00 00 00 00 02 DF	08
					39 01 00 00 00 00 02 B0	03
					39 01 00 00 00 00 02 C8	0B
					39 01 00 00 00 00 02 C9	07
					39 01 00 00 00 00 02 C3	00
					39 01 00 00 00 00 02 E7	00
					39 01 00 00 00 00 02 C5	2A
					39 01 00 00 00 00 02 DE	2A
					39 01 00 00 00 00 02 CA	43
					39 01 00 00 00 00 02 E4	C0
					39 01 00 00 00 00 02 E5	0D
					39 01 00 00 00 00 02 CB	28
					39 01 00 00 00 00 02 B0	00
					39 01 00 00 00 00 02 B6	03
					39 01 00 00 00 00 02 BA	87
					39 01 00 00 00 00 02 BF	15
					39 01 00 00 00 00 02 C0	0F
					39 01 00 00 00 00 02 C2	09
					39 01 00 00 00 00 02 C3	02
					39 01 00 00 00 00 02 C4	0F
					39 01 00 00 00 00 02 C5	02
					39 01 00 00 00 00 02 B0	02
					39 01 00 00 00 00 02 C0	00
					39 01 00 00 00 00 02 C1	04
					39 01 00 00 00 00 02 C2	15
					39 01 00 00 00 00 02 C3	26
					39 01 00 00 00 00 02 C4	2A
					39 01 00 00 00 00 02 C5	2F
					39 01 00 00 00 00 02 C6	32
					39 01 00 00 00 00 02 C7	36
					39 01 00 00 00 00 02 C8	3A
					39 01 00 00 00 00 02 C9	37
					39 01 00 00 00 00 02 CA	38
					39 01 00 00 00 00 02 CB	37
					39 01 00 00 00 00 02 CC	3F
					39 01 00 00 00 00 02 CD	32
					39 01 00 00 00 00 02 CE	34
					39 01 00 00 00 00 02 CF	33
					39 01 00 00 00 00 02 D0	07
					39 01 00 00 00 00 02 D2	04
					39 01 00 00 00 00 02 D3	0B
					39 01 00 00 00 00 02 D4	17
					39 01 00 00 00 00 02 D5	2B
					39 01 00 00 00 00 02 D6	38
					39 01 00 00 00 00 02 D7	3B
					39 01 00 00 00 00 02 D8	3D
					39 01 00 00 00 00 02 D9	3E
					39 01 00 00 00 00 02 DA	3E
					39 01 00 00 00 00 02 DB	3F
					39 01 00 00 00 00 02 DC	3F
					39 01 00 00 00 00 02 DD	3F
					39 01 00 00 00 00 02 DE	3F
					39 01 00 00 00 00 02 DF	32
					39 01 00 00 00 00 02 E0	30
					39 01 00 00 00 00 02 E1	2F
					39 01 00 00 00 00 02 E2	00
					39 01 00 00 00 00 02 B0	07
					39 01 00 00 00 00 02 B1	00
					39 01 00 00 00 00 02 B2	00
					39 01 00 00 00 00 02 B3	0E
					39 01 00 00 00 00 02 B4	1B
					39 01 00 00 00 00 02 B5	2C
					39 01 00 00 00 00 02 B6	39
					39 01 00 00 00 00 02 B7	5B
					39 01 00 00 00 00 02 B8	7C
					39 01 00 00 00 00 02 B9	BC
					39 01 00 00 00 00 02 BA	FB
					39 01 00 00 00 00 02 BB	75
					39 01 00 00 00 00 02 BC	F5
					39 01 00 00 00 00 02 BD	F9
					39 01 00 00 00 00 02 BE	7B
					39 01 00 00 00 00 02 BF	01
					39 01 00 00 00 00 02 C0	45
					39 01 00 00 00 00 02 C1	85
					39 01 00 00 00 00 02 C2	A1
					39 01 00 00 00 00 02 C3	BF
					39 01 00 00 00 00 02 C4	CF
					39 01 00 00 00 00 02 C5	DE
					39 01 00 00 00 00 02 C6	EE
					39 01 00 00 00 00 02 C7	F8
					39 01 00 00 00 00 02 C8	FC
					39 01 00 00 00 00 02 C9	00
					39 01 00 00 00 00 02 CA	00
					39 01 00 00 00 00 02 CB	05
					39 01 00 00 00 00 02 CC	6F
					39 01 00 00 00 00 02 CD	FF
					39 01 00 00 00 00 02 CE	FF
					39 01 00 00 00 00 02 B0	08
					39 01 00 00 00 00 02 B1	00
					39 01 00 00 00 00 02 B2	02
					39 01 00 00 00 00 02 B3	13
					39 01 00 00 00 00 02 B4	1E
					39 01 00 00 00 00 02 B5	2C
					39 01 00 00 00 00 02 B6	38
					39 01 00 00 00 00 02 B7	5B
					39 01 00 00 00 00 02 B8	7B
					39 01 00 00 00 00 02 B9	BA
					39 01 00 00 00 00 02 BA	F9
					39 01 00 00 00 00 02 BB	72
					39 01 00 00 00 00 02 BC	F1
					39 01 00 00 00 00 02 BD	F5
					39 01 00 00 00 00 02 BE	76
					39 01 00 00 00 00 02 BF	FA
					39 01 00 00 00 00 02 C0	3D
					39 01 00 00 00 00 02 C1	7D
					39 01 00 00 00 00 02 C2	9A
					39 01 00 00 00 00 02 C3	B6
					39 01 00 00 00 00 02 C4	C5
					39 01 00 00 00 00 02 C5	D5
					39 01 00 00 00 00 02 C6	E4
					39 01 00 00 00 00 02 C7	EC
					39 01 00 00 00 00 02 C8	F0
					39 01 00 00 00 00 02 C9	00
					39 01 00 00 00 00 02 CA	00
					39 01 00 00 00 00 02 CB	05
					39 01 00 00 00 00 02 CC	6B
					39 01 00 00 00 00 02 CD	FF
					39 01 00 00 00 00 02 CE	FF
					39 01 00 00 00 00 02 B0	09
					39 01 00 00 00 00 02 B1	00
					39 01 00 00 00 00 02 B2	10
					39 01 00 00 00 00 02 B3	14
					39 01 00 00 00 00 02 B4	1D
					39 01 00 00 00 00 02 B5	2B
					39 01 00 00 00 00 02 B6	37
					39 01 00 00 00 00 02 B7	5A
					39 01 00 00 00 00 02 B8	7B
					39 01 00 00 00 00 02 B9	BB
					39 01 00 00 00 00 02 BA	FB
					39 01 00 00 00 00 02 BB	74
					39 01 00 00 00 00 02 BC	F4
					39 01 00 00 00 00 02 BD	F8
					39 01 00 00 00 00 02 BE	79
					39 01 00 00 00 00 02 BF	FB
					39 01 00 00 00 00 02 C0	3C
					39 01 00 00 00 00 02 C1	7B
					39 01 00 00 00 00 02 C2	97
					39 01 00 00 00 00 02 C3	B2
					39 01 00 00 00 00 02 C4	C0
					39 01 00 00 00 00 02 C5	CF
					39 01 00 00 00 00 02 C6	DC
					39 01 00 00 00 00 02 C7	E4
					39 01 00 00 00 00 02 C8	E8
					39 01 00 00 00 00 02 C9	00
					39 01 00 00 00 00 02 CA	00
					39 01 00 00 00 00 02 CB	05
					39 01 00 00 00 00 02 CC	6B
					39 01 00 00 00 00 02 CD	FF
					39 01 00 00 00 00 02 CE	FF
					39 01 00 00 00 00 02 B0	0A
					39 01 00 00 00 00 02 B1	00
					39 01 00 00 00 00 02 B2	00
					39 01 00 00 00 00 02 B3	0E
					39 01 00 00 00 00 02 B4	1B
					39 01 00 00 00 00 02 B5	2C
					39 01 00 00 00 00 02 B6	39
					39 01 00 00 00 00 02 B7	5B
					39 01 00 00 00 00 02 B8	7C
					39 01 00 00 00 00 02 B9	BC
					39 01 00 00 00 00 02 BA	FB
					39 01 00 00 00 00 02 BB	75
					39 01 00 00 00 00 02 BC	F5
					39 01 00 00 00 00 02 BD	F9
					39 01 00 00 00 00 02 BE	7B
					39 01 00 00 00 00 02 BF	01
					39 01 00 00 00 00 02 C0	45
					39 01 00 00 00 00 02 C1	85
					39 01 00 00 00 00 02 C2	A1
					39 01 00 00 00 00 02 C3	BF
					39 01 00 00 00 00 02 C4	CF
					39 01 00 00 00 00 02 C5	DE
					39 01 00 00 00 00 02 C6	EE
					39 01 00 00 00 00 02 C7	F8
					39 01 00 00 00 00 02 C8	FC
					39 01 00 00 00 00 02 C9	00
					39 01 00 00 00 00 02 CA	00
					39 01 00 00 00 00 02 CB	05
					39 01 00 00 00 00 02 CC	6F
					39 01 00 00 00 00 02 CD	FF
					39 01 00 00 00 00 02 CE	FF
					39 01 00 00 00 00 02 B0	0B
					39 01 00 00 00 00 02 B1	00
					39 01 00 00 00 00 02 B2	02
					39 01 00 00 00 00 02 B3	13
					39 01 00 00 00 00 02 B4	1E
					39 01 00 00 00 00 02 B5	2C
					39 01 00 00 00 00 02 B6	38
					39 01 00 00 00 00 02 B7	5B
					39 01 00 00 00 00 02 B8	7B
					39 01 00 00 00 00 02 B9	BA
					39 01 00 00 00 00 02 BA	F9
					39 01 00 00 00 00 02 BB	72
					39 01 00 00 00 00 02 BC	F1
					39 01 00 00 00 00 02 BD	F5
					39 01 00 00 00 00 02 BE	76
					39 01 00 00 00 00 02 BF	FA
					39 01 00 00 00 00 02 C0	3D
					39 01 00 00 00 00 02 C1	7D
					39 01 00 00 00 00 02 C2	9A
					39 01 00 00 00 00 02 C3	B6
					39 01 00 00 00 00 02 C4	C5
					39 01 00 00 00 00 02 C5	D5
					39 01 00 00 00 00 02 C6	E4
					39 01 00 00 00 00 02 C7	EC
					39 01 00 00 00 00 02 C8	F0
					39 01 00 00 00 00 02 C9	00
					39 01 00 00 00 00 02 CA	00
					39 01 00 00 00 00 02 CB	05
					39 01 00 00 00 00 02 CC	6B
					39 01 00 00 00 00 02 CD	FF
					39 01 00 00 00 00 02 CE	FF
					39 01 00 00 00 00 02 B0	0C
					39 01 00 00 00 00 02 B1	00
					39 01 00 00 00 00 02 B2	10
					39 01 00 00 00 00 02 B3	14
					39 01 00 00 00 00 02 B4	1D
					39 01 00 00 00 00 02 B5	2B
					39 01 00 00 00 00 02 B6	37
					39 01 00 00 00 00 02 B7	5A
					39 01 00 00 00 00 02 B8	7B
					39 01 00 00 00 00 02 B9	BB
					39 01 00 00 00 00 02 BA	FB
					39 01 00 00 00 00 02 BB	74
					39 01 00 00 00 00 02 BC	F4
					39 01 00 00 00 00 02 BD	F8
					39 01 00 00 00 00 02 BE	79
					39 01 00 00 00 00 02 BF	FB
					39 01 00 00 00 00 02 C0	3C
					39 01 00 00 00 00 02 C1	7B
					39 01 00 00 00 00 02 C2	97
					39 01 00 00 00 00 02 C3	B2
					39 01 00 00 00 00 02 C4	C0
					39 01 00 00 00 00 02 C5	CF
					39 01 00 00 00 00 02 C6	DC
					39 01 00 00 00 00 02 C7	E4
					39 01 00 00 00 00 02 C8	E8
					39 01 00 00 00 00 02 C9	00
					39 01 00 00 00 00 02 CA	00
					39 01 00 00 00 00 02 CB	05
					39 01 00 00 00 00 02 CC	6B
					39 01 00 00 00 00 02 CD	FF
					39 01 00 00 00 00 02 CE	FF
					39 01 00 00 00 00 02 B0 06
					39 01 00 00 00 00 02 C0 A5
					39 01 00 00 00 00 02 CA 09
					39 01 00 00 00 00 02 C0 00
					39 01 00 00 78 00 02 35 00 /* 120ms delay */
				];

				qcom,mdss-dsi-on-command-state = "dsi_lp_mode";
				qcom,mdss-dsi-off-command-state = "dsi_lp_mode";

				qcom,mdss-dsi-off-command = [
					05 01 00 00 78 00 02 10 00  /* 120ms delay */
				];
			};
		};
	};
};
