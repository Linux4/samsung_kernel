/* Copyright (c) 2012, Samsung Electronics Corporation. All rights reserved.
 *
 * This program is free software; you can redistribute it and/or modify
 * it under the terms of the GNU General Public License version 2 and
 * only version 2 as published by the Free Software Foundation.
 *
 * This program is distributed in the hope that it will be useful,
 * but WITHOUT ANY WARRANTY; without even the implied warranty of
 * MERCHANTABILITY or FITNESS FOR A PARTICULAR PURPOSE.  See the
 * GNU General Public License for more details.
 */

&mdss_mdp {
	ss_dsi_panel_S6E3FA9_AMB667UM07_FHD: ss_dsi_panel_S6E3FA9_AMB667UM07_FHD {
		qcom,mdss-dsi-panel-name = "ss_dsi_panel_S6E3FA9_AMB667UM07_FHD";
		label = "ss_dsi_panel_S6E3FA9_AMB667UM07_FHD";

		qcom,mdss-dsi-bpp = <24>;

		qcom,mdss-dsi-h-pulse-width = <121>;
		qcom,mdss-dsi-h-back-porch = <122>;
		qcom,mdss-dsi-h-front-porch = <120>;
		qcom,mdss-dsi-h-sync-skew = <0>;

		qcom,mdss-dsi-v-pulse-width = <2>;
		qcom,mdss-dsi-v-back-porch = <16>;
		qcom,mdss-dsi-v-front-porch = <248>;

		qcom,mdss-dsi-h-left-border = <0>;
		qcom,mdss-dsi-h-right-border = <0>;
		qcom,mdss-dsi-v-top-border = <0>;
		qcom,mdss-dsi-v-bottom-border = <0>;

		qcom,mdss-dsi-panel-framerate = <60>;
		qcom,mdss-dsi-panel-clockrate = <1200000000>;
		qcom,mdss-dsi-panel-phy-timings = [00 27 0A 0A 27 25 0A 0B 07 02 04 00];		/* SM7150 : dsi_phy_v3_0 */

		qcom,mdss-dsi-underflow-color = <0xFF>;
		qcom,mdss-dsi-border-color = <0>;

		qcom,mdss-dsi-bl-pmic-control-type = "bl_ctrl_dcs";

		qcom,mdss-dsi-bl-min-level = <1>;
		qcom,mdss-dsi-bl-max-level = <425>;
		qcom,mdss-brightness-max-level = <425>;
		qcom,mdss-brightness-default-level = <255>;
		qcom,mdss-dsi-interleave-mode = <0>;
		qcom,mdss-dsi-panel-type = "dsi_cmd_mode";

		qcom,mdss-dsi-te-pin-select = <1>;

		qcom,mdss-dsi-te-dcs-command = <1>;
		qcom,mdss-dsi-wr-mem-start = <0x2C>;
		qcom,mdss-dsi-wr-mem-continue = <0x3C>;

		qcom,mdss-dsi-pixel-packing = "loose";

		qcom,mdss-dsi-virtual-channel-id = <0>;
		qcom,mdss-dsi-color-order = "rgb_swap_rgb";
		qcom,mdss-dsi-lane-0-state;
		qcom,mdss-dsi-lane-1-state;
		qcom,mdss-dsi-lane-2-state;
		qcom,mdss-dsi-lane-3-state;
		qcom,mdss-dsi-lane-map = "lane_map_0123";

		qcom,mdss-dsi-t-clk-pre = <0x3B>;
		qcom,mdss-dsi-t-clk-post = <0x0F>;

		qcom,mdss-dsi-stream = <0>;
		qcom,mdss-dsi-mdp-trigger = "none";
		qcom,mdss-dsi-dma-trigger = "trigger_sw";

		qcom,mdss-pan-physical-width-dimension = <70>;
		qcom,mdss-pan-physical-height-dimension = <155>;

		samsung,mdss-dsi-off-reset-delay-us = <1000>;
		qcom,mdss-dsi-reset-sequence = <0 10>, <1 10>;

		/*qcom,mdss-dsi-lp11-init;*/
		/*qcom,mdss-dsi-init-delay-us = <1000>;*/

		qcom,mdss-dsi-rx-eot-ignore;
		qcom,mdss-dsi-tx-eot-append;

		/* *************************************************************
		 * Below  parameters are samsung dependent things
		 * *************************************************************
		 */
		samsung,panel-vendor = "SDC";
		samsung,disp-model = "AMB667UM06";
		samsung,panel-lpm-enable;
		samsung,support_factory_panel_swap;
		samsung,support_dynamic_mipi_clk;

		/* *************************************************************
		 *  Tx
		 * *************************************************************
		 */
		samsung,level0_key_enable_tx_cmds_revA	= [29 01 00 00 00 00 03 9F A5 A5]; /* PASSWD0 */
		samsung,level0_key_disable_tx_cmds_revA	= [29 01 00 00 00 00 03 9F 5A 5A]; /* PASSWD0 */
		samsung,level1_key_enable_tx_cmds_revA	= [29 01 00 00 00 00 03 F0 5A 5A]; /* PASSWD1 */
		samsung,level1_key_disable_tx_cmds_revA	= [29 01 00 00 00 00 03 F0 A5 A5]; /* PASSWD1 */
		samsung,level2_key_enable_tx_cmds_revA	= [29 01 00 00 00 00 03 FC 5A 5A];
		samsung,level2_key_disable_tx_cmds_revA	= [29 01 00 00 00 00 03 FC A5 A5];

		/* BRIGHTNESS_MAX_PACKET = 50 */
		samsung,brightness_tx_cmds_revA = [
			39 01 00 00 00 00 01 00
			39 01 00 00 00 00 01 00
			39 01 00 00 00 00 01 00
			39 01 00 00 00 00 01 00
			39 01 00 00 00 00 01 00
			39 01 00 00 00 00 01 00
			39 01 00 00 00 00 01 00
			39 01 00 00 00 00 01 00
			39 01 00 00 00 00 01 00
			39 01 00 00 00 00 01 00
			39 01 00 00 00 00 01 00
			39 01 00 00 00 00 01 00
			39 01 00 00 00 00 01 00
			39 01 00 00 00 00 01 00
			39 01 00 00 00 00 01 00
			39 01 00 00 00 00 01 00
			39 01 00 00 00 00 01 00
			39 01 00 00 00 00 01 00
			39 01 00 00 00 00 01 00
			39 01 00 00 00 00 01 00
			39 01 00 00 00 00 01 00
			39 01 00 00 00 00 01 00
			39 01 00 00 00 00 01 00
			39 01 00 00 00 00 01 00
			39 01 00 00 00 00 01 00
			39 01 00 00 00 00 01 00
			39 01 00 00 00 00 01 00
			39 01 00 00 00 00 01 00
			39 01 00 00 00 00 01 00
			39 01 00 00 00 00 01 00
			39 01 00 00 00 00 01 00
			39 01 00 00 00 00 01 00
			39 01 00 00 00 00 01 00
			39 01 00 00 00 00 01 00
			39 01 00 00 00 00 01 00
			39 01 00 00 00 00 01 00
			39 01 00 00 00 00 01 00
			39 01 00 00 00 00 01 00
			39 01 00 00 00 00 01 00
			39 01 00 00 00 00 01 00
			39 01 00 00 00 00 01 00
			39 01 00 00 00 00 01 00
			39 01 00 00 00 00 01 00
			39 01 00 00 00 00 01 00
			39 01 00 00 00 00 01 00
			39 01 00 00 00 00 01 00
			39 01 00 00 00 00 01 00
			39 01 00 00 00 00 01 00
			39 01 00 00 00 00 01 00
			39 01 00 00 00 00 01 00
		];


		samsung,display_on_tx_cmds_revA = [
			05 01 00 00 00 00 02 29 00
		];

		samsung,display_off_tx_cmds_revA = [05 01 00 00 00 00 02 28 00];

		/* *************************************************************
		 *  Rx (Module Information READ)
		 * *************************************************************
		 */
		samsung,mdnie_read_rx_cmds_revA		= [06 01 00 00 00 00 01 A1 04 00]; /* White color position */
		samsung,manufacture_date_rx_cmds_revA	= [06 01 00 00 00 00 01 A1 04 04]; /* manufacture data 4 byte*/
		samsung,octa_id_rx_cmds_revA		= [06 01 00 00 00 00 01 A1 14 0B]; /* manufacture information */
		samsung,cell_id_rx_cmds_revA		= [06 01 00 00 00 00 01 A1 07 04]; /* manufacture data 7 byte*/
		samsung,ddi_id_rx_cmds_revA		= [06 01 00 00 00 00 01 D6 05 00]; /* CHIP ID : read D6 1~5th */

		samsung,manufacture_id0_rx_cmds_revA	= [06 01 00 00 00 00 01 da 01 00];
		samsung,manufacture_id1_rx_cmds_revA	= [06 01 00 00 00 00 01 db 01 00];
		samsung,manufacture_id2_rx_cmds_revA	= [06 01 00 00 00 00 01 dc 01 00];

		samsung,mtp_read_sysfs_rx_cmds_revA	= [06 01 00 00 00 00 01 00 00 00];

		/*
		*************************************************************************************************************************
		* Self mask check debug (SELF MASK CHECK)
		*************************************************************************************************************************
		*/

		samsung,mask_crc_pass_data = [0F 09];
		samsung,self_mask_check_rx_cmds = [ 06 01 00 00 00 00 01 FB 02 0F];	/* read FB 16th ~ 17th */
		samsung,support_gamma_mode2;

		/* *************************************************************
		 *  SELF DISPLAY
		 * *************************************************************
		 */

		samsung,support_self_display;
		ss,self_display = <&self_display_FA9_dtsi>;

		/* *************************************************************
		 * VINT
		 * *************************************************************
		 */
		samsung,vint_tx_cmds_revA = [
			29 01 00 00 00 00 02 F4 CC
		];

		/* *************************************************************
		 * TEST MODE
		 * **************************************************************
		 */
		/* MCD TEST */
		samsung,mcd_on_tx_cmds_revA = [
			29 01 00 00 00 00 03 F0 5A 5A
			29 01 00 00 00 00 02 F4 CE
			29 01 00 00 00 00 2B CB
				00 00 42 0F 00 02 00 00
				00 00 00 00 00 00 00 00
				00 00 50 00 00 40 47 00
				4D 00 00 00 20 07 28 38
				51 00 00 00 00 00 F0 F0
				0B 46
			29 01 00 00 00 00 03 B0 05 F6
			29 01 00 00 00 00 02 F6 00
			29 01 00 00 00 00 03 B0 04 CC
			29 01 00 00 00 00 02 CC 12
			29 01 00 00 64 00 02 F7 03			/* 100 ms Delay */
			29 01 00 00 00 00 03 F0 A5 A5
		];

		samsung,mcd_off_tx_cmds_revA = [
			29 01 00 00 00 00 03 F0 5A 5A
			29 01 00 00 00 00 02 F4 CC
			29 01 00 00 00 00 2B CB
				00 00 42 0B 00 06 00 00
				00 00 00 00 00 00 00 00
				00 00 50 00 00 40 47 00
				4D 00 00 00 20 07 28 38
				51 00 00 00 00 00 F0 F0
				00 00
			29 01 00 00 00 00 03 B0 05 F6
			29 01 00 00 00 00 02 F6 90
			29 01 00 00 00 00 03 B0 04 CC
			29 01 00 00 00 00 02 CC 00
			29 01 00 00 64 00 02 F7 03			/* 100 ms Delay */
			29 01 00 00 00 00 03 F0 A5 A5
		];


		/* GRAY SPOT TEST */
		samsung,gray_spot_test_on_tx_cmds_revA = [
			29 01 00 00 00 00 03 F0 5A 5A
			29 01 00 00 00 00 03 B0 05 F6
			29 01 00 00 00 00 02 F6 00
			29 01 00 00 00 00 03 B0 07 F2
			29 01 00 00 00 00 06 F2 02 00 58 38 D0
			29 01 00 00 00 00 03 B0 11 F4
			29 01 00 00 00 00 02 F4 1E
			29 01 00 00 00 00 05 B5 19 8D 35 00
			29 01 00 00 64 00 02 F7 03
			29 01 00 00 00 00 03 F0 A5 A5
		];

		samsung,gray_spot_test_off_tx_cmds_revA = [
			29 01 00 00 00 00 03 F0 5A 5A
			29 01 00 00 00 00 03 B0 05 F6
			29 01 00 00 00 00 02 F6 90
			29 01 00 00 00 00 03 B0 07 F2
			29 01 00 00 00 00 06 F2 02 0E 58 38 50
			29 01 00 00 00 00 03 B0 11 F4
			29 01 00 00 00 00 02 F4 1E
			29 01 00 00 00 00 05 B5 19 8D 35 00
			29 01 00 00 64 00 02 F7 03
			29 01 00 00 00 00 03 F0 A5 A5
		];

		samsung,gray_spot_rx_cmds_revA	= [06 01 00 00 00 00 01 B5 02 02];

		/* MICRO CRACK Test */
		samsung,micro_short_test_on_tx_cmds_revA = [
			29 00 00 00 00 00 03 F0 5A 5A
			29 01 00 00 00 00 03 B0 03 F6
			29 01 00 00 00 00 04 F6 3B 00 78
			29 00 00 00 00 00 03 BF 33 25
			29 01 00 00 00 00 03 F0 A5 A5
		];

		samsung,micro_short_test_off_tx_cmds_revA = [
			29 00 00 00 00 00 03 F0 5A 5A
			29 01 00 00 00 00 03 B0 03 F6
			29 01 00 00 00 00 04 F6 00 00 90
			29 00 00 00 00 00 03 BF 00 07
			29 01 00 00 00 00 03 F0 A5 A5
		];

		/* CCD TEST */
		samsung,ccd_test_on_tx_cmds_revA = [
			29 00 00 00 00 00 03 F0 5A 5A
			29 01 00 00 00 00 03 B0 02 CC
			29 01 00 00 01 00 02 CC 01	/* wait 1 ms */
			29 01 00 00 00 00 03 F0 A5 A5
		];

		samsung,ccd_pass_val = <0x00>;
		samsung,ccd_fail_val = <0x04>;

		samsung,ccd_state_rx_cmds_revA= [06 01 00 00 00 00 01 CD 01 0E];

		samsung,ccd_test_off_tx_cmds_revA = [
			29 00 00 00 00 00 03 F0 5A 5A
			29 01 00 00 00 00 03 B0 02 CC
			29 01 00 00 00 00 02 CC 00
			29 01 00 00 00 00 03 F0 A5 A5
		];

		/* *************************************************************
		 * ACL command list and mappings
		 * **************************************************************
		 */
		samsung,acl_on_tx_cmds_revA = [
			/* 32 frame AVG ACL ON, Start 50%, ACL 15%, 32Frame AVG */
			29 01 00 00 00 00 05 B4 00 55 40 FF
			29 01 00 00 00 00 03 B0 51 B8
			29 01 00 00 00 00 03 B8 02 00
			29 01 00 00 00 00 02 55 02	/* ACL ON */
		];

		samsung,acl_off_tx_cmds_revA = [
			/* 16 Frame AVG ACL OFF, Start Point 60%, ACL 0%*/
			29 01 00 00 00 00 05 B4 00 44 80 65
			29 01 00 00 00 00 03 B0 51 B8
			29 01 00 00 00 00 03 B8 00 00
			29 01 00 00 00 00 02 55 00	/* ACL ON */
		];

		samsung,elvss_rx_cmds_revA = [ 06 01 00 00 00 00 01 B5 19];	/* read B7 9th, 10th para */

		/* *************************************************************
		 * Dynamic MIPI Clock
		 * **************************************************************
		 */

		samsung,ffc_cmds_line_position = <2>;

		samsung,ffc_tx_cmds_revA = [
			29 00 00 00 00 00 03 F0 5A 5A
			29 00 00 00 00 00 03 FC 5A 5A
			29 00 00 00 00 00 0A C5 0D 10 64 1E AF 05 00 26 B0	/* 0 Default : 1176.5 Mbps (588.25) */
			29 00 00 00 00 00 03 F0 A5 A5
			29 00 00 00 00 00 03 FC A5 A5
		];

		samsung,dyn_mipi_clk_ffc_cmds_revA = [
			29 00 00 00 00 00 0A C5 0D 10 64 1E AF 05 00 26 B0	/* 0 Default : 1176.5 Mbps (588.25) */
			29 00 00 00 00 00 0A C5 0D 10 64 1E AF 05 00 26 B0	/* 1 : 1176.5 Mbps (588.25) */
			29 00 00 00 00 00 0A C5 0D 10 64 1E 32 05 00 26 B0	/* 2 : 1195.5 Mbps (597.75) */
			29 00 00 00 00 00 0A C5 0D 10 64 1F 61 05 00 26 B0	/* 3 : 1150.5    Mbps (575.25)  */
			29 00 00 00 00 00 0A C5 0D 10 64 1F 34 05 00 26 B0	/* 4 : 1157 Mbps (578.5) */
		];

		samsung,dynamic_mipi_clk_timing_table = <
			/*<bitclk><>*/
			1176500000 /* clk id 0 default */
			1176500000 /* clk id 1 A */
			1195500000 /* clk id 2 B */
			1150500000 /* clk id 3 C */
			1157000000 /* clk id 4 D */
		>;

		samsung,dynamic_mipi_clk_sel_table = <
			/*<RAT><BAND><from><end><clk index>*/
				1	1	0	0	2
				1	2	0	0	1
				1	3	0	0	1
				1	4	0	0	1
				2	11	10562	10838	1
				2	12	9662	9938	1
				2	13	1162	1513	1
				2	14	1537	1738	1
				2	15	4357	4399	1
				2	15	4400	4420	2
				2	15	4421	4458	1
				2	17	2237	2563	1
				2	18	2937	3088	1
				3	91	0	599	1
				3	92	600	1199	1
				3	93	1200	1949	1
				3	94	1950	2399	1
				3	95	2400	2519	1
				3	95	2520	2530	2
				3	95	2531	2649	1
				3	97	2750	3449	1
				3	98	3450	3799	1
				3	102	5010	5089	1
				3	102	5090	5099	2
				3	102	5100	5179	1
				3	103	5180	5279	1
				3	104	5280	5379	1
				3	107	5730	5788	1
				3	107	5789	5791	2
				3	107	5792	5849	1
				3	108	5850	5999	1
				3	109	6000	6149	1
				3	110	6150	6449	1
				3	111	6450	6599	1
				3	115	8040	8689	1
				3	116	8690	9039	1
				3	118	9210	9429	1
				3	118	9430	9440	2
				3	118	9441	9659	1
				3	119	9660	9769	1
				3	120	9770	9869	1
				3	122	9920	10359	1
				3	124	36200	36349	1
				3	128	37750	38249	1
				3	129	38250	38649	1
				3	130	38650	39119	1
				3	130	39120	39149	4
				3	130	39150	39210	2
				3	130	39211	39649	1
				3	131	39650	41589	1
				3	132	41590	43589	1
				3	138	55240	56739	1
				3	156	66436	67335	1
				3	161	68586	68935	1
				4	51	0	0	1
				4	52	0	0	1
				4	53	0	0	1
				4	54	0	0	1
				4	55	0	0	1
				4	56	0	0	1
				5	61	0	0	1
				5	62	0	0	1
				5	71	0	0	1
		>;

		/* *************************************************************
		 * candela to index mappings
		 * **************************************************************
		 */
		samsung,gamma_mode2_candela_map_table_revA = < /* THIS TABLE USED FOR DIMMING */
		/*<idx>	  <from>  <till> <scaled_level>  <Panel_Real_CD> */
			0		0		0		3		2
			1		1		1		6		3
			2		2		2		9		4
			3		3		3		12		6
			4		4		4		15		7
			5		5		5		18		8
			6		6		6		21		9
			7		7		7		24		10
			8		8		8		27		12
			9		9		9		30		13
			10		10		10		33		14
			11		11		11		36		15
			12		12		12		39		16
			13		13		13		42		18
			14		14		14		45		19
			15		15		15		48		20
			16		16		16		52		22
			17		17		17		55		23
			18		18		18		59		24
			19		19		19		62		26
			20		20		20		66		27
			21		21		21		70		29
			22		22		22		73		30
			23		23		23		77		32
			24		24		24		80		33
			25		25		25		84		34
			26		26		26		88		36
			27		27		27		91		37
			28		28		28		95		39
			29		29		29		98		40
			30		30		30		102		42
			31		31		31		106		43
			32		32		32		109		44
			33		33		33		113		46
			34		34		34		116		47
			35		35		35		120		49
			36		36		36		124		50
			37		37		37		127		52
			38		38		38		131		53
			39		39		39		134		54
			40		40		40		138		56
			41		41		41		142		58
			42		42		42		145		59
			43		43		43		149		60
			44		44		44		152		62
			45		45		45		156		63
			46		46		46		160		65
			47		47		47		163		66
			48		48		48		167		68
			49		49		49		170		69
			50		50		50		174		70
			51		51		51		178		72
			52		52		52		181		73
			53		53		53		185		75
			54		54		54		188		76
			55		55		55		192		78
			56		56		56		196		79
			57		57		57		199		80
			58		58		58		203		82
			59		59		59		206		83
			60		60		60		210		85
			61		61		61		214		86
			62		62		62		217		88
			63		63		63		221		89
			64		64		64		224		90
			65		65		65		228		92
			66		66		66		232		94
			67		67		67		235		95
			68		68		68		239		97
			69		69		69		242		98
			70		70		70		246		99
			71		71		71		250		101
			72		72		72		253		102
			73		73		73		257		104
			74		74		74		260		105
			75		75		75		264		107
			76		76		76		268		108
			77		77		77		271		109
			78		78		78		275		111
			79		79		79		278		112
			80		80		80		282		114
			81		81		81		286		115
			82		82		82		289		117
			83		83		83		293		118
			84		84		84		297		120
			85		85		85		300		121
			86		86		86		304		123
			87		87		87		307		124
			88		88		88		311		125
			89		89		89		315		127
			90		90		90		318		128
			91		91		91		322		130
			92		92		92		325		131
			93		93		93		329		133
			94		94		94		333		134
			95		95		95		336		135
			96		96		96		340		137
			97		97		97		343		138
			98		98		98		347		140
			99		99		99		351		141
			100		100		100		354		143
			101		101		101		358		144
			102		102		102		361		145
			103		103		103		365		147
			104		104		104		369		149
			105		105		105		372		150
			106		106		106		376		151
			107		107		107		379		153
			108		108		108		383		154
			109		109		109		387		156
			110		110		110		390		157
			111		111		111		394		159
			112		112		112		397		160
			113		113		113		401		161
			114		114		114		405		163
			115		115		115		408		164
			116		116		116		412		166
			117		117		117		415		167
			118		118		118		419		169
			119		119		119		423		170
			120		120		120		426		171
			121		121		121		430		173
			122		122		122		433		174
			123		123		123		437		176
			124		124		124		441		177
			125		125		125		444		179
			126		126		126		448		180
			127		127		127		451		181
			128		128		128		455		183
			129		129		129		459		185
			130		130		130		464		187
			131		131		131		468		188
			132		132		132		473		191
			133		133		133		477		192
			134		134		134		482		194
			135		135		135		486		196
			136		136		136		491		198
			137		137		137		495		200
			138		138		138		500		202
			139		139		139		504		203
			140		140		140		509		206
			141		141		141		513		207
			142		142		142		518		209
			143		143		143		522		211
			144		144		144		527		213
			145		145		145		531		215
			146		146		146		535		216
			147		147		147		540		218
			148		148		148		544		220
			149		149		149		549		222
			150		150		150		553		224
			151		151		151		558		226
			152		152		152		562		228
			153		153		153		567		230
			154		154		154		571		231
			155		155		155		576		233
			156		156		156		580		235
			157		157		157		585		237
			158		158		158		589		239
			159		159		159		594		241
			160		160		160		598		243
			161		161		161		603		245
			162		162		162		607		246
			163		163		163		612		249
			164		164		164		616		250
			165		165		165		620		252
			166		166		166		625		254
			167		167		167		629		256
			168		168		168		634		258
			169		169		169		638		259
			170		170		170		643		261
			171		171		171		647		263
			172		172		172		652		265
			173		173		173		656		267
			174		174		174		661		269
			175		175		175		665		271
			176		176		176		670		273
			177		177		177		674		274
			178		178		178		679		276
			179		179		179		683		278
			180		180		180		688		280
			181		181		181		692		282
			182		182		182		696		284
			183		183		183		701		286
			184		184		184		705		287
			185		185		185		710		289
			186		186		186		714		291
			187		187		187		719		293
			188		188		188		723		295
			189		189		189		728		297
			190		190		190		732		299
			191		191		191		737		301
			192		192		192		741		302
			193		193		193		746		304
			194		194		194		750		306
			195		195		195		755		308
			196		196		196		759		310
			197		197		197		764		312
			198		198		198		768		314
			199		199		199		773		316
			200		200		200		777		317
			201		201		201		781		319
			202		202		202		786		321
			203		203		203		790		323
			204		204		204		795		325
			205		205		205		799		327
			206		206		206		804		329
			207		207		207		808		330
			208		208		208		813		332
			209		209		209		817		334
			210		210		210		822		336
			211		211		211		826		338
			212		212		212		831		340
			213		213		213		835		342
			214		214		214		840		344
			215		215		215		844		345
			216		216		216		849		347
			217		217		217		853		349
			218		218		218		858		351
			219		219		219		862		353
			220		220		220		866		354
			221		221		221		871		357
			222		222		222		875		358
			223		223		223		880		360
			224		224		224		884		362
			225		225		225		889		364
			226		226		226		893		366
			227		227		227		898		368
			228		228		228		902		370
			229		229		229		907		372
			230		230		230		911		373
			231		231		231		916		375
			232		232		232		920		377
			233		233		233		925		379
			234		234		234		929		381
			235		235		235		934		383
			236		236		236		938		385
			237		237		237		942		386
			238		238		238		947		388
			239		239		239		951		390
			240		240		240		956		392
			241		241		241		960		394
			242		242		242		965		396
			243		243		243		969		397
			244		244		244		974		400
			245		245		245		978		401
			246		246		246		983		403
			247		247		247		987		405
			248		248		248		992		407
			249		249		249		996		409
			250		250		250		1001	411
			251		251		251		1005	412
			252		252		252		1010	415
			253		253		253		1014	416
			254		254		254		1019	418
			255		255		255		1023	420
			256		256		256		3		421
			257		257		257		5		423
			258		258		258		7		424
			259		259		259		9		425
			260		260		260		12		428
			261		261		261		14		429
			262		262		262		17		431
			263		263		263		19		432
			264		264		264		21		434
			265		265		265		24		436
			266		266		266		26		437
			267		267		267		29		439
			268		268		268		31		441
			269		269		269		33		442
			270		270		270		36		444
			271		271		271		38		446
			272		272		272		40		447
			273		273		273		43		449
			274		274		274		45		450
			275		275		275		48		453
			276		276		276		50		454
			277		277		277		52		455
			278		278		278		55		457
			279		279		279		57		459
			280		280		280		59		460
			281		281		281		62		462
			282		282		282		64		464
			283		283		283		67		466
			284		284		284		69		467
			285		285		285		71		469
			286		286		286		74		471
			287		287		287		76		472
			288		288		288		78		473
			289		289		289		81		476
			290		290		290		83		477
			291		291		291		86		479
			292		292		292		88		480
			293		293		293		90		482
			294		294		294		93		484
			295		295		295		95		485
			296		296		296		97		487
			297		297		297		100		489
			298		298		298		102		490
			299		299		299		105		492
			300		300		300		107		494
			301		301		301		109		495
			302		302		302		112		497
			303		303		303		114		498
			304		304		304		116		500
			305		305		305		119		502
			306		306		306		121		503
			307		307		307		124		505
			308		308		308		126		507
			309		309		309		128		508
			310		310		310		131		510
			311		311		311		133		512
			312		312		312		135		513
			313		313		313		138		515
			314		314		314		140		517
			315		315		315		143		519
			316		316		316		145		520
			317		317		317		147		521
			318		318		318		150		523
			319		319		319		152		525
			320		320		320		154		526
			321		321		321		157		528
			322		322		322		159		530
			323		323		323		162		532
			324		324		324		164		533
			325		325		325		166		535
			326		326		326		169		537
			327		327		327		171		538
			328		328		328		173		539
			329		329		329		176		542
			330		330		330		178		543
			331		331		331		181		545
			332		332		332		183		546
			333		333		333		185		548
			334		334		334		188		550
			335		335		335		190		551
			336		336		336		192		553
			337		337		337		195		555
			338		338		338		197		556
			339		339		339		200		558
			340		340		340		202		560
			341		341		341		204		561
			342		342		342		207		563
			343		343		343		209		564
			344		344		344		211		566
			345		345		345		214		568
			346		346		346		216		569
			347		347		347		219		571
			348		348		348		221		573
			349		349		349		223		574
			350		350		350		226		576
			351		351		351		228		578
			352		352		352		231		580
			353		353		353		233		581
			354		354		354		235		583
			355		355		355		238		585
			356		356		356		240		586
			357		357		357		242		587
			358		358		358		245		589
			359		359		359		247		591
			360		360		360		250		593
			361		361		361		252		594
			362		362		362		254		596
			363		363		363		257		598
			364		364		364		259		599
			365		365		365		261		601
			366		366		366		264		603
			367		367		367		266		604
			368		368		368		269		606
			369		369		369		271		608
			370		370		370		273		609
			371		371		371		276		611
			372		372		372		278		612
			373		373		373		280		614
			374		374		374		283		616
			375		375		375		285		617
			376		376		376		288		619
			377		377		377		290		621
			378		378		378		292		622
			379		379		379		295		624
			380		380		380		297		626
			381		381		381		299		627
			382		382		382		302		629
			383		383		383		304		630
			384		384		384		307		633
			385		385		385		309		634
			386		386		386		311		635
			387		387		387		314		637
			388		388		388		316		639
			389		389		389		318		640
			390		390		390		321		642
			391		391		391		323		644
			392		392		392		326		646
			393		393		393		328		647
			394		394		394		330		649
			395		395		395		333		651
			396		396		396		335		652
			397		397		397		337		653
			398		398		398		340		656
			399		399		399		342		657
			400		400		400		345		659
			401		401		401		347		660
			402		402		402		349		662
			403		403		403		352		664
			404		404		404		354		665
			405		405		405		356		667
			406		406		406		359		669
			407		407		407		361		670
			408		408		408		364		672
			409		409		409		366		674
			410		410		410		368		675
			411		411		411		371		677
			412		412		412		373		678
			413		413		413		375		680
			414		414		414		378		682
			415		415		415		380		683
			416		416		416		383		685
			417		417		417		385		687
			418		418		418		387		688
			419		419		419		390		690
			420		420		420		392		692
			421		421		421		394		693
			422		422		422		397		695
			423		423		423		399		697
			424		424		424		402		699
			425		425		425		404		700
		>;

		samsung,aod_candela_map_table_revA = <
			/*<idx>   <from>  <till> <candella> */
			0	0	6	2
			1	7	21	10
			2	22	42	30
			3	43	255	60
		>;

		samsung,gamma_mode2_tx_cmds_revA=[
			39 00 00 00 00 00 02 53 20
			39 00 00 00 00 00 04 B5 19 8D 10
			39 01 00 00 00 00 03 51 03 FF
		]; /* B5 1th para: TSET */


		/*
		 * ************************************************************************************************************************
		 *  FD Settings
		 * ************************************************************************************************************************
		 */

		samsung,fd_on_tx_cmds_revA = [
			29 01 00 00 00 00 03 F0 5A 5A	/* TEST KEY Enable */
			29 01 00 00 00 00 03 B0 0B B5   /* Global Para */
			29 01 00 00 00 00 02 B5 40      /* FD On */
			29 01 00 00 00 00 03 F0 A5 A5	/* TEST KEY Disable */
		];

		samsung,fd_off_tx_cmds_revA = [
			29 01 00 00 00 00 03 F0 5A 5A	/* TEST KEY Enable */
			29 01 00 00 00 00 03 B0 0B B5   /* Global Para */
			29 01 00 00 00 00 02 B5 80      /* FD Off */
			29 01 00 00 00 00 03 F0 A5 A5	/* TEST KEY Disable */
		];


		/* *************************************************************
		 *   APLPM
		 * *************************************************************
		 */

		samsung,lpm_on_tx_cmds_revA = [ // TX_LPM_ON
			/* Image write for HLPM/ALPM Mode */
			29 00 00 00 00 00 03 F0 5A 5A	/* TEST KEY Enable */
			29 00 00 00 00 00 03 B0 02 BB	/* Global Para */
			29 00 00 00 00 00 03 BB 09 18	/* HLPM AOR Setting */
			29 00 00 00 01 00 02 53 22	/* HLPM On Setting */
			29 01 00 00 00 00 03 F0 A5 A5	/* TEST KEY Disable */
		];

		samsung,lpm_off_tx_cmds_revA = [
			/* Image write for Normal Mode */
			29 00 00 00 00 00 03 F0 5A 5A	/* TEST KEY Enable */
			29 00 00 00 01 00 02 53 20	/* ALPM/HLPM off */
			29 01 00 00 00 00 03 F0 A5 A5	/* TEST KEY Disable */
		];

		/* ALPM/HLPM 2nit or 60nit On Commands */
		samsung,lpm_2nit_tx_cmds_revA  = [29 01 00 00 01 00 02 53 23];
		samsung,lpm_10nit_tx_cmds_revA = [29 01 00 00 01 00 02 53 22];
		samsung,lpm_30nit_tx_cmds_revA = [29 01 00 00 01 00 02 53 22];
		samsung,lpm_60nit_tx_cmds_revA = [29 01 00 00 01 00 02 53 22];

		/* HLPM / ALPM Control Commands */
		samsung,lpm_ctrl_hlpm_2nit_tx_cmds_revA  = [29 01 00 00 00 00 03 BB 89 07];
		samsung,lpm_ctrl_hlpm_10nit_tx_cmds_revA = [29 01 00 00 00 00 03 BB 89 07];
		samsung,lpm_ctrl_hlpm_30nit_tx_cmds_revA = [29 01 00 00 00 00 03 BB 59 0C];
		samsung,lpm_ctrl_hlpm_60nit_tx_cmds_revA = [29 01 00 00 00 00 03 BB 09 18];

		/* HLPM / ALPM brightness Commands: default alpm 2nit */
		samsung,lpm_brightnes_tx_cmds_revA = [
			29 00 00 00 00 00 03 F0 5A 5A	/* TEST KEY Enable */
			29 00 00 00 01 00 02 53 22		/* HLPM On Setting */
			29 00 00 00 00 00 03 B0 02 BB
			29 00 00 00 00 00 03 BB 09 18	/* HLPM AOR SETTING */
			29 01 00 00 00 00 03 F0 A5 A5	/* TEST KEY Disable */
		];

		/* AOR Control(97.3%) Commands */
		samsung,lpm-init-delay-ms = <124>; /* used AOD Sequnce. error flag case: Panel OFF => AOD ON case */

		/*
		* ************************************************************************************************************************
		*  DMS (Dynamic Mode Switch)
		* ************************************************************************************************************************
		*/

		qcom,mdss-dsi-display-timings {
			fhd {
				qcom,display-topology = <1 0 1>;
				qcom,default-topology-index = <0>;

				qcom,mdss-dsi-panel-width = <1080>;
				qcom,mdss-dsi-panel-height = <2400>;

				qcom,mdss-dsi-h-pulse-width = <121>;
				qcom,mdss-dsi-h-back-porch = <122>;
				qcom,mdss-dsi-h-front-porch = <120>;
				qcom,mdss-dsi-h-sync-skew = <0>;

				qcom,mdss-dsi-v-pulse-width = <2>;
				qcom,mdss-dsi-v-back-porch = <16>;
				qcom,mdss-dsi-v-front-porch = <248>;

				qcom,mdss-dsi-panel-framerate = <60>;

				qcom,mdss-dsi-panel-clockrate = <1176500000>;
				qcom,mdss-dsi-panel-phy-timings = [00 27 0A 0A 27 25 0A 0B 07 02 04 00];		/* SM7150 : dsi_phy_v3_0 */

				qcom,mdss-dsi-t-clk-pre = <0x3B>;
				qcom,mdss-dsi-t-clk-post = <0x0F>;

				/*only for factory binary*/
				qcom,mdss-fd-on-command = [
					29 01 00 00 00 00 03 F0 5A 5A	/* TEST KEY Enable */
					29 01 00 00 00 00 03 B0 0B B5   /* Global Para */
					29 01 00 00 00 00 02 B5 40      /* FD On */
					29 01 00 00 00 00 03 F0 A5 A5	/* TEST KEY Disable */
				];

				qcom,mdss-dsi-on-command = [
					/* Sleep out, wait 10ms */
					05 01 00 00 0A 00 02 11 00

					/* TE Vsync On */
					29 00 00 00 00 00 03 F0 5A 5A
					29 00 00 00 00 00 02 35 00
					29 00 00 00 00 00 03 F0 A5 A5

					/* PAGE Address Setting */
					29 00 00 00 00 00 05 2A 00 00 04 37
					29 00 00 00 00 00 05 2B 00 00 09 5F

					/* FFC SET MIPI Speed 1195.5Mhz */
					29 00 00 00 00 00 03 F0 5A 5A
					29 00 00 00 00 00 03 FC 5A 5A
					29 00 00 00 00 00 0A C5 0D 10 64 1E AF 05 00 26 B0
					29 00 00 00 00 00 03 F0 A5 A5
					29 00 00 00 00 00 03 FC A5 A5

					/* ERR_FG Setting */
					29 00 00 00 00 00 03 F0 5A 5A
					29 00 00 00 00 00 03 FC 5A 5A
					29 00 00 00 00 00 02 E5 13 /* Error Flag Enable */
					29 00 00 00 00 00 04 ED 00 4C 40
					29 00 00 00 00 00 03 F0 A5 A5
					29 00 00 00 00 00 03 FC A5 A5
					
					/*Smooth Dimming Setting*/
					29 00 00 00 00 00 03 F0 5A 5A 
					29 00 00 00 00 00 03 B0 04 B6
					29 00 00 00 00 00 02 B6 08 
					29 00 00 00 00 00 03 F0 A5 A5

					/* TSP VSYNC ON  */
					29 00 00 00 00 00 03 F0 5A 5A
					29 00 00 00 00 00 0A B9 00 80 E8 09 00 00 00 11 03
					29 00 00 00 00 00 03 F0 A5 A5

					/* Brightness */
					29 00 00 00 00 00 03 F0 5A 5A
					29 00 00 00 00 00 02 53 28
					39 00 00 00 00 00 04 B5 19 8D 10
					29 00 00 00 00 00 03 51 01 C7	/* 420 Nit */
					29 01 00 00 00 00 03 F0 A5 A5
				];

				qcom,mdss-dsi-off-command=[
					05 01 00 00 14 00 02 28 00
					05 01 00 00 78 00 02 10 00	/* wait 120ms(0x78) */
				];

				qcom,mdss-dsi-on-command-state = "dsi_hs_mode";
				qcom,mdss-dsi-off-command-state = "dsi_lp_mode";

			};
		};
	};
};
