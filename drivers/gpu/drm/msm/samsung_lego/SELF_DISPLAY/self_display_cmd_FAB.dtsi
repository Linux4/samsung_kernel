/* Copyright (c) 2020, Samsung Electronics Corporation. All rights reserved.
 *
 * This program is free software; you can redistribute it and/or modify
 * it under the terms of the GNU General Public License version 2 and
 * only version 2 as published by the Free Software Foundation.
 *
 * This program is distributed in the hope that it will be useful,
 * but WITHOUT ANY WARRANTY; without even the implied warranty of
 * MERCHANTABILITY or FITNESS FOR A PARTICULAR PURPOSE.  See the
 * GNU General Public License for more details.
 */

&soc {
	self_display_FAB_dtsi: self_display_FAB_dtsi {
		label = "self_display_FAB_dtsi";

		samsung,support_self_display;

		/*
		 *************************************************************************************************************************
		 * Self Display Operation (Enable/Disable)
		 *************************************************************************************************************************
		 */
		samsung,self_dispaly_on_revA = [ // AOD ENTER
			29 01 00 00 00 00 03 F0 5A 5A	/* TEST KEY Enable */
			29 01 00 00 00 00 03 75 00 01
			29 01 00 00 00 00 03 F0 A5 A5	/* TEST KEY Disable */
		];

		samsung,self_dispaly_off_revA = [ // AOD EXIT
			29 01 00 00 00 00 03 F0 5A 5A	/* TEST KEY Enable */
			29 01 00 00 00 00 03 75 00 00
			29 01 00 00 00 00 02 85 00	/* Partial HLPM & Scan Off */
			29 01 00 00 00 00 03 F0 A5 A5	/* TEST KEY Disable */
		];

		/*
		 *************************************************************************************************************************
		 * Self Display Operation (SELF MASK)
		 *************************************************************************************************************************
		//ss_send_cmd(vdd, TX_LEVEL1_KEY_ENABLE);
		//ss_send_cmd(vdd, TX_SELF_MASK_SET_PRE);
		//ss_send_cmd(vdd, TX_SELF_MASK_IMAGE);
		//ss_send_cmd(vdd, TX_SELF_MASK_SET_POST);
		//ss_send_cmd(vdd, TX_LEVEL1_KEY_DISABLE);
		 */

		samsung,self_mask_setting_pre_revA = [
			29 01 00 00 00 00 02 75 10	/* MA_SEL(1), IC_SEL, VI_SEL, DC_SEL, AC_SEL */
			/* image data (4C,5C) ... */
		];

		samsung,self_mask_setting_post_revA = [
			29 01 00 00 00 00 02 75 01	/* MA_SEL(0), IC_SEL, VI_SEL, DC_SEL, AC_SEL */
		];

		samsung,self_mask_on_revA = [
			29 01 00 00 00 00 03 F0 5A 5A	/* TEST KEY Enable */
			29 01 00 00 00 00 10 7A
					21 00 00 01 2B 08 34 09
					5F 09 0f 00 00 00 00
			29 01 00 00 00 00 03 F0 A5 A5	/* TEST KEY Disable */
		];

		samsung,self_mask_on_factory_revA = [
			29 01 00 00 00 00 03 F0 5A 5A	/* TEST KEY Enable */
			29 01 00 00 00 00 10 7A
					21 09 60 09 61 09 62 09
					63 09 0f 00 00 00 00
			29 01 00 00 00 00 03 F0 A5 A5	/* TEST KEY Disable */
		];

		samsung,self_mask_off_revA = [
			29 01 00 00 00 00 03 F0 5A 5A	/* TEST KEY Enable  */
			29 01 00 00 00 00 02 7A 00	/* SM_MASK_EN(0)  */
			29 01 00 00 00 00 03 F0 A5 A5	/* TEST KEY Disable */
		];

		/*
		 *************************************************************************************************************************
		 * Self Display Operation (DEBUGGING FEATURE)
		 *************************************************************************************************************************
		 */

		samsung,self_disp_debug_rx_cmds_revA = [ 06 01 00 00 00 00 01 7F 04 06];	/* read 7F 7th ~ 10th */

		samsung,self_mask_check_tx_pre1_revA = [
			29 01 00 00 00 00 03 9F A5 A5	/* TEST KEY Enable */
			29 01 00 00 00 00 03 F0 5A 5A	/* TEST KEY Enable */
			29 01 00 00 00 00 03 FC 5A 5A	/* TEST KEY Enable */

			/* CRC ON */
			29 01 00 00 00 00 03 B0 27 D8
			29 01 00 00 00 00 02 D8 15

			/* DBIST ON */
			29 01 00 00 00 00 0A BF 01 07 00 00 00 10 00 00 00

			29 01 00 00 15 00 02 7A 00	/* self mask off, delay 1 frame (21ms for 48hz, worst case) */

			/* side memory write */
			29 01 00 00 00 00 02 75 10

			/* write self mask data (4C, 5C) */

			29 01 00 00 00 00 03 FC A5 A5	/* TEST KEY Disable */
			29 01 00 00 00 00 03 F0 A5 A5	/* TEST KEY Disable */
			29 01 00 00 00 00 03 9F 5A 5A	/* TEST KEY Enable */
		];

		samsung,self_mask_check_tx_pre2_revA = [
			29 01 00 00 00 00 03 9F A5 A5	/* TEST KEY Enable */
			29 01 00 00 00 00 03 F0 5A 5A	/* TEST KEY Enable */
			29 01 00 00 00 00 03 FC 5A 5A	/* TEST KEY Enable */

			29 01 00 00 00 00 02 75 01
			29 01 00 00 00 00 10 7A	/* self mask on */
						21 01 F4 02 33
						09 60 09 61 09
						0F FF FF FF FF

			/* delay 2 frames in self_mask_check() function */

			29 01 00 00 00 00 03 FC A5 A5	/* TEST KEY Disable */
			29 01 00 00 00 00 03 F0 A5 A5	/* TEST KEY Disable */
			29 01 00 00 00 00 03 9F 5A 5A	/* TEST KEY Enable */
		];

		samsung,mask_crc_pass_data = [0C 95];

		samsung,self_mask_check_rx_cmds_revA = [ 06 01 00 00 00 00 01 14 02 00];	/* read 14h 1st ~ 2nd */

		samsung,self_mask_check_tx_post_revA = [
			29 01 00 00 00 00 03 9F A5 A5	/* TEST KEY Enable */
			29 01 00 00 00 00 03 F0 5A 5A	/* TEST KEY Enable */
			29 01 00 00 00 00 03 FC 5A 5A	/* TEST KEY Enable */

			29 01 00 00 00 00 10 7A 		/* self mask restore */
						21 09 60 09 61
						09 62 09 63 09
						0F 00 00 00 00
			29 01 00 00 00 00 0A BF 00 07 FF 00 00 10 00 00 00	/* Exit DBIST */

			29 01 00 00 00 00 03 FC A5 A5	/* TEST KEY Disable */
			29 01 00 00 00 00 03 F0 A5 A5	/* TEST KEY Disable */
			29 01 00 00 00 00 03 9F 5A 5A	/* TEST KEY Enable */
		];
	};
};
