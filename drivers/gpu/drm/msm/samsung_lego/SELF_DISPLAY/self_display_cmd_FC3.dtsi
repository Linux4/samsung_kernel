/* Copyright (c) 2021, Samsung Electronics Corporation. All rights reserved.
 *
 * This program is free software; you can redistribute it and/or modify
 * it under the terms of the GNU General Public License version 2 and
 * only version 2 as published by the Free Software Foundation.
 *
 * This program is distributed in the hope that it will be useful,
 * but WITHOUT ANY WARRANTY; without even the implied warranty of
 * MERCHANTABILITY or FITNESS FOR A PARTICULAR PURPOSE.  See the
 * GNU General Public License for more details.
 */

&soc {
	self_display_FC3_dtsi: self_display_FC3_dtsi {
		label = "self_display_FC3_dtsi";

		samsung,support_self_display;

		/*
		 *************************************************************************************************************************
		 * Self Display Operation (SELF MASK)
		 *************************************************************************************************************************
		//ss_send_cmd(vdd, TX_LEVEL1_KEY_ENABLE);
		//ss_send_cmd(vdd, TX_SELF_MASK_SET_PRE);
		//ss_send_cmd(vdd, TX_SELF_MASK_IMAGE);
		//ss_send_cmd(vdd, TX_SELF_MASK_SET_POST);
		//ss_send_cmd(vdd, TX_LEVEL1_KEY_DISABLE);
		 */

		samsung,self_mask_setting_pre_revA = [
			29 01 00 00 00 00 02 7A 00	/* SM_MASK_EN */
			/* skip one frame delay because self mask is default off at display on sequence.. */
			29 01 00 00 00 00 02 75 10
			/* Self Mask Image data (4C,5C) ... */
		];

		samsung,self_mask_setting_post_revA = [
			29 01 00 00 00 00 02 75 00
		];

		samsung,self_mask_on_revA = [
			29 01 00 00 00 00 03 F0 5A 5A	/* TEST KEY Enable */
			29 01 00 00 00 00 17 7A
					01 06 00 00 00 00 00 00 00 00 00
					00 00 00 00 95 07 9E 09 5F 09 0C
			29 01 00 00 00 00 03 F0 A5 A5	/* TEST KEY Disable */
		];

		samsung,self_mask_on_factory_revA = [
			29 01 00 00 00 00 03 F0 5A 5A	/* TEST KEY Enable */
			29 01 00 00 00 00 17 7A
					01 06 00 00 00 00 00 00 00 00 00
					00 09 60 09 61 09 62 09 63 09 0C
			29 01 00 00 00 00 03 F0 A5 A5	/* TEST KEY Disable */
		];

		samsung,self_mask_off_revA = [
			29 01 00 00 00 00 03 F0 5A 5A	/* TEST KEY Enable  */
			29 01 00 00 00 00 02 7A 00		/* SM_MASK_EN(0)  */
			29 01 00 00 00 00 03 F0 A5 A5	/* TEST KEY Disable */
		];

		/*
		 *************************************************************************************************************************
		 * Self Display Operation (DEBUGGING FEATURE)
		 *************************************************************************************************************************
		 */

		samsung,self_disp_debug_rx_cmds_revA = [ 06 01 00 00 00 00 01 7F 04 01];	/* read 7F 2nd ~ 5th */

		samsung,self_mask_check_tx_pre1_revA = [
			29 01 00 00 00 00 03 9F A5 A5	/* TEST KEY Enable */
			29 01 00 00 00 00 03 F0 5A 5A	/* TEST KEY Enable */
			29 01 00 00 00 00 03 FC 5A 5A	/* TEST KEY Enable */

			/* CRC ON */
			29 01 00 00 00 00 04 B0 00 27 D8
			29 01 00 00 00 00 02 D8 16

			/* DBIST ON */
			29 01 00 00 00 00 0A BF 01 07 00 00 00 10 00 00 00

			29 01 00 00 11 00 02 7A 00	/* self mask off, delay 1 frame (17ms for 60hz) */

			29 01 00 00 00 00 02 75 10 /* side memory write */

			/* write self mask data (4C, 5C) */

			29 01 00 00 00 00 03 FC A5 A5	/* TEST KEY Disable */
			29 01 00 00 00 00 03 F0 A5 A5	/* TEST KEY Disable */
			29 01 00 00 00 00 03 9F 5A 5A	/* TEST KEY Enable */
		];

		samsung,self_mask_check_tx_pre2_revA = [
			29 01 00 00 00 00 03 9F A5 A5	/* TEST KEY Enable */
			29 01 00 00 00 00 03 F0 5A 5A	/* TEST KEY Enable */
			29 01 00 00 00 00 03 FC 5A 5A	/* TEST KEY Enable */

			29 01 00 00 00 00 02 75 00
			29 01 00 00 22 00 1A 7A	/* self mask on */
						01 06 00 00 00 00 00 00
						00 00 00 00 01 f4 02 33
						09 60 09 61 00 00 FF FF
						FF

			/* delay 2 frames(34ms) */

			29 01 00 00 00 00 03 FC A5 A5	/* TEST KEY Disable */
			29 01 00 00 00 00 03 F0 A5 A5	/* TEST KEY Disable */
			29 01 00 00 00 00 03 9F 5A 5A	/* TEST KEY Enable */
		];

		samsung,mask_crc_pass_data = [D3 9B];

		samsung,self_mask_check_rx_cmds_revA = [ 06 01 00 00 00 00 01 14 02 00];	/* read 14h 1st ~ 2nd */

		samsung,self_mask_check_tx_post_revA = [
			29 01 00 00 00 00 03 9F A5 A5	/* TEST KEY Enable */
			29 01 00 00 00 00 03 F0 5A 5A	/* TEST KEY Enable */
			29 01 00 00 00 00 03 FC 5A 5A	/* TEST KEY Enable */

			29 01 00 00 00 00 1A 7A 		/* self mask restore */
						01 06 00 00 00 00 00 00
						00 00 00 00 09 60 09 61
						09 62 09 63 00 00 00 00
						00
			29 01 00 00 00 00 02 BF 00 	/* Exit DBIST */

			29 01 00 00 00 00 03 FC A5 A5	/* TEST KEY Disable */
			29 01 00 00 00 00 03 F0 A5 A5	/* TEST KEY Disable */
			29 01 00 00 00 00 03 9F 5A 5A	/* TEST KEY Enable */
		];
	};
};
