/* Copyright (c) 2020, Samsung Electronics Corporation. All rights reserved.
 *
 * This program is free software; you can redistribute it and/or modify
 * it under the terms of the GNU General Public License version 2 and
 * only version 2 as published by the Free Software Foundation.
 *
 * This program is distributed in the hope that it will be useful,
 * but WITHOUT ANY WARRANTY; without even the implied warranty of
 * MERCHANTABILITY or FITNESS FOR A PARTICULAR PURPOSE.  See the
 * GNU General Public License for more details.
 */

&mdss_mdp {
	ss_dsi_panel_EA8076GA_AMS638VL01_FHD: ss_dsi_panel_EA8076GA_AMS638VL01_FHD {
		qcom,mdss-dsi-panel-name = "ss_dsi_panel_EA8076GA_AMS638VL01_FHD";
		label = "ss_dsi_panel_EA8076GA_AMS638VL01_FHD";

		qcom,mdss-dsi-bpp = <24>;

		qcom,mdss-dsi-underflow-color = <0xFF>;
		qcom,mdss-dsi-border-color = <0>;

		qcom,mdss-dsi-bl-pmic-control-type = "bl_ctrl_dcs";

		qcom,mdss-dsi-bl-min-level = <1>;
		qcom,mdss-dsi-bl-max-level = <425>;
		qcom,mdss-brightness-max-level = <425>;
		qcom,mdss-brightness-default-level = <255>;

		qcom,mdss-dsi-panel-type = "dsi_cmd_mode";

		qcom,mdss-dsi-te-pin-select = <1>;

		/*qcom,dynamic-mode-switch-enabled;*/
		/*qcom,dynamic-mode-switch-type = "dynamic-resolution-switch-immediate";*/

		qcom,mdss-dsi-te-dcs-command = <1>;
		qcom,mdss-dsi-wr-mem-start = <0x2C>;
		qcom,mdss-dsi-wr-mem-continue = <0x3C>;

		qcom,mdss-dsi-pixel-packing = "loose";

		qcom,mdss-dsi-virtual-channel-id = <0>;
		qcom,mdss-dsi-color-order = "rgb_swap_rgb";
		qcom,mdss-dsi-lane-0-state;
		qcom,mdss-dsi-lane-1-state;
		qcom,mdss-dsi-lane-2-state;
		qcom,mdss-dsi-lane-3-state;
		qcom,mdss-dsi-lane-map = "lane_map_0123";

		qcom,mdss-dsi-t-clk-pre = <0x1F>;
		qcom,mdss-dsi-t-clk-post = <0x1A>;

		qcom,mdss-dsi-stream = <0>;
		qcom,mdss-dsi-mdp-trigger = "none";
		qcom,mdss-dsi-dma-trigger = "trigger_sw";

		qcom,mdss-pan-physical-width-dimension = <67>; /* 66.528 */
		qcom,mdss-pan-physical-height-dimension = <148>; /* 147.84 */

		qcom,mdss-dsi-reset-sequence = <0 10>, <1 15>;

		qcom,mdss-dsi-lp11-init;
		/*qcom,mdss-dsi-init-delay-us = <1000>;*/

		qcom,mdss-dsi-rx-eot-ignore;
		qcom,mdss-dsi-tx-eot-append;

		/* HDR Setting */
		/*qcom,mdss-dsi-panel-hdr-enabled;*/
		/*qcom,mdss-dsi-panel-hdr-color-primaries = <15635 16450 34000 16000 13250 34500 7500 3000>;*/
		/*qcom,mdss-dsi-panel-peak-brightness = <5400000>;*/
		/*qcom,mdss-dsi-panel-average-brightness = <2000000>;*/
		/*qcom,mdss-dsi-panel-blackness-level = <2000>;*/

		//qcom,ulps-enabled;
		/* qcom,suspend-ulps-enabled; */
		//qcom,esd-check-enabled;
		//qcom,mdss-dsi-panel-status-check-mode ="irq_check";
		/*qcom,mdss-dsi-panel-status-read-length;*/
		/*qcom,mdss-dsi-panel-status-value;*/


		/* *************************************************************
		 * Below  parameters are samsung dependent thigs
		 * *************************************************************
		 */
		samsung,panel-vendor = "SDC";
		samsung,disp-model = "AMS638LV01";
		samsung,panel-lpm-enable;
		samsung,support_gamma_mode2;
		//samsung,support_irc;
		//samsung,elvss_interpolation_temperature = <(-15)>;
		samsung,support_factory_panel_swap;
		//samsung,support_gct;
		//samsung,support_pac;
		//samsung,support_gpara;
		/* samsung,support_poc_driver; */

		//samsung,esd-irq-trigger1 = "falling"; /* DISP_DET */
		//samsung,esd-irq-trigger2 = "falling"; /* FG_ERR */

		/* *************************************************************
		 *  Tx
		 * *************************************************************
		 */
		samsung,level0_key_enable_tx_cmds_revA	= [29 01 00 00 00 00 03 9F A5 A5]; /* PASSWD0 */
		samsung,level0_key_disable_tx_cmds_revA	= [29 01 00 00 00 00 03 9F 5A 5A]; /* PASSWD0 */
		samsung,level1_key_enable_tx_cmds_revA	= [29 01 00 00 00 00 03 F0 5A 5A]; /* PASSWD1 */
		samsung,level1_key_disable_tx_cmds_revA	= [29 01 00 00 00 00 03 F0 A5 A5]; /* PASSWD1 */
		samsung,level2_key_enable_tx_cmds_revA	= [29 01 00 00 00 00 03 FC 5A 5A];
		samsung,level2_key_disable_tx_cmds_revA	= [29 01 00 00 00 00 03 FC A5 A5];

		/* BRIGHTNESS_MAX_PACKET = 50 */
		samsung,brightness_tx_cmds_revA = [
			39 01 00 00 00 00 01 00
			39 01 00 00 00 00 01 00
			39 01 00 00 00 00 01 00
			39 01 00 00 00 00 01 00
			39 01 00 00 00 00 01 00
			39 01 00 00 00 00 01 00
			39 01 00 00 00 00 01 00
			39 01 00 00 00 00 01 00
			39 01 00 00 00 00 01 00
			39 01 00 00 00 00 01 00
			39 01 00 00 00 00 01 00
			39 01 00 00 00 00 01 00
			39 01 00 00 00 00 01 00
			39 01 00 00 00 00 01 00
			39 01 00 00 00 00 01 00
			39 01 00 00 00 00 01 00
			39 01 00 00 00 00 01 00
			39 01 00 00 00 00 01 00
			39 01 00 00 00 00 01 00
			39 01 00 00 00 00 01 00
			39 01 00 00 00 00 01 00
			39 01 00 00 00 00 01 00
			39 01 00 00 00 00 01 00
			39 01 00 00 00 00 01 00
			39 01 00 00 00 00 01 00
			39 01 00 00 00 00 01 00
			39 01 00 00 00 00 01 00
			39 01 00 00 00 00 01 00
			39 01 00 00 00 00 01 00
			39 01 00 00 00 00 01 00
			39 01 00 00 00 00 01 00
			39 01 00 00 00 00 01 00
			39 01 00 00 00 00 01 00
			39 01 00 00 00 00 01 00
			39 01 00 00 00 00 01 00
			39 01 00 00 00 00 01 00
			39 01 00 00 00 00 01 00
			39 01 00 00 00 00 01 00
			39 01 00 00 00 00 01 00
			39 01 00 00 00 00 01 00
			39 01 00 00 00 00 01 00
			39 01 00 00 00 00 01 00
			39 01 00 00 00 00 01 00
			39 01 00 00 00 00 01 00
			39 01 00 00 00 00 01 00
			39 01 00 00 00 00 01 00
			39 01 00 00 00 00 01 00
			39 01 00 00 00 00 01 00
			39 01 00 00 00 00 01 00
			39 01 00 00 00 00 01 00
		];

		//samsung,mdnie_tx_cmds_revA = [
		//	39 01 00 00 00 00 00 00 00
		//];

		//samsung,packet_size_tx_cmds_revA = [
		//37 01 00 00 00 00 02 07 00
		//];

		//samsung,reg_read_pos_tx_cmds_revA = [
		//	15 01 00 00 00 00 02 B0 00
		//];

		//samsung,manufacture_read_pre_tx_cmds_revA = [
		//	05 01 00 00 14 00 02 11 00			/* Sleep out, wait 20ms(0x14) */
		//];

		samsung,display_on_tx_cmds_revA = [
			05 01 00 00 00 00 02 29 00
		];

		samsung,display_off_tx_cmds_revA = [05 01 00 00 00 00 02 28 00];

		/* *************************************************************
		 *  Rx (Module Information READ)
		 * *************************************************************
		 */
		samsung,mdnie_read_rx_cmds_revA		= [06 01 00 00 00 00 01 EA 04 03]; /* White color position EA 4th ~ 7th */
		samsung,manufacture_date_rx_cmds_revA	= [06 01 00 00 00 00 01 EA 07 07]; /* manufacture data EA 8th ~ 14th*/
		samsung,octa_id_rx_cmds_revA		= [06 01 00 00 00 00 01 EA 04 10]; /* manufacture information(4bytes) + Cell ID(16bytes) */
		samsung,cell_id_rx_cmds_revA		= [06 01 00 00 00 00 01 EF 10 02]; /* Cell ID 16bytes EF 3rd ~ 18th*/
		samsung,ddi_id_rx_cmds_revA		= [06 01 00 00 00 00 01 D1 06 38]; /* CHIP ID : read D1 56~61th */

		samsung,manufacture_id0_rx_cmds_revA	= [06 01 00 00 00 00 01 da 01 00];
		samsung,manufacture_id1_rx_cmds_revA	= [06 01 00 00 00 00 01 db 01 00];
		samsung,manufacture_id2_rx_cmds_revA	= [06 01 00 00 00 00 01 dc 01 00];

#if 0
		//samsung,smart_dimming_mtp_rx_cmds_revA	= [06 01 00 00 00 00 01 c8 20 00];

		samsung,ldi_debug0_rx_cmds_revA		= [06 01 00 00 00 00 01 0A 01 00]; /* rddpm */
		//samsung,ldi_debug1_rx_cmds_revA		= [06 01 00 00 00 00 01 0E 01 00]; /* no operation */
		samsung,ldi_debug2_rx_cmds_revA		= [06 01 00 00 00 00 01 0E 01 00]; /* errfg */
		samsung,ldi_debug3_rx_cmds_revA		= [06 01 00 00 00 00 01 0E 01 00]; /* rddsm*/
		samsung,ldi_debug4_rx_cmds_revA		= [06 01 00 00 00 00 01 05 01 00]; /* dsierr */
		//samsung,ldi_debug5_rx_cmds_revA		= [06 01 00 00 00 00 01 0F 01 00]; /* self_diag*/

		/* 255 bytes, its ddi max size is 512, and sw limit is 0xff = 255... */
		//samsung,ldi_debug_logbuf_rx_cmds_revA	= [06 01 00 00 00 00 01 9C FF 00];

		samsung,mtp_read_sysfs_rx_cmds_revA	= [06 01 00 00 00 00 01 00 00 00];

		/* *************************************************************
		 *  SELF DISPLAY
		 * *************************************************************
		 */
		//samsung,support_self_display;
		//ss,self_display = <&self_display_FA7_AMS628RF05_dtsi>;

		/* *************************************************************
		 * ACL command list and mappings
		 * **************************************************************
		 */
		samsung,acl_on_tx_cmds_revA = [
			/* 32 frame AVG ACL ON, Start 50%, ACL 15%, 32Frame AVG */
			29 01 00 00 00 00 02 55 03	/* ACL ON */
		]; /* ACL on */

		samsung,acl_off_tx_cmds_revA = [
			/* 16 Frame AVG ACL OFF, Start Point 60%, ACL 0%*/
			29 01 00 00 00 00 02 55 00	/* ACL OFF */
		];

		samsung,elvss_rx_cmds_revA = [ 06 01 00 00 00 00 01 B7 02 08];	/* read B7 9th, 10th para */
#endif
		/* *************************************************************
		 * candela to index mappings
		 * **************************************************************
		 */
		samsung,candela_map_table_revA = < /* THIS TABLE USED FOR DIMMING */
		/* <idx> <from> <till> <gm2_wrdisbv> <cd> */
			0		0		0		3	     2
			1		1		1		6            3
			2		2		2		9            4
			3		3		3		12           6
			4		4		4		15           7
			5		5		5		18           8
			6		6		6		21           9
			7		7		7		24           10
			8		8		8		27           12
			9		9		9		30           13
			10		10		10		33           14
			11		11		11		36           15
			12		12		12		39           16
			13		13		13		42           18
			14		14		14		45           19
			15		15		15		48           20
			16		16		16		52           22
			17		17		17		55           23
			18		18		18		59           24
			19		19		19		62           26
			20		20		20		66           27
			21		21		21		70           29
			22		22		22		73           30
			23		23		23		77           32
			24		24		24		80           33
			25		25		25		84           34
			26		26		26		88           36
			27		27		27		91           37
			28		28		28		95           39
			29		29		29		98           40
			30		30		30		102          42
			31		31		31		106          43
			32		32		32		109          44
			33		33		33		113          46
			34		34		34		116          47
			35		35		35		120          49
			36		36		36		124          50
			37		37		37		127          52
			38		38		38		131          53
			39		39		39		134          54
			40		40		40		138          56
			41		41		41		142          58
			42		42		42		145          59
			43		43		43		149          60
			44		44		44		152          62
			45		45		45		156          63
			46		46		46		160          65
			47		47		47		163          66
			48		48		48		167          68
			49		49		49		170          69
			50		50		50		174          70
			51		51		51		178          72
			52		52		52		181          73
			53		53		53		185          75
			54		54		54		188          76
			55		55		55		192          78
			56		56		56		196          79
			57		57		57		199          80
			58		58		58		203          82
			59		59		59		206          83
			60		60		60		210          85
			61		61		61		214          86
			62		62		62		217          88
			63		63		63		221          89
			64		64		64		224          90
			65		65		65		228          92
			66		66		66		232          94
			67		67		67		235          95
			68		68		68		239          97
			69		69		69		242          98
			70		70		70		246          99
			71		71		71		250          101
			72		72		72		253          102
			73		73		73		257          104
			74		74		74		260          105
			75		75		75		264          107
			76		76		76		268          108
			77		77		77		271          109
			78		78		78		275          111
			79		79		79		278          112
			80		80		80		282          114
			81		81		81		286          115
			82		82		82		289          117
			83		83		83		293          118
			84		84		84		297          120
			85		85		85		300          121
			86		86		86		304          123
			87		87		87		307          124
			88		88		88		311          125
			89		89		89		315          127
			90		90		90		318          128
			91		91		91		322          130
			92		92		92		325          131
			93		93		93		329          133
			94		94		94		333          134
			95		95		95		336          135
			96		96		96		340          137
			97		97		97		343          138
			98		98		98		347          140
			99		99		99		351          141
			100		100		100		354          143
			101		101		101		358          144
			102		102		102		361          145
			103		103		103		365          147
			104		104		104		369          149
			105		105		105		372          150
			106		106		106		376          151
			107		107		107		379          153
			108		108		108		383          154
			109		109		109		387          156
			110		110		110		390          157
			111		111		111		394          159
			112		112		112		397          160
			113		113		113		401          161
			114		114		114		405          163
			115		115		115		408          164
			116		116		116		412          166
			117		117		117		415          167
			118		118		118		419          169
			119		119		119		423          170
			120		120		120		426          171
			121		121		121		430          173
			122		122		122		433          174
			123		123		123		437          176
			124		124		124		441          177
			125		125		125		444          179
			126		126		126		448          180
			127		127		127		451          181
			128		128		128		455          183
			129		129		129		459          185
			130		130		130		464          187
			131		131		131		468          188
			132		132		132		473          191
			133		133		133		477          192
			134		134		134		482          194
			135		135		135		486          196
			136		136		136		491          198
			137		137		137		495          200
			138		138		138		500          202
			139		139		139		504          203
			140		140		140		509          206
			141		141		141		513          207
			142		142		142		518          209
			143		143		143		522          211
			144		144		144		527          213
			145		145		145		531          215
			146		146		146		535          216
			147		147		147		540          218
			148		148		148		544          220
			149		149		149		549          222
			150		150		150		553          224
			151		151		151		558          226
			152		152		152		562          228
			153		153		153		567          230
			154		154		154		571          231
			155		155		155		576          233
			156		156		156		580          235
			157		157		157		585          237
			158		158		158		589          239
			159		159		159		594          241
			160		160		160		598          243
			161		161		161		603          245
			162		162		162		607          246
			163		163		163		612          249
			164		164		164		616          250
			165		165		165		620          252
			166		166		166		625          254
			167		167		167		629          256
			168		168		168		634          258
			169		169		169		638          259
			170		170		170		643          261
			171		171		171		647          263
			172		172		172		652          265
			173		173		173		656          267
			174		174		174		661          269
			175		175		175		665          271
			176		176		176		670          273
			177		177		177		674          274
			178		178		178		679          276
			179		179		179		683          278
			180		180		180		688          280
			181		181		181		692          282
			182		182		182		696          284
			183		183		183		701          286
			184		184		184		705          287
			185		185		185		710          289
			186		186		186		714          291
			187		187		187		719          293
			188		188		188		723          295
			189		189		189		728          297
			190		190		190		732          299
			191		191		191		737          301
			192		192		192		741          302
			193		193		193		746          304
			194		194		194		750          306
			195		195		195		755          308
			196		196		196		759          310
			197		197		197		764          312
			198		198		198		768          314
			199		199		199		773          316
			200		200		200		777          317
			201		201		201		781          319
			202		202		202		786          321
			203		203		203		790          323
			204		204		204		795          325
			205		205		205		799          327
			206		206		206		804          329
			207		207		207		808          330
			208		208		208		813          332
			209		209		209		817          334
			210		210		210		822          336
			211		211		211		826          338
			212		212		212		831          340
			213		213		213		835          342
			214		214		214		840          344
			215		215		215		844          345
			216		216		216		849          347
			217		217		217		853          349
			218		218		218		858          351
			219		219		219		862          353
			220		220		220		866          354
			221		221		221		871          357
			222		222		222		875          358
			223		223		223		880          360
			224		224		224		884          362
			225		225		225		889          364
			226		226		226		893          366
			227		227		227		898          368
			228		228		228		902          370
			229		229		229		907          372
			230		230		230		911          373
			231		231		231		916          375
			232		232		232		920          377
			233		233		233		925          379
			234		234		234		929          381
			235		235		235		934          383
			236		236		236		938          385
			237		237		237		942          386
			238		238		238		947          388
			239		239		239		951          390
			240		240		240		956          392
			241		241		241		960          394
			242		242		242		965          396
			243		243		243		969          397
			244		244		244		974          400
			245		245		245		978          401
			246		246		246		983          403
			247		247		247		987          405
			248		248		248		992          407
			249		249		249		996          409
			250		250		250		1001         411
			251		251		251		1005         412
			252		252		252		1010         415
			253		253		253		1014         416
			254		254		254		1019         418
			255		255		255		1023         420
		>;

		samsung,hbm_candela_map_table_revA = <
		/* <idx> <from> <till> <gm2_wrdisbv> <cd> <auto> */
			0		256		256		3		422		0
			1		257		257		7		423		0
			2		258		258		11		425		0
			3		259		259		15		427		0
			4		260		260		18		428		0
			5		261		261		22		430		0
			6		262		262		26		432		0
			7		263		263		29		433		0
			8		264		264		33		435		0
			9		265		265		37		436		0
			10		266		266		40		438		0
			11		267		267		44		440		0
			12		268		268		48		441		0
			13		269		269		51		443		0
			14		270		270		55		444		0
			15		271		271		59		446		0
			16		272		272		62		448		0
			17		273		273		66		449		0
			18		274		274		70		451		0
			19		275		275		73		452		0
			20		276		276		77		454		0
			21		277		277		81		456		0
			22		278		278		84		457		0
			23		279		279		88		459		0
			24		280		280		92		461		0
			25		281		281		95		462		0
			26		282		282		99		464		0
			27		283		283		103		466		0
			28		284		284		107		468		0
			29		285		285		110		469		0
			30		286		286		114		471		0
			31		287		287		118		473		0
			32		288		288		121		474		0
			33		289		289		125		476		0
			34		290		290		129		477		0
			35		291		291		132		479		0
			36		292		292		136		481		0
			37		293		293		140		482		0
			38		294		294		143		484		0
			39		295		295		147		485		0
			40		296		296		151		487		0
			41		297		297		154		489		0
			42		298		298		158		490		0
			43		299		299		162		492		0
			44		300		300		165		493		0
			45		301		301		169		495		0
			46		302		302		173		497		0
			47		303		303		176		498		0
			48		304		304		180		500		0
			49		305		305		184		502		0
			50		306		306		187		503		0
			51		307		307		191		505		0
			52		308		308		195		507		0
			53		309		309		198		508		0
			54		310		310		202		510		0
			55		311		311		206		512		0
			56		312		312		209		513		0
			57		313		313		213		515		0
			58		314		314		217		517		0
			59		315		315		220		518		0
			60		316		316		224		520		0
			61		317		317		228		522		0
			62		318		318		231		523		0
			63		319		319		235		525		0
			64		320		320		239		526		0
			65		321		321		242		528		0
			66		322		322		246		530		0
			67		323		323		250		531		0
			68		324		324		253		533		0
			69		325		325		257		534		0
			70		326		326		261		536		0
			71		327		327		264		538		0
			72		328		328		268		539		0
			73		329		329		272		541		0
			74		330		330		275		543		0
			75		331		331		279		544		0
			76		332		332		283		546		0
			77		333		333		286		547		0
			78		334		334		290		549		0
			79		335		335		294		551		0
			80		336		336		297		552		0
			81		337		337		301		554		0
			82		338		338		305		556		0
			83		339		339		309		558		0
			84		340		340		312		559		0
			85		341		341		316		561		0
			86		342		342		320		563		0
			87		343		343		323		564		0
			88		344		344		327		566		0
			89		345		345		331		567		0
			90		346		346		334		569		0
			91		347		347		338		571		0
			92		348		348		342		572		0
			93		349		349		345		574		0
			94		350		350		349		575		0
			95		351		351		353		577		0
			96		352		352		356		579		0
			97		353		353		360		580		0
			98		354		354		364		582		0
			99		355		355		367		584		0
			100		356		356		371		585		0
			101		357		357		375		587		0
			102		358		358		378		588		0
			103		359		359		382		590		0
			104		360		360		386		592		0
			105		361		361		389		593		0
			106		362		362		393		595		0
			107		363		363		397		597		0
			108		364		364		400		598		0
			109		365		365		404		600		0
		>;

		samsung,gamma_mode2_normal_tx_cmds_revA=[
			39 00 00 00 00 00 02 53 20
			39 00 00 00 00 00 2F B7
					01 53 28 4D 00 96 04 00
					00 00 00 00 01 01 02 02
					42 43 43 43 43 43 83 C3
					83 C3 83 C3 23 03 03 03
					00 00 00 00 00 00 00 00
					00 00 00 00 00 00
			39 01 00 00 00 00 03 51 03 FF
		];

		samsung,gamma_mode2_hbm_tx_cmds_revA=[
			39 00 00 00 00 00 02 53 E0
			39 00 00 00 00 00 2F B7
					01 53 28 4D 00 96 04 00
					00 00 00 00 01 01 02 02
					42 43 43 43 43 43 83 C3
					83 C3 83 C3 23 03 03 03
					00 00 00 00 00 00 00 00
					00 00 00 00 00 00
			39 01 00 00 00 00 03 51 03 FF
		];

#if 0
		samsung,aod_candela_map_table_revA = <
			/*<idx>   <from>  <till> <candella> */
			0	0	39	2
			1	40	70	10
			2	71	93	30
			3	94	255	60
		>;

		samsung,gamma_mode2_tx_cmds_revA=[
			39 00 00 00 00 00 02 53 20
			39 00 00 00 00 00 2F B7
					01 53 28 4D 00 96 04 00
					00 00 00 00 01 01 02 02
					42 43 43 43 43 43 83 C3
					83 C3 83 C3 23 03 03 03
					00 00 00 00 00 00 00 00
					00 00 00 00 00 00
			39 01 00 00 00 00 03 51 03 FF
		]; /* B7 9th para:(Normal Elvss Offset),10th para:(HBM Elvss Offset) OTP, 47th para: TSET */

		/*
		 * ************************************************************************************************************************
		 *  FD Settings
		 * ************************************************************************************************************************
		 */

		samsung,fd_on_tx_cmds_revA = [
			29 01 00 00 00 00 03 F0 5A 5A
			29 01 00 00 00 00 0B D5 82 FF 5C 44 BF 89 00 00 03 01
			29 01 00 00 78 00 03 F0 A5 A5
		];

		samsung,fd_off_tx_cmds_revA = [
			29 01 00 00 00 00 03 F0 5A 5A
			29 01 00 00 00 00 0B D5 82 FF 5C 44 BF 89 00 00 03 02
			29 01 00 00 00 00 03 F0 A5 A5
		];

		/* *************************************************************
		 *   APLPM
		 * *************************************************************
		 */

		samsung,lpm_on_tx_cmds_revA = [
			/* Image write for HLPM/ALPM Mode */
			29 00 00 00 00 00 03 F0 5A 5A	/* TEST KEY Enable */
			29 00 00 00 00 00 02 B0 A3 		/* Global Para */
			29 00 00 00 00 00 02 C7 00 		/* HLPM Select */
			29 00 00 00 00 00 02 B0 68 		/* Global Para */
			29 00 00 00 00 00 03 B9 01 89	/* HLPM AOR Setting */
			/* === OSC 89.9Mhz === */
			29 00 00 00 00 00 02 B0 5C 		/* Global Para */
			29 00 00 00 00 00 08 C0 63 28 00 00 03 38 3E	/* HLPM Setting */
			29 00 00 00 00 00 02 B0 09 		/* Global Para */
			29 00 00 00 00 00 03 D9 78 3D	/* HLPM Setting */
			29 00 00 00 00 00 02 C0 01 		/* HLPM Update */
			/* === OSC 89.9Mhz === */
			29 00 00 00 01 00 02 53 22		/* HLPM On Setting */
			29 01 00 00 11 00 03 F0 A5 A5	/* TEST KEY Disable */
		];

		samsung,lpm_off_tx_cmds_revA = [
			/* Image write for Normal Mode */
			29 00 00 00 00 00 03 F0 5A 5A	/* TEST KEY Enable */
			29 00 00 00 00 00 0A D5 82 FF 5C 44 BF 89 00 00 00		/* Normal ASWIRE No Pulse */
			29 00 00 00 01 00 02 53 20		/* ALPM/HLPM off */
			29 01 00 00 00 00 03 F0 A5 A5	/* TEST KEY Disable */
		];

		/* ALPM/HLPM 2nit or 60nit On Commands */
		samsung,lpm_2nit_tx_cmds_revA  = [29 01 00 00 00 00 02 53 22];
		samsung,lpm_10nit_tx_cmds_revA = [29 01 00 00 00 00 02 53 22];
		samsung,lpm_30nit_tx_cmds_revA = [29 01 00 00 00 00 02 53 22];
		samsung,lpm_60nit_tx_cmds_revA = [29 01 00 00 00 00 02 53 22];

		/* HLPM / ALPM Control Commands */
		samsung,lpm_ctrl_hlpm_2nit_tx_cmds_revA  = [29 01 00 00 00 00 03 B9 9D C9];
		samsung,lpm_ctrl_hlpm_10nit_tx_cmds_revA = [29 01 00 00 00 00 03 B9 89 C9];
		samsung,lpm_ctrl_hlpm_30nit_tx_cmds_revA = [29 01 00 00 00 00 03 B9 55 A9];
		samsung,lpm_ctrl_hlpm_60nit_tx_cmds_revA = [29 01 00 00 00 00 03 B9 01 89];

		/* HLPM / ALPM brightness Commands: default HLPM 2nit */
		samsung,lpm_brightnes_tx_cmds_revA		= [
			29 00 00 00 00 00 03 F0 5A 5A	/* TEST KEY Enable */
			29 00 00 00 00 00 02 B0 68		/* Global Para */
			29 00 00 00 00 00 03 B9 9D C9	/* HLPM AOR SETTING */
			29 00 00 00 01 00 02 53 22		/* HLPM On Setting */
			29 01 00 00 00 00 03 F0 A5 A5	/* TEST KEY Disable */
		];

		/* AOR Control(97.3%) Commands */
		//samsung,lpm_ctrl_hlpm_off_tx_cmds_revA		= [29 01 00 00 00 00 02 53 20];

		samsung,lpm-init-delay-ms = <124>; /* used AOD Sequnce. error flag case: Panel OFF => AOD ON case */
#endif

		/*
		* ***********************************************************
		*  DMS (Dynamic Mode Switch)
		* ***********************************************************
		*/

		qcom,mdss-dsi-display-timings {
			fhd {
				qcom,display-topology = <1 0 1>;
				qcom,default-topology-index = <0>;
				qcom,mdss-dsi-panel-width = <1080>;
				qcom,mdss-dsi-panel-height = <2400>;

				qcom,mdss-dsi-h-pulse-width = <88>;
				qcom,mdss-dsi-h-back-porch = <92>;
				qcom,mdss-dsi-h-front-porch = <91>;
				qcom,mdss-dsi-h-sync-skew = <0>;

				qcom,mdss-dsi-v-pulse-width = <2>;
				qcom,mdss-dsi-v-back-porch = <16>;
				qcom,mdss-dsi-v-front-porch = <176>;

				qcom,mdss-dsi-panel-framerate = <60>;

				qcom,mdss-dsi-panel-clockrate = <1195500000>; /* 1195.5 Mbps*/
				qcom,mdss-dsi-panel-phy-timings = [00 25 0A 0A 27 24 0A 0A 07 02 04 00];

				/*qcom,mdss-dsi-timing-switch-command; use samsung,panel_multires_XXX instead*/
				/*qcom,mdss-dsi-timing-switch-command-state;*/

				qcom,mdss-dsi-t-clk-pre = <0x1F>;
				qcom,mdss-dsi-t-clk-post = <0x1A>;

				/*only for factory binary*/
				qcom,mdss-fd-on-command = [
					29 01 00 00 00 00 03 F1 5A 5A	/* TEST KEY Enable */
					29 01 00 00 00 00 02 D0 08
					29 01 00 00 00 00 03 F1 A5 A5
					29 01 00 00 00 00 03 F0 5A 5A
					29 01 00 00 00 00 02 B0 03
					29 01 00 00 00 00 02 CD 04
					29 01 00 00 00 00 03 F0 A5 A5	/* TEST KEY Disable */
				];

				qcom,mdss-dsi-on-command = [
					/* Sleep out, wait 10ms(0x0A) */
					05 01 00 00 0A 00 02 11 00

					/* AVC Setting  */
					29 00 00 00 00 00 03 F0 5A 5A
					29 00 00 00 00 00 02 ED B3
					29 01 00 00 00 00 03 F0 A5 A5

					/* TE Vsync On */
					29 00 00 00 00 00 03 F0 5A 5A
					29 00 00 00 00 00 02 35 00
					29 01 00 00 00 00 03 F0 A5 A5

					/* PAGE Address Setting */
					29 00 00 00 00 00 05 2A 00 00 04 37
					29 01 00 00 00 00 05 2B 00 00 09 5F

					/* ERR_FG Setting */
					29 00 00 00 00 00 03 F0 5A 5A
					29 00 00 00 00 00 03 FC 5A 5A
					29 00 00 00 00 00 0E E1 00 00 02 00 10 10 00 00 20 00 00 01 19
					29 00 00 00 00 00 03 F0 A5 A5
					29 01 00 00 00 00 03 FC A5 A5

					/* Vsync Setting */
					29 00 00 00 00 00 03 F0 5A 5A
					29 00 00 00 00 00 02 E0 01
					29 01 00 00 00 00 03 F0 A5 A5

					/* PCD Setting */
					29 00 00 00 00 00 03 F0 5A 5A
					29 00 00 00 00 00 03 E3 55 12
					29 01 00 00 00 00 03 F0 A5 A5

					/* ACL Setting Value */
					29 00 00 00 00 00 03 F0 5A 5A
					29 00 00 00 00 00 02 B0 CC
					29 00 00 00 00 00 04 B9 55 27 65
					29 00 00 00 00 00 02 B0 D7
					29 00 00 00 00 00 08 B9 02 61 24 49 41 FF 00
					29 01 00 00 00 00 03 F0 A5 A5

					/* Brightness */
					29 00 00 00 00 00 03 F0 5A 5A
					29 00 00 00 00 00 02 53 20			/* Dimming Speed */
					29 00 00 00 00 00 07 B7 01 53 28 4D 00 8A	/* ELVSS */
					29 01 00 00 00 00 03 51 03 FF			/* 420 Nit */
					29 01 00 00 6E 00 03 F0 A5 A5
					/* Wait 110ms(0x6E) */
				];

				qcom,mdss-dsi-off-command=[
					05 01 00 00 14 00 02 28 00
					/* wait 20ms(0x14) */
					05 01 00 00 78 00 02 10 00
					/* wait 20ms(0x14) */
				];

				qcom,mdss-dsi-on-command-state = "dsi_lp_mode";
				qcom,mdss-dsi-off-command-state = "dsi_hs_mode";
			};
		};
	};
};
