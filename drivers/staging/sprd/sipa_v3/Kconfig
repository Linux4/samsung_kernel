## drivers/staging/sprd/sipa_v3/Kconfig
```kconfig
menu "SIPA_V3 modules"

config SPRD_SIPA_V3
	bool "Sprd IPA"
	default n
	help
	  SIPA is a module designed by Spreadtrum to
	  accelerate IP packets, which is mainly suitable
	  for 5g scenarios.

	  This option be opend indicate that the SIPA
	  module will use the SIPA version 3.

config SPRD_SIPA_WCN
	bool "Enable sipa for WCN"
	default n
	depends on SPRD_SIPA_V3
	help
	  This option enables sipa interface for WCN.

endmenu
```

## drivers/sti/abc/Kconfig
```kconfig
comment "Samsung ABC Hub Connect Detect for ABC HUB"
config SEC_ABC_HUB_COND
	tristate "Samsung ABC Hub Connect Detect Feature"
	depends on SEC_ABC_HUB
	help
	  Samsung COND(Connect Detect) Feature
	  This function is to detect connect h/w problem
	  It is sub module of ABC Hub Driver
	  It depends on SEC_ABC_HUB Feature

comment "Samsung ABC Hub Connect Detect Kunit Test FEATURE"
config SEC_ABC_DETECT_KUNIT
	tristate "Samsung Connector Detector Kunit TEST"
	help
		Feature for checking connector detection code .
		This feature should be enabled only for testing while development.

comment "Samsung ABC Hub Connect Detect FEATURE"
config SEC_ABC_DETECT_CONN
	tristate "Samsung Connector Detector feature"
	help
		Feature for checking connector status.
		This feature should be enabled in factory mode.

comment "Samsung ABC Hub Connect Detect for QCOM, MTK"
config QCOM_SEC_ABC_DETECT
	tristate "Samsung Connector Detector Qcom feature"
	help
		Feature for checking QCOM Chipset.
		This feature should be enabled for QCOM chipset in factory mode.
```

## drivers/switch/Kconfig
```kconfig
menuconfig SWITCH
	tristate "Switch class support"
	help
	  Say Y here to enable switch class support. This allows
	  monitoring switches by userspace via sysfs and uevent.

if SWITCH

config SWITCH_GPIO
	tristate "GPIO Swith support"
	depends on GENERIC_GPIO
	help
	  Say Y here to enable GPIO based switch support.

config SWITCH_88PM860X_HS
	tristate "88pm806x Headset Switch support"
	depends on GENERIC_GPIO && MFD_88PM860X
	help
	  Say Y here to enable 88pm860x headset & hook switch support.

config SWITCH_88PM800_HS
	tristate "88pm800 Headset Switch support"
	depends on GENERIC_GPIO && MFD_88PM800
	help
	  Say Y here to enable headset & hook switch support.

config SWITCH_88PM800_HS_SEC
	tristate "88pm800 Headset Switch support for SEC"
	depends on GENERIC_GPIO && MFD_88PM800
	help
	  Say Y here to enable headset & hook switch support.

config SAMSUNG_JACK 
	bool "3.5MM ear jack KSND driver for Samsung devices on Marvell PXA986"
	depends on GENERIC_GPIO && MFD_88PM800
	help
	  Say Y here to enable headset & hook switch support.

endif # SWITCH
```

## drivers/tee/Kconfig
```kconfig
# Generic Trusted Execution Environment Configuration
config TEE
	tristate "Trusted Execution Environment support"
	depends on HAVE_ARM_SMCCC || COMPILE_TEST
	select DMA_SHARED_BUFFER
	select GENERIC_ALLOCATOR
	help
	  This implements a generic interface towards a Trusted Execution
	  Environment (TEE).

if TEE

menu "TEE drivers"

source "drivers/tee/optee/Kconfig"
source "drivers/tee/gud/Kconfig"
source "drivers/tee/teei/Kconfig"
source "drivers/tee/tkcore/Kconfig"
source "drivers/tee/tzdev/Kconfig"

endmenu

#
# TEEGRIS configuration
#
config TEEGRIS_TEE_SUPPORT
       bool "Enable TEEGRIS TEE Support"
       default n
       ---help---
         Enable TEEGRIS TEE Support,
         mainly for all kernel drivers
         that are built for TEEGRIS TEE,
         such as SVP and TZDEV.

endif
```

## drivers/trace/Kconfig
```kconfig
menuconfig TRACE
	bool "TRACE driver support"
	default y
	help
	  The "TRACE driver" is a kind of driver for debugging

if TRACE

config EXYNOS_DRAMTEST
	bool "Exynos DRAMTEST driver"
	help
	  This driver is to test DRAM. It write all 2MB with data 1.

config EXYNOS_BUSMONITOR
	bool "Exynos BUS Monitor support(logging / timeout)"
	default y
	depends on ARCH_EXYNOS

menuconfig EXYNOS_SNAPSHOT
	bool "Exynos SnapShot(ESS) support for debugging"
	default y
	depends on ARCH_EXYNOS

config EXYNOS_SNAPSHOT_CALLSTACK
	int "shown callstack level"
	depends on EXYNOS_SNAPSHOT
	range 1 4
	default 4

config EXYNOS_SNAPSHOT_IRQ_EXIT
	bool "Enable debugging of interrupt exit event by kevent"
	depends on EXYNOS_SNAPSHOT && !EXYNOS_SNAPSHOT_MINIMIZED_MODE
	default y

config EXYNOS_SNAPSHOT_IRQ_EXIT_THRESHOLD
	int "threshold of detection(microsecond)"
	depends on EXYNOS_SNAPSHOT_IRQ_EXIT && !EXYNOS_SNAPSHOT_MINIMIZED_MODE
	range 0 1000000
	default 0

config EXYNOS_SNAPSHOT_IRQ_DISABLED
	bool "Enable debugging of interrupt disable event by kevent(EXPERIMENTAL)"
	depends on EXYNOS_SNAPSHOT && !EXYNOS_SNAPSHOT_MINIMIZED_MODE
	default n

config EXYNOS_SNAPSHOT_SPINLOCK
	bool "Enable debugging of spinlock event by kevent(EXPERIMENTAL)"
	depends on EXYNOS_SNAPSHOT && DEBUG_SPINLOCK && !EXYNOS_SNAPSHOT_MINIMIZED_MODE
	default y

config EXYNOS_SNAPSHOT_CLK
	bool "Enable debugging of clock event by kevent(EXPERIMENTAL)"
	depends on EXYNOS_SNAPSHOT && !EXYNOS_SNAPSHOT_MINIMIZED_MODE
	default y

config EXYNOS_SNAPSHOT_FREQ
	bool "Enable debugging of frequence event by kevent(EXPERIMENTAL)"
	depends on EXYNOS_SNAPSHOT && PM_DEVFREQ && !EXYNOS_SNAPSHOT_MINIMIZED_MODE
	default y

config EXYNOS_SNAPSHOT_HRTIMER
	bool "Enable debugging of hrtimer by kevent"
	depends on EXYNOS_SNAPSHOT && !EXYNOS_SNAPSHOT_MINIMIZED_MODE
	default n

config EXYNOS_SNAPSHOT_SOFTIRQ
	bool "Enable debugging of softirq by kevent"
	depends on EXYNOS_SNAPSHOT && !EXYNOS_SNAPSHOT_MINIMIZED_MODE
	default y

config EXYNOS_SNAPSHOT_REG
	bool "Enable debugging of accessing register by kevent"
	depends on EXYNOS_SNAPSHOT && !EXYNOS_SNAPSHOT_MINIMIZED_MODE
	default n

config EXYNOS_SNAPSHOT_MBOX
	bool "Enable debugging of mailbox for transferring with APM"
	depends on EXYNOS_SNAPSHOT && EXYNOS_MBOX && !EXYNOS_SNAPSHOT_MINIMIZED_MODE
	default y

config EXYNOS_SNAPSHOT_HOOK_LOGGER
	bool "Enable hooking android platform log for ramdump"
	depends on EXYNOS_SNAPSHOT
	default y

config EXYNOS_SNAPSHOT_PANIC_REBOOT
	bool "Enable forced reboot after panic for ramdump"
	depends on EXYNOS_SNAPSHOT
	default y

config EXYNOS_SNAPSHOT_WATCHDOG_RESET
	bool "Support watchdog reset when hardlockup detect"
	depends on EXYNOS_SNAPSHOT && EXYNOS_SNAPSHOT_PANIC_REBOOT
	default y

config EXYNOS_SNAPSHOT_MINIMIZED_MODE
	bool "Support minimized feature configuration"
	depends on EXYNOS_SNAPSHOT
	default n

endif
```

## drivers/usb/notify/Kconfig
```kconfig
#
# USB notify configuration
#

comment "USB Notify features"
config USB_HOST_NOTIFY
	bool "USB Host notify Driver"
	depends on USB
	help
	  Android framework needs uevents for usb host operation.
	  Host notify Driver serves uevent format
	  that is used by usb host or otg.

config USB_NOTIFIER
	bool "USB_NOTIFIER"
	help
	  Added platform driver to call usb notify.
	  The usb_notifier.c can be fixed for each models.

config USB_STORAGE_DETECT
	bool "USB storage detect function"
	depends on USB && SCSI
	depends on USB_STORAGE
	help
	  This feature enables to detect inserting or removing
          sd card in sd reader device.
          This must to be defined in /usb/storage/Kconfig 
          directory originally. But this feature is defined
          in this Kconfig to gather samsung feature about usb host.
```

## drivers/usb/typec/Kconfig
```kconfig
menu "USB Power Delivery and Type-C drivers"

config TYPEC
	tristate
	default n

config TYPEC_WCOVE
	tristate "Intel WhiskeyCove PMIC USB Type-C PHY driver"
	depends on ACPI
	depends on INTEL_SOC_PMIC
	depends on INTEL_PMC_IPC
	depends on BXT_WC_PMIC_OPREGION
	select TYPEC
	help
	  This driver adds support for USB Type-C detection on Intel Broxton
	  platforms that have Intel Whiskey Cove PMIC. The driver can detect the
	  role and cable orientation.

	  To compile this driver as module, choose M here: the module will be
	  called typec_wcove

source "drivers/usb/typec/ucsi/Kconfig"

source "drivers/usb/typec/manager/Kconfig"

source "drivers/usb/typec/common/Kconfig"

source "drivers/usb/typec/slsi/Kconfig"

endmenu
```

## drivers/usb/typec/P86801_tcpc/aw35615/Kconfig
```kconfig
#
# awinic driver configuration
#

config AW35615_PD
	tristate "Awinic Pd"
	depends on I2C
	help
		this option enables support for the AW35615 PD connected
		through I2C. Say Y to enable support for the AW35615 PD
```

## drivers/usb/typec/common/Kconfig
```kconfig
#
# USB PDIC common driver
#

comment "USB PDIC common configs"

config PDIC_NOTIFIER
	tristate "PDIC notifier support"
	depends on I2C
	default n
	help
	  If you say yes here you will get support for
	  the PDIC attached device status change notification.

config USB_ARCH_EXYNOS
	bool "Using exynos"
	default n
	help
	  If you say yes here you will get support for
	  using exynos.
	  For distinguish with Qcom
```

## drivers/usb/typec/etek/et7303/Kconfig
```kconfig
config TCPC_CLASS
	tristate "TypeC Port Controller Device Class"
	help
	  Say Y to enable
	  Typec Port
	  Controller Device
	  Class

config USB_POWER_DELIVERY
	bool "Support USB power delivery Function"
	default n
	help
	  Say Y to enable
	  USB
	  Power Delivery
	  support

config USB_PD_VBUS_STABLE_TOUT
	int "PD VBUS Stable Timeout"
	depends on USB_POWER_DELIVERY
	range 0 1000                       # >= 0,  <= 1000
	default 125
	help
	  Setup a timeout value (ms)
	  for
	  VBUS change
	  stable

config USB_PD_VBUS_PRESENT_TOUT
	int "PD VBUS Present Timeout"
	depends on USB_POWER_DELIVERY
	range 0 1000                       # >= 0,  <= 1000
	default 20
	help
	  Setup a timeout value (ms)
	  for
	  VBUS present
	  stable

config PD_DBG_INFO
	bool "PD debug information"
	depends on TCPC_CLASS
	default n
	help
	  Say Y to enable PD debug
	  information
	  Say N to disable
```

## drivers/usb/typec/etek/et7303/devices/Kconfig
```kconfig
config TCPC_ET7303
	tristate "Etek et7303 TypeC port Controller Driver"
	depends on TCPC_CLASS
	default n
	help
	  Say Y to enable
	  Etek ET7303
	  TypeC port Controller
	  Driver

config RT_REGMAP
	tristate "Richtek Regmap"
	default n
	help
	  Say Y to enable Richtek Register Map
```

## drivers/usb/typec/maxim/max77705/Kconfig
```kconfig
#
# CCIC devices
#

comment "CCIC configs"

config CCIC_MAX77705
	bool "CCIC 77705"
	depends on I2C
	default n
	help
	  If you say yes here you will get support for
	  max77705 ccic full version chipset

config CCIC_MAX77705_DEBUG
	bool "CCIC 77705 DEBUG"
	depends on CCIC_MAX77705
	default n
	help
	  If you say yes here you will get support for
	  debugging feature with max77705 ccic chipset

config PDIC_PD30
	bool "support PD30"
	depends on CCIC_MAX77705
	default n
	help
	  If you say yes here you will get support for PD30

config MAX77705_FW_PID03_SUPPORT
	bool "support MAX77705 FW PID 0x03"
	depends on CCIC_MAX77705
	default n
	help
	  If you say yes here you will get support for
	  specified firmware with max77705 ccic chipset
```

## drivers/usb/typec/pm6150/Kconfig
```kconfig
#
# pm6150 driver
#

comment "PM6150 configs"

config CCIC_PM6150
	bool "Using PM6150 USB PD"
	depends on USE_CCIC
	default n
	help
	  If you say yes here you will get support for
	  the PM6150 USBPD chip.

config PM6150_FACTORY_MODE
	bool "Using PM6150 USB PD"
	depends on CCIC_PM6150
	default n
	help
	  If you say yes here you will get support for
	  the PM6150 FACTORY MODE. 

config PDIC_PD30
	bool "support PD3.0"
	depends on CCIC_PM6150
	default n
	help
	  If you say yes here you will get support for PD3.0
```

## drivers/usb/typec/s2mu107/Kconfig
```kconfig
#
# S2MU107 driver
#

comment "S2MU107 configs"

config CCIC_S2MU107
	bool "Using S2MU107 USB PD"
	depends on USE_CCIC
	default n
	help
	  If you say yes here you will get support for
	  the S2MU107 USBPD chip.

config CCIC_S2MU106
	bool "Using S2MU106 USB PD"
	depends on USE_CCIC	
	default n
	help
	  If you say yes here you will get support for
	  for the S2MU106 USBPD chip.

config PDIC_PD30
	bool "support PD3.0"
	depends on CCIC_S2MU107 || CCIC_S2MU106
	default n
	help
	  If you say yes here you will get support for PD3.0
	  
config CCIC_AUTO_PPS
    bool "support auto pps"
    depends on I2C
    default n
    help
      If you say yes here you will get support for
      sending pps message automatically

config CCIC_9V_OTG_SUPPORT 
    bool "support 9V/1A PDO for OTG(pd source)"
    depends on USE_CCIC
    default n
    help
      If you say yes here you will get support for 9V/1A PDO for PD source
```

## drivers/usb/typec/samsung/Kconfig
```kconfig
#
# PDIC devices
#

comment "PDIC configs"

config TYPEC_SAMSUNG_IFPMIC
	tristate "Using common USBPD device driver"
	depends on I2C
	default n
	help
	  If you say yes here you will get support for
	  the common USB PD(Power Delivery) device driver.

config USE_S2M_PDIC
	tristate "Using USBPD device driver"
	depends on I2C
	default n
	help
	  If you say yes here you will get support for
	  the USB PD(Power Delivery) device driver.

config PDIC_S2MU106
	bool "Using S2MU106 USB PD"
	depends on USE_S2M_PDIC
	default n
	help
		If you say yes here you will get support for
		the S2MU106 USBPD chip

config PDIC_S2MF301
	bool "Using S2MF301 USB PD"
	depends on USE_S2M_PDIC
	default n
	help
		If you say yes here you will get support for
		the S2MF301 USBPD chip

config PDIC_SYSFS
	bool "Using PDIC SYSFS System"
	depends on USE_S2M_PDIC
	default n
	help
	  If you say yes here you will get support for
	  sysfs system.

config PDIC_AUDIO_ACC
	bool "Using PDIC Audio accessory support(Ra-Ra)"
	depends on USE_S2M_PDIC
	default n
	help
	  If you say yes here you will get support for
	  Audio Accessory support (need usb audio switch device)

config CHECK_CTYPE_SIDE
	bool "Using Check Side of Type-C PLUG"
	help
		This Config for function that check side of Type-C PLUG for USB

config SUPPORT_USB_TYPEC_OPS
	bool "Using USB_TYPEC_OPS for GKI"
	help
		This config for support typec_ops for GKI

config USB_SW_MAX20328B
	bool "MAX20328B USB Switch driver"
	help
		This driver is for MAX20328B USB switch that use I2C interface
		To compile this driver as a module, choose M here: the
		module will be called max20328b

config PDIC_SUPPORT_DP
	tristate "Support booting with DP"
	help
		This Config for function that support DP

config PDIC_PD30
	bool "Support PD30"
	help
		This Config for function that support PD30
```

## drivers/usb/typec/slsi/Kconfig
```kconfig
source "drivers/usb/typec/slsi/common/Kconfig"
source "drivers/usb/typec/slsi/s2mu107/Kconfig"
source "drivers/usb/typec/slsi/s2mu106/Kconfig"
```

## drivers/usb/typec/slsi/common/Kconfig
```kconfig
#
# PDIC devices
#

comment "PDIC configs"

config PDIC_SLSI
	bool "Using SLSI PDIC driver"
	depends on I2C
	default n
	help
	  If you say yes here you will get support for
	  the S.LSI PD(Power Delivery)IC device driver.

config PDIC_SLSI_NON_MCU
	bool "Using USBPD device driver"
	depends on I2C
	default n
	help
	  If you say yes here you will get support for
	  the S.LSI Non MCU USB PD(Power Delivery) device driver.

config PDIC_PD30
	bool "support PD30"
	depends on PDIC_SLSI_NON_MCU
	default n
	help
	  If you say yes here you will get support for PD30
```

## drivers/usb/typec/slsi/s2mu106/Kconfig
```kconfig
#
# PDIC devices
#

comment "PDIC configs"

config PDIC_S2MU106
	bool "Using S2MU106 USB PD"
	depends on PDIC_SLSI_NON_MCU
	default n
	help
	  If you say yes here you will get support for
	  for the S2MU106 USBPD chip.
```

## drivers/usb/typec/slsi/s2mu107/Kconfig
```kconfig
#
# PDIC devices
#

comment "PDIC configs"

config PDIC_S2MU107
	bool "Using S2MU107 USB PD"
	depends on PDIC_SLSI_NON_MCU
	default n
	help
	  If you say yes here you will get support for
	  for the S2MU107 USBPD chip.
```
