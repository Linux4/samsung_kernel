## drivers/usb/typec/sm/sm5714/Kconfig
```kconfig
#
# sm5714 driver
#

comment "SM5714 configs"

config PDIC_SM5714
	bool "Using SM5714 USB PD"
	default n
	help
	  If you say yes here you will get support for
	  the SM5714 USBPD chip.

config SM5714_FACTORY_MODE
	bool "Using SM5714 USB PD"
	depends on PDIC_SM5714
	default n
	help
	  If you say yes here you will get support for
	  the SM5714 FACTORY MODE.

config PDIC_PD30
	bool "support PD3.0"
	depends on PDIC_SM5714
	default n
	help
	  If you say yes here you will get support for PD3.0
```

## drivers/uwb/Kconfig
```kconfig
#
# UWB device configuration
#
config SAMSUNG_UWB
	tristate "Samsung UWB driver"
	default n
	help
	  Say Y here if you want to build support for UWB devices.
	  To compile this support as a module, choose M here: the module will
	  be called uwb.

config UWB_SR100
	bool "Nxp SPI driver for SR100 devices"
	default n
	help
	  NXP SR100 UWB controller support.

config SEC_UWB_LOGGER
	bool "UWB logger"
	default n
	help
	  Enable UWB logger.
```

## drivers/vibrator/awinic/aw8622x/Kconfig
```kconfig
config INPUT_AW8622X_HAPTIC
	tristate "Awinic AW8622X Input Haptic Driver"
	depends on I2C
	help
	  Say Y here if you have Awinic AW8622X chip in your system.
	  If unsure, say N.
	  To compile this driver as a module, choose M here: the
	  module will be called aw8622x input haptic driver.

config AW8622X_SAMSUNG_FEATURE
	bool "AWINIC AW8622X Haptic Driver for Samsung feature"
	depends on INPUT_AW8622X_HAPTIC
	default n
	help
	  Say Y to enable AW8622X_SAMSUNG_FEATURE
	  codes featured with this comment
	  aren't the original code from AWINIC.
	  To use samsung concept, please enable this.
```

## drivers/vibrator/common/Kconfig
```kconfig
config SEC_VIBRATOR
	tristate "sec vibrator"
	default n
	help
	  If you say yes here you will get support for the
	  sec vibrator driver

config SEC_VIB_NOTIFIER
	tristate "use sec vibrator notifier"
	default n
	help
	  Enable notifier functions to get motor enable status
	  and timeout value by register notifiy
	  If you unsure, please select n
```

## drivers/vibrator/dc/dc_haptic/Kconfig
```kconfig
#
#
#
config DC_HAPTIC_VIBRATOR
	tristate "SEC DC Haptic Vibrator"
	default n
	help
	  If you say yes here you will get support for the
	  SEC DC Vibrator. This will also support haptic
	  feedback with DC motor.

config USE_HAPTIC_DURATIONS
	tristate "SUPPORT haptic_durations node"
	default n
	help
	  If you say yes here you will use haptic duration interface
	  instead of haptic intensities interface.
	  In ONEUI 3.1 models, we will use haptic intensities interface,
	  and from ONEUI 3.5, we will use haptic duration interface
```
