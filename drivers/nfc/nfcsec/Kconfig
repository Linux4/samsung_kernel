## drivers/nfc/nfcsec/Kconfig
```kconfig
menuconfig NFC_SEC
	tristate "Samsung NFC driver support"
	depends on I2C
	help
	  The core driver to support Samsung NFC devices.

	  Say Y here to compile Samsung NFC driver into the kernel or
	  say M to compile it as module.

if NFC_SEC

choice
	prompt "SEC NFC Products"
	default SEC_NFC_PRODUCT_N5
config SEC_NFC_PRODUCT_N3
	bool "N3"
config SEC_NFC_PRODUCT_N5
	bool "N5"
endchoice

choice
	prompt "SEC NFC Interface"
	default SEC_NFC_IF_I2C
config SEC_NFC_IF_UART
	bool "UART"
config SEC_NFC_IF_I2C
	depends on I2C
	bool "I2C"
config SEC_NFC_IF_I2C_GPIO
	bool "I2C-GPIO (S/W-I2C)"
	select I2C_ALGOBIT
endchoice

config SEC_NFC_CLK_REQ
	bool "External clock control (RF clock)"
	depends on SEC_NFC_PRODUCT_N5
	default n
	help
	  Driver controls NFC external clock.
	  This option should be enabled to control NFC external clock.
	  you should select if your NFC device requests exnternal clock.
	  Say Y here to compile support for exnternal clock control in the kernel.

endif #NFC_SEC
```

## drivers/nfc/nxp/Kconfig
```kconfig
#
# Near Field Communication (NFC) devices
#
config SAMSUNG_NFC
	tristate "Samsung NFC driver"
	default n
	help
	  Say Y here if you want to build support for NFC (Near field
	  communication) devices.
	  To compile this support as a module, choose M here: the module will
	  be called nfc.

config NFC_PN547
	bool "NXP PN547 NFC Controller Driver"
	depends on I2C
	default n
	help
	  NXP PN547 Near Field Communication controller support.
	  This option enables device driver support for the NFC.
	  It is used by many services. NFC is fully controlled using I2C
	  to communication.

config NFC_FEATURE_SN100U
	bool "NXP SN100U Feature"
	default n
	help
	  NXP SN100U Near Field Communication controller support
	  This option enables device driver support for the NFC.
	  It is used by many services. NFC is fully controlled using I2C
	  to communicate the AP chip.

config NFC_PN547_CLK_BBCLK2
	bool "NXP PN547 NFC CLOCK Controller"
	depends on NFC_PN547
	default n
	help
	  NXP PN547 Near Field Communication controller support.
	  This option enables device driver support for the NFC.
	  It is used by many services. NFC is fully controlled using I2C
	  to communicate the AP chip.

config NFC_P61
	bool "NXP PN547 NFC Controller Driver"
	depends on SPI
	default n
	help
	  NXP PN547 Near Field Communication controller support.
	  This option enables device driver support for the NFC.
	  It is used by many services. NFC is fully controlled using I2C
	  to communication

config NFC_PN547_ESE_SUPPORT
	bool "NXP PN547 ESE SUPPORT"
	depends on NFC_PN547
	default n
	help
	  NXP PN547 Near Field Communication controller support.
	  This option enables device driver support for the NFC.
	  It is used by many services. NFC is fully controlled using I2C
	  to communication

config NFC_PN547_LDO_CONTROL
	bool "PN547 NFC LDO CONTROL"
	depends on NFC_PN547
	default n
	help
	  SAMSUNG PN547 NFC LDO CONTROL feature.
	  This feature provides support for NXP PN547 products.
	  You should select this feature if your NFC product uses ldo control of i2c.

	  Say Y here to compile support for NXP PN547 LDO CONTROL feature into the
	  kernel.

config ESE_SECURE
        bool "ese secure"
        depends on !SEC_FACTORY
        default n
        help
          eSE Driver.
          This driver provides support for ESE products.
          This option enables device spi communication
          via secured OS only.

config ESE_USE_TZ_API
        bool "use tz api"
        depends on NFC_PN547_ESE_SUPPORT
        default n
        help
          Enable when using TZ API.
	  You should select this feature if your NFC product
          uses S.LSI AP and TZ API.
	  Say Y here to compile support for TZ API.

config SEC_STAR
        tristate "LSI star platform"
        default n
        help
          LSI star platform
          This driver provides support for LSI star platform.

config STAR_MEMORY_LEAK
        bool "memory leak test in sec-star"
        help
          memory leak test in sec-star.
          All allocated memory are listed in array.

config STAR_K250A
        bool "S.LSI k250a driver"
        help
          S.LSI k250a driver except ISO7816 protocol layer
          This driver provides support for S.LSI k250a product.
```

## drivers/nfc/pn557/Kconfig
```kconfig
config NFC_PN557
        tristate "QTI NCI based NFC Controller Driver for NQx"
        depends on I2C
        help
          This enables the NFC driver for NQx based devices.
          This is for i2c connected version. NCI protocol logic
          resides in the usermode and it has no other NFC dependencies.
                                                                      
config NXP_NFC_SN1XX
        bool "Nxp NFC sn1xx Controller"
        help
          You'll have to say Y if your computer contains an sn1xx I2C device that
          you want to use under Linux.
          You can say N here if you don't have any sn1xx I2C connected to your computer.


config NXP_NFC_PN8XT
        bool "Nxp NFC pn8xt Controller"
        help
          You'll have to say Y if your computer contains an pn8xt I2C device that
          you want to use under Linux.
          You can say N here if you don't have any pn8xt I2C connected to your computer.

config NXP_PN557
    tristate "NFC driver solution - NXPMicroelectronics PN533 NFC Controller Driver"
    #default n
    depends on I2C
    help
      STMicroelectronics PN533 Near Field Communication controller support.
      PN533 is standalone NFC and PN533 is combined with secure element.
      If configures to be y, means devices supports NFC functionality.
```

## drivers/nfc/sec-star/Kconfig
```kconfig
#
# SEC STAR platform devices
#

config STAR_MEMORY_LEAK
	bool "memory leak test in sec-star"
	help
	  memory leak test in sec-star.
	  All allocated memory are listed in array.

config STAR_K250A
	bool "S.LSI k250a driver"
	help
	  S.LSI k250a driver except ISO7816 protocol layer
	  This driver provides support for S.LSI k250a product.
```

## drivers/nfc/snvm/Kconfig
```kconfig
#
# SEC STAR platform devices
#

config STAR_MEMORY_LEAK
	bool "memory leak test in sec-star"
	help
	  memory leak test in sec-star.
	  All allocated memory are listed in array.

config STAR_K250A_LEGO
	tristate "S.LSI k250a driver"
	default n
	help
	  S.LSI k250a driver except ISO7816 protocol layer
	  This driver provides support for S.LSI k250a product.
```

## drivers/optics/Kconfig
```kconfig
config SENSORS_FLICKER_SELF_TEST
	tristate "Flicker EOL test use flash"
	help
		make Test environment using led flash.

config SENSORS_TSL2510
	tristate "AMS TSL2510 ALS, Flicker sensor"
	depends on I2C
	help
	  If you say yes here, you get support for the AMS TSL2510.
	  This driver can also be built as a module.
	  If so, the module will be called TSL2510.

config SENSORS_STK3A8X
    tristate "sensortek stk3a8x light device driver"
    depends on I2C
    help
        If you say yes here, you get support for the stk3a8x.
```

## drivers/perf_mgr/Kconfig
```kconfig
config SEC_PERF_MANAGER
	tristate "performance manager Driver"
	default n
	help
	  Samsung Performance Manager Driver
	  Say Y here if enable perf_mgr driver to boost system resources by scheduler.
	  Such as make util of tasks high for proper frequency.
	  GPIS which is Graphic Pipeline Inhenced Solution adjusts scheduling util & migraion for 120Hz mode.
	  When frame drops occurs.

	  Say N here if you disable input boosting.

	  If unsure, say N.

config SEC_PERF_MANAGER_QC
	bool "SEC_PERF_MANAGER_QC"
	depends on SEC_PERF_MANAGER
	default n
	help
	  Say Y here if you enable perf manager of QC under QC chipset

	  Say N here if you disable perf manager of QC

	  If unsure, say N.

config SEC_PERF_MANAGER_SLSI
	bool "SEC_PERF_MANAGER_SLSI"
	depends on SEC_PERF_MANAGER
	default n
	help
	  Say Y here if you enable perf manager of SLSI under SLSI chipset
	  such as touch.

	  Say N here if you disable perf manager of SLSI

	  If unsure, say N.

config SEC_PERF_MANAGER_MTK
	bool "SEC_PERF_MANAGER_MTK"
	depends on SEC_PERF_MANAGER
	default n
	help
	  Say Y here if you enable perf manager of MTK under MTK chipset
	  such as touch.

	  Say N here if you disable perf manager of MTK

	  If unsure, say N.
```

## drivers/phy/common/Kconfig
```kconfig
#
# USB repeater common driver
#

comment "USB repeater common configs"

config USB_REPEATER
	tristate "USB repeater support"
	default n
	help
	  If you say yes here you will get support for
	  the USB repeater device.

config USB_REPEATER_TEST
        bool "KUnit test for usb_repeater_test"
        depends on SEC_KUNIT
        help
          This driver is for usb_repeater_test driver
		  usb_repeater_test kunit test
		  If you want to add some functions,
		  Please make the test case.
```

## drivers/phy/ti/tusb2e11/Kconfig
```kconfig
config USB_REPEATER_TUSB2E11
	tristate "TI TUSB2E11 Support"
	depends on I2C && USB_REPEATER
	help
	  Say yes here to support for TI TUSB2E11.
```

## drivers/pinctrl/samsung/pmic/Kconfig
```kconfig
# SPDX-License-Identifier: GPL-2.0-only
#
# SAMSUNG PINCTRL infrastructure and pmic drivers
#

config PINCTRL_SAMSUNG_PMIC
	tristate "SAMSUNG COMMON PMIC pin controller"
	help
	 This is the pinctrl, pinmux, pinconf and gpiolib driver for the
	 Qualcomm GPIO and MPP blocks found in the Qualcomm PMIC's chips,
	 which are using SPMI for communication with SoC. Example PMIC's
	 devices are pm8841, pm8941 and pma8084.

config PINCTRL_SAMSUNG_S2MPS26
	tristate "SAMSUNG PMIC pin controller driver"
#depends on GPIOLIB && OF && SPMI
#	select REGMAP_SPMI
#	select PINMUX
#	select PINCONF
#	select GENERIC_PINCONF
#	select GPIOLIB_IRQCHIP
#	select IRQ_DOMAIN_HIERARCHY
	help
	 This is the pinctrl, pinmux, pinconf and gpiolib driver for the
	 Qualcomm GPIO and MPP blocks found in the Qualcomm PMIC's chips,
	 which are using SPMI for communication with SoC. Example PMIC's
	 devices are pm8841, pm8941 and pma8084.

config PINCTRL_SAMSUNG_S2MPM07
	tristate "SAMSUNG PMIC pin controller driver"
	help
	 This is the pinctrl, pinmux, pinconf and gpiolib driver for the
	 Qualcomm GPIO and MPP blocks found in the Qualcomm PMIC's chips,
	 which are using SPMI for communication with SoC. Example PMIC's
	 devices are pm8841, pm8941 and pma8084.

config PINCTRL_SAMSUNG_S2MPS26_9935
	tristate "SAMSUNG PMIC pin controller driver for s5e9935"
#depends on GPIOLIB && OF && SPMI
#	select REGMAP_SPMI
#	select PINMUX
#	select PINCONF
#	select GENERIC_PINCONF
#	select GPIOLIB_IRQCHIP
#	select IRQ_DOMAIN_HIERARCHY
	help
	 This is the pinctrl, pinmux, pinconf and gpiolib driver for the
	 Qualcomm GPIO and MPP blocks found in the Qualcomm PMIC's chips,
	 which are using SPMI for communication with SoC. Example PMIC's
	 devices are pm8841, pm8941 and pma8084.

config PINCTRL_SAMSUNG_S2MPM07_9935
	tristate "SAMSUNG PMIC pin controller driver for s5e9935"
	help
	 This is the pinctrl, pinmux, pinconf and gpiolib driver for the
	 Qualcomm GPIO and MPP blocks found in the Qualcomm PMIC's chips,
	 which are using SPMI for communication with SoC. Example PMIC's
	 devices are pm8841, pm8941 and pma8084.

config PINCTRL_SAMSUNG_S2MPA05_8535
	tristate "SAMSUNG PMIC pin controller driver for s5e8535"
	help
	 This is the pinctrl, pinmux, pinconf and gpiolib driver for the
	 Samung GPIO found in the Samsung PMIC's chips, which are using
	 SPMI for communication with SoC.

config PINCTRL_SAMSUNG_S2MPU15_8535
	tristate "SAMSUNG PMIC pin controller driver for s5e8535"
	help
	 This is the pinctrl, pinmux, pinconf and gpiolib driver for the
	 Samung GPIO found in the Samsung PMIC's chips, which are using
	 SPMI for communication with SoC.

config PINCTRL_SAMSUNG_S2MPU15_8835
	tristate "SAMSUNG PMIC pin controller driver for s5e8835"
	help
	 This is the pinctrl, pinmux, pinconf and gpiolib driver for the
	 Samung GPIO found in the Samsung PMIC's chips, which are using
	 SPMI for communication with SoC.

config PINCTRL_SAMSUNG_S2MPU16_8835
	tristate "SAMSUNG PMIC pin controller driver for s5e8835"
	help
	 This is the pinctrl, pinmux, pinconf and gpiolib driver for the
	 Samung GPIO found in the Samsung PMIC's chips, which are using
	 SPMI for communication with SoC.
```
