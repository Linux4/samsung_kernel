## drivers/power/supply/mediatek/charger/Kconfig
```kconfig
config MTK_CHARGER
	bool "MediaTek Charging Driver"
	depends on MEDIATEK_SOLUTION
	help
	  Say yes here to enable MediaTek charging driver.
	  This driver contains charging control flow and
	  maintains charging status.
	  Say no if not using MediaTek charging driver.

config POWER_EXT
	bool "MediaTek Power Ext"
	help
	  Check this if the device is not powered by battery.
	  For example, if the device is powered by AC adapter.
	  Select No if the device needs info about
	  battery voltage, temperature, etc.

config MTK_SWCHR_SUPPORT
	bool "MediaTek switch charger"
	depends on MTK_CHARGER
	help
	  This is to enable switching charger control flow.
	  switching charger has better performance than pulse charger
	  Set to yes if switching charger is used.
	  Set to no if pmic pulse charger is used.

config MTK_KERNEL_POWER_OFF_CHARGING
	bool "MTK kernel power off charging"
	depends on MTK_CHARGER
	help
	  yes : support KPOC feature, power off charging would running by
	  kernel and charging animation by kpoc service. no: not support KPOC
	  feature.
	  device won't enter charging mode if config is no.

config MTK_PUMP_EXPRESS_PLUS_SUPPORT
	bool "MediaTek PUMP EXPRESS PLUS"
	depends on MTK_CHARGER
	help
	  Fast charging technology using switch charger and current pattern
	  to achive better charging ability.
	  Set Yes to enable PE+
	  Set No to disable PE+

config MTK_PUMP_EXPRESS_PLUS_20_SUPPORT
	bool "MediaTek PUMP EXPRESS PLUS 2.0"
	depends on MTK_CHARGER
	help
	  Fast charging technology using switch charger and current pattern
	  to achive better charging ability. It has higher charging efficiency
	  and has better thermal performance than PE+.
	  Set Yes to enable PE+2.0
	  Set No to disable PE+2.0

config MTK_PUMP_EXPRESS_50_SUPPORT
	bool "Mediatek Pump Express 5.0"
	select RT_PROP_CHGALGO
	depends on MTK_CHARGER
	help
	  Fast charging technology using divider charger to achieve better
	  charging ability. It has higher charging efficiency and better
	  thermal performance than using switching charger.
	  Set Yes to enable PE5.0
	  Set No to disable PE5.0

config MTK_DUAL_CHARGER_SUPPORT
	bool "MediaTek dual charger support"
	depends on MTK_CHARGER
	help
	  Use two charging ICs (master and slave) to charge the system.
	  The master IC is connected to VBUS, VSYS, and VBAT, the slave
	  IC is conneceted to PMID pin from the master and VBAT.
	  Say Yes to enable dual charger support.

config SWCHR_POWER_PATH
	bool "External charger IC supports powerpath"
	depends on MTK_CHARGER
	help
	  Set Yes if the external charger IC
	  supports power path function.
	  This affects setting of auxadc channels
	  used to representing voltage of system
	  or battery.

config MTK_BQ24196_SUPPORT
	bool "MediaTek Battery driver for TI BQ24196 charger IC"
	help
	  BQ24196 charger IC support
	  This is to enable MediaTek supports to BQ24196.
	  It depends on config MTK_SMART_BATTERY
	  and config MTK_SWCHR_SUPPORT
	  Set to Yes if BQ24196 is used.

config MTK_BQ24296_SUPPORT
	bool "MediaTek Battery driver for TI BQ24296 charger IC"
	help
	  This is to enable MediaTek supports to BQ24296 Charger IC.
	  It depends on config MTK_SMART_BATTERY
	  and config MTK_SWCHR_SUPPORT
	  Set to Yes if BQ24296 is used.

config CHARGER_MT6362
	tristate "MT6362 SPMI CHG driver"
	depends on MFD_MT6362
	help
	  Say yes here to have support for the MT6362 CHG
	  It supports BC1.2 and OTG boost.
	  The driver can also be build as a module.
	  If so, the module will be called mt6362_chg

config CHARGER_RT9465
	bool "Charger Driver for Richtek RT9465 Charger IC"
	depends on MTK_CHARGER
	help
	  Say Yes to enable Richtek RT9465 driver.
	  It is mainly used as slave IC for dual charger
	  application.
	  It depends on config MTK_CHARGER.

config CHARGER_RT9458
	bool "Charger Driver for Richtek RT9458 Charger IC"
	depends on MTK_SWCHR_SUPPORT
	help
	  Say Y to enable
	  Richtek RT9458 driver.
	  It depends on
	  the config MTK_SWCHR_SUPPORT.

config CHARGER_RT9466
	bool "Charger Driver for Richtek RT9466 Charger IC"
	default n
	depends on MTK_SWCHR_SUPPORT
	help
	  Say Yes to enable
	  Say No to disable
	  Richtek RT9466 driver.
	  It depends on config  MTK_SWCHR_SUPPORT.

config CHARGER_RT9467
	bool "Charger Driver for Richtek RT9467 Charger IC"
	depends on MTK_CHARGER
	help
	  Say Yes to enable Richtek RT9467 driver.
	  It is mainly used as slave IC for dual charger
	  application.
	  It depends on config MTK_CHARGER.

config CHARGER_RT9471
	bool "Charger Driver for Richtek RT9471 Charger IC"
	depends on MTK_CHARGER
	help
	  Say Yes to enable Richtek RT9471 charger driver.
	  It supports RT9470/RT9470D/RT9471/RT9471D/RT9472/RT9472D,
	  which RT9470D, RT9471D and RT9472D support BC1.2
	  It depends on config MTK_CHARGER.

config CHARGER_RT9759
	bool "Richtek RT9759 Divider Charger Driver"
	depends on MTK_CHARGER
	help
	  Say Y here to enable support of rt9759 divider charger
	  It is mainly used as divider charger for
	  direct charge
	  It depends on config MTK_CHARGER

config RT_PROP_CHGALGO
	bool "Richtek Proprietary Charging Algorithm"
	help
	  Say Y to enable
	  Richtek Proprietary charging algorithm
	  Say N to disable
	  Richtek Proprietary charging algorithm

config MTK_CHARGER_UNLIMITED
	bool "MediaTek Charger Unlimited"
	depends on MTK_CHARGER
	help
	  Say Yes to release charging current restrictions.
	  Say No to not release charging current restrictions.
	  It is mainly used for long-term tests.
	  It depends on config MTK_CHARGER.

config CHARGER_HL7005
	bool "Charger Driver for Halo HL7005 Charger IC"
	depends on MTK_SWCHR_SUPPORT
	help
	  Say Y to enable
	  Halo HL7005 driver.
	  It depends on config MTK_SWCHR_SUPPORT.

config CHARGER_BQ25601
	bool "CHARGER_BQ25601"
	help
	  This is to enable MediaTek supports to BQ25601.
	  It depends on config MTK_SMART_BATTERY
	  and config MTK_SWCHR_SUPPORT
	  Set to Yes if BQ25601 is used.

config LOAD_SWITCH_RT9750
	bool "Load Switch Driver for Richtek RT9750"
	depends on MTK_CHARGER
	help
	  Say Yes to enable Richtek RT9750 driver.
	  It is a load switch,
	  which is good for direct charge.
	  It depends on config MTK_CHARGER.

# AL6528A code for SR-AL6528A-01-307 by wenyaqi at 2022/08/30 start
config CHARGER_SGM41513
	bool "CHARGER_SGM41513"
	depends on MTK_CHARGER
	help
	  Say Yes to enable
	  SGM41513 driver.
# AL6528A code for SR-AL6528A-01-307 by wenyaqi at 2022/08/30 end

# hs14 code for SR-AL6528A-01-305 by gaozhengwei at 2022/09/01 start
config CHARGER_SC8960X
	tristate "SC SC8960X battery charger driver"
	depends on I2C
	default n
	help
	  Say Y to enable support for SC SC8960X charger
# hs14 code for SR-AL6528A-01-305 by gaozhengwei at 2022/09/01 end

# hs14 code for SR-AL6528A-01-304 by gaozhengwei at 2022/09/07 start
config CHARGER_UPM6910
	bool "CHARGER_UPM6910"
	depends on MTK_CHARGER
	help
	  Say Yes to enable
	  UPM6910 driver.
# hs14 code for SR-AL6528A-01-304 by gaozhengwei at 2022/09/07 end

# hs14 code for SR-AL6528A-01-305 by shanxinkai at 2022/09/19 start
config CHARGER_VBUS
	bool "CHARGER_VBUS"
	depends on MTK_CHARGER
	default n
	help
	  Say Y to enable support for vbus ctrl
# hs14 code for SR-AL6528A-01-305 by shanxinkai at 2022/09/19 end

# hs14 code for SR-AL6528A-01-321 by gaozhengwei at 2022/09/22 start
config AFC_CHARGER
	bool "Using AFC device driver"
	default n
	help
	  If you say yes here you will get support for
	  the AFC device driver.
# hs14 code for SR-AL6528A-01-321 by gaozhengwei at 2022/09/22 end

# hs14_u code for AL6528AU-252 by liufurong at 2024/01/11 start
config GXY_BATT_TIME_TO_FULL
	bool "Using gxy time to full feature"
	default n
	help
	  If you say yes here you will get support for
	  the gxy batt time to full.
# hs14_u code for AL6528AU-252 by liufurong at 2024/01/11 end
```

## drivers/power/supply/mediatek/charger/charge_pump/Kconfig
```kconfig
config CHARGER_CP_PPS
	tristate "charge pump pps support"
	default n
	bool "CHARGER_CP_PPS"
        help
	  Say Y to enable support for charge pump pps
```

## drivers/power/supply/samsung/Kconfig
```kconfig
# SPDX-License-Identifier: GPL-2.0-only
#
# Multifunction miscellaneous devices for samsung pmic
#

config PWR_SAMSUNG_IFPMIC
	tristate "common power device driver support"
	depends on (MFD_S2MF301) && I2C
	help
	 Say Y here to enable support for the common power device drivers.

config FUELGAUGE_S2MU106
       tristate "S2MU106 fuelgauge driver"
       default n
       depends on I2C
       help
        say y to include support
        for s.lsi S2MU106 fuelgauge driver.

config CHARGER_S2MU106
	tristate "S2MU106 charger support"
	depends on (MFD_S2MU106) && I2C
	help
	 Say Y here to enable support for the S2MU106 charger
	 S2MU106 incluse pmic, led driver.
	 You have to define MFD_S2MU106

config PM_S2MU106
	tristate "S2MU106 power meter support"
	depends on (MFD_S2MU106) && I2C
	help
	 Say Y here to enable support for the S2MU106 power meter.
	 S2MU106 power meter is dependent on MFD_S2MU106
	 so it needs to be defined.

config CHARGER_S2MC501
	tristate "S2MC501 charger support"
	depends on I2C && (DIRECT_CHARGER)
	help
	 Say Y here to enable support for the S2MC501 direct charger

config CHARGER_S2MF301
	tristate "S2MF301 charger support"
	depends on (MFD_S2MF301) && I2C
	help
	 Say Y here to enable support for the S2MF301 charger
	 S2MF301 incluse pmic, led driver.
	 You have to define MFD_S2MF301

config FUELGAUGE_S2MF301
	tristate "S2MF301 fuelgauge driver"
	depends on (MFD_S2MF301) && I2C
	help
	 say y to include support
	 for s.lsi S2MF301 fuelgauge driver.
	 You have to define MFD_S2MF301

config PM_S2MF301
	tristate "S2MF301 power meter support"
	depends on (MFD_S2MF301) && I2C
	help
	 Say Y here to enable support for the S2MF301 power meter.
	 S2MF301 power meter is dependent on MFD_S2MF301
	 so it needs to be defined.

config TOP_S2MF301
	tristate "S2MF301 top support"
	depends on (MFD_S2MF301) && I2C
	help
	 Say Y here to enable support for the S2MF301 top.

config TOP_S2MF301_SUPPORT_S2MC501
	bool "S2MF301 top supports s2mc501 dc"
	depends on TOP_S2MF301
	help
	 Say Y here to enable support for s2mc501 dc functions

config FAKE_BATT
	tristate "SMDK board only support"
	help
	  Say Y here to enable support for S2MXXXX charging manager driver on SMDK board.

config DIRECT_CHARGER
       tristate "S2M Direct charging battery driver"
       help
         Say Y here to enable support for S2MXXXX charging manager driver.
         This direct charging manager driver supports only the basic functions.

config MANAGER_S2M_CHARGER
	tristate "S2M_CHG_MANAGER battery driver"
	help
	  Say Y here to enable support for S2MXXXX charging manager driver.
	  This charging manager driver supports only the basic functions.

config SWITCHING_S2ASL01
    tristate "S2ASL01 SWITCHING IC support"
    depends on I2C
    help
	  Say Y here to enable support for S2ASL01 switching driver.

config BLOCK_CHG_SMDK_S2MU106
	tristate "S2ASL01 SWITCHING IC support"
	depends on I2C
	help
	 Say Y here to block charging mode for S2MU106 charger.

config S2M_THERMAL
	tristate "PMIC Thermal Function"
	depends on MANAGER_S2M_CHARGER
	help
	  Say Y here to enable PMIC thermal function.

config SYSFS_S2MF301
	tristate "ifpmic sysfs system"
	depends on I2C
	help
	 This driver supports a ifpmic sysfs.
```

## drivers/power/supply/wt_charger/Kconfig
```kconfig
# SPDX-License-Identifier: GPL-2.0-only

menu "Wingtech Technologies, Inc. Charger and Fuel Gauge support"

config WT_DISABLE_TEMP_CONTROL
	tristate "CONFIG_WT_DISABLE_TEMP_CONTROL"
config CHARGE_SGM41542
        tristate "CONFIG_CHARGE_SGM41542 charger ic"
        depends on I2C
        help
           Say Y here to enable support for charge with SGM41542 chips
           connected over an I2C bus.

config CHARGE_CX25890H
	tristate "CONFIG_CHARGE_CX25890H charger ic"
        depends on I2C
	help
	   Say Y here to enable support for charge with CX25890H chips
	   connected over an I2C bus.

config CHARGE_SC89890H
	tristate "CONFIG_CHARGE_SC89890H charger ic"
        depends on I2C
	help
	   Say Y here to enable support for charge with SC89890H chips
	   connected over an I2C bus.

config FG_CW2217
	tristate "CONFIG_FG_CW2217 FG ic"
        depends on I2C
	help
	   Say Y here to enable support for charge with CW2217 chips
	   connected over an I2C bus.

config FG_SD77428
        tristate "CONFIG_FG_SD77428 FG ic"
        depends on I2C
        help
           Say Y here to enable support for charge with SD77428 chips
           connected over an I2C bus.

config CHARGE_SY65153
	tristate "CONFIG_CHARGE_SY65153 charger ic"
        depends on I2C
	help
	   Say Y here to enable support for charge with SY65153 chips
	   connected over an I2C bus.

config WT_CHARGER
	tristate "WT CHARGER CONTROL"
        depends on I2C
	help
	  Say Y to include the support of WT_CHARGER Charge driver based on power
	  supply framework.
	  WT_CHARGER is a combo charger chip which can work in different modes:

config AFC
	bool "Using AFC device driver"
	default n
	help
	  If you say yes here you will get support for
	  the AFC device driver.

# +P231018-03087 gudi.wt 20231025 fix eng adb prot
config CHARGER_ENG
	bool "S86801EA1"
	help
	  This enables support for S86801EA1 ENG.
# -P231018-03087 gudi.wt 20231025 fix eng adb prot

endmenu
```

## drivers/power/tps61280a-power/Kconfig
```kconfig
config TPS61280A_POWER
	tristate "TPS61280A Power Supply"
	depends on I2C
	help
	  Say Y to include support for TPS61280A Power Supply.
	  TPS61280A is power supply from TI.
```

## drivers/pwm/pwm-gpclk/Kconfig
```kconfig
config PWM_GPCLK
	tristate "Qualcomm GP CLK control driver"
	depends on OF
	help
	  Qualcomm GP CLK control driver

config PWM_GPCLK_DEBUG_FEATURE
	tristate "PWM GPLK Debug info enable"
	depends on OF
	help
	  Qualcomm GP CLK control driver's Debug info enable
```

## drivers/redriver/Kconfig
```kconfig
#
# Combo redriver  devices
#

comment "Combo driver configs"

config COMBO_REDRIVER
	bool "ptn38003 support"
	depends on I2C
	default n
	help
	  If you say yes here you will get support for
	  the CCIC attached device status change notification.

config COMBO_REDRIVER_PTN36502
	bool "ptn36503 support"
	depends on I2C
	default n
	help
	  If you say yes here you will get support for
	  the CCIC attached device status change notification.

config COMBO_REDRIVER_PTN36502_WITHOUT_AUX
	bool "ptn36503 without aux support"
	depends on I2C
	default n
	help
	  If you say yes here you will get support for
	  the CCIC attached device status change notification.
```

## drivers/regulator/s2dos05/Kconfig
```kconfig
if REGULATOR

config REGULATOR_S2DOS05
	tristate "Samsung S2DOS05 regulator"
	depends on I2C
	help
	 This driver controls a Samsung S2DOS05 regulator
	 via I2C bus.
endif
```

## drivers/regulator/s2mpb03/Kconfig
```kconfig
if REGULATOR

config REGULATOR_S2MPB03
	tristate "Samsung S2MPB03 regulator"
	depends on I2C
	help
	 This driver controls a Samsung S2MPB03 regulator
	 via I2C bus.
endif
```
