## drivers/platform/sprd/Kconfig
```kconfig
#
# SPREADTRUM Platform Specific Drivers
#
menu "Spreadtrum Platform Specific Drivers"

menu "Spreadtrum Adie Type"
config ADIE_SC2713
	bool "Spredtrum A-die SC2713 Chip Support"
        default n
	help
	  Say Y here to support for Spreadtrum a-die sc2713 chip.

config ADIE_SC2713S
	bool "Spredtrum A-die SC2713S Chip Support"
        default n
	help
	  Say Y here to support for Spreadtrum a-die sc2713s chip.

config ADIE_SC2711
	bool "Spredtrum A-die SC2711 Chip Support"
        default n
	help
	  Say Y here to support for Spreadtrum a-die sc2711 chip.

config ADIE_SC2723
	bool "Spredtrum A-die SC2723 Chip Support"
        default n
	help
	  Say Y here to support for Spreadtrum a-die sc2723 chip.

config ADIE_SC2723S
	bool "Spredtrum A-die SC2723S Chip Support"
        default n
	help
	  Say Y here to support for Spreadtrum a-die sc2723S chip.
endmenu

config BUS_MONITOR_DEBUG
    bool "Spreadtrum BM Support"
	default y
	help
	  Say Y here to support debug busmonitor

config DJTAG
    bool "Spreadtrum DJTAG Support"
	default y
	help
	  Say Y here to support djtag

config BUS_MONITOR_PERF
    bool "Spreadtrum NEW BM Support"
	default y
	help
	  Say Y here to support sprd busmonitor, only for perf.

config SC_FPGA
	bool "Spreadtrum FPGA support"
	default n
	help
	  This is used for FPGA verification

config SCX35L64BIT_FPGA
	bool "Spreadtrum FPGA platform"
	depends on ARCH_SCX35L64
	select  SC_FPGA
	default n
	help
	  SCX35L64BIT_FPGA fpga platform

config SC_VIBRATOR
        bool "vibrator for SC serials"
        select ANDROID_TIMED_OUTPUT
        default n

config SPRD_VIBRATOR_2723
        bool "vibrator for sprd_vibrator_2723"
        select ANDROID_TIMED_OUTPUT
        default n

config SC_VIBRATOR_GPIO
        bool "vibrator for SC serials by gpio"
        default n
	depends on SC_VIBRATOR

config SC_VIBRATOR_POWER
        bool "vibrator for SC serials by power"
        default n
	depends on SC_VIBRATOR

config SPRD_ION_MM_SIZE
        int "size for ion"
        range 1 64
        default 1
	depends on ION

config SPRD_ION_OVERLAY_SIZE
        int "size for ion overlay"
        range 1 64
        default 1
	depends on ION

config SPRD_VIBRATOR_2723
        bool "vibrator for sprd_vibrator_2723"
        select ANDROID_TIMED_OUTPUT
        default n

config SPRD_VIBRATOR_2731
        bool "vibrator for sprd_vibrator_2731"
        select ANDROID_TIMED_OUTPUT
        default n

config EIRQ_NUM
        int "number for external irq region desc request"
        range 0 1024
	default 0

config PIN_POWER_DOMAIN_SWITCH
        bool "pin power domain switch for 28nm chip"
		default n

comment "SC8830 ADIE type"

config SC_INTERNAL_ADI
	bool "spreadtrum sc internal adi"
	default y
	depends on ARCH_SCX35

config SC_INTERNAL_ADC
	bool "spreadtrum sc internal adc"
	default y
	depends on ARCH_SCX35

config SC_INTERNAL_WATCHDOG
	bool "spreadtrum sc internal watchdog"
	default y
	depends on ARCH_SCX35

config FIX_V7TAGRAM_BUG
        bool "fix arm-v7 scu tag ram bug"
        default n
	depends on ARCH_SCX35
	depends on SMP

config DDR_VALIDITY_TEST
	bool "test ddr validity before go into ddr"
	default n

config SPRD_CPU_DYNAMIC_HOTPLUG
	bool "cpu dynamic hotplug with DVFS"
	default n
	depends on HOTPLUG_CPU
	depends on ARCH_SCX35

config SPRD_MEM_POOL
	default y
	bool "Using a memory pool to alloc 8k to 64k"
	depends on !COMPACTION
	help
	  This option enables memmory pool for allocating 8k to 64k.

config SPRD_DCDC_DEBUG
	tristate "Enable dcdc debug module"
	default n
	help
	  This option select dcdc debug module.

config SPRD_AVS_DEBUG
	tristate "Enable avs debug module"
	default n
	help
	  This option select avs debug module.

config SPRD_AUX_DEBUG
       tristate "Enable aux debug moduel"
       default n
       help
         This option select aux debug module.

config SPRD_SIMCTRL
	bool "Enable simctrl module"
	default n
	help
	  This option select simctrl module.
config SPRD_MODEM_TD
	bool "SPRD TD modem"
	default n
	help
	  This option select modem type.

config MODEM_W_MEMCUT
	bool "SPRD w modem memory cut"
	default n
	help
	  This option select for w modem memory cut.

config SIPC_TD
	bool "SIPC instance of TD modem"
	select SIPC
	default n

config SIPC_WCDMA
	bool "SIPC instance of WCDMA modem"
	select SIPC
	default n

config SIPC_WCN
	bool "SIPC instance of Wireless Connection"
	select SIPC
	default n

config SIPC_PMIC
	bool "SIPC instance of PMIC arm7 modem"
	select SIPC
	default n


config SIPC_GGE
	bool "SIPC instance of GGE modem"
	select SIPC
	default n

config SIPC_LTE
	bool "SIPC instance of LTE modem"
	select SIPC
	default n

config VOIP_CPT
	bool "VOIP process in modem T,it is processed in modem W by default"
	default n
	depends on SIPC_TD

config VOIP_LTE
	bool "VOIP process in modem LTE,it is processed in modem W by default"
	default n
	depends on SIPC_LTE

config CP_SWITCH
	bool "cp switch"
	default n
	help
	  This option select cp switch

config EAR_LOW_LEVEL_DETECT
        bool "ear detecting trigger is low level"
        default n
config SS_FUNCTION
        bool "only for samsung function"
        default n
config TSP_0_1_A
        bool "For corsica_ve 3131 0.1A board"
        default n

config SPRD_MAILBOX
	bool "Spreadtrum Mailbox IPI Arch"
	default n

config SPRD_MAILBOX_FIFO
	bool "Spreadtrum Mailbox Use FIFO"
	default n

config MUIC_CABLE_DETECT
	bool "usb, jig-box and so on cables are detected by external MUIC chip"
	default n
	depends on MFD_SM5504 || MFD_RT8973

config SPRD_SYSDUMP
        bool "Enable SPRD sysdump handler"
        help
          This option enables Spreadtrum sysdump which prepare debug info
	  for u-boot to write into mmc storage after kernel panics.
config SPRD_POWEROFF
        bool "Enable SPRD Adie power-off and reset Operation"
	default y
	depends on ARCH_WHALE || ADIE_SC2731
        help
          This option enables Spreadtrum power-off and reset pmic opertaion.

config SPRD_DEBUG
	bool "Enable SPRD DEBUG"

config SPRD_DEBUG_SCHED_LOG
	bool "SPRD Scheduler Logging Feature"
	depends on SPRD_DEBUG
	default n
	help
	  SPRD Scheduler Logging Feature for Debug use.

config SPRD_DEBUG_DMALOG
	bool "SPRD dma Logging Feature"
	depends on SPRD_DEBUG
	default y
	help
	  SPRD DMA Logging Feature for Debug use.

config SEC_DEBUG64
	bool "enable SEC_DEBUG"
	depends on ARM64

config SEC_LOG64
	bool "enable SEC_LOG"
	depends on ARM64


comment "BSP Feature"
menuconfig SEC_BSP
	bool "Samsung TN BSP Feature"
	default n
	help
	  Samsung TN BSP Feature.

config SEC_DEBUG
	bool "Enable SEC DEBUG"
	default n

if SEC_DEBUG
config SEC_DEBUG_SCHED_LOG
	bool "Samsung Scheduler Logging Feature"
	default n
	help
	 Samsung Scheduler Logging Feature for Debug use.

config SEC_DEBUG_SCHED_LOG_NONCACHED
    bool "Samsung Scheduler log for non cache"
	default n
	depends on SEC_DEBUG_SCHED_LOG

config SEC_DEBUG_SOFTIRQ_LOG
	bool "Samsung Softirq Logging Feature"
	default n
	depends on SEC_DEBUG_SCHED_LOG
	help
	 Samsung Softirq Logging Feature for Debug use.
         This option enables us to log softirq enter/exit.
         It is not only hard-irq which results in scheduler lockup,
         To be more clear we need to see also softirq logs.

config SEC_DEBUG_TIMER_LOG
        bool "Samsung Timer Logging Feature"
        default n
        help
          Samsung Timer Logging Feature for Debug use.

config SEC_LOG
        bool "Samsung log buffer"
        default n

config SEC_LOG_BUF_NOCACHE
	bool "samsung log buf for cache type"
	depends on SEC_LOG
	default n
	
config SEC_LOG_LAST_KMSG
        bool "Samsung Use Sec Log Last Kmsg"
        depends on SEC_LOG
        default n
        help
           This feature creats a node to read contents of sec_log_buf
           area just before booting into kernel from bootloader.
           This is very helpful to read sec_log_buf area without reset
           or entering upload mode.

config SEC_DEBUG_USER
        bool "Enable user options"
        default n

config SEC_DEBUG_REG_ACCESS
        bool "Samsung reg access debugging"
        default n
endif

config GPS_LSI_S5N6420
bool "LSI_GPS_CHIPSET_HARRIER"
default n

config SPRD_EIRQSOFF_DEBUG
	bool "spreadtrum IRQ disable time debug"
	depends on IRQSOFF_TRACER && SPRD_DEBUG
	default y
config SEC_THERMISTOR
		bool "Sec thermister for SIOP implementation"
		default y

comment "use for Factory mode"
config SEC_FACTORY
	bool "when it comes to sec factory mode"
	default n
	help
	  It will support a sec factory mode

endmenu
```

## drivers/pogo/Kconfig
```kconfig
config MUIC_SM5504_POGO
	tristate "Using SM5504 MUIC for pogo"
	depends on USE_MUIC
	default n
	help
	  If you say yes here you will get support for sm5504 muic pogo.
```

## drivers/power/Kconfig
```kconfig
source "drivers/power/avs/Kconfig"
source "drivers/power/reset/Kconfig"
source "drivers/power/supply/Kconfig"
#bug541231,zhaobeilong@wt,20200323,add booster chip tps61280 driver
source "drivers/power/tps61280a-power/Kconfig"
```

## drivers/power/marvell/power_domain/Kconfig
```kconfig
menuconfig MMP_PM_DOMAIN
	bool "power domain support for mmp"
	depends on PM_GENERIC_DOMAINS
	help
	  Say Y to enable support for the power domain managment for
	  Marvell mmp SOCes.
	  It will includes the APIs and help functions for specific
	  power domains. The power domain will provide power for
	  VPU/GC/ISP and etc.

if MMP_PM_DOMAIN

config MMP_PM_DOMAIN_COMMON
        bool "power domain for vpu/gc/isp"
        help
          Say Y here to enable related power domain for pxa1088/pxa1L88

config MMP_PM_DOMAIN_ISP_V3
	   bool "power domain for b52isp V3"
	   help
          Say Y here to enable related power domain for pxa1908

config MMP_PM_DOMAIN_SC2_ISP
	   bool "power domain for b52isp"
	   help
          Say Y here to enable related power domain for pxa1928

config MMP_PM_DOMAIN_DISPLAY
        bool "power domain for display"
        help
          Say Y here to enable related power domain for pxa1088/pxa1L88/pxa1920

config MMP_PM_DOMAIN_HANTRO
        bool "power domain for hantro"
        help
          Say Y here to enable related power domain for pxa1928
config MMP_PM_DOMAIN_GC2D
        bool "power domain for gc2d"
        help
          Say Y here to enable related power domain for pxa1928
config MMP_PM_DOMAIN_GC3D
        bool "power domain for gc3d"
        help
          Say Y here to enable related power domain for pxa1928
config MMP_PM_DOMAIN_SMMU
        bool "power domain for smmu"
        help
          Say Y here to enable smmu related power domain for pxa1U88/pxa1928.
	  As now smmu at the same power domain of vpu, we need to set vpu as
	  its parent power domain.
endif
```

## drivers/power/reset/exynos/Kconfig
```kconfig
# SPDX-License-Identifier: GPL-2.0-only

config POWER_RESET_EXYNOS
	tristate "Samsung Exynos power-off driver"
	depends on ARCH_EXYNOS
	help
	  Reboot support for Samsung Exynos boards.
```

## drivers/power/supply/afc/Kconfig
```kconfig
#
#AFC devices
#

comment "AFC configs Test"

config AFC
	bool "Using AFC device driver"
	default n
	help
	  If you say yes here you will get support for
	  the AFC device driver.
```
