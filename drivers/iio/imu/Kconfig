## drivers/iio/light/Kconfig
```kconfig
#
# Light sensors
#
menu "Light sensors"

config ADJD_S311
	tristate "ADJD-S311-CR999 digital color sensor"
	select IIO_BUFFER
	select IIO_TRIGGERED_BUFFER
	depends on I2C
	help
	 If you say yes here you get support for the Avago ADJD-S311-CR999
	 digital color light sensor.

	 This driver can also be built as a module.  If so, the module
	 will be called adjd_s311.

config SENSORS_LM3533
	tristate "LM3533 ambient light sensor"
	depends on MFD_LM3533
	help
	  If you say yes here you get support for the ambient light sensor
	  interface on National Semiconductor / TI LM3533 Lighting Power
	  chips.

	  The sensor interface can be used to control the LEDs and backlights
	  of the chip through defining five light zones and three sets of
	  corresponding output-current values.

	  The driver provides raw and mean adc readings along with the current
	  light zone through sysfs. A threshold event can be generated on zone
	  changes. The ALS-control output values can be set per zone for the
	  three current output channels.

config SENSORS_TSL2563
	tristate "TAOS TSL2560, TSL2561, TSL2562 and TSL2563 ambient light sensors"
	depends on I2C
	help
	 If you say yes here you get support for the Taos TSL2560,
	 TSL2561, TSL2562 and TSL2563 ambient light sensors.

	 This driver can also be built as a module.  If so, the module
	 will be called tsl2563.

config VCNL4000
	tristate "VCNL4000 combined ALS and proximity sensor"
	depends on I2C
	help
	 Say Y here if you want to build a driver for the Vishay VCNL4000
	 combined ambient light and proximity sensor.

	 To compile this driver as a module, choose M here: the
	 module will be called vcnl4000.

config HID_SENSOR_ALS
	depends on HID_SENSOR_HUB
	select IIO_BUFFER
	select IIO_TRIGGERED_BUFFER
	select HID_SENSOR_IIO_COMMON
	select HID_SENSOR_IIO_TRIGGER
	tristate "HID ALS"
	help
	  Say yes here to build support for the HID SENSOR
	  Ambient light sensor.

config SENSORS_CM36652_IIO
	depends on IIO
	tristate "CM366852 driver"
	default n
	help
	  This option enables proximity & light sensors using CM36652 driver.

config SENSORS_CM36652_DEFENCE_CODE_FOR_NOISE
	depends on SENSORS_CM36652_IIO
	tristate "CM366852 defence code"
	default n
	help
	  This option enables CM36652 defence code for noise.

config SENSORS_CM3323_IIO
	depends on IIO
	tristate "CM3323 driver"
	default n
	help
	  Say Y here if you use cm3323.
	  This option enables RGB sensors using
	  Capella cm3323 device driver.

	  Say N here if you do not use cm3323.

config SENSORS_CS5032_IIO
	depends on IIO
	tristate "CS5032 driver"
	default n
	help
	  This option enables proximity & light sensors using CS5032 driver.

endmenu
```

## drivers/iio/magnetometer/yas539/Kconfig
```kconfig
#
# Magnetometer sensors
#

config SENSORS_YAS_IIO_MAGNETOMETER
	tristate "Yamaha 3-Axis Magnetometer"
	depends on IIO
	help
	  Say Y here to add support for the Yamaha 3-Axis Magnetometer.
```

## drivers/iio/proximity/Kconfig
```kconfig
#
# Proximity sensors
#

menu "Lightning sensors"

config AS3935
	tristate "AS3935 Franklin lightning sensor"
	select IIO_BUFFER
	select IIO_TRIGGERED_BUFFER
	depends on SPI
	help
	  Say Y here to build SPI interface support for the Austrian
	  Microsystems AS3935 lightning detection sensor.

	  To compile this driver as a module, choose M here: the
	  module will be called as3935

config SENSORS_STK3013_IIO
	depends on I2C
	tristate "STK3013 driver"
	default n
	help
	   This option enables proximity sensors using STK3013 driver.

config SENSORS_CM36672P_IIO
	depends on I2C
	tristate "CM36672P driver"
	default n
	help
	  This option enables proximity sensor using CM36672P driver.

endmenu
```

## drivers/input/fingerprint/Kconfig
```kconfig
#
# Fingerprint driver configuration
#
menuconfig INPUT_FINGERPRINT
	bool "Fingerprint"
	help
	  Say Y here, and a list of supported fingerprint(s) will be displayed.
	  This option doesn't affect the kernel.

	  If unsure, say Y.

if INPUT_FINGERPRINT
config FINGERPRINT_FPC1020
	tristate "FPC1020 fingerprint driver"
	depends on SPI_MASTER
	help
	Say Y here if you want to support FPC1020 fingerprint device

	  If unsure, say N.

	  To compile this driver as a module, choose M here: the
	  module will be called fpc1020.

config FINGERPRINT_ET300
	tristate "ET300 fingerprint driver"
	depends on SPI_MASTER
	help
	  This option enables support for the fingerprint device via SPI.

	  If unsure, say N.

endif
```

## drivers/input/fingerprint/cdfinger/Kconfig
```kconfig
#
# cdfinger fingerprint driver configuration
#

config CDFINGER_FP
	tristate "cdfinger fingerprint driver support"
	select cdfinger_fp
	help
	  This supports Silead platform Fingerprint drivers.
```

## drivers/input/fingerprint/egis/Kconfig
```kconfig
#
# egis fingerprint driver configuration
#
	  
config EGIS_FINGERPRINT
	tristate "egis fingerprint driver support"
	select egis_fp
	help
	  This support egis fingerprint drivers.
```

## drivers/input/fingerprint/focaltech/Kconfig
```kconfig
#
# cdfinger fingerprint driver configuration
#
	  
config FOCALTECH_FINGERPRINT
	tristate "focaltech fingerprint driver support"
	select focaltech_fp
	help
	  This support focaltech fingerprint drivers.
```

## drivers/input/fingerprint/fpc/Kconfig
```kconfig
config FINGERPRINT_FPC
	default n
       tristate "FPC_BTP fingerprint sensor support"
```

## drivers/input/fingerprint/silead/Kconfig
```kconfig
#
# Silead Fingerprint driver configuration
#

config SILEAD_FP_PLATFORM
	tristate "Silead platformm Fingerprint driver support"
	select silead_fp
	help
	  This supports Silead platform Fingerprint drivers.
```

## drivers/input/fingerprint/sunwave_n6/Kconfig
```kconfig
config SUNWAVE_FINGERPRINT_N6
       tristate "Sunwave Fingerprint"
       default n
       help
          SUNWAVECORP Fingerprint
```

## drivers/input/fingerprint_O22/Kconfig
```kconfig
menu "O22 Fingerprint support"
    depends on INPUT

# hs14 code for SR-AL6528A-01-282|SR-AL6528A-01-292 by xiongxiaoliang at 2022/10/10 start
config MTK_FINGERPRINT_SUPPORT
    bool "O22 Fingerprint support"
    default n
    help
        Fingerprint mtk driver enable/disable
        in the kernel.Say Y here if you want to
        use mediatek fingerprint driver,fingerprint
        driver will support fingerprint function

config MTK_FINGERPRINT_SELECT
    string "sensor type"
    default "GF318M"

source "drivers/input/fingerprint_O22/silead/Kconfig"
# hs14 code added for SR-AL6528A-01-272 by Wentao at 2022/10/09 start
source "drivers/input/fingerprint_O22/focaltech/Kconfig"
# hs14 code added for SR-AL6528A-01-272 by Wentao at 2022/10/09 end
source "drivers/input/fingerprint_O22/cdfinger/Kconfig"
# hs14 code for SR-AL6528A-01-282|SR-AL6528A-01-292 by xiongxiaoliang at 2022/10/10 end

endmenu
```

## drivers/input/fingerprint_O22/cdfinger/Kconfig
```kconfig
#
# fp_sensor driver configuration
#
config CDFINGER_FP
    tristate "cdfinger fingerPrint sensor"
    default n
    help
        add for support cdfinger FP Sensor.
```

## drivers/input/fingerprint_O22/focaltech/Kconfig
```kconfig
#
# Focaltech Fingerprint driver configuration
#

config FINGERPRINT_FOCALTECH
    tristate "FocalTech Fingerprint"
    default n
    help
      If you say Y to this option, support will be included for
      the FocalTech's capacitive or optical fingerprint sensor.
      This driver supports almost all the TEE solutions just like
      QSEE, Trustonic, TrustKernel, Beanpod.., also including
      REE emulation.

      This driver can also be built as a module. If so, the module
      will be called 'focaltech_fp'.


config FINGERPRINT_FOCALTECH_SPI_SUPPORT
    bool "FocalTech Fingerprint SPI Support"
    default n
    depends on FINGERPRINT_FOCALTECH
    help
        Set Y here if supports SPI communication
        in kernel.
        If unsure, say N.
```

## drivers/input/fingerprint_O8/Kconfig
```kconfig
menu "O8 Fingerprint support"
    depends on INPUT

config FINGER_O8
	tristate "Export input device finger"
	default n

# a06 code for SR-AL7160A-01-39 by wenghailong at 20240326 start
config MTK_FINGERPRINT_SUPPORT
    bool "O8 Fingerprint support"
    default n
    help
        Fingerprint mtk driver enable/disable
        in the kernel.Say Y here if you want to
        use mediatek fingerprint driver,fingerprint
        driver will support fingerprint function

config MTK_FINGERPRINT_SELECT
    string "sensor type"
    default "GF318M"

source "drivers/input/fingerprint_O8/silead/Kconfig"
# a06 code for SR-AL7160A-01-39 by wenghailong at 20240326 end
# A06 code for SR-AL7160A-01-54 by hehaoran at 20240407 start
source "drivers/input/fingerprint_O8/jiiov/Kconfig"
source "drivers/input/fingerprint_O8/focaltech/Kconfig"
# A06 code for SR-AL7160A-01-54 by hehaoran at 20240407 end

endmenu
```

## drivers/input/fingerprint_O8/jiiov/Kconfig
```kconfig
config JIIOV_FP
    tristate "JIIOV Fingerprint"
    default y
    help
      If you say Y to this option, support will be included for
      the JIIOV's fingerprint sensor. This driver supports
      both REE and TEE. If in REE, CONFIG_SPI_SPIDEV must be set
      to use the standard 'spidev' driver.
```

## drivers/input/grip/Kconfig
```kconfig
#
# Input core configuration
#
menuconfig INPUT_GRIP
	bool "Grip"
	default y
	help
	  Say Y here, and a list of supported keyboards will be displayed.
	  This option doesn't affect the kernel.

	  If unsure, say Y.

if INPUT_GRIP

config GRIP_TC305K
	tristate "Coreriver TC300K grip"
	depends on I2C
	help
	 Say Y if you want use Coreriver TC305K chip as grip.

	 To compile this driver as a module, choose M here: the
	  module will be called tc305k.

endif
```

## drivers/input/hx9031_sar/Kconfig
```kconfig
#
# SPRD HX9031 Driver
#

config HX9031_SAR
	tristate "TianYiHeXin HX9031_Sar driver"
	depends on I2C
	help
	  Say Y here if you have TianYiHeXin HX9031_Sar controller
	  chip in your system.
	  If unsure, say N.
	  To compile this driver as a module, choose M here: the
	  module will be called HX9031_Sar key.

config SENSORS
	bool "Sensors Class Support"
	help
	  This option enables the sensor sysfs class in /sys/class/sensors.
	  You'll need this to do anything useful with sensorss. If unsure, say N.
```

## drivers/input/hx9031a_sar/Kconfig
```kconfig
#
# Mediatek AW9610X Driver
#

config HX9031A_SAR
	tristate "TianYiHeXin HX9031A_Sar driver"
	depends on I2C
	help
	  Say Y here if you have TianYiHeXin HX9031A_Sar controller
	  chip in your system.
	  If unsure, say N.
	  To compile this driver as a module, choose M here: the
	  module will be called HX9031A_Sar key.
```

## drivers/input/input_boost/Kconfig
```kconfig
config SEC_INPUT_BOOSTER
	tristate "SEC INPUT BOOSTER"
	depends on INPUT_EVDEV
	default n
	help
	  Say Y here if you enable input boosting for various input device
	  such as touch.

	  Say N here if you disable input boosting.

	  If unsure, say Y.

config SEC_INPUT_BOOSTER_QC
	bool "SEC INPUT BOOSTER QC"
	depends on SEC_INPUT_BOOSTER
	default n
	help
	  Say Y here if you enable input boosting of QC under QC chipset

	  Say N here if you disable input boosting of QC

	  If unsure, say N.

config SEC_INPUT_BOOSTER_SLSI
	bool "SEC INPUT BOOSTER SLSI"
	depends on SEC_INPUT_BOOSTER
	default n
	help
	  Say Y here if you enable input boosting of SLSI under SLSI chipset
	  such as touch.

	  Say N here if you disable input boosting of SLSI

	  If unsure, say N.

config SEC_INPUT_BOOSTER_MTK
	bool "SEC INPUT BOOSTER MTK"
	depends on SEC_INPUT_BOOSTER
	default n
	help
	  Say Y here if you enable input boosting of MTK under MTK chipset
	  such as touch.

	  Say N here if you disable input boosting of MTK

	  If unsure, say N.
```

## drivers/input/keyboard/abov/Kconfig
```kconfig
#
# grip sensors configuration
#
config KEYBOARD_A96T396
	depends on I2C
	tristate "A96T396 driver for grip"
	help
	  If you say yes here if you use A96T396 for grip.
	  This option enables grip sensors using
	  Above A96T396 device driver for grip.
```

## drivers/input/keyboard/samsung/pmic/Kconfig
```kconfig
# SPDX-License-Identifier: GPL-2.0-only
#
# Input core configuration
#

config KEYBOARD_SAMSUNG_PMIC
	depends on I2C
	tristate "Samsung Electronics PMIC Powerkey/Vol-down Controller"

config KEYBOARD_S2MPS25
	tristate "Samsung Electronics S2MPS25 Powerkey/Vol-down Controller"
	depends on I2C
	depends on MFD_S2MPS25

config KEYBOARD_S2MPS25_9935
	tristate "Samsung Electronics S2MPS25 Powerkey/Vol-down Controller for s5e9935"
	depends on I2C
	depends on MFD_S2MPS25_9935

config KEYBOARD_S2MPU15_8535
	tristate "Samsung Electronics S2MPU15 Powerkey/Vol-down Controller for s5e8535"
	depends on I2C
	depends on MFD_S2MPU15_8535
	select SEC_PMIC_PWRKEY

config KEYBOARD_S2MPU15_8835
	tristate "Samsung Electronics S2MPU15 Powerkey/Vol-down Controller for s5e8835"
	depends on I2C
	depends on MFD_S2MPU15_8835
```

## drivers/input/misc/hall/Kconfig
```kconfig
config INPUT_HALL_IC
	tristate "Enable HALL IC"
	default n
	help
	  Enable Hall IC Feature
```

## drivers/input/misc/mpu6500/Kconfig
```kconfig
config INPUT_MPU6500
	bool "Invensense MPU-6500 sensor"
	default n
	help
	  Say Y here if you want support for the MPU-6500 sensor
	  device.
	  To compile this driver as a module, choose M here: the
	  module will be called MPU6500.

config INPUT_MPU6500_SELFTEST
	bool "Self-test of Invensense MPU-6500 sensor"
	default n
	help
	  Say Y here if you want support for self-test of the MPU-6500 sensor
	  device.
	  To compile this driver as a module, choose M here: the
	  module will be called MPU6500.

config INPUT_MPU6500_LP
	bool "Low power features of Invensense MPU-6500 sensor"
	default n
	help
	  Say Y here if you want support for LP features of the MPU-6500 sensor
	  device.
	  To compile this driver as a module, choose M here: the
	  module will be called MPU6500.

config INPUT_MPU6500_POLLING
	bool "Polling-mode of Invensense MPU-6500 sensor"
	default n
	help
	  Say Y here if you want support for polling-mode of the MPU-6500 sensor
	  device.
	  To compile this driver as a module, choose M here: the
	  module will be called MPU6500.
```
