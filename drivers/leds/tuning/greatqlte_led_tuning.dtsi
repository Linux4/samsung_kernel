/* Copyright (c) 2012, The Linux Foundation. All rights reserved.
 *
 * This program is free software; you can redistribute it and/or modify
 * it under the terms of the GNU General Public License version 2 and
 * only version 2 as published by the Free Software Foundation.
 *
 * This program is distributed in the hope that it will be useful,
 * but WITHOUT ANY WARRANTY; without even the implied warranty of
 * MERCHANTABILITY or FITNESS FOR A PARTICULAR PURPOSE.  See the
 * GNU General Public License for more details.
 */

&soc {
	rgb {
		device_type = "dream2";
		rgb-name = "led_b", "led_r", "led_g", "led_w";

		normal_powermode_current = <10>;
		low_powermode_current = <10>;
		br_ratio_r = <700>;
		br_ratio_g = <50>;
		br_ratio_b = <110>;
		br_ratio_r_low = <90>;
		br_ratio_g_low = <10>;
		br_ratio_b_low = <20>;

		normal_powermode_current_u = <10>;
		low_powermode_current_u = <10>;
		br_ratio_r_u = <700>;
		br_ratio_g_u = <50>;
		br_ratio_b_u = <110>;
		br_ratio_r_low_u = <90>;
		br_ratio_g_low_u = <10>;
		br_ratio_b_low_u = <20>;

		normal_powermode_current_bk = <10>;
		low_powermode_current_bk = <10>;
		br_ratio_r_bk = <700>;
		br_ratio_g_bk = <50>;
		br_ratio_b_bk = <110>;
		br_ratio_r_low_bk = <90>;
		br_ratio_g_low_bk = <10>;
		br_ratio_b_low_bk = <20>;

		normal_powermode_current_gd = <10>;
		low_powermode_current_gd = <10>;
		br_ratio_r_gd = <700>;
		br_ratio_g_gd = <50>;
		br_ratio_b_gd = <110>;
		br_ratio_r_low_gd = <90>;
		br_ratio_g_low_gd = <10>;
		br_ratio_b_low_gd = <20>;

		normal_powermode_current_sv = <10>;
		low_powermode_current_sv = <10>;
		br_ratio_r_sv = <700>;
		br_ratio_g_sv = <50>;
		br_ratio_b_sv = <110>;
		br_ratio_r_low_sv = <90>;
		br_ratio_g_low_sv = <10>;
		br_ratio_b_low_sv = <20>;

		normal_powermode_current_bl = <10>;
		low_powermode_current_bl = <10>;
		br_ratio_r_bl = <700>;
		br_ratio_g_bl = <50>;
		br_ratio_b_bl = <110>;
		br_ratio_r_low_bl = <90>;
		br_ratio_g_low_bl = <10>;
		br_ratio_b_low_bl = <20>;
	};
};

