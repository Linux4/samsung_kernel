/* Copyright (c) 2016, The Linux Foundation. All rights reserved.
 *
 * This program is free software; you can redistribute it and/or modify
 * it under the terms of the GNU General Public License version 2 and
 * only version 2 as published by the Free Software Foundation.
 *
 * This program is distributed in the hope that it will be useful,
 * but WITHOUT ANY WARRANTY; without even the implied warranty of
 * MERCHANTABILITY or FITNESS FOR A PARTICULAR PURPOSE.  See the
 * GNU General Public License for more details.
 */
&soc {
    s2mu004_led {
        status = "okay";
        compatible = "s2mu004_led";
        brightness = <100>;
        lp_brightness = <100>;
        nleds = <3>;
        led_color = "RGB";
        ratio = <18 7 45 0>;
        ratio_low = <2 1 3 0>;
    };
};
