/* Copyright (c) 2016, The Linux Foundation. All rights reserved.                 
 *                                                                                
 * This program is free software; you can redistribute it and/or modify           
 * it under the terms of the GNU General Public License version 2 and             
 * only version 2 as published by the Free Software Foundation.                   
 *                                                                                
 * This program is distributed in the hope that it will be useful,                
 * but WITHOUT ANY WARRANTY; without even the implied warranty of                 
 * MERCHANTABILITY or FITNESS FOR A PARTICULAR PURPOSE.  See the                  
 * GNU General Public License for more details.                                   
 */                    

/*                                                                                
 * As a general rule, only motor tuning property overrides should be placed   
 * inside this file.                                                              
 */

&soc {
	sm5705_rgb {
		/* color-code / normal_cur / low_cur / normal_ratio_r,g,b / low_ratio_r,g,b */
		octa-names = "Black", "White";
		octa-0 = <1 255 255 9 6 18 1 1 2>;
		octa-1 = <1 255 255 9 6 18 1 1 2>;
	};
};
