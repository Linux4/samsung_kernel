## sound/soc/samsung/vts/Kconfig
```kconfig
config SND_SOC_SAMSUNG_MAILBOX
	bool "Samsung MAILBOX"
	select GENERIC_IRQ_CHIP
	help
	  Say Y if you want to use mailbox for voice trigger system.

config SND_SOC_SAMSUNG_VTS
	bool "Samsung VTS"
	depends on SND_SOC_SAMSUNG_MAILBOX
	help
	  Say Y if you want to use voice trigger system.

config SND_SOC_SAMSUNG_VTS_S_LIF
	bool "Samsung VTS Serial LIF"
	depends on SND_SOC_SAMSUNG_VTS
	help
	  Say Y if you want to use Serial LIF.

config SND_SOC_SAMSUNG_VTS_S_LIF_VERSION
	hex "VTS Serial LIF IP version"
	depends on SND_SOC_SAMSUNG_VTS_S_LIF
	default 0x10000 if SOC_EXYNOS9830_EVT0
	default 0x10101 if SOC_EXYNOS9830
	help
	  Version of VTS Serial LIF IP.
	  Value = 0x10000 * major + 0x100 * minor + rev.
	  Ex. 1.00 rev0 => 0x10000, 1.01 rev1 => 0x10101
```

## sound/soc/sprd/Kconfig
```kconfig
menu "SoC Audio for the SPREADTRUM"
config SND_SOC_SPRD
	bool "sprd audio base"

config SND_SOC_SPRD_VBC_R1P0_SPRD_CODEC_V1
	tristate "VBC(R1P0)CODEC(V1)"
	select SND_SOC_SPRD_VBC_R1P0
	select SND_SOC_SPRD_VAUDIO
	select SND_SOC_SPRD_AUDIO_DMA
	select SND_SOC_SPRD_CODEC_V1
	help
	  Say Y if you want to built in to kernel, Say M for ko module.
	  use VBC(R1P0) and  SPRD CODEC(V1) for the audio system.

config SND_SOC_SPRD_VBC_R2P0_SPRD_CODEC_V3
	tristate "VBC(R2P0)CODEC(V3)"
	select SND_SOC_SPRD_VBC_R2P0
	select SND_SOC_SPRD_VAUDIO
	select SND_SOC_SPRD_AUDIO_DMA
	select SND_SOC_SPRD_CODEC_V3
	help
	  Say Y if you want to built in to kernel, Say M for ko module.
	  use VBC(R2P0) and  SPRD CODEC(V3) for the audio system.

config SND_SOC_SPRD_VBC_R2P0_SPRD_CODEC_V4
	tristate "VBC(R2P0)CODEC(V4)"
	select SND_SOC_SPRD_VBC_R2P0
	select SND_SOC_SPRD_VAUDIO
	select SND_SOC_SPRD_AUDIO_DMA
	select SND_SOC_SPRD_CODEC_V4
	help
	  Say Y if you want to built in to kernel, Say M for ko module.
	  use VBC(R2P0) and  SPRD CODEC(V4) for the audio system.

config SND_SOC_SPRD_MACHINE_TI
	tristate "VBC(R3P0)CODEC(TI)"
	select SND_SOC_SPRD_VBC_R3P0
	select SND_SOC_SPRD_AUDIO_DMA
	select SND_SOC_TLV320AIC32X4
	help
	  Say Y if you want to built in to kernel, Say M for ko module.
	  use VBC(R3P0) and  SPRD CODEC(TI) for the audio system.

config SND_SOC_SPRD_MACHINE_4AUDIENCE
	tristate "VBC(R3P0)CODEC(AUDIENCE)"
	select SND_SOC_SPRD_VBC_R3P0
	select SND_SOC_SPRD_AUDIO_DMA
	#select SND_SOC_ES755
	help
	  Say Y if you want to built in to kernel, Say M for ko module.
	  use VBC(R3P0) and  SPRD CODEC(AUDIENCE) for the audio system.

config SND_SOC_SPRD_MACHINE_4REALTEK
	tristate "VBC(R3P0)CODEC(REALTEK)"
	select SND_SOC_SPRD_VBC_R3P0
	select SND_SOC_SPRD_AUDIO_DMA
	select SND_SOC_CODEC_REALTEK
	help
	  Say Y if you want to built in to kernel, Say M for ko module.
	  use VBC(R3P0) and  SPRD CODEC(AUDIENCE) for the audio system.

config SND_SOC_SPRD_I2S_V0_NULL_CODEC
	tristate "I2S(V0)NC"
	select SND_SOC_SPRD_I2S
	select SND_SOC_SPRD_AUDIO_DMA
	select SND_SOC_NULL_CODEC
	help
	  Say Y if you want to built in to kernel, Say M for ko module.
	   this option will build spreadtrum I2S driver for external codec
           or like BT/Digital FM etc.

config SND_SOC_SPRD_AUDIO_DEBUG
	bool "sprd audio debug"
	help
          Say Y if defined this will include more
	    print debug information for detail.
	    Or, maybe could reduce the code size.

config SND_SOC_SPRD_AUDIO_OFFLOAD
	bool "SPRD Offload support"
	depends on MCDT_DRV && SND_COMPRESS_OFFLOAD
	help
	  Say Y if you want to use Offoad when playback, Normally
	   Offload reduce power consumption. But we used MCDT to transfer data,
           so we must depend on MCDT now.
config SND_SOC_SPRD_AUDIO_SIPC
	bool "SPRD audio sipc"
	depends on SIPC
	help
	  Say Y if you want to use audio sipc

config SND_SOC_SPRD_AUDIO_OFFLOAD_2STAGE_DMA
	bool "SPRD Offload 2stage DMA support"
	depends on SND_SOC_SPRD_AUDIO_OFFLOAD
	help
	  Say Y if you want to use Offoad 2stage DMA when playback, Normally
	   it will reduce more power consumption.

source "sound/soc/sprd/dai/Kconfig"
source "sound/soc/sprd/dai/vbc/Kconfig"
source "sound/soc/sprd/dai/vaudio/Kconfig"
source "sound/soc/sprd/dai/i2s/Kconfig"
source "sound/soc/sprd/codec/sprd/Kconfig"
source "sound/soc/sprd/codec/null-codec/Kconfig"

endmenu
```

## sound/soc/sprd/codec/sprd/dp/Kconfig
```kconfig
config SND_SOC_SPRD_DP_CODEC
	tristate "sprd dp codec"
	default n
	help
		Say Y or M here if you want to use dp feature.
```

## sound/soc/sprd/codec/sprd/pdm_r2p0/Kconfig
```kconfig
config SND_SOC_SPRD_PDM_R2P0
	bool "Sprd pdm r2p0"
	default n
	help
	  If using pdm r2p0, set this to Y or M, else N.
```

## sound/soc/sprd/codec/sprd/ump9620/Kconfig
```kconfig
config SND_SOC_SPRD_CODEC_UMP9620
	tristate #"Sprd codec ump9620"
	#depends on PMIC_SC2730
	select POWER_SUPPLY
	help
	  If the codec is the series of UMP9620, set this to Y or M, else N.
```

## sound/soc/sprd/codec/sprd/v3/Kconfig
```kconfig
config SND_SOC_SPRD_CODEC_V3
	tristate # "Sprd-codec-v3"

config SND_SOC_SPRD_AUDIO_USE_INTER_HP_PA
	depends on SND_SOC_SPRD_CODEC_V3
	bool "Use spreadtrum internal HeadPhone PA"
	help
	  Say Y if you want use sprdtrume internal headphone pa

config SND_SOC_SPRD_USE_EAR_JACK_TYPE13
	depends on SND_SOC_SPRD_CODEC_V3
	bool "Use spreadtrum ear jack type 1 or 3"
	help
	  Say Y if you want to use sprdtrume ear jack type 1 or 3
```

## sound/soc/sprd/codec/sprd/v4/Kconfig
```kconfig
config SND_SOC_SPRD_CODEC_V4
	tristate # "Sprd-codec-v4"

config SND_SOC_SPRD_AUDIO_USE_INTER_HP_PA_V4
	depends on SND_SOC_SPRD_CODEC_V4
	bool "Use spreadtrum internal HeadPhone PA(V4)"
	help
	  Say Y if you want use sprdtrume internal headphone pa
```

## sound/soc/sprd/dai/Kconfig
```kconfig
menu "SPRD CPU DAI"

config SND_SOC_SPRD_DAI
	tristate "sprd dai"
	default n
	help
		Say Y or M here if you want to use sprd dai.

endmenu
```

## sound/soc/sprd/dai/vbc/Kconfig
```kconfig
menu "VBC"

source "sound/soc/sprd/dai/vbc/r1p0/Kconfig"
source "sound/soc/sprd/dai/vbc/r2p0/Kconfig"

config SND_SOC_SPRD_VBC_LR_INVERT
	bool "VBC Support L/R invert"
	help
	 say Y then the VBC will support invert the L/R channel.

config SND_SOC_VBC_SUPPORT_DYNAMIC_EQ
	bool "VBC SUPPORT DYNAMIC EQ"
	default n if ARCH_SCX30G
	help
	  say Y if it is r3p0 vbc, N in r2p0 & r1p0 vbc.
	  Now r2p0 and r3p0 use the same vbc driver, so we need
	  to add it to separate them.

endmenu
```

## sound/soc/sprd/dai/vbc/r2p0/Kconfig
```kconfig
config SND_SOC_SPRD_VBC_R2P0
	tristate # "VBC_R2P0"
	help

config SND_SOC_SPRD_VBC_SRC_OPEN
	bool "VBC ADC/ADC23 SRC open"
	depends on SND_SOC_SPRD_VBC_R2P0
	help
	  say Y then the VBC will open adc SRC for FM  function.

config SND_SOC_VBC_SRC_SAMPLE_RATE
	int "VBC SRC Source Rate (32000 or 48000) unit(HZ)"
	range 32000 48000
	default 32000
	depends on SND_SOC_SPRD_VBC_R2P0
	help
	  when capture sample rate is 44100HZ,
	   we cann't set 44100 HZ for CODEC adc sample rate,
	   so need to set CODEC sample to 32000/48000,
	   then open VBC SRC changing to 44100HZ..
```

## techpack/audio/4.0/asoc/codecs/tas256x/Kconfig
```kconfig
menuconfig SND_SOC_TAS256X
	tristate "Texas Instruments TAS256X SmartAmp(R)"
    help
      Enable the support for TAS driver.

      This is the main config under which various
      other configuration can be enabled based on
      the below configurations.

if SND_SOC_TAS256X
config TAS256X_REGMAP
    bool "Use of RegMap API"
    depends on SND_SOC_TAS256X
    help
      Enable support for TAS256X regmap driver.

      This includes i2c i2c driver structure,
      IRQ processing, registers read and write
      by i2c operations.

config TAS256X_CODEC
    bool "Codec Driver support"
    depends on SND_SOC_TAS256X
    help
      Enable support for TAS256X codec driver.

      This includes codec driver interfaces
      and functions and necessary functions for
      Linux Kernel ASOC Interface

config PLATFORM_EXYNOS
    bool "Exynos platform support"
    depends on SND_SOC_TAS256X
    default n
    help
      Enable support for Exynos platform.

      This enables the platform specific interface
      which acts as abstraction layer to the algorithm
      for Exynos platform.

config TAS25XX_ALGO
    bool "TAS256X Calibration Support"
	depends on SND_SOC_TAS256X
    help
      Enable support for TAS25XX Calibration driver.

      This includes TAS256X Calibration driver interfaces
      and functions also interfacing driver to corresponding
      Platform/DSP

config PLATFORM_QCOM
    bool "QCOM platform support"
    depends on TAS25XX_ALGO
    default y
    help
      Enable support for Qcom platform.

      This enables the platform specific interface
      which acts as abstraction layer to the algorithm
      for Exynos platform.

config TAS256X_REGBIN_PARSER
    bool "REG Bin File support"
    depends on SND_SOC_TAS256X
    default y
    help
      Enable support for REG Bin File.

      This enables the parsing of the binary file
      where the register settings can be stored and
      loaded to driver without the code modifications
      to the driver.

config TISA_KBIN_INTF
    bool "Kbin file method support"
    depends on PLATFORM_QCOM
    default n
    help
      Enable support for KBin file method

      This is the algorithm specific configuration
      where the binary file will be opened in the kernel
      using request_firmware API. This interface currently supported
      only on the Qualcomm platform

config CONFIG_TAS25XX_CALIB_VAL_BIG
    bool "For bigdata & calibration support"
    depends on SND_SOC_TAS256X
    default n
    help
      Enable support for bigdata & calibration.

      Enables the support for sysfs entries under
      /sys/class/tas25xx directory
      for calibration, validataion and bigdata

#config TAS2558_CODEC

config TAS256X_MISC
    bool "Misc Driver support"
    help
      Enable misc driver support.

      Enable the misc driver "tas256x" which is
      interface to communicate to device via register
      read and write

endif # SND_SOC_TAS256X
```

## techpack/audio/asoc/codecs/tfa9878/Kconfig
```kconfig
menu "Goodix TFA9878 amplifier configuration"

if SND_SOC_TFA9878
config TFA_STEREO_NODE
        bool "Stereo sysfs node support"
        help
          Enable sysfs nodes for stereo support.
          Enable sysfs nodes for stereo support.
          Enable sysfs nodes for stereo support.
          Enable sysfs nodes for stereo support.

config PLATFORM_QUALCOMM
        bool "Qualcomm platform support"
        default y
        help
          Enable support for Qualcomm platform.
          Enable support for Qualcomm platform.
          Enable support for Qualcomm platform.
          Enable support for Qualcomm platform.

endif # SND_SOC_TFA9878

endmenu
```

## techpack/camera/drivers/Kconfig
```kconfig
config CAMERA_FRAME_CNT_DBG
	tristate "Camera frame cnt for debug"
	default n
	help
	Enables support for debug.

config CAMERA_FRAME_CNT_CHECK
	tristate "Check frame count before stream on/off"
	default n
	help
	Enables support for check frame count before stream on/off

config SAMSUNG_OIS_MCU_STM32
	tristate "External ois MCU STM32 support"
	default n
	help
	Enables support for external ois module.

config SAMSUNG_OIS_Z_AXIS_CAL
	tristate "OIS Z axis calibraion support"
	default n
	help
	Enables support for Z axis calibration.

config CAMERA_SYSFS_V2
	bool "CAMERA SYS"
	help
	Enable support CAMERA SYS.

config SAMSUNG_REAR_QUADRA
	tristate "Rear quadra camera support"
	default n
	help
	Enables support for rear quadra camera.

config SAMSUNG_REAR_TRIPLE
	tristate "Rear triple camera support"
	default y if SAMSUNG_REAR_QUADRA
	default n
	help
	Enables support for rear triple camera.

config SAMSUNG_REAR_DUAL
	tristate "Rear triple camera support"
	default y if SAMSUNG_REAR_TRIPLE || SAMSUNG_REAR_QUADRA
	default n
	help
	Enables support for rear dual camera.

config SAMSUNG_FRONT_EEPROM
	tristate "Front eeprom support"
	default n
	help
	Enables support for front eeprom

config SAMSUNG_SBI
	tristate "SBI support"
	default n
	help
	Enables support for SBI

config CAMERA_ADAPTIVE_MIPI
	tristate "adaptive mipi support"
	default n
	help
	Enables support for adaptive mipi.

config SAMSUNG_ACTUATOR_PREVENT_SHAKING
	tristate "Prevent actuator shaking"
	default n
	help
	Enables support for actuator softlanding

config SAMSUNG_SUPPORT_MULTI_MODULE
	tristate "Multiple module support"
	default n
	help
	Enables support for multiple modules

config USE_CAMERA_HW_BIG_DATA
	bool "CAMERA HW SYS"
	default n
	help
	CAMERA HW SYS

config SENSOR_RETENTION
	tristate "Sensor Retention"
	default n
	help
	Enables support for sensor retention

config SAMSUNG_WACOM_NOTIFIER
	tristate "NOTIFIER"
	default n
	help
	Enables support for camera notifier

config CAMERA_SSM_I2C_ENV
	tristate "SSM GMC feature support"
	default n
	help
	Enables support for SSM I2C test

config FLASH_CURRENT_JAPAN
	tristate "flash current for jpn"
	default n
	help
	Enables support for JPN

config SAMSUNG_FRONT_TOP
	tristate "Front top support"
	default n
	help
	Enables support for front top

config SAMSUNG_FRONT_TOP_EEPROM
	tristate "Front top eeprom support"
	default n
	help
	Enables support for front top eeprom

config SAMSUNG_CAMERA_OTP
	tristate "Sensor OTP support"
	default n
	help
	Enables support for SENSOR OTP
	

config CAMERA_HYPERLAPSE_300X
    tristate "Camera HYPERLAPSE 300x support"
    default n
    help
    Enables support for Camera HYPERLAPSE 300x
	
config CAMERA_CDR_TEST
    tristate "Camera CDR Test support"
    default n
    help
    Enables support for Camera CDR Test
```

## techpack/display/msm/dp/Kconfig
```kconfig
config SEC_DISPLAYPORT
	bool "SEC DISPLAYPORT feature"
	default n
	help
          Samsung specific displayport changes.

config SEC_DISPLAYPORT_BIGDATA
	bool "DISPLAYPORT bigdata"
	depends on !SEC_FACTORY
	default n
	help
          Enable DISPLAYPORT bigdata.

config SEC_DISPLAYPORT_LOGGER
	bool "SEC DISPLAYPORT LOGGER feature"
	depends on SEC_DISPLAYPORT
	help
          Samsung specific displayport log changes.

config SEC_DISPLAYPORT_ENG
	bool "SEC DISPLAYPORT ENG feature"
	depends on SEC_DISPLAYPORT
	help
          Samsung specific eng test code for displayport.
```

## techpack/display/msm/samsung/A23XQ_NT36672C_PM6585JB3/Kconfig
```kconfig
config PANEL_A23XQ_NT36672C_PM6585JB3_FHD
	depends on DISPLAY_SAMSUNG
	bool "NOVATEK NT36672C A23XQ TDDI"
	default n
	---help---
	NOVATEK NT36672C TDDI 1080_2408 A23XQ
```

## techpack/display/msm/samsung/A23XQ_SW89112_TCFJ6606/Kconfig
```kconfig
config PANEL_A23XQ_SW89112_TCFJ6606_FHD
	depends on DISPLAY_SAMSUNG
	bool "LX SEMICON SW89112 A23XQ TDDI"
	default n
	---help---
	LX SEMICON SW89112 TDDI 1080_2408 A23XQ
```

## techpack/display/msm/samsung/A23XQ_TD4375_BS066FBM/Kconfig
```kconfig
config PANEL_A23XQ_TD4375_BS066FBM_FHD
	depends on DISPLAY_SAMSUNG
	bool "Omnivision TD4375 A23XQ TDDI"
	default n
	---help---
	Omnivision TD4375 TDDI 1080_2408 A23XQ
```

## techpack/display/msm/samsung/A23XQ_TD4375_TL066FVMC03/Kconfig
```kconfig
config PANEL_A23XQ_TD4375_TL066FVMC03_FHD
	depends on DISPLAY_SAMSUNG
	bool "Omnivision TD4375 A23XQ TDDI"
	default n
	---help---
	Omnivision TD4375 TDDI 1080_2408 A23XQ
```

## techpack/display/msm/samsung/A23_FT8720_LPS066A767A/Kconfig
```kconfig
config  PANEL_A23_FT8720_LPS066A767A_FHD
	depends on DISPLAY_SAMSUNG
	bool "DTC FT8720 TDDI"
	default n
	---help---
	DTC FT8720 TDDI 1080_2408 A23
```

## techpack/display/msm/samsung/A23_ILI7807S_BS066FBM/Kconfig
```kconfig
config  PANEL_A23_ILI7807S_BS066FBM_FHD
	depends on DISPLAY_SAMSUNG
	bool "BOE ILI7807S TDDI"
	default n
	---help---
	BOE ILI7807S TDDI 1080_2408 A23
```

## techpack/display/msm/samsung/A23_NT36672C_TCFJ6606/Kconfig
```kconfig
config  PANEL_A23_NT36672C_TCFJ6606_FHD
	depends on DISPLAY_SAMSUNG
	bool "NOVATEK NT36672C TDDI"
	default n
	---help---
	NOVATEK NT36672C TDDI 1080_2408 A23
```
